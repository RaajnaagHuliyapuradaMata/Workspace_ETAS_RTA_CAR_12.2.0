AUTOSAR XML (schema 00048)
package /AUTOSAR_Csm/EcucModuleDefs
  module definition Csm [0..1]: category=VENDOR_SPECIFIC_MODULE_DEFINITION, refined-module-def=Csm, variants pre-compile  # Configuration of the Csm (CryptoServiceManager) module.
    container CsmCallbacks [0..1]: multiplicity set at pre-compile  # Container for callback function configurations
      container CsmCallback [0..*]: multiplicity set at pre-compile  # Container for configuration of a callback function
        function name CsmCallbackFunc [0..1]: multiplicity set at pre-compile, set at pre-compile  # Callback function to be called if an asynchronous operation has finished. The corresponding job has to be configured to be processed asynchronously. (If the parameter is left empty and the corresponding job has Rte interfaces enabled, then the callback is handled through an Rte Client Server Port.)
    container CsmGeneral  # Container for common configuration options.
      boolean CsmDevErrorDetect: set at pre-compile, default-value=false  # Switches the development error detection and notification on or off. | * true: detection and notification is enabled. * false: detection and notification is disabled.
      float CsmMainFunctionPeriod [0..1]: 0..INF, multiplicity set at pre-compile, set at pre-compile  # Specifies the period of main function Csm_MainFunction in seconds (applicable only for the default MainFunction instance).
      boolean CsmRbAutoFillConfig: origin=RB:1.0.0:2021-06-01, set at pre-compile, default-value=false  # If this parameter is set to True, then Csm generator try to automatically fill missing configuration parameters and connection in Csm, CryIf and Crypto components.
      boolean CsmVersionInfoApi: set at pre-compile, default-value=false  # Pre-processor switch to enable and disable availability of the API Csm_GetVersionInfo(). | True: API Csm_GetVersionInfo() is available. False: API Csm_GetVersionInfo() is not available.
    container CsmInOutRedirections [0..1]: multiplicity set at pre-compile  # Configuration for CSM redirection configurations
      container CsmInOutRedirection [1..*]: multiplicity set at pre-compile  # Container for configuration of a CSM redirection. | A redirection let a CSM job use a specific key element as input or/and output.
        integer CsmInputKeyElementId [0..1]: 0..4294967295, multiplicity set at pre-compile, set at pre-compile  # Identifier of the key element used as input
        integer CsmOutputKeyElementId [0..1]: 0..4294967295, multiplicity set at pre-compile, set at pre-compile  # Identifier of the key element used as output.
        integer CsmSecondaryInputKeyElementId [0..1]: 0..4294967295, multiplicity set at pre-compile, set at pre-compile  # Identifier of the key element used as secondary input.
        integer CsmSecondaryOutputKeyElementId [0..1]: 0..4294967295, multiplicity set at pre-compile, set at pre-compile  # Identifier of the key element used as secondary output.
        integer CsmTertiaryInputKeyElementId [0..1]: 0..4294967295, multiplicity set at pre-compile, set at pre-compile  # Identifier of the key element used as tertiary input.
        reference CsmInputKeyRef [0..1]: multiplicity set at pre-compile, set at pre-compile, destination=CsmKey  # This parameter refers to the key used as input.
        reference CsmOutputKeyRef [0..1]: multiplicity set at pre-compile, set at pre-compile, destination=CsmKey  # This parameter refers to the key used as output.
        reference CsmSecondaryInputKeyRef [0..1]: multiplicity set at pre-compile, set at pre-compile, destination=CsmKey  # This parameter refers to the key used as secondary input.
        reference CsmSecondaryOutputKeyRef [0..1]: multiplicity set at pre-compile, set at pre-compile, destination=CsmKey  # This parameter refers to the key used as secondary output.
        reference CsmTertiaryInputKeyRef [0..1]: multiplicity set at pre-compile, set at pre-compile, destination=CsmKey  # This parameter refers to the key used as tertiary input.
    container CsmJobs [0..1]: multiplicity set at pre-compile  # Container for configuration of CSM jobs.
      container CsmJob [1..*]: multiplicity set at pre-compile  # Container for configuration of CSM job. The container name serves as a symbolic name for the identifier of a job configuration.
        integer CsmJobId [0..1]: 0..4294967295, multiplicity set at pre-compile, set at pre-compile, symbolic-name-value=true  # Identifier of the CSM job. The set of actually configured identifiers shall be consecutive and gapless.
        enumeration CsmJobInterfaceUsePort: {CRYPTO_USE_FNC, CRYPTO_USE_PORT, CRYPTO_USE_PORT_OPTIMIZED}, set at pre-compile  # Does the job need RTE interfaces?
        integer CsmJobPriority: 0..4294967295, set at pre-compile  # Priority of the job. | The higher the value, the higher the job's priority.
        enumeration CsmProcessingMode: {CRYPTO_PROCESSING_ASYNC, CRYPTO_PROCESSING_SYNC}, set at pre-compile  # Determines how the interface shall be used for that job. Synchronous processing returns with the result while asynchronous processing returns without processing the job. The caller will be notified by the corresponding callback.
        integer CsmRbJobRteQLength [0..1]: 0..4294967295, multiplicity set at pre-compile, origin=RB:1.0.0:2021-06-01, set at pre-compile, default-value=1  # This parameter is the depth of the q-length, the history buffer, provided by the Rte. Usage might be needed if: Rte is used (AND) CsmJobUsePort == TRUE (AND) CsmJobPrimitiveRef is referencing an operation of a Client-Server-Interface e.g. MacGenerate (AND) Port provision and request are asynchron and running on different OsApplications e.g. 1ms 10ms (AND) a history of all values is needed on the requesting side.
        reference CsmInOutRedirectionRef [0..1]: multiplicity set at pre-compile, set at pre-compile, destination=CsmInOutRedirection  # This parameter refers to the used redirection.
        reference CsmJobKeyRef [0..1]: multiplicity set at pre-compile, set at pre-compile, destination=CsmKey  # This parameter refers to the key which shall be used for the CsmPrimitive. It's possible to use a CsmKey for different jobs
        reference CsmJobPrimitiveCallbackRef [0..1]: multiplicity set at pre-compile, set at pre-compile, destination=CsmCallback  # This parameter refers to the used CsmCallback. | The referred CsmCallback is called when the crypto job has been finished.
        reference CsmJobPrimitiveRef: set at pre-compile, destination=CsmPrimitives  # This parameter refers to the used CsmPrimitive. | Different jobs may refer to one CsmPrimitive. The referred CsmPrimitive provides detailed information on the actual cryptographic routine.
        reference CsmJobQueueRef [0..1]: multiplicity set at pre-compile, set at pre-compile, destination=CsmQueue  # This parameter refers to the queue. | The queue is used if the underlying crypto driver object is busy. The queue refers also to the channel which is used.
    container CsmKeys [0..1]: multiplicity set at pre-compile  # Container for CSM key configurations.
      container CsmKey [0..*]: multiplicity set at pre-compile  # Container for configuration of a CSM key. The container name serves as a symbolic name for the identifier of a key configuration.
        integer CsmKeyId [0..1]: 0..4294967295, multiplicity set at pre-compile, set at pre-compile, symbolic-name-value=true  # Identifier of the CsmKey. The set of actually configured identifiers shall be consecutive and gapless.
        boolean CsmKeyUsePort: set at pre-compile  # Does the key need RTE interfaces? | True: RTE interfaces used for this key False: No RTE interfaces used for this key
        enumeration CsmRbAutoConfigCryptoSelect [0..1]: {rba_CryptoCCL, rba_CryptoHSM}, multiplicity set at pre-compile, origin=RB:1.0.0:2021-06-01, set at pre-compile  # When automatic configuration completion used for the key, then this parameter needs to be filled out to select the crypto target for the key.
        string CsmRbAutoConfigHsmKeySlotId [0..1]: multiplicity set at pre-compile, origin=RB:1.0.0:2021-06-01, set at pre-compile  # This parameter explicitly maps the secure cryptokey element into a specified key slot inside the HSM secure flash. If left empty, then an available key slot automatically assigned to it. The name (e.g. DYNAMIC_CFG_CRYPTO_AES_KEY_BASE_0) of the key slot must be provided. This autoconfiguration parameter will only apply to key element which are stored in HSM.
        string CsmRbAutoConfigKeyElement [0..*]: multiplicity set at pre-compile, origin=RB:1.0.0:2021-06-01, set at pre-compile  # When automatic configuration completion is used for the key, then this parameter needs to be filled out to define keyElements. The configuration needs to be defined in the following format: [elementId]_[P/p(Persistent/Volatile)][(R|E|C)/(r|e|c)((Read allowed | Encrypted | Internal copy) / Read denied)][(W|E|C)/(w|e|c)((Write allowed | Encrypted | Internal copy) / Write denied)][P/p(Partial access allowed / Partial access denied)]_[Size in bytes]_(optional)[Initvalue as hex string ] Example: 1_PRWp_16_0011 or 1_PRWp_16 ( KeyElementId=1, persistent stored with read/write access, partial access denied, Length=16bytes, (optional) Init Value 0x00, 0x11 )
        reference CsmKeyRef [0..1]: multiplicity set at pre-compile, set at pre-compile, requires-symbolic-name-value=true, destination=CryIfKey  # This parameter refers to the used CryIfKey. The underlying CryIfKey refers to a specific CryptoKey in the Crypto Driver.
        reference CsmRbAutoConfigCryptoNvBlockRef [0..1]: multiplicity set at pre-compile, origin=RB:1.0.0:2023-06-01, set at pre-compile, destination=CryptoNvBlock  # Reference to the Crypto NV block where the persistent key elements of this key shall be stored to.
    container CsmMainFunction [0..*]: multiplicity set at pre-compile  # Each element of this container defines one instance of Csm_MainFunction. For each partition, where the Csm module shall be instantiated, at least one MainFunction instance needs to be configured.
      float CsmMainFunctionPeriod [0..1]: 0..INF, multiplicity set at pre-compile, set at pre-compile  # Specifies the period of the respective main function Csm_MainFunction instance in seconds.
      reference CsmMainFunctionPartitionRef: set at pre-compile, destination=EcucPartition  # Reference to EcucPartition, where the according CsmMainFunction instance is assigned to.
    container CsmPrimitives [0..*]: multiplicity set at pre-compile  # Container for configuration of CsmPrimitives
      enumeration CsmRbAutoConfigCryptoSelect [0..1]: {rba_CryptoCCL, rba_CryptoHSM}, multiplicity set at pre-compile, origin=RB:1.0.0:2021-06-01, set at pre-compile  # When automatic configuration completion used for a job-primitive pair, then this parameter needs to be filled out to select the crypto target for the key.
      container CsmAEADDecrypt [0..1]: multiplicity set at pre-compile  # Configuration of AEAD decryption primitives
        container CsmAEADDecryptConfig  # Container for configuration of a CSM decryption interface. The container name serves as a symbolic name for the identifier of an decryption interface.
          enumeration CsmAEADDecryptAlgorithmFamily: {CRYPTO_ALGOFAM_3DES, CRYPTO_ALGOFAM_AES, CRYPTO_ALGOFAM_CHACHA, CRYPTO_ALGOFAM_CUSTOM, CRYPTO_ALGOFAM_EEA3}, multiplicity set at pre-compile, set at pre-compile  # Determines the algorithm family used for the crypto service. This parameter defines the most significant part of the algorithm.
          integer CsmAEADDecryptAlgorithmKeyLength: 1..4294967295, set at pre-compile  # Size of the AEAD decryption key in bytes
          enumeration CsmAEADDecryptAlgorithmMode: {CRYPTO_ALGOMODE_12ROUNDS, CRYPTO_ALGOMODE_20ROUNDS, CRYPTO_ALGOMODE_8ROUNDS, CRYPTO_ALGOMODE_CUSTOM, CRYPTO_ALGOMODE_GCM}, multiplicity set at pre-compile, set at pre-compile  # Determines the algorithm mode used for the crypto service
          enumeration CsmAEADDecryptAlgorithmSecondaryFamily: {CRYPTO_ALGOFAM_CUSTOM, CRYPTO_ALGOFAM_NOT_SET, CRYPTO_ALGOFAM_POLY1305}, set at pre-compile  # Defines the secondary family used for the crypto service
          integer CsmAEADDecryptAssociatedDataMaxLength [0..1]: 1..4294967295, multiplicity set at pre-compile, set at pre-compile  # Max size of the input associated data length in bytes
          integer CsmAEADDecryptCiphertextMaxLength [0..1]: 1..4294967295, multiplicity set at pre-compile, set at pre-compile  # Max size of the input ciphertext in bytes
          integer CsmAEADDecryptPlaintextMaxLength [0..1]: 1..4294967295, multiplicity set at pre-compile, set at pre-compile  # Size of the output plaintext length in bytes
          integer CsmAEADDecryptTagLength: 1..4294967295, set at pre-compile  # Size of the input Tag length in BITS
          integer CsmRbAEADDecryptTagMaxLength [0..1]: 1..4294967295, multiplicity set at pre-compile, origin=RB:1.0.0:2021-06-01, set at pre-compile  # Max size of the input Tag length in BITS
          reference CsmAEADDecryptAlgorithmFamilyCustomRef [0..1]: multiplicity set at pre-compile, set at pre-compile, destination=CryptoPrimitiveAlgorithmFamilyCustom  # Reference to a customer specific algorithm family custom container.
          reference CsmAEADDecryptAlgorithmModeCustomRef [0..1]: multiplicity set at pre-compile, set at pre-compile, destination=CryptoPrimitiveAlgorithmModeCustom  # Reference to a customer specific algorithm mode custom container.
          reference CsmAEADDecryptAlgorithmSecondaryFamilyCustomRef [0..1]: multiplicity set at pre-compile, set at pre-compile, destination=CryptoPrimitiveAlgorithmFamilyCustom  # Reference to a customer specific algorithm family container in the Crypto Driver.
          reference CsmAEADDecryptKeyRef: multiplicity set at pre-compile, set at pre-compile, destination=CsmKey  # This parameter refers to the key used for that decryption primitive.
          reference CsmAEADDecryptQueueRef: multiplicity set at pre-compile, set at pre-compile, destination=CsmQueue  # This parameter refers to the queue used for that decryption primitive.
      container CsmAEADEncrypt [0..1]: multiplicity set at pre-compile  # Configuration of AEAD encryption primitives
        container CsmAEADEncryptConfig  # Container for configuration of a CSM encryption interface. The container name serves as a symbolic name for the identifier of an encryption interface.
          enumeration CsmAEADEncryptAlgorithmFamily: {CRYPTO_ALGOFAM_3DES, CRYPTO_ALGOFAM_AES, CRYPTO_ALGOFAM_CHACHA, CRYPTO_ALGOFAM_CUSTOM, CRYPTO_ALGOFAM_EEA3}, multiplicity set at pre-compile, set at pre-compile  # Determines the algorithm family used for the crypto service. This parameter defines the most significant part of the algorithm.
          integer CsmAEADEncryptAlgorithmKeyLength: 1..4294967295, set at pre-compile  # Size of the AEAD encryption key in bytes
          enumeration CsmAEADEncryptAlgorithmMode: {CRYPTO_ALGOMODE_12ROUNDS, CRYPTO_ALGOMODE_20ROUNDS, CRYPTO_ALGOMODE_8ROUNDS, CRYPTO_ALGOMODE_CUSTOM, CRYPTO_ALGOMODE_GCM}, multiplicity set at pre-compile, set at pre-compile  # Determines the algorithm mode used for the crypto service
          enumeration CsmAEADEncryptAlgorithmSecondaryFamily: {CRYPTO_ALGOFAM_CUSTOM, CRYPTO_ALGOFAM_NOT_SET, CRYPTO_ALGOFAM_POLY1305}, multiplicity set at pre-compile, set at pre-compile  # Defines the secondary family used for the crypto service
          integer CsmAEADEncryptAssociatedDataMaxLength [0..1]: 1..4294967295, multiplicity set at pre-compile, set at pre-compile  # Max size of the input associated data length in bytes
          integer CsmAEADEncryptCiphertextMaxLength [0..1]: 1..4294967295, multiplicity set at pre-compile, set at pre-compile  # Max size of the output ciphertext length in bytes
          integer CsmAEADEncryptPlaintextMaxLength [0..1]: 1..4294967295, multiplicity set at pre-compile, set at pre-compile  # Max size of the input plaintext length in bytes
          integer CsmAEADEncryptTagLength: 1..4294967295, set at pre-compile  # Size of the output Tag length in bytes
          reference CsmAEADEncryptAlgorithmFamilyCustomRef [0..1]: multiplicity set at pre-compile, set at pre-compile, destination=CryptoPrimitiveAlgorithmFamilyCustom  # Reference to a customer specific algorithm family custom container.
          reference CsmAEADEncryptAlgorithmModeCustomRef [0..1]: multiplicity set at pre-compile, set at pre-compile, destination=CryptoPrimitiveAlgorithmModeCustom  # Reference to a customer specific algorithm mode custom container.
          reference CsmAEADEncryptAlgorithmSecondaryFamilyCustomRef [0..1]: multiplicity set at pre-compile, set at pre-compile, destination=CryptoPrimitiveAlgorithmFamilyCustom  # Reference to a customer specific algorithm family container in the Crypto Driver.
          reference CsmAEADEncryptKeyRef: multiplicity set at pre-compile, set at pre-compile, destination=CsmKey  # This parameter refers to the key used for that encryption primitive.
          reference CsmAEADEncryptQueueRef: multiplicity set at pre-compile, set at pre-compile, destination=CsmQueue  # This parameter refers to the queue used for that encryption primitive.
      container CsmDecrypt [0..1]: multiplicity set at pre-compile  # Configurations of Decryption primitives
        container CsmDecryptConfig  # Container for configuration of a CSM decryption interface. The container name serves as a symbolic name for the identifier of an decryption interface.
          enumeration CsmDecryptAlgorithmFamily: {CRYPTO_ALGOFAM_3DES, CRYPTO_ALGOFAM_AES, CRYPTO_ALGOFAM_CHACHA, CRYPTO_ALGOFAM_CUSTOM, CRYPTO_ALGOFAM_EEA3, CRYPTO_ALGOFAM_RSA}, multiplicity set at pre-compile, set at pre-compile  # Determines the algorithm family used for the crypto service. This parameter defines the most significant part of the algorithm.
          integer CsmDecryptAlgorithmKeyLength: 1..4294967295, set at pre-compile  # Size of the encryption key in bytes
          enumeration CsmDecryptAlgorithmMode: {CRYPTO_ALGOMODE_12ROUNDS, CRYPTO_ALGOMODE_20ROUNDS, CRYPTO_ALGOMODE_8ROUNDS, CRYPTO_ALGOMODE_CBC, CRYPTO_ALGOMODE_CFB, CRYPTO_ALGOMODE_CTR, CRYPTO_ALGOMODE_CUSTOM, CRYPTO_ALGOMODE_ECB, CRYPTO_ALGOMODE_OFB, CRYPTO_ALGOMODE_RSAES_OAEP, CRYPTO_ALGOMODE_RSAES_PKCS1_v1_5, CRYPTO_ALGOMODE_XTS}, multiplicity set at pre-compile, set at pre-compile  # Determines the algorithm mode used for the crypto service
          enumeration CsmDecryptAlgorithmSecondaryFamily: {CRYPTO_ALGOFAM_BLAKE_1_256, CRYPTO_ALGOFAM_BLAKE_1_512, CRYPTO_ALGOFAM_BLAKE_2s_256, CRYPTO_ALGOFAM_BLAKE_2s_512, CRYPTO_ALGOFAM_CUSTOM, CRYPTO_ALGOFAM_NOT_SET, CRYPTO_ALGOFAM_RIPEMD160, CRYPTO_ALGOFAM_SHA1, CRYPTO_ALGOFAM_SHA2_224, CRYPTO_ALGOFAM_SHA2_256, CRYPTO_ALGOFAM_SHA2_384, CRYPTO_ALGOFAM_SHA2_512, CRYPTO_ALGOFAM_SHA2_512_224, CRYPTO_ALGOFAM_SHA2_512_256, CRYPTO_ALGOFAM_SHA3_224, CRYPTO_ALGOFAM_SHA3_256, CRYPTO_ALGOFAM_SHA3_384, CRYPTO_ALGOFAM_SHA3_512, CRYPTO_ALGOFAM_SHAKE128, CRYPTO_ALGOFAM_SHAKE256}, multiplicity set at pre-compile, set at pre-compile, default-value=CRYPTO_ALGOFAM_NOT_SET  # Determines the secondary algorithm family used for the crypto service
          integer CsmDecryptDataMaxLength [0..1]: 1..4294967295, multiplicity set at pre-compile, set at pre-compile  # Max size of the input ciphertext length in bytes
          integer CsmDecryptResultMaxLength [0..1]: 1..4294967295, multiplicity set at pre-compile, set at pre-compile  # Max size of the output plaintext length in bytes
          reference CsmDecryptAlgorithmFamilyCustomRef [0..1]: multiplicity set at pre-compile, set at pre-compile, destination=CryptoPrimitiveAlgorithmFamilyCustom  # Reference to a customer specific algorithm family custom container.
          reference CsmDecryptAlgorithmModeCustomRef [0..1]: multiplicity set at pre-compile, set at pre-compile, destination=CryptoPrimitiveAlgorithmModeCustom  # Reference to a customer specific algorithm mode custom container.
          reference CsmDecryptAlgorithmSecondaryFamilyCustomRef [0..1]: multiplicity set at pre-compile, set at pre-compile, destination=CryptoPrimitiveAlgorithmFamilyCustom  # Reference to a customer specific algorithm family container in the Crypto Driver.
      container CsmEncrypt [0..1]: multiplicity set at pre-compile  # Configurations of Encryption primitives
        container CsmEncryptConfig  # Container for configuration of a CSM encryption interface. The container name serves as a symbolic name for the identifier of an encryption interface.
          enumeration CsmEncryptAlgorithmFamily: {CRYPTO_ALGOFAM_3DES, CRYPTO_ALGOFAM_AES, CRYPTO_ALGOFAM_CHACHA, CRYPTO_ALGOFAM_CUSTOM, CRYPTO_ALGOFAM_EEA3, CRYPTO_ALGOFAM_RSA}, multiplicity set at pre-compile, set at pre-compile  # Determines the algorithm family used for the crypto service. This parameter defines the most significant part of the algorithm.
          integer CsmEncryptAlgorithmKeyLength: 1..4294967295, set at pre-compile  # Size of the encryption key in bytes
          enumeration CsmEncryptAlgorithmMode: {CRYPTO_ALGOMODE_12ROUNDS, CRYPTO_ALGOMODE_20ROUNDS, CRYPTO_ALGOMODE_8ROUNDS, CRYPTO_ALGOMODE_CBC, CRYPTO_ALGOMODE_CFB, CRYPTO_ALGOMODE_CTR, CRYPTO_ALGOMODE_CUSTOM, CRYPTO_ALGOMODE_ECB, CRYPTO_ALGOMODE_NOT_SET, CRYPTO_ALGOMODE_OFB, CRYPTO_ALGOMODE_RSAES_OAEP, CRYPTO_ALGOMODE_RSAES_PKCS1_v1_5, CRYPTO_ALGOMODE_XTS}, multiplicity set at pre-compile, set at pre-compile  # Determines the algorithm mode used for the crypto service
          enumeration CsmEncryptAlgorithmSecondaryFamily: {CRYPTO_ALGOFAM_BLAKE_1_256, CRYPTO_ALGOFAM_BLAKE_1_512, CRYPTO_ALGOFAM_BLAKE_2s_256, CRYPTO_ALGOFAM_BLAKE_2s_512, CRYPTO_ALGOFAM_CUSTOM, CRYPTO_ALGOFAM_NOT_SET, CRYPTO_ALGOFAM_RIPEMD160, CRYPTO_ALGOFAM_SHA1, CRYPTO_ALGOFAM_SHA2_224, CRYPTO_ALGOFAM_SHA2_256, CRYPTO_ALGOFAM_SHA2_384, CRYPTO_ALGOFAM_SHA2_512, CRYPTO_ALGOFAM_SHA2_512_224, CRYPTO_ALGOFAM_SHA2_512_256, CRYPTO_ALGOFAM_SHA3_224, CRYPTO_ALGOFAM_SHA3_256, CRYPTO_ALGOFAM_SHA3_384, CRYPTO_ALGOFAM_SHA3_512, CRYPTO_ALGOFAM_SHAKE128, CRYPTO_ALGOFAM_SHAKE256}, multiplicity set at pre-compile, set at pre-compile, default-value=CRYPTO_ALGOFAM_NOT_SET  # Determines the algorithm family used for the crypto service
          integer CsmEncryptDataMaxLength [0..1]: 1..4294967295, multiplicity set at pre-compile, set at pre-compile  # Max size of the input plaintext length in bytes
          integer CsmEncryptResultMaxLength [0..1]: 1..4294967295, multiplicity set at pre-compile, set at pre-compile  # Max size of the output cipher length in bytes
          reference CsmEncryptAlgorithmFamilyCustomRef [0..1]: multiplicity set at pre-compile, set at pre-compile, destination=CryptoPrimitiveAlgorithmFamilyCustom  # Reference to a customer specific algorithm family custom container.
          reference CsmEncryptAlgorithmModeCustomRef [0..1]: multiplicity set at pre-compile, set at pre-compile, destination=CryptoPrimitiveAlgorithmModeCustom  # Reference to a customer specific algorithm mode custom container.
          reference CsmEncryptAlgorithmSecondaryFamilyCustomRef [0..1]: multiplicity set at pre-compile, set at pre-compile, destination=CryptoPrimitiveAlgorithmFamilyCustom  # Reference to a customer specific algorithm family container in the Crypto Driver.
      container CsmHash [0..1]: multiplicity set at pre-compile  # Container for Hash Configurations
        container CsmHashConfig  # Container for configuration of a CSM hash. The container name serves as a symbolic name for the identifier of a key configuration.
          enumeration CsmHashAlgorithmFamily: {CRYPTO_ALGOFAM_BLAKE_1_256, CRYPTO_ALGOFAM_BLAKE_1_512, CRYPTO_ALGOFAM_BLAKE_2s_256, CRYPTO_ALGOFAM_BLAKE_2s_512, CRYPTO_ALGOFAM_CUSTOM, CRYPTO_ALGOFAM_RIPEMD160, CRYPTO_ALGOFAM_SHA1, CRYPTO_ALGOFAM_SHA2_224, CRYPTO_ALGOFAM_SHA2_256, CRYPTO_ALGOFAM_SHA2_384, CRYPTO_ALGOFAM_SHA2_512, CRYPTO_ALGOFAM_SHA2_512_224, CRYPTO_ALGOFAM_SHA2_512_256, CRYPTO_ALGOFAM_SHA3_224, CRYPTO_ALGOFAM_SHA3_256, CRYPTO_ALGOFAM_SHA3_384, CRYPTO_ALGOFAM_SHA3_512, CRYPTO_ALGOFAM_SHAKE128, CRYPTO_ALGOFAM_SHAKE256, CRYPTO_ALGOFAM_SM3}, multiplicity set at pre-compile, set at pre-compile  # Determines the algorithm family used for the crypto service. This parameter defines the most significant part of the algorithm.
          enumeration CsmHashAlgorithmMode: {CRYPTO_ALGOMODE_CUSTOM, CRYPTO_ALGOMODE_NOT_SET}, multiplicity set at pre-compile, set at pre-compile, default-value=CRYPTO_ALGOMODE_NOT_SET  # Determines the algorithm mode used for the crypto service
          enumeration CsmHashAlgorithmSecondaryFamily: {CRYPTO_ALGOFAM_CUSTOM, CRYPTO_ALGOFAM_NOT_SET}, multiplicity set at pre-compile, set at pre-compile, default-value=CRYPTO_ALGOFAM_NOT_SET  # Determines the algorithm family used for the crypto service
          integer CsmHashDataMaxLength [0..1]: 1..4294967295, multiplicity set at pre-compile, set at pre-compile  # Max size of the input data length in bytes
          integer CsmHashResultLength: 1..4294967295, set at pre-compile  # Size of the output hash length in bytes. Used only in Crypto_HSM if output buffering feature is enabled.
          reference CsmHashAlgorithmFamilyCustomRef [0..1]: multiplicity set at pre-compile, set at pre-compile, destination=CryptoPrimitiveAlgorithmFamilyCustom  # Reference to a customer specific algorithm family custom container.
          reference CsmHashAlgorithmModeCustomRef [0..1]: multiplicity set at pre-compile, set at pre-compile, destination=CryptoPrimitiveAlgorithmModeCustom  # Reference to a customer specific algorithm mode custom container.
          reference CsmHashAlgorithmSecondaryFamilyCustomRef [0..1]: multiplicity set at pre-compile, set at pre-compile, destination=CryptoPrimitiveAlgorithmFamilyCustom  # Reference to a customer specific algorithm family container in the Crypto Driver.
      container CsmJobCertificateParse [0..1]: multiplicity set at pre-compile  # Configurations of CertificateParse primitives
        container CsmJobCertificateParseConfig  # Container for configuration of a CSM CsmJobCertificateParse. The container name serves as a symbolic name for the identifier of a key configuration.
          string CsmJobCertificateParseAlgorithmFamilyCustom [0..1]: multiplicity set at pre-compile, set at pre-compile  # This is the name of the custom algorithm family, if CRYPTO_ALGOFAM_CUSTOM is used.
          enumeration CsmJobCertificateParseAlgorithmMode: {CRYPTO_ALGOMODE_CUSTOM, CRYPTO_ALGOMODE_NOT_SET}, set at pre-compile  # Determines the algorithm mode used for the crypto service
          string CsmJobCertificateParseAlgorithmModeCustom [0..1]: multiplicity set at pre-compile, set at pre-compile  # Name of the custom primitive mode.
          enumeration CsmJobCertificateParseAlgorithmSecondaryFamily: {CRYPTO_ALGOFAM_CUSTOM, CRYPTO_ALGOFAM_NOT_SET}, set at pre-compile  # Determines the algorithm family used for the crypto service.
          string CsmJobCertificateParseAlgorithmSecondaryFamilyCustom [0..1]: multiplicity set at pre-compile, set at pre-compile  # This is the second name of the custom algorithm family, if CRYPTO_ALGOFAM_CUSTOM is used.
      container CsmJobCertificateVerify [0..1]: multiplicity set at pre-compile  # Configurations of CertificateVerify primitves
        container CsmJobCertificateVerifyConfig  # Container for configuration of a CSM CsmJobCertificateVerify. The container name serves as a symbolic name for the identifier of a key configuration.
          enumeration CsmJobCertificateVerifyAlgorithmFamily: {CRYPTO_ALGOFAM_CUSTOM}, set at pre-compile  # Determines the algorithm family used for the crypto service. This parameter defines the most significant part of the algorithm.
          string CsmJobCertificateVerifyAlgorithmFamilyCustom [0..1]: multiplicity set at pre-compile, set at pre-compile  # This is the name of the custom algorithm family, if CRYPTO_ALGOFAM_CUSTOM is used.
          enumeration CsmJobCertificateVerifyAlgorithmMode: {CRYPTO_ALGOMODE_CUSTOM, CRYPTO_ALGOMODE_NOT_SET}, set at pre-compile  # Determines the algorithm mode used for the crypto service
          string CsmJobCertificateVerifyAlgorithmModeCustom [0..1]: multiplicity set at pre-compile, set at pre-compile  # Name of the custom primitive mode.
          enumeration CsmJobCertificateVerifyAlgorithmSecondaryFamily: {CRYPTO_ALGOFAM_CUSTOM, CRYPTO_ALGOFAM_NOT_SET}, set at pre-compile  # Determines the algorithm family used for the crypto service.
          string CsmJobCertificateVerifyAlgorithmSecondaryFamilyCustom [0..1]: multiplicity set at pre-compile, set at pre-compile  # This is the second name of the custom algorithm family, if CRYPTO_ALGOFAM_CUSTOM is used.
      container CsmJobKeyDerive [0..1]: multiplicity set at pre-compile  # Configurations of KeyDerive primitives
        container CsmJobKeyDeriveConfig  # Container for configuration of a CSM key derive operation. The container name serves as a symbolic name for the identifier of a key derive configuration.
          enumeration CsmJobKeyDeriveAlgorithmFamily: {CRYPTO_ALGOFAM_CUSTOM, CRYPTO_ALGOFAM_HKDF, CRYPTO_ALGOFAM_KDFX963, CRYPTO_ALGOFAM_PBKDF2}, set at pre-compile  # Determines the algorithm family used for the crypto service. This parameter defines the most significant part of the algorithm.
          enumeration CsmJobKeyDeriveAlgorithmMode: {CRYPTO_ALGOMODE_CMAC, CRYPTO_ALGOMODE_CTRDRBG, CRYPTO_ALGOMODE_CUSTOM, CRYPTO_ALGOMODE_GMAC, CRYPTO_ALGOMODE_HMAC, CRYPTO_ALGOMODE_NOT_SET, CRYPTO_ALGOMODE_SIPHASH_2_4, CRYPTO_ALGOMODE_SIPHASH_4_8}, set at pre-compile  # Determines the algorithm mode used for the crypto service
          enumeration CsmJobKeyDeriveAlgorithmSecondaryFamily: {CRYPTO_ALGOFAM_BLAKE_1_256, CRYPTO_ALGOFAM_BLAKE_1_512, CRYPTO_ALGOFAM_BLAKE_2s_256, CRYPTO_ALGOFAM_BLAKE_2s_512, CRYPTO_ALGOFAM_CUSTOM, CRYPTO_ALGOFAM_NOT_SET, CRYPTO_ALGOFAM_RIPEMD160, CRYPTO_ALGOFAM_SHA1, CRYPTO_ALGOFAM_SHA2_224, CRYPTO_ALGOFAM_SHA2_256, CRYPTO_ALGOFAM_SHA2_512, CRYPTO_ALGOFAM_SHA2_512_224, CRYPTO_ALGOFAM_SHA2_512_256, CRYPTO_ALGOFAM_SHA3_224, CRYPTO_ALGOFAM_SHA3_256, CRYPTO_ALGOFAM_SHA3_384, CRYPTO_ALGOFAM_SHA3_512, CRYPTO_ALGOFAM_SHAKE128, CRYPTO_ALGOFAM_SHAKE256}, set at pre-compile, default-value=CRYPTO_ALGOFAM_NOT_SET  # Determines the algorithm family used for the crypto service.
          reference CsmJobKeyDeriveAlgorithmFamilyCustomRef [0..1]: multiplicity set at pre-compile, set at pre-compile, destination=CryptoPrimitiveAlgorithmFamilyCustom  # Reference to a customer specific algorithm family custom container.
          reference CsmJobKeyDeriveAlgorithmModeCustomRef [0..1]: multiplicity set at pre-compile, set at pre-compile, destination=CryptoPrimitiveAlgorithmModeCustom  # Reference to a customer specific algorithm mode custom container.
          reference CsmJobKeyDeriveAlgorithmSecondaryFamilyCustomRef [0..1]: multiplicity set at pre-compile, set at pre-compile, destination=CryptoPrimitiveAlgorithmFamilyCustom  # Reference to a customer specific algorithm family container in the Crypto Driver.
      container CsmJobKeyElementGet [0..1]: multiplicity set at pre-compile  # Configurations of KeyElementGet primitives
        container CsmJobKeyElementGetConfig  # Container for configuration of a CSM key element get operation. The container name serves as a symbolic name for the identifier of a key configuration.
          enumeration CsmJobKeyElementGetAlgorithmFamily: {CRYPTO_ALGOFAM_CUSTOM, CRYPTO_ALGOFAM_NOT_SET}, multiplicity set at pre-compile, set at pre-compile  # Determines the algorithm family used for the crypto service. This parameter defines the most significant part of the algorithm.
          enumeration CsmJobKeyElementGetAlgorithmMode: {CRYPTO_ALGOMODE_CUSTOM, CRYPTO_ALGOMODE_NOT_SET}, multiplicity set at pre-compile, set at pre-compile  # Determines the algorithm mode used for the crypto service. This parameter defines the most significant part of the algorithm.
          enumeration CsmJobKeyElementGetAlgorithmSecondaryFamily: {CRYPTO_ALGOFAM_CUSTOM, CRYPTO_ALGOFAM_NOT_SET}, multiplicity set at pre-compile, set at pre-compile  # Determines the algorithm family used for the crypto service. This parameter defines the most significant part of the algorithm.
          reference CsmJobKeyElementGetAlgorithmFamilyCustomRef [0..1]: multiplicity set at pre-compile, set at pre-compile, destination=CryptoPrimitiveAlgorithmFamilyCustom  # Reference to a customer specific algorithm family custom container.
          reference CsmJobKeyElementGetAlgorithmModeCustomRef [0..1]: multiplicity set at pre-compile, set at pre-compile, destination=CryptoPrimitiveAlgorithmModeCustom  # Reference to a customer specific algorithm mode custom container.
          reference CsmJobKeyElementGetAlgorithmSecondaryFamilyCustomRef [0..1]: multiplicity set at pre-compile, set at pre-compile, destination=CryptoPrimitiveAlgorithmFamilyCustom  # Reference to a customer specific algorithm family container in the Crypto Driver.
      container CsmJobKeyElementSet [0..1]: multiplicity set at pre-compile  # Configurations of KeyElementSet primitives
        container CsmJobKeyElementSetConfig  # Container for configuration of a CSM key element set operation. The container name serves as a symbolic name for the identifier of a key configuration.
          enumeration CsmJobKeyElementSetAlgorithmFamily: {CRYPTO_ALGOFAM_CUSTOM, CRYPTO_ALGOFAM_NOT_SET}, multiplicity set at pre-compile, set at pre-compile  # Determines the algorithm family used for the crypto service. This parameter defines the most significant part of the algorithm.
          enumeration CsmJobKeyElementSetAlgorithmMode: {CRYPTO_ALGOMODE_CUSTOM, CRYPTO_ALGOMODE_NOT_SET}, multiplicity set at pre-compile, set at pre-compile  # Determines the algorithm mode used for the crypto service. This parameter defines the most significant part of the algorithm.
          enumeration CsmJobKeyElementSetAlgorithmSecondaryFamily: {CRYPTO_ALGOFAM_CUSTOM, CRYPTO_ALGOFAM_NOT_SET}, multiplicity set at pre-compile, set at pre-compile  # Determines the algorithm family used for the crypto service. This parameter defines the most significant part of the algorithm.
          reference CsmJobKeyElementSetAlgorithmFamilyCustomRef [0..1]: multiplicity set at pre-compile, set at pre-compile, destination=CryptoPrimitiveAlgorithmFamilyCustom  # Reference to a customer specific algorithm family custom container.
          reference CsmJobKeyElementSetAlgorithmModeCustomRef [0..1]: multiplicity set at pre-compile, set at pre-compile, destination=CryptoPrimitiveAlgorithmModeCustom  # Reference to a customer specific algorithm mode custom container.
          reference CsmJobKeyElementSetAlgorithmSecondaryFamilyCustomRef [0..1]: multiplicity set at pre-compile, set at pre-compile, destination=CryptoPrimitiveAlgorithmFamilyCustom  # Reference to a customer specific algorithm family container in the Crypto Driver.
      container CsmJobKeyExchangeCalcPubVal [0..1]: multiplicity set at pre-compile  # Configurations of KeyExchangeCalcPubVal primitives
        container CsmJobKeyExchangeCalcPubValConfig  # Container for configuration of a CSM JobKeyExchangeCalcPubVal. The container name serves as a symbolic name for the identifier of JobKeyExchangeCalcPubVal interface.
          enumeration CsmJobKeyExchangeCalcPubValAlgorithmFamily: {CRYPTO_ALGOFAM_CUSTOM, CRYPTO_ALGOFAM_DH, CRYPTO_ALGOFAM_ECDH, CRYPTO_ALGOFAM_RSA}, set at pre-compile  # Determines the algorithm family used for the crypto service. This parameter defines the most significant part of the algorithm.
          enumeration CsmJobKeyExchangeCalcPubValAlgorithmMode: {CRYPTO_ALGOMODE_CUSTOM, CRYPTO_ALGOMODE_NOT_SET}, set at pre-compile  # Determines the algorithm mode used for the crypto service
          enumeration CsmJobKeyExchangeCalcPubValAlgorithmSecondaryFamily: {CRYPTO_ALGOFAM_CUSTOM, CRYPTO_ALGOFAM_ECCANSI, CRYPTO_ALGOFAM_ECCNIST, CRYPTO_ALGOFAM_ECCSEC, CRYPTO_ALGOFAM_NOT_SET, CRYPTO_ALGOFAM_X25519}, set at pre-compile, default-value=CRYPTO_ALGOFAM_NOT_SET  # Determines the algorithm family used for the crypto service.
          reference CsmJobKeyExchangeCalcPubValAlgorithmFamilyCustomRef [0..1]: multiplicity set at pre-compile, set at pre-compile, destination=CryptoPrimitiveAlgorithmFamilyCustom  # Reference to a customer specific algorithm family custom container.
          reference CsmJobKeyExchangeCalcPubValAlgorithmModeCustomRef [0..1]: multiplicity set at pre-compile, set at pre-compile, destination=CryptoPrimitiveAlgorithmModeCustom  # Reference to a customer specific algorithm mode custom container.
          reference CsmJobKeyExchangeCalcPubValAlgorithmSecondaryFamilyCustomRef [0..1]: multiplicity set at pre-compile, set at pre-compile, destination=CryptoPrimitiveAlgorithmFamilyCustom  # Reference to a customer specific algorithm family container in the Crypto Driver.
      container CsmJobKeyExchangeCalcSecret [0..1]: multiplicity set at pre-compile  # Configurations of KeyExchangeCalcSecret primitives
        container CsmJobKeyExchangeCalcSecretConfig  # Container for configuration of a CSM JobKeyExchangeCalcSecret. The container name serves as a symbolic name for the identifier of a JobKeyExchangeCalcSecret configuration.
          enumeration CsmJobKeyExchangeCalcSecretAlgorithmFamily: {CRYPTO_ALGOFAM_CUSTOM, CRYPTO_ALGOFAM_DH, CRYPTO_ALGOFAM_ECDH, CRYPTO_ALGOFAM_RSA}, set at pre-compile  # Determines the algorithm family used for the crypto service. This parameter defines the most significant part of the algorithm.
          enumeration CsmJobKeyExchangeCalcSecretAlgorithmMode: {CRYPTO_ALGOMODE_CUSTOM, CRYPTO_ALGOMODE_NOT_SET}, set at pre-compile  # Determines the algorithm mode used for the crypto service
          enumeration CsmJobKeyExchangeCalcSecretAlgorithmSecondaryFamily: {CRYPTO_ALGOFAM_CUSTOM, CRYPTO_ALGOFAM_ECCANSI, CRYPTO_ALGOFAM_ECCNIST, CRYPTO_ALGOFAM_ECCSEC, CRYPTO_ALGOFAM_NOT_SET, CRYPTO_ALGOFAM_X25519}, set at pre-compile  # Determines the algorithm family used for the crypto service.
          reference CsmJobKeyExchangeCalcSecretAlgorithmFamilyCustomRef [0..1]: multiplicity set at pre-compile, set at pre-compile, destination=CryptoPrimitiveAlgorithmFamilyCustom  # Reference to a customer specific algorithm family custom container.
          reference CsmJobKeyExchangeCalcSecretAlgorithmModeCustomRef [0..1]: multiplicity set at pre-compile, set at pre-compile, destination=CryptoPrimitiveAlgorithmModeCustom  # Reference to a customer specific algorithm mode custom container.
          reference CsmJobKeyExchangeCalcSecretAlgorithmSecondaryFamilyCustomRef [0..1]: multiplicity set at pre-compile, set at pre-compile, destination=CryptoPrimitiveAlgorithmFamilyCustom  # Reference to a customer specific algorithm family container in the Crypto Driver.
      container CsmJobKeyGenerate [0..1]: multiplicity set at pre-compile  # Configurations of KeyGenerate primitives
        container CsmJobKeyGenerateConfig  # Container for configuration of a CSM key generate operation. The container name serves as a symbolic name for the identifier of a key generate configuration.
          enumeration CsmJobKeyGenerateAlgorithmFamily: {CRYPTO_ALGOFAM_CUSTOM, CRYPTO_ALGOFAM_ECCANSI, CRYPTO_ALGOFAM_ECCNIST, CRYPTO_ALGOFAM_ECCSEC, CRYPTO_ALGOFAM_ECDH, CRYPTO_ALGOFAM_ED25519, CRYPTO_ALGOFAM_X25519}, set at pre-compile  # Determines the algorithm family used for the crypto service. This parameter defines the most significant part of the algorithm.
          enumeration CsmJobKeyGenerateAlgorithmMode: {CRYPTO_ALGOMODE_CUSTOM, CRYPTO_ALGOMODE_NOT_SET}, set at pre-compile, default-value=CRYPTO_ALGOMODE_NOT_SET  # Determines the algorithm mode used for the crypto service
          enumeration CsmJobKeyGenerateAlgorithmSecondaryFamily: {CRYPTO_ALGOFAM_CUSTOM, CRYPTO_ALGOFAM_NOT_SET}, set at pre-compile, default-value=CRYPTO_ALGOFAM_NOT_SET  # Determines the algorithm family used for the crypto service.
          reference CsmJobKeyGenerateAlgorithmFamilyCustomRef [0..1]: multiplicity set at pre-compile, set at pre-compile, destination=CryptoPrimitiveAlgorithmFamilyCustom  # Reference to a customer specific algorithm family custom container.
          reference CsmJobKeyGenerateAlgorithmModeCustomRef [0..1]: multiplicity set at pre-compile, set at pre-compile, destination=CryptoPrimitiveAlgorithmModeCustom  # Reference to a customer specific algorithm mode custom container.
          reference CsmJobKeyGenerateAlgorithmSecondaryFamilyCustomRef [0..1]: multiplicity set at pre-compile, set at pre-compile, destination=CryptoPrimitiveAlgorithmFamilyCustom  # Reference to a customer specific algorithm family container in the Crypto Driver.
      container CsmJobKeySetInvalid [0..1]: multiplicity set at pre-compile  # Configurations of KeySetInvalid primitives
        container CsmJobKeySetInvalidConfig  # Container for configuration of a CSM key set invalid operation. The container name serves as a symbolic name for the identifier of a key configuration.
          enumeration CsmJobKeySetInvalidAlgorithmFamily: {CRYPTO_ALGOFAM_CUSTOM, CRYPTO_ALGOFAM_NOT_SET}, multiplicity set at pre-compile, set at pre-compile  # Determines the algorithm family used for the crypto service. This parameter defines the most significant part of the algorithm.
          enumeration CsmJobKeySetInvalidAlgorithmMode: {CRYPTO_ALGOMODE_CUSTOM, CRYPTO_ALGOMODE_NOT_SET}, multiplicity set at pre-compile, set at pre-compile  # Determines the algorithm mode used for the crypto service. This parameter defines the most significant part of the algorithm.
          enumeration CsmJobKeySetInvalidAlgorithmSecondaryFamily: {CRYPTO_ALGOFAM_CUSTOM, CRYPTO_ALGOFAM_NOT_SET}, multiplicity set at pre-compile, set at pre-compile  # Determines the algorithm family used for the crypto service. This parameter defines the most significant part of the algorithm.
          reference CsmJobKeySetInvalidAlgorithmFamilyCustomRef [0..1]: multiplicity set at pre-compile, set at pre-compile, destination=CryptoPrimitiveAlgorithmFamilyCustom  # Reference to a customer specific algorithm family custom container.
          reference CsmJobKeySetInvalidAlgorithmModeCustomRef [0..1]: multiplicity set at pre-compile, set at pre-compile, destination=CryptoPrimitiveAlgorithmModeCustom  # Reference to a customer specific algorithm mode custom container.
          reference CsmJobKeySetInvalidAlgorithmSecondaryFamilyCustomRef [0..1]: multiplicity set at pre-compile, set at pre-compile, destination=CryptoPrimitiveAlgorithmFamilyCustom  # Reference to a customer specific algorithm family container in the Crypto Driver.
      container CsmJobKeySetValid [0..1]: multiplicity set at pre-compile  # Configurations of KeySetValid primitives
        container CsmJobKeySetValidConfig  # Container for configuration of a CSM key set valid operation. The container name serves as a symbolic name for the identifier of a key configuration.
          enumeration CsmJobKeySetValidAlgorithmFamily: {CRYPTO_ALGOFAM_CUSTOM, CRYPTO_ALGOFAM_NOT_SET}, multiplicity set at pre-compile, set at pre-compile  # Determines the algorithm family used for the crypto service. This parameter defines the most significant part of the algorithm.
          enumeration CsmJobKeySetValidAlgorithmMode: {CRYPTO_ALGOMODE_CUSTOM, CRYPTO_ALGOMODE_NOT_SET}, multiplicity set at pre-compile, set at pre-compile  # Determines the algorithm mode used for the crypto service. This parameter defines the most significant part of the algorithm.
          enumeration CsmJobKeySetValidAlgorithmSecondaryFamily: {CRYPTO_ALGOFAM_CUSTOM, CRYPTO_ALGOFAM_NOT_SET}, multiplicity set at pre-compile, set at pre-compile  # Determines the algorithm family used for the crypto service. This parameter defines the most significant part of the algorithm.
          reference CsmJobKeySetValidAlgorithmFamilyCustomRef [0..1]: multiplicity set at pre-compile, set at pre-compile, destination=CryptoPrimitiveAlgorithmFamilyCustom  # Reference to a customer specific algorithm family custom container.
          reference CsmJobKeySetValidAlgorithmModeCustomRef [0..1]: multiplicity set at pre-compile, set at pre-compile, destination=CryptoPrimitiveAlgorithmModeCustom  # Reference to a customer specific algorithm mode custom container.
          reference CsmJobKeySetValidAlgorithmSecondaryFamilyCustomRef [0..1]: multiplicity set at pre-compile, set at pre-compile, destination=CryptoPrimitiveAlgorithmFamilyCustom  # Reference to a customer specific algorithm family container in the Crypto Driver.
      container CsmJobRandomSeed [0..1]: multiplicity set at pre-compile  # Configurations of RandomSeed primitives
        container CsmJobRandomSeedConfig  # Container for configuration of a CSM random seed operation. The container name serves as a symbolic name for the identifier of a random seed configuration.
          enumeration CsmJobRandomSeedAlgorithmFamily: {CRYPTO_ALGOFAM_3DES, CRYPTO_ALGOFAM_AES, CRYPTO_ALGOFAM_BLAKE_1_256, CRYPTO_ALGOFAM_BLAKE_1_512, CRYPTO_ALGOFAM_BLAKE_2s_256, CRYPTO_ALGOFAM_BLAKE_2s_512, CRYPTO_ALGOFAM_CHACHA, CRYPTO_ALGOFAM_CUSTOM, CRYPTO_ALGOFAM_DRBG, CRYPTO_ALGOFAM_RIPEMD160, CRYPTO_ALGOFAM_RNG, CRYPTO_ALGOFAM_SHA1, CRYPTO_ALGOFAM_SHA2_224, CRYPTO_ALGOFAM_SHA2_256, CRYPTO_ALGOFAM_SHA2_384, CRYPTO_ALGOFAM_SHA2_512, CRYPTO_ALGOFAM_SHA2_512_224, CRYPTO_ALGOFAM_SHA2_512_256, CRYPTO_ALGOFAM_SHA3_224, CRYPTO_ALGOFAM_SHA3_256, CRYPTO_ALGOFAM_SHA3_384, CRYPTO_ALGOFAM_SHA3_512, CRYPTO_ALGOFAM_SHAKE128, CRYPTO_ALGOFAM_SHAKE256, CRYPTO_ALGOFAM_SM3}, multiplicity set at pre-compile, set at pre-compile  # Determines the algorithm family used for the crypto service. This parameter defines the most significant part of the algorithm.
          enumeration CsmJobRandomSeedAlgorithmMode: {CRYPTO_ALGOMODE_CMAC, CRYPTO_ALGOMODE_CTRDRBG, CRYPTO_ALGOMODE_CUSTOM, CRYPTO_ALGOMODE_GMAC, CRYPTO_ALGOMODE_HMAC, CRYPTO_ALGOMODE_NOT_SET, CRYPTO_ALGOMODE_SIPHASH_2_4, CRYPTO_ALGOMODE_SIPHASH_4_8}, set at pre-compile  # Determines the algorithm mode used for the crypto service
          enumeration CsmJobRandomSeedAlgorithmSecondaryFamily: {CRYPTO_ALGOFAM_3DES, CRYPTO_ALGOFAM_AES, CRYPTO_ALGOFAM_BLAKE_1_256, CRYPTO_ALGOFAM_BLAKE_1_512, CRYPTO_ALGOFAM_BLAKE_2s_256, CRYPTO_ALGOFAM_BLAKE_2s_512, CRYPTO_ALGOFAM_CHACHA, CRYPTO_ALGOFAM_CUSTOM, CRYPTO_ALGOFAM_NOT_SET, CRYPTO_ALGOFAM_RIPEMD160, CRYPTO_ALGOFAM_SHA1, CRYPTO_ALGOFAM_SHA2_224, CRYPTO_ALGOFAM_SHA2_256, CRYPTO_ALGOFAM_SHA2_384, CRYPTO_ALGOFAM_SHA2_512, CRYPTO_ALGOFAM_SHA2_512_224, CRYPTO_ALGOFAM_SHA2_512_256, CRYPTO_ALGOFAM_SHA3_224, CRYPTO_ALGOFAM_SHA3_256, CRYPTO_ALGOFAM_SHA3_384, CRYPTO_ALGOFAM_SHA3_512, CRYPTO_ALGOFAM_SHAKE128, CRYPTO_ALGOFAM_SHAKE256}, set at pre-compile  # Determines the algorithm family used for the crypto service.
          reference CsmJobRandomSeedAlgorithmFamilyCustomRef [0..1]: multiplicity set at pre-compile, set at pre-compile, destination=CryptoPrimitiveAlgorithmFamilyCustom  # Reference to a customer specific algorithm family custom container.
          reference CsmJobRandomSeedAlgorithmModeCustomRef [0..1]: multiplicity set at pre-compile, set at pre-compile, destination=CryptoPrimitiveAlgorithmModeCustom  # Reference to a customer specific algorithm mode custom container.
          reference CsmJobRandomSeedAlgorithmSecondaryFamilyCustomRef [0..1]: multiplicity set at pre-compile, set at pre-compile, destination=CryptoPrimitiveAlgorithmFamilyCustom  # Reference to a customer specific algorithm family container in the Crypto Driver.
      container CsmMacGenerate [0..1]: multiplicity set at pre-compile  # Configurations of MacGenerate primitives
        container CsmMacGenerateConfig  # Container for configuration of a CSM mac generation interface. The container name serves as a symbolic name for the identifier of a MAC generation interface.
          enumeration CsmMacGenerateAlgorithmFamily: {CRYPTO_ALGOFAM_3DES, CRYPTO_ALGOFAM_AES, CRYPTO_ALGOFAM_BLAKE_1_256, CRYPTO_ALGOFAM_BLAKE_1_512, CRYPTO_ALGOFAM_BLAKE_2s_256, CRYPTO_ALGOFAM_BLAKE_2s_512, CRYPTO_ALGOFAM_CHACHA, CRYPTO_ALGOFAM_CUSTOM, CRYPTO_ALGOFAM_EEA3, CRYPTO_ALGOFAM_EIA3, CRYPTO_ALGOFAM_POLY1305, CRYPTO_ALGOFAM_RIPEMD160, CRYPTO_ALGOFAM_RNG, CRYPTO_ALGOFAM_SHA1, CRYPTO_ALGOFAM_SHA2_224, CRYPTO_ALGOFAM_SHA2_256, CRYPTO_ALGOFAM_SHA2_384, CRYPTO_ALGOFAM_SHA2_512, CRYPTO_ALGOFAM_SHA2_512_224, CRYPTO_ALGOFAM_SHA2_512_256, CRYPTO_ALGOFAM_SHA3_224, CRYPTO_ALGOFAM_SHA3_256, CRYPTO_ALGOFAM_SHA3_384, CRYPTO_ALGOFAM_SHA3_512, CRYPTO_ALGOFAM_SHAKE128, CRYPTO_ALGOFAM_SHAKE256, CRYPTO_ALGOFAM_SIPHASH, CRYPTO_ALGOFAM_SM3}, multiplicity set at pre-compile, set at pre-compile  # Determines the algorithm family used for the crypto service. This parameter defines the most significant part of the algorithm.
          integer CsmMacGenerateAlgorithmKeyLength: 1..4294967295, set at pre-compile  # Size of the MAC key in bytes
          enumeration CsmMacGenerateAlgorithmMode: {CRYPTO_ALGOMODE_CMAC, CRYPTO_ALGOMODE_CTRDRBG, CRYPTO_ALGOMODE_CUSTOM, CRYPTO_ALGOMODE_GMAC, CRYPTO_ALGOMODE_HMAC, CRYPTO_ALGOMODE_NOT_SET, CRYPTO_ALGOMODE_SIPHASH_2_4, CRYPTO_ALGOMODE_SIPHASH_4_8}, multiplicity set at pre-compile, set at pre-compile  # Determines the algorithm mode used for the crypto service
          enumeration CsmMacGenerateAlgorithmSecondaryFamily: {CRYPTO_ALGOFAM_CUSTOM, CRYPTO_ALGOFAM_NOT_SET}, multiplicity set at pre-compile, set at pre-compile, default-value=CRYPTO_ALGOFAM_NOT_SET  # Determines the secondary algorithm family used for the crypto service
          integer CsmMacGenerateDataMaxLength [0..1]: 1..4294967295, multiplicity set at pre-compile, set at pre-compile  # Max size of the input data length in bytes
          integer CsmMacGenerateResultLength: 1..4294967295, set at pre-compile  # Size of the output MAC length in bytes. Used only in Crypto_HSM if output buffering feature is enabled.
          boolean CsmRbAutoConfigBulkProcessingModeEnabled [0..1]: multiplicity set at pre-compile, origin=RB:1.0.0:2021-06-01, set at pre-compile, default-value=false  # When automatic configuration completion is used for a Mac primitive, then this parameter needs to be filled out to switch between Mac behaviors. | True: Enables the bulk processing mode for any mac generation. False: Disables the bulk processing mode for any mac generation (FALSE = default).
          reference CsmMacGenerateAlgorithmFamilyCustomRef [0..1]: multiplicity set at pre-compile, set at pre-compile, destination=CryptoPrimitiveAlgorithmFamilyCustom  # Reference to a customer specific algorithm family custom container.
          reference CsmMacGenerateAlgorithmModeCustomRef [0..1]: multiplicity set at pre-compile, set at pre-compile, destination=CryptoPrimitiveAlgorithmModeCustom  # Reference to a customer specific algorithm mode custom container.
          reference CsmMacGenerateAlgorithmSecondaryFamilyCustomRef [0..1]: multiplicity set at pre-compile, set at pre-compile, destination=CryptoPrimitiveAlgorithmFamilyCustom  # Reference to a customer specific algorithm family container in the Crypto Driver.
      container CsmMacVerify [0..1]: multiplicity set at pre-compile  # Configurations of MacVerify primitives
        container CsmMacVerifyConfig  # Container for configuration of a CSM MAC verification interface. The container name serves as a symbolic name for the identifier of a MAC generation interface
          enumeration CsmMacVerifyAlgorithmFamily: {CRYPTO_ALGOFAM_3DES, CRYPTO_ALGOFAM_AES, CRYPTO_ALGOFAM_BLAKE_1_256, CRYPTO_ALGOFAM_BLAKE_1_512, CRYPTO_ALGOFAM_BLAKE_2s_256, CRYPTO_ALGOFAM_BLAKE_2s_512, CRYPTO_ALGOFAM_CHACHA, CRYPTO_ALGOFAM_CUSTOM, CRYPTO_ALGOFAM_EEA3, CRYPTO_ALGOFAM_EIA3, CRYPTO_ALGOFAM_POLY1305, CRYPTO_ALGOFAM_RIPEMD160, CRYPTO_ALGOFAM_RNG, CRYPTO_ALGOFAM_SHA1, CRYPTO_ALGOFAM_SHA2_224, CRYPTO_ALGOFAM_SHA2_256, CRYPTO_ALGOFAM_SHA2_384, CRYPTO_ALGOFAM_SHA2_512, CRYPTO_ALGOFAM_SHA2_512_224, CRYPTO_ALGOFAM_SHA2_512_256, CRYPTO_ALGOFAM_SHA3_224, CRYPTO_ALGOFAM_SHA3_256, CRYPTO_ALGOFAM_SHA3_384, CRYPTO_ALGOFAM_SHA3_512, CRYPTO_ALGOFAM_SHAKE128, CRYPTO_ALGOFAM_SHAKE256, CRYPTO_ALGOFAM_SIPHASH, CRYPTO_ALGOFAM_SM3}, multiplicity set at pre-compile, set at pre-compile  # Determines the algorithm family used for the crypto service. This parameter defines the most significant part of the algorithm.
          integer CsmMacVerifyAlgorithmKeyLength: 1..4294967295, set at pre-compile  # Size of the MAC key in bytes
          enumeration CsmMacVerifyAlgorithmMode: {CRYPTO_ALGOMODE_CMAC, CRYPTO_ALGOMODE_CTRDRBG, CRYPTO_ALGOMODE_CUSTOM, CRYPTO_ALGOMODE_GMAC, CRYPTO_ALGOMODE_HMAC, CRYPTO_ALGOMODE_NOT_SET, CRYPTO_ALGOMODE_SIPHASH_2_4, CRYPTO_ALGOMODE_SIPHASH_4_8}, multiplicity set at pre-compile, set at pre-compile  # Determines the algorithm mode used for the crypto service
          enumeration CsmMacVerifyAlgorithmSecondaryFamily: {CRYPTO_ALGOFAM_CUSTOM, CRYPTO_ALGOFAM_NOT_SET}, multiplicity set at pre-compile, set at pre-compile, default-value=CRYPTO_ALGOFAM_NOT_SET  # Determines the secondary algorithm family used for the crypto service
          integer CsmMacVerifyCompareLength: 1..4294967295, set at pre-compile  # Size of the input MAC length, that shall be verified, in BITS
          integer CsmMacVerifyDataMaxLength [0..1]: 1..4294967295, multiplicity set at pre-compile, set at pre-compile  # Max size of the input data length, for whichs MAC shall be verified, in bytes
          boolean CsmRbAutoConfigBulkProcessingModeEnabled [0..1]: multiplicity set at pre-compile, origin=RB:1.0.0:2021-06-01, set at pre-compile, default-value=false  # When automatic configuration completion is used for a Mac primitive, then this parameter needs to be filled out to switch between Mac behaviors. | True: Enables the bulk processing mode for any mac verification. False: Disables the bulk processing mode for any mac verification (FALSE = default).
          reference CsmMacVerifyAlgorithmFamilyCustomRef [0..1]: multiplicity set at pre-compile, set at pre-compile, destination=CryptoPrimitiveAlgorithmFamilyCustom  # Reference to a customer specific algorithm family custom container.
          reference CsmMacVerifyAlgorithmModeCustomRef [0..1]: multiplicity set at pre-compile, set at pre-compile, destination=CryptoPrimitiveAlgorithmModeCustom  # Reference to a customer specific algorithm mode custom container.
          reference CsmMacVerifyAlgorithmSecondaryFamilyCustomRef [0..1]: multiplicity set at pre-compile, set at pre-compile, destination=CryptoPrimitiveAlgorithmFamilyCustom  # Reference to a customer specific algorithm family container in the Crypto Driver.
      container CsmRandomGenerate [0..1]: multiplicity set at pre-compile  # Configurations of RandomGenerate primitives
        container CsmRandomGenerateConfig  # Container for configuration of a CSM random generator. The container name serves as a symbolic name for the identifier of a random generator configuration.
          enumeration CsmRandomGenerateAlgorithmFamily: {CRYPTO_ALGOFAM_3DES, CRYPTO_ALGOFAM_AES, CRYPTO_ALGOFAM_BLAKE_1_256, CRYPTO_ALGOFAM_BLAKE_1_512, CRYPTO_ALGOFAM_BLAKE_2s_256, CRYPTO_ALGOFAM_BLAKE_2s_512, CRYPTO_ALGOFAM_CHACHA, CRYPTO_ALGOFAM_CUSTOM, CRYPTO_ALGOFAM_DRBG, CRYPTO_ALGOFAM_RIPEMD160, CRYPTO_ALGOFAM_RNG, CRYPTO_ALGOFAM_SHA1, CRYPTO_ALGOFAM_SHA2_224, CRYPTO_ALGOFAM_SHA2_256, CRYPTO_ALGOFAM_SHA2_384, CRYPTO_ALGOFAM_SHA2_512, CRYPTO_ALGOFAM_SHA2_512_224, CRYPTO_ALGOFAM_SHA2_512_256, CRYPTO_ALGOFAM_SHA3_224, CRYPTO_ALGOFAM_SHA3_256, CRYPTO_ALGOFAM_SHA3_384, CRYPTO_ALGOFAM_SHA3_512, CRYPTO_ALGOFAM_SHAKE128, CRYPTO_ALGOFAM_SHAKE256, CRYPTO_ALGOFAM_SM3}, multiplicity set at pre-compile, set at pre-compile  # Determines the algorithm family used for the crypto service. This parameter defines the most significant part of the algorithm.
          enumeration CsmRandomGenerateAlgorithmMode: {CRYPTO_ALGOMODE_CMAC, CRYPTO_ALGOMODE_CTRDRBG, CRYPTO_ALGOMODE_CUSTOM, CRYPTO_ALGOMODE_GMAC, CRYPTO_ALGOMODE_HMAC, CRYPTO_ALGOMODE_NOT_SET, CRYPTO_ALGOMODE_SIPHASH_2_4, CRYPTO_ALGOMODE_SIPHASH_4_8}, multiplicity set at pre-compile, set at pre-compile  # Determines the algorithm mode used for the crypto service
          enumeration CsmRandomGenerateAlgorithmSecondaryFamily: {CRYPTO_ALGOFAM_CUSTOM, CRYPTO_ALGOFAM_NOT_SET, CRYPTO_ALGOFAM_SHA2_224, CRYPTO_ALGOFAM_SHA2_256, CRYPTO_ALGOFAM_SHA2_384, CRYPTO_ALGOFAM_SHA2_512}, multiplicity set at pre-compile, set at pre-compile  # Determines the algorithm family used for the crypto service
          integer CsmRandomGenerateResultLength: 1..4294967295, set at pre-compile  # Size of the random generate key in bytes. Used only in Crypto_HSM if output buffering feature is enabled.
          reference CsmRandomGenerateAlgorithmFamilyCustomRef [0..1]: multiplicity set at pre-compile, set at pre-compile, destination=CryptoPrimitiveAlgorithmFamilyCustom  # Reference to a customer specific algorithm family custom container.
          reference CsmRandomGenerateAlgorithmModeCustomRef [0..1]: multiplicity set at pre-compile, set at pre-compile, destination=CryptoPrimitiveAlgorithmModeCustom  # Reference to a customer specific algorithm mode custom container.
          reference CsmRandomGenerateAlgorithmSecondaryFamilyCustomRef [0..1]: multiplicity set at pre-compile, set at pre-compile, destination=CryptoPrimitiveAlgorithmFamilyCustom  # Reference to a customer specific algorithm family container in the Crypto Driver.
      container CsmRbSheExportRamKey [0..1]: multiplicity set at pre-compile  # Configuration of She Export Ram Key primitives
      container CsmRbSheGetID [0..1]: multiplicity set at pre-compile  # Configuration of She Get ID primitives
      container CsmRbSheLoadKey [0..1]: multiplicity set at pre-compile  # Configuration of She Load Key primitives - which is applicable only for basic SHE keys (up to RAM_KEY slot)
      container CsmRbSheLoadKeySlot [0..1]: multiplicity set at pre-compile  # Configuration of She Load Key Slot primitives - for updating up to 50 general purpose SHE key slots
      container CsmRbSheLoadPlainKey [0..1]: multiplicity set at pre-compile  # Configuration of She Load Plain Key primitives
      container CsmSignatureGenerate [0..1]: multiplicity set at pre-compile  # Configurations of SignatureGenerate primitives
        container CsmSignatureGenerateConfig  # Container for configuration of a CSM signature generation interface. The container name serves as a symbolic name for the identifier of signature generation interface.
          enumeration CsmSignatureGenerateAlgorithmFamily: {CRYPTO_ALGOFAM_BRAINPOOL, CRYPTO_ALGOFAM_CUSTOM, CRYPTO_ALGOFAM_ECCNIST, CRYPTO_ALGOFAM_ECDSA, CRYPTO_ALGOFAM_ED25519, CRYPTO_ALGOFAM_RSA, CRYPTO_ALGOFAM_SM2}, multiplicity set at pre-compile, set at pre-compile  # Determines the algorithm family used for the crypto service. This parameter defines the most significant part of the algorithm.
          enumeration CsmSignatureGenerateAlgorithmMode: {CRYPTO_ALGOMODE_CUSTOM, CRYPTO_ALGOMODE_NOT_SET, CRYPTO_ALGOMODE_RSASSA_PKCS1_v1_5, CRYPTO_ALGOMODE_RSASSA_PSS}, multiplicity set at pre-compile, set at pre-compile  # Determines the algorithm mode used for the crypto service
          enumeration CsmSignatureGenerateAlgorithmSecondaryFamily: {CRYPTO_ALGOFAM_AES, CRYPTO_ALGOFAM_BLAKE_1_256, CRYPTO_ALGOFAM_BLAKE_1_512, CRYPTO_ALGOFAM_BLAKE_2s_256, CRYPTO_ALGOFAM_BLAKE_2s_512, CRYPTO_ALGOFAM_CUSTOM, CRYPTO_ALGOFAM_NOT_SET, CRYPTO_ALGOFAM_RIPEMD160, CRYPTO_ALGOFAM_SHA1, CRYPTO_ALGOFAM_SHA2_224, CRYPTO_ALGOFAM_SHA2_256, CRYPTO_ALGOFAM_SHA2_384, CRYPTO_ALGOFAM_SHA2_512, CRYPTO_ALGOFAM_SHA2_512_224, CRYPTO_ALGOFAM_SHA2_512_256, CRYPTO_ALGOFAM_SHA3_224, CRYPTO_ALGOFAM_SHA3_256, CRYPTO_ALGOFAM_SHA3_384, CRYPTO_ALGOFAM_SHA3_512, CRYPTO_ALGOFAM_SHAKE128, CRYPTO_ALGOFAM_SHAKE256}, multiplicity set at pre-compile, set at pre-compile, default-value=CRYPTO_ALGOFAM_NOT_SET  # Determines the algorithm mode used for the crypto service
          integer CsmSignatureGenerateDataMaxLength [0..1]: 1..4294967295, multiplicity set at pre-compile, set at pre-compile  # Size of the input data length in bytes
          integer CsmSignatureGenerateKeyLength: 1..4294967295, set at pre-compile  # Size of the signature generate key in bytes
          integer CsmSignatureGenerateResultLength: 1..4294967295, set at pre-compile  # Size of the output signature length in bytes. Used only in Crypto_HSM if output buffering feature is enabled.
          reference CsmSignatureGenerateAlgorithmFamilyCustomRef [0..1]: multiplicity set at pre-compile, set at pre-compile, destination=CryptoPrimitiveAlgorithmFamilyCustom  # Reference to a customer specific algorithm family custom container.
          reference CsmSignatureGenerateAlgorithmModeCustomRef [0..1]: multiplicity set at pre-compile, set at pre-compile, destination=CryptoPrimitiveAlgorithmModeCustom  # Reference to a customer specific algorithm mode custom container.
          reference CsmSignatureGenerateAlgorithmSecondaryFamilyCustomRef [0..1]: multiplicity set at pre-compile, set at pre-compile, destination=CryptoPrimitiveAlgorithmFamilyCustom  # Reference to a customer specific algorithm family container in the Crypto Driver.
      container CsmSignatureVerify [0..1]: multiplicity set at pre-compile  # Configurations of SignatureVerify primitives
        container CsmSignatureVerifyConfig  # Container for configuration of a CSM signature verification interface. The container name serves as a symbolic name for the identifier of signature verification interface.
          enumeration CsmSignatureVerifyAlgorithmFamily: {CRYPTO_ALGOFAM_BRAINPOOL, CRYPTO_ALGOFAM_CUSTOM, CRYPTO_ALGOFAM_ECCNIST, CRYPTO_ALGOFAM_ECDSA, CRYPTO_ALGOFAM_ED25519, CRYPTO_ALGOFAM_RSA, CRYPTO_ALGOFAM_SM2}, multiplicity set at pre-compile, set at pre-compile  # Determines the algorithm family used for the crypto service. This parameter defines the most significant part of the algorithm.
          enumeration CsmSignatureVerifyAlgorithmMode: {CRYPTO_ALGOMODE_CUSTOM, CRYPTO_ALGOMODE_NOT_SET, CRYPTO_ALGOMODE_RSASSA_PKCS1_v1_5, CRYPTO_ALGOMODE_RSASSA_PSS}, multiplicity set at pre-compile, set at pre-compile  # Determines the algorithm mode used for the crypto service
          enumeration CsmSignatureVerifyAlgorithmSecondaryFamily: {CRYPTO_ALGOFAM_AES, CRYPTO_ALGOFAM_BLAKE_1_256, CRYPTO_ALGOFAM_BLAKE_1_512, CRYPTO_ALGOFAM_BLAKE_2s_256, CRYPTO_ALGOFAM_BLAKE_2s_512, CRYPTO_ALGOFAM_CUSTOM, CRYPTO_ALGOFAM_NOT_SET, CRYPTO_ALGOFAM_RIPEMD160, CRYPTO_ALGOFAM_SHA1, CRYPTO_ALGOFAM_SHA2_224, CRYPTO_ALGOFAM_SHA2_256, CRYPTO_ALGOFAM_SHA2_384, CRYPTO_ALGOFAM_SHA2_512, CRYPTO_ALGOFAM_SHA2_512_224, CRYPTO_ALGOFAM_SHA2_512_256, CRYPTO_ALGOFAM_SHA3_224, CRYPTO_ALGOFAM_SHA3_256, CRYPTO_ALGOFAM_SHA3_384, CRYPTO_ALGOFAM_SHA3_512, CRYPTO_ALGOFAM_SHAKE128, CRYPTO_ALGOFAM_SHAKE256}, multiplicity set at pre-compile, set at pre-compile  # Determines the algorithm family used for the crypto service. This parameter defines the most significant part of the algorithm.
          integer CsmSignatureVerifyCompareLength: 1..4294967295, set at pre-compile  # Number of the least significant bytes of the signature, for which the verification shall be calculated.
          integer CsmSignatureVerifyDataMaxLength [0..1]: 1..4294967295, multiplicity set at pre-compile, set at pre-compile  # Max size of the input data, for which the signature shall be verified, in bytes.
          integer CsmSignatureVerifyKeyLength: 1..4294967295, set at pre-compile  # Size of the signature verify key in bytes
          reference CsmSignatureVerifyAlgorithmFamilyCustomRef [0..1]: multiplicity set at pre-compile, set at pre-compile, destination=CryptoPrimitiveAlgorithmFamilyCustom  # Reference to a customer specific algorithm family custom container.
          reference CsmSignatureVerifyAlgorithmModeCustomRef [0..1]: multiplicity set at pre-compile, set at pre-compile, destination=CryptoPrimitiveAlgorithmModeCustom  # Reference to a customer specific algorithm mode custom container.
          reference CsmSignatureVerifyAlgorithmSecondaryFamilyCustomRef [0..1]: multiplicity set at pre-compile, set at pre-compile, destination=CryptoPrimitiveAlgorithmFamilyCustom  # Reference to a customer specific algorithm family container in the Crypto Driver.
    container CsmQueues [0..1]: multiplicity set at pre-compile  # Container for CSM queue configurations
      container CsmQueue [1..*]: multiplicity set at pre-compile  # Container for configuration of a CSM queue. | A queue has two tasks: 1. queue jobs which cannot be processed since the underlying hardware is busy and 2. refer to channel which shall be used
        integer CsmQueueSize [0..1]: 0..4294967295, multiplicity set at pre-compile, set at pre-compile  # Size of the CsmQueue. If jobs cannot be processed by the underlying hardware since the hardware is busy, the jobs stay in the prioritized queue. If the queue is full, the next job will be rejected.
        reference CsmChannelRef [0..1]: multiplicity set at pre-compile, set at pre-compile, requires-symbolic-name-value=true, destination=CryIfChannel  # Refers to the underlying Crypto Interface channel.
        reference CsmQueueMainFunctionRef [0..1]: multiplicity set at pre-compile, set at pre-compile, destination=CsmMainFunction  # This parameter refers to the used CsmMainFunction. | Reference to CsmMainFunction, where the according CsmQueue is assigned to.
