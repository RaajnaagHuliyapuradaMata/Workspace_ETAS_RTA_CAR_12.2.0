AUTOSAR XML (schema 4-2-2)
package /AUTOSAR_Ea/BswModuleDescriptions
  bsw module description Ea: category=BSW_MODULE, module-id=40, outgoing-callbacks=Ea_Rb_ErrorHandling_CallBackFunction  # EEPROM Abstraction
    provided-entrys:
      Ea_Cancel
      Ea_EraseImmediateBlock
      Ea_GetJobResult
      Ea_GetStatus
      Ea_GetVersionInfo
      Ea_Init
      Ea_InvalidateBlock
      Ea_MainFunction
      Ea_Rb_BlockMaintenance
      Ea_Rb_EndInit
      Ea_Read
      Ea_SetMode
      Ea_Write
      Ea_Rb_MigrationStatus
      Ea_Rb_EnterStopMode
      Ea_Rb_GetAdapterJobResult
      Ea_Rb_MainFunctionAndDependency
    bsw module dependency Crc: target-module-id=201
    bsw module dependency Det: target-module-id=15
    bsw module dependency Eep: target-module-id=90
package /AUTOSAR_Ea/BswModuleEntrys
  18 x bsw module entry, all with is-reentrant=false, sw-service-impl-policy=STANDARD:
    Ea_Cancel: service-id=0x04, is-synchronous=true, call-type=REGULAR, execution-context=UNSPECIFIED  # Service to cancel an ongoing asynchronous job (read/write/erase/compare) . | The function Ea_Cancel call the cancel function of the underlying EEPROM driver. If development error detection for the module EA is enabled: the function Ea_Cancel shall check that the module has been initialized. If this check fails, the function Ea_Cancel shall raise the development error EA_E_NOT_INITIALIZED and return without performing the requested function. If a cancel request is rejected by the function Ea_Cancel, i.e. requirement EA132 applies, the function Ea_Cancel shall not change the current module status or job result. The function Ea_Cancel shall reset the EA module's internal variables to make the module ready for a new job request. I.e. the function Ea_Cancel shall set the job result to MEMIF_JOB_CANCELED and the module status to MEMIF_IDLE. Note: The function Ea_Cancel and the cancel function of the underlying EEPROM driver are synchronous in their behaviour, i.e. their job is done once they return to the caller. On the other hand, they are asynchronous w.r.t. an ongoing read, erase or write job in the EEPROM memory. The cancel functions shall only reset their modules internal variables so that a new job can be accepted by the modules. They do not cancel an ongoing job in the hardware and they do not wait for an ongoing job to be finished by the hardware. This might lead to the situation in which the module's state is reported as IDLE while there is still an ongoing job being executed by the hardware. Therefore, the EEPROM driver's main function shall check that the hardware is indeed free before starting a new job.
    Ea_EraseImmediateBlock: service-id=0x09, is-synchronous=false, call-type=REGULAR, execution-context=UNSPECIFIED  # Service to erase the Block Number. | The function Ea_EraseImmediateBlock erases the block with in module Eep defined erase value. If development error detection for the module EA is enabled: the function Ea_EraseImmediateBlock shall check that the module has been initialized. If this check fails, the function Ea_EraseImmediateBlock shall raise the development error EA_E_NOT_INITIALIZED and return E_NOT_OK to the caller without performing the requested function; the function Ea_EraseImmediateBlock shall check whether the given block number is valid (i.e. inside the configured range). If this check fails, the function Ea_EraseImmediateBlock shall raise the development error EA_E_INVALID_BLOCK_NO and return E_NOT_OK to the caller without performing the requested function. Note: The function Ea_EraseImmediateBlock shall only be called by e.g. diagnostic or similar system services to pre-erase the area for immediate data if necessary.
      return type ReturnValue: direction=OUT, implementation-data-type=Std_ReturnType  # E_OK is returned if the requested job has been accepted by the module. Otherwise, E_NOT_OK is returned. | Possible reasons for Ea_eraseImmediateBlock returning E_NOT_OK are: The Given BlockNumber is Invalid. The Module is not yet initialized.
      sw service arg BlockNumber: direction=IN, implementation-data-type=uint16  # Number of logical block, also denoting start address of that block in EEPROM.
    Ea_GetJobResult: service-id=0x06, is-synchronous=true, call-type=REGULAR, execution-context=UNSPECIFIED  # Service to return the JobResult | The function Ea_GetJobResult returns the current job (last job requested by the NVRAM manager) result of Ea running. If development error detection for the module EA is enabled: the function Ea_GetJobResult shall check that the module has been initialized. If this check fails, the function Ea_GetJobResult shall raise the development error EA_E_NOT_INITIALIZED and return MEMIF_JOB_FAILED to the caller without performing the requested function.
      return type ReturnValue: direction=OUT, implementation-data-type=Std_ReturnType  # MEMIF_JOB_OK is returned if the last job has been finished successfully. MEMIF_JOB_PENDING is returned if the last job is waiting for execution or currently being executed.MEMIF_JOB_CANCELED is returned if The last job has been canceled (which means it failed).MEMIF_JOB_FAILED is returned if the last job was not finished successfully(it failed).MEMIF_BLOCK_INCONSISTENT is returned if the requested block is inconsistent it may contain corrupted data. MEMIF_BLOCK_INVALID is returned if the requested block has been invalidated,the requested operation can not be performed.
    Ea_GetStatus: service-id=0x05, is-synchronous=true, call-type=REGULAR, execution-context=UNSPECIFIED  # Service to Return the Status | The function Ea_GetStatus reads the current status of Ea running. If development error detection for the module EA is enabled: the function Ea_GetStatus shall check that the module has been initialized. If this check fails, the function Ea_GetStatus shall raise the development error EA_E_NOT_INITIALIZED and return MEMIF_UNINIT to the caller without performing the requested function. The function Ea_GetStatus shall return MEMIF_UNINIT if the module has not (yet) been initialized. The function Ea_GetStatus shall return MEMIF_IDLE if it has not currently requested a job from the underlying EEPROM driver. The function Ea_GetStatus shall return MEMIF_BUSY if it has currently requested a job from the underlying EEPROM driver. The function Ea_GetStatus shall return MEMIF_BUSY_INTERNAL, if an internal management operation is currently ongoing.
      return type ReturnValue: direction=OUT, implementation-data-type=Std_ReturnType  # MEMIF_UNINIT: The Ea Module has not been initialized (yet).MEMIF_IDLE: The Ea Module is currently idle.MEMIF_BUSY: The Ea Module is currently busy.MEMIF_BUSY_INTERNAL: The Ea Module is currently busy with internal management operations.
    Ea_GetVersionInfo: service-id=0x08, is-synchronous=true, call-type=REGULAR, execution-context=UNSPECIFIED  # Service to get the version information of this module. | The function Ea_GetVersionInfo shall return the version information of this module. The version information includes: - Module Id - Vendor Id - Vendor specific version numbers (BSW00407). The function Ea_GetVersionInfo shall be pre compile time configurable On/Off by the configuration parameter EA_VERSION_INFO_API. If development error detection for the module EA is enabled: the function EA_GetVersionInfo shall raise the development error EA_E_PARAM_ POINTER if the argument is a NULL pointer and return without any action.
      sw service arg VersioninfoPtr: category=DATA_REFERENCE, direction=OUT, sw-pointer-target-props={target-category=STRUCTURE, implementation-data-type=Std_VersionInfoType}  # Pointer to standard version information structure.
    Ea_Init: service-id=0x00, is-synchronous=true, call-type=REGULAR, execution-context=UNSPECIFIED  # Service to initialize the EEPROM abstraction module | The function Ea_Init shall initialize the EEPROM abstraction module. It sets the module state to MEMIF_IDLE and the job result to MEMIF_JOB_ OK after successful module initialization and before it returns to the caller. Note: The Ea module's user shall call the function Ea_Init before a running operation of the Ea module. Note: During the Ea_Init runs the migration prepare function for the EEPROM layout.
    Ea_InvalidateBlock: service-id=0x07, is-synchronous=true, call-type=REGULAR, execution-context=UNSPECIFIED  # Service to invalidate the BlockNumber | The function Ea_InvalidateBlock shall take the block number and calculate the corresponding memory write address, invalidate the block. If development error detection for the module Ea is enabled: the function Ea_InvalidateBlock shall check that the module has been initialized. If this check fails, the function Ea_InvalidateBlock shall raise the development error EA_E_NOT_INITIALIZED and return E_NOT_OK to the caller without performing the requested function; the function Ea_InvalidateBlock shall check whether the given block number is valid (i.e. inside the configured range). If this check fails, the function Ea_InvalidateBlock shall raise the development error EA_E_INVALID_BLOCK_NO and return E_NOT_OK to the caller without performing the requested function. Note: for redundant blocks, it invalidates all copies of block. Note: for invalidating block, block version will be incremented as usual.
      return type ReturnValue: direction=OUT, implementation-data-type=Std_ReturnType  # E_OK is returned if the requested job has been accepted by the module. Otherwise, E_NOT_OK is returned. | Possible reasons for Ea_InvalidateBlock returning E_NOT_OK are: The given BlockNumber is Invalid. The Module has not yet been initialized.
      sw service arg BlockNumber: direction=IN, implementation-data-type=uint16  # Number of logical block, also denoting start address of that block in EEPROM.
    Ea_MainFunction: service-id=0x12, is-synchronous=true, call-type=SCHEDULED, execution-context=TASK  # Service to perform the processing of the EEPROM jobs (read/write/erase/compare) . | Service to handle the requested jobs and the internal management operations.
    Ea_Rb_BlockMaintenance: service-id=0x0a, is-synchronous=true, call-type=REGULAR, execution-context=UNSPECIFIED  # Service to handle the requested jobs and the internal management operations. | The function Ea_Rb_BlockMaintenance shall take the redundant block number and repair the corresponding data of both two copies. The function Ea_Rb_BlockMaintenance shall copy the given / computed parameters to module internal variables, initiate a maintain job, set the EA module status to MEMIF_BUSY, set the job result to MEMIF_JOB_PENDING and return with E_OK. The EA module shall execute the maintain job of the function Ea_Rb_BlockMaintenance asynchronously within the EA module's main function. The function Ea_Rb_BlockMaintenance shall detect the corrupted data copy and repair it with the right data from another copy. It changes nothing if both of copies are corrupted or both have the right data. If development error detection for the module EA is enabled: the function Ea_Rb_BlockMaintenance shall check that the module has been initialized. If this check fails, the function Ea_Rb_BlockMaintenance shall raise the development error EA_E_NOT_INITIALIZED and return E_NOT_OK to the caller without performing the requested function; The function Ea_Rb_BlockMaintenance shall check whether the given block number is valid and redundant (i.e. inside the configured range). If this check fails, the function Ea_Rb_BlockMaintenance shall raise the development error EA_E_INVALID_BLOCK_NO and return E_NOT_OK to the caller without performing the requested function.
      return type ReturnValue: direction=OUT, implementation-data-type=Std_ReturnType  # E_OK is returned if the requested job has been accepted by the module.. Otherwise, E_NOT_OK is returned. | Possible reasons for Ea_Rb_BlockMaintenance returning E_NOT_OK are: The given BlockNumber is Invalid. The Module has not yet been initialized.
      sw service arg BlockNumber: direction=IN, implementation-data-type=uint16  # Number of logical block, also denoting start address of that block in EEPROM.
    Ea_Rb_EndInit: service-id=0xff, is-synchronous=true, call-type=REGULAR, execution-context=UNSPECIFIED  # Service To indicate the end of the system's init phase and therefore allow the Ea to start migration if necessary. | This function indicates the end of the system's init phase and therefore allows the Ea to start migration if necessary. This function should be placed when the period of a necessary fast start-up is finished, e.g. after calling NvM_ReadAll. This function should also be called right after the Ea_Init() function in case the system uses the initialization function inside a power down service (e.g. Shutdown). Otherwise migration will not be formed inside this system state anymore. NOTE: Service Id is given for this function only to avoid validation Error.
    Ea_Read: service-id=0x02, is-synchronous=true, call-type=REGULAR, execution-context=UNSPECIFIED  # Service to Read Length bytes of block Blocknumber at offset BlockOffset into the buffer DataBufferPtr. | If the user data length is not equal to the configured data length during a read order, the order should not be rejected but the smaller amount of bytes should be transfered instead and the rest of the bytes should be filled up with zeros. - RAM data length > EEPROM data length: Copy available EEPROM data to begin of target RAM and fill remaining RAM with a configurable default initialization value - RAM data length < EEPROM data length: Copy available EEPROM data to begin of target RAM and cut exceeding data If development error detection for the module EA is enabled: the function Ea_Read shall check that the module has been initialized. If this check fails, the function Ea_Read shall raise the development error EA_E_NOT_INITIALIZED and return E_NOT_OK to the caller without performing the requested function; the function Ea_Read shall check whether the given block number is valid (i.e. inside the configured range). If this check fails, the function Ea_Read shall raise the development error EA_E_INVALID_BLOCK_NO and return E_NOT_OK to the caller without performing the requested function.
      return type ReturnValue: direction=OUT, implementation-data-type=Std_ReturnType  # E_OK is returned if the read command has been accepted successfully. Otherwise, E_NOT_OK is returned. | Possible reasons for Ea_Read returning E_NOT_OK are: The given BlockNumber is Invalid The Module has not yet been initialized.
      4 x sw service arg:
        BlockNumber: direction=IN, implementation-data-type=uint16  # Number of logical block, also denoting start address of that block in EEPROM
        BlockOffset: direction=IN, implementation-data-type=uint16  # Read address offset inside the block
        DataBufferPtr: category=DATA_REFERENCE, direction=OUT, sw-pointer-target-props={target-category=VALUE, implementation-data-type=uint8}  # Pointer to data buffer
        Length: direction=IN, implementation-data-type=uint16  # Number of bytes to read
    Ea_SetMode: service-id=0x01, is-synchronous=true, call-type=REGULAR, execution-context=UNSPECIFIED  # Service to set the Mode. | The function Ea_SetMode shall be enabled / disabled via the pre-compile time parameter EaSetModeSupported such that the function is completely removed from the code if it is disabled. If development error detection for the module EA is enabled: the function Ea_SetMode checks that the module has been initialized. If this check fails, the function Ea_SetMode will raise the development error EA_E_NOT_INITIALIZED and return without performing the requested function. It sets the transfer mode of underlying hardware, so it calls the "Eep_SetMode" function of the EEPROM driver with the gven "Mode" parameter. Note: For an Eep module driving an external EEPROM through SPI: there is no burst access defined by SPI, so it has no effect on this setting for the HW speed. But if it is set with fast mode for write order, no data compare is necessary before and after writing. The write time will be faster than slow mode.
      sw service arg Mode: direction=IN, implementation-data-type=MemIf_ModeType  # Desired mode for the underlying EEPROM driver
    Ea_Rb_EnterStopMode: service-id=0x17, is-synchronous=false, call-type=REGULAR, execution-context=UNSPECIFIED  # Ea_Rb_EnterStopMode function shall be called by rba_FeeAddOnAS module to request Ea to enter into Stop Mode.This request shall be processed Asynchronously. | Ea_Rb_EnterStopMode API shall be called only by rba_FeeAddOnAS Module.
      return type ReturnValue: direction=OUT, implementation-data-type=Std_ReturnType  # E_OK: Order was accepted. E_NOT_OK: Order was not accepted
    Ea_Rb_GetAdapterJobResult: service-id=0x16, is-synchronous=true, call-type=REGULAR, execution-context=UNSPECIFIED  # Ea_Rb_GetAdapterJobResult function returns the Job Result of Ea_Rb_EnterStopMode request. | Ea_Rb_GetAdapterJobResult API shall be called only by rba_FeeAddOnAS Module.
      return type ReturnValue: direction=OUT, implementation-data-type=MemIf_JobResultType  # MEMIF_JOB_OK: The last job has been finished successfully. MEMIF_JOB_PENDING: The last job is waiting for execution or currently being executed. MEMIF_JOB_FAILED: The last job was not finished successfully (it failed).
    Ea_Write: service-id=0x03, is-synchronous=true, call-type=REGULAR, execution-context=UNSPECIFIED  # Service to Write the contents of the DataBufferPtr to the block BlockNumber. | The function Ea_Write shall take the block number and calculate the corresponding memory write address. The block offset shall be fixed to zero for this address calculation. The function Ea_Write shall copy the given / computed parameters to module internal variables, initiate a write job, set the EA module status to MEMIF_BUSY, set the job result to MEMIF_JOB_PENDING and return with E_OK. The EA module shall execute the write job of the function Ea_Write asynchronously within the EA module's main function. The function Ea_Write shall set the length parameter for the write job to the length configured for this logical block. If development error detection for the module EA is enabled: the function Ea_Write shall check that the module has been initialized. If this check fails, the function Ea_Write shall raise the development error EA_E_NOT_INITIALIZED and return E_NOT_OK to the caller without performing the requested function; The function Ea_Write shall check whether the given block number is valid (i.e. inside the configured range). If this check fails, the function Ea_Write shall raise the development error EA_E_INVALID_BLOCK_NO and return E_NOT_OK to the caller without performing the requested function.
      return type ReturnValue: direction=OUT, implementation-data-type=Std_ReturnType  # E_OK is returned if the Write command has been accepted successfully. Otherwise, E_NOT_OK is returned. | Possible reasons for Ea_write returning E_NOT_OK are: The given BlockNumber is Invalid and redundant. The Module has not yet been Initialized.
      sw service arg BlockNumber: direction=IN, implementation-data-type=uint16  # Number of logical block, also denoting start address of that block in EEPROM.
      sw service arg DataBufferPtr: category=DATA_REFERENCE, direction=IN, sw-pointer-target-props={target-category=VALUE, implementation-data-type=uint8}  # Pointer to data buffer
    Ea_Rb_MigrationStatus: service-id=0xfe, is-synchronous=true, call-type=REGULAR, execution-context=UNSPECIFIED  # The function Ea_Rb_MigrationStatus returns the Migration/Defragmentation status to user. | This function is applicable for both rba_EaFs1 and rba_EaFs2.In rba_EaFs1 component the design concept used for layout change is called as Migration.In rba_EaFs2 component the design concept used for layout change is called as defragmentation. Inorder to keep the backward compatibility the "Ea_Rb_MigrationStatus" function will now return layout change status for both rba_EaFs1 and rba_EaFs2 component, the return values(i.e the MACROS) are common for both rba_EaFs1 and rba_EaFs2 component.This function should not be called before calling Ea_Init. If the configured layout and layout present in Eeprom Hardware is same then it will return EA_RB_MIGRATION_NOTNEEDED.If Configured layout and layout present in Eeprom Hardware is different then it will return the status as EA_RB_MIGRATION_RUNNING.Once Migration/Defragmentation is completed successfully it will return EA_RB_MIGRATION_FINISHED.if Migration/Defragmentation is not completed successfully then it will return EA_RB_MIGRATION_ERROR.This function is not applicable for bootmode.The Migration/Defragmentation will be started only after the call of Ea_Rb_EndInit function.
      return type ReturnValue: direction=OUT, implementation-data-type=uint8  # Returns the Migration/Defragmentation status | EA_RB_MIGRATION_NOTNEEDED : Configured layout and layout present in Eeprom Hardware is same. EA_RB_MIGRATION_RUNNING : Configured layout and layout present in Eeprom Hardware is different and layout change is ongoing. EA_RB_MIGRATION_FINISHED : Migration/Defragmentation is completed successfully. EA_RB_MIGRATION_ERROR : Migration/Defragmentation is not successful. EA_RB_MIGRATION_FORCEDRUNNING : Forced Defragmentation is triggerred via rba_FeeAddOnAS Module
    Ea_Rb_MainFunctionAndDependency: is-synchronous=true, call-type=REGULAR, execution-context=UNSPECIFIED  # Service to perform the processing of the EEPROM jobs and invocation of its dependency. | Service invokes Ea MainFunction and its dependency typically Eep.
    Ea_Rb_ErrorHandling_CallBackFunction: is-synchronous=true, call-type=CALLBACK, execution-context=UNSPECIFIED  # CallBack function from the user for Error handling. | It is a module-specific callback routine which shall be invoked if critical error in Ea occurs, for example migration not successful or not possible, so that some block can't been written any more.
      sw service arg ErrorId: direction=IN, implementation-data-type=uint8  # Parameter to store the Error Id.
