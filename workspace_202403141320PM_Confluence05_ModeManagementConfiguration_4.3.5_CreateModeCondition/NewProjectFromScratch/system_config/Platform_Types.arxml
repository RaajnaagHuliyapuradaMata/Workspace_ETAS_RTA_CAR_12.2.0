AUTOSAR XML (schema 4-2-2)
standard types defined: boolean, uint8, uint16, uint32, uint64, sint8, sint16, sint32, sint64, float32, float64, uint8_least, uint16_least, uint32_least, sint8_least, sint16_least, sint32_least
package /AUTOSAR_Platform/ImplementationDataTypes  # AUTOSAR Platform types
  impl type VoidPtr: category=VALUE, base-type=void, type-emitter=Platform_Types  # Void Pointer | This standard AUTOSAR type shall be a void pointer.
  impl type ConstVoidPtr: category=VALUE, base-type=void, type-emitter=Platform_Types  # Constant Void Pointer | This standard AUTOSAR type shall be a void pointer to const.
