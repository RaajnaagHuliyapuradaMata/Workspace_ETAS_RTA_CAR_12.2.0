AUTOSAR XML (schema 00048)
package /AUTOSAR_CanTrcv/EcucModuleDefs
  module definition CanTrcv [0..*]: category=VENDOR_SPECIFIC_MODULE_DEFINITION, post-build-variant-support=true, refined-module-def=CanTrcv, variants link-time/post-build/pre-compile  # Configuration of the CanTrcv (CAN Transceiver driver) module.
    container CanTrcvConfigSet  # This container contains the configuration parameters and sub containers of the AUTOSAR WdgM module.
      integer CanTrcvSPICommRetries [0..1]: 0..255, post-build-variant-value=true, set at link in variant link-time / post-build in variant post-build / pre-compile in variant pre-compile, default-value=0  # Indicates the maximum number of communication retries in case of a failed SPI communication (applies both to timed out communication and to er-rors/NACK in the response data). | If configured value is 0, no retry is allowed (communication is expected to succeed at first try).
      integer CanTrcvSPICommTimeout [0..1]: 0..100, post-build-variant-value=true, set at link in variant link-time / post-build in variant post-build / pre-compile in variant pre-compile, default-value=0  # Indicates the maximum time allowed to the CanTrcv for replying (either positively or negatively) to a SPI command. | Timeout is configured in milliseconds. Timeout value of '0' means that no specific timeout is to be used by CanTrcv and the communication is executed at the best of the SPI HW capacity.
      container CanTrcvChannel [1..*]  # Container gives CAN transceiver driver information about a single CAN | transceiver (channel).
        integer CanTrcvChannelId: 0..255, scope=ECU, set at pre-compile, symbolic-name-value=true, with-auto=true  # Unique identifier of the CAN Transceiver Channel.
        string CanTrcvRbCddName [0..1]: origin=RB, set at pre-compile  # Only used if CDD is choosen as HardwareType. A separate freetext field which is used to generate function calls out of CanTrcv into the CDD and to include the corresponding .h file. E:G. if "rba_IoExtCy321" is configured, the CanTrcv code generator generates function calls "rba_IoExtCy321_CanTrcvSetOpMode", "rba_IoExtCy321_CanTrcvGetOpMode", "rba_IoExtCy321_CanTrcvGetBusWuReason", "rba_IoExtCy321_CanTrcvSetWakeupMode" and includes the file rba_IoExtCy321.h.
        boolean CanTrcvRbCddInitApiUsed [0..1]: origin=RB, set at pre-compile  # To be enabled if a CDD Init API is available for this channel
        boolean CanTrcvRbCddMainApiUsed [0..1]: origin=RB, set at pre-compile  # To be enabled if a CDD Main function API is available for this channel
        boolean CanTrcvRbCddGetBusWakeUpReasonApiUsed [0..1]: origin=RB, set at pre-compile  # To be enabled if a CDD Get Bus Wakeup reason API is available for this channel
        boolean CanTrcvRbCddSetWakeupModeApiUsed [0..1]: origin=RB, set at pre-compile  # To be enabled if a CDD Set Wakeup mode API is available for this channel
        boolean CanTrcvRbCddCheckWakeupApiUsed [0..1]: origin=RB, set at pre-compile  # To be enabled if a CDD Check Wakeup API is available for this channel
        integer CanTrcvRbCddModeChangeDelay [0..1]: 1..255, origin=RB, set at pre-compile  # This parameter need to be configured only if unexpected Mode Propogation monitoring for Transceiver is enabled. Here user need to specify the minimum delay required to set the requested mode of transcier. User have to enter the number in the multiples of main fucntion duration. For example if Main funtion is scheduled in 10ms task and minimum time required to change the transceiver mode is 20ms then configure this parameter as 2 .
        boolean CanTrcvChannelUsed: set at pre-compile, default-value=true  # Shall the related CAN transceiver channel be used?
        boolean CanTrcvControlsPowerSupply: set at pre-compile, default-value=false  # Is ECU power supply controlled by this transceiver? | TRUE = Controlled by transceiver. FALSE = Not controlled by transceiver.
        enumeration CanTrcvRbHardwareType: {TJA1040, TJA1041, TJA1042, TJA1044GT, TJA1043, TJA1463, TJA1046TK, TJA1048, TCAN1466, TJA1145, TLE9255, ATA6570, ATA6571, ATA6572, TLE6250G, TLE6250GV33, TLE6251, TLE8250GVIO, CDD, CY327, CS9XX}, scope=ECU, origin=RB, set at pre-compile  # Selects the Type of the Cantrcv Hardware used The below list provides the similar devices which can be selected from the drop down list in the configuration. TJA1043 ------- TJA1443/TJA1443ATK/TJA1463ATK/TCAN1043A-Q1/TCAN1463-Q1 TJA1044GT ------- TJA1442/TJA1442ATK/TJA1462ATK/TCAN1044A-Q1/TCAN1462-Q1 TJA1059 ------- TCAN1466
        boolean CanTrcvHwPnSupport: set at pre-compile, default-value=false  # Indicates whether the HW supports the selective wake-up function | TRUE = Selective wakeup feature is supported by the transceiver FALSE = Selective wakeup functionality is not available in transceiver
        enumeration CanTrcvInitState: {CANTRCV_OP_MODE_SLEEP, CANTRCV_OP_MODE_STANDBY}, set at pre-compile  # State of CAN transceiver after call to CanTrcv_Init.
        integer CanTrcvMaxBaudrate: 0..12000, set at pre-compile  # Indicates the data transfer rate in kbps. | Maximum data transfer rate in kbps for transceiver hardware type. Only used for validation purposes. This value can be used by configuration tools.
        boolean CanTrcvWakeupByBusUsed [0..1]: multiplicity set at pre-compile, set at pre-compile, default-value=false  # Is wake up by bus supported? If CAN transceiver hardware does not support wake up by bus value is always FALSE. If CAN transceiver hardware supports wake up by bus value is TRUE or FALSE depending whether it is used or not. | TRUE = Is used. FALSE = Is not used.
        reference CanTrcvChannelEcucPartitionRef [0..0]: scope=ECU, multiplicity set at pre-compile, post-build-variant-multiplicity=true, post-build-variant-value=true, set at pre-compile, destination=EcucPartition  # (Currently Not Supported) Maps the CAN transceiver channel to zero or one ECUC partitions. The ECUC partition referenced is a subset of the ECUC partitions where the CAN transceiver driver is mapped to.
        reference CanTrcvIcuChannelRef [0..1]: multiplicity set at pre-compile, set at pre-compile, requires-symbolic-name-value=true, destination=IcuChannel  # Reference to the IcuChannel to enable/disable the interrupts | for wakeups.
        reference CanTrcvPorWakeupSourceRef [0..1]: scope=ECU, multiplicity set at pre-compile, set at pre-compile, requires-symbolic-name-value=true, destination=EcuMWakeupSource  # Symbolic name reference to specify the wakeup sources that should be used in the calls to EcuM_SetWakeupEvent as specified in [SWS_CanTrcv_00183] and [SWS_CanTrcv_00184]. | This reference is mandatory if the HW supports POR or SYSERR flags
        reference CanTrcvPinWakeupSourceRef [0..1]: scope=ECU, multiplicity set at pre-compile, origin=RB, set at pre-compile, requires-symbolic-name-value=true, destination=EcuMWakeupSource  # Symbolic name reference to specify the wakeup sources that should be used in the calls to EcuM_SetWakeupEvent for wakeup by PIN. | This reference is mandatory if the HW supports PIN wakeup
        reference CanTrcvSyserrWakeupSourceRef [0..0]: scope=ECU, multiplicity set at pre-compile, set at pre-compile, requires-symbolic-name-value=true, destination=EcuMWakeupSource  # (Currently Not Supported)Symbolic name reference to specify the wakeup sources that should be used in the calls to EcuM_SetWakeupEvent as specified in [SWS_CanTrcv_00183] | This reference is mandatory if the HW supports POR or SYSERR flags
        reference CanTrcvWakeupSourceRef [0..1]: scope=ECU, multiplicity set at pre-compile, set at pre-compile, requires-symbolic-name-value=true, destination=EcuMWakeupSource  # Reference to a wakeup source in the EcuM configuration. | This reference is only needed if CanTrcvWakeupByBusUsed is true.
        choice container CanTrcvAccess [0..1]  # Container gives CanTrcv Driver information about access to a single CAN transceiver.
          container CanTrcvDioAccess [0..1]  # Container gives CAN transceiver driver information about accessing ports and port pins. In addition relation between CAN transceiver hardware pin names and Dio port access information is given. | If a CAN transceiver hardware has no Dio interface, there is no instance of this container.
            container CanTrcvDioChannelAccess [1..*]  # Container gives DIO channel access by single Can transceiver channel.
              enumeration CanTrcvRbDioHardwareInterfaceType: {Enable, Standby, ErrorPin, WakeupSignalisation, Inhibit}, origin=RB, set at pre-compile  # This Rb parameter defines functionality of DIO pin. The trcv-software uses this parameter to know particular functionality of the referenced Dio Pin connected to the Trcv-HW. | DIO pins of tranceiver are configured with Enable, Standby, ErrorPin, WakeupSignalisation or Inhibhit
              boolean CanTrcvRbHardwarePinInvert [0..1]: multiplicity set at pre-compile, origin=RB, set at pre-compile, default-value=false  # Parameter depends on hardware: Describes, if a inverter is between transceiver pin and micro controller. If the transceiver is directly connected to the Controller, 'false' should be configured. If there is an inverter between transceiver and micro controller, 'yes' should be configured. | false: No inverter between Micro Controller and transceiver true : Inverter between Micro Controller and transceiver Ex: TJA1059/TCAN1466 can be selected and is compatible for TCAN1048AV-Q1 as well with Stby pin invert set as True
              string CanTrcvHardwareInterfaceName: set at pre-compile  # CAN transceiver hardware interface name. It is typically the name of a pin. From a Dio point of view it is either a port, a single channel or a channel group. | CANTRCV_DIO_PORT_SYMBOLIC_NAME or CANTRCV_DIO_CHANNEL_SYMBOLIC_NAME or CANTRCV_DIO_CHANNEL_GROUP_SYMBOLIC_NAME shall reference a Dio configuration. The CAN transceiver driver implementation description shall list up this name for the appropriate CAN transceiver hardware.
              choice reference CanTrcvDioSymNameRef: set at pre-compile, destination=[DioChannel, DioChannelGroup, DioPort]  # Choice Reference to a DIO Port, DIO Channel or DIO Channel Group. This reference replaces the CANTRCV_DIO_PORT_SYM_NAME, CANTRCV_DIO_CHANNEL_SYM_NAME and CANTRCV_DIO_GROUP_SYM_NAME references in the Can Trcv SWS.
          container CanTrcvSpiAccess [0..1]  # Container gives CAN transceiver driver information about accessing Spi. If a CAN transceiver hardware has no Spi interface, there is no instance of this container.
            boolean CanTrcvRbWPFE [0..1]: origin=RB, set at pre-compile, default-value=true  # false: falling-edge detection on WAKE pin disabled true falling-edge detection on WAKE pin enabled This param is placed here as Tja1145param container is removed in resturcutured code
            boolean CanTrcvRbWPRE [0..1]: origin=RB, set at pre-compile, default-value=true  # false: rising-edge detection on WAKE pin disabled true rising-edge detection on WAKE pin enabled This param is placed here as Tja1145param container is removed in resturcutured code
            boolean CanTrcvRbToggleRxD [0..1]: origin=RB, set at pre-compile, default-value=false  # false: The RxD Pin will be constant “low” true The RxD Pin will toggle between “low” and “high” This param is only applicable for TLE9255 CanTrcv
            container CanTrcvSpiSequence [1..*]  # Container gives CAN transceiver driver information about one SPI sequence. | One SPI sequence used by CAN transceiver driver is in exclusive use for it. No other driver is allowed to access this sequence. CAN transceiver driver may use one sequence to access n CAN transceiver hardwares chips of the same type or n sequences are used to access one single CAN transceiver hardware chip. If a CAN transceiver hardware has no SPI interface, there is no instance of this container.
              boolean CanTrcvSpiAccessSynchronous [0..1]: multiplicity set at pre-compile, set at pre-compile, default-value=false  # This parameter is used to define whether the access to the Spi sequence is synchronous or asynchronous. | true: SPI access is synchronous. false: SPI access is asynchronous.
              reference CanTrcvSpiSequenceName [0..*]: multiplicity set at pre-compile, set at pre-compile, requires-symbolic-name-value=true, destination=SpiSequence  # Reference to a Spi sequence configuration container.
        container CanTrcvDemEventParameterRefs [0..1]  # Container for the references to DemEventParameter elements which shall be invoked using the API Dem_SetEventStatus in case the corresponding error occurs. The EventId is taken from the referenced DemEventParameter's DemEventId symbolic value. The standardized errors are provided in this container and can be extended by vendor-specific error references.
          enumeration CanTrcvRbDynCreate_DemEvents [0..1]: {Disabled, Standard}, origin=RB, set at pre-compile, default-value=Disabled  # Dynamically create DemEvent | Selects the way how the example DemEvent is created. If not set or set to Disabled, no such DemEvent is automatically created. If the dynamic creation of this DemEvent is enabled, the reference to this DemEvent (in parameter rba_Example_DemEventRef) is also automatically created and shall therefore not be set manually.
          reference CANTRCV_RB_E_UNEXPECTED_MODE_PROP [0..1]: scope=ECU, multiplicity set at pre-compile, origin=RB:v4.1.0:2018-2-28, set at pre-compile, destination=DemEventParameter  # Reference to the DemEventParameter which shall be issued when the unexpected mode propogation is detcted in Transceiver HW.
        container CanTrcvPartialNetwork [0..1]  # Container gives CAN transceiver driver information about the configuration of Partial Networking functionality.
          integer CanTrcvBaudRate: 0..12000, post-build-variant-value=true, set at link in variant link-time / post-build in variant post-build / pre-compile in variant pre-compile  # Indicates the data transfer rate in kbps.
          boolean CanTrcvBusErrFlag: post-build-variant-value=true, set at link in variant link-time / post-build in variant post-build / pre-compile in variant pre-compile, default-value=false  # Indicates if the Bus Error (BUSERR) flag is managed by the BSW. This flag is set if a bus failure is detected by the transceiver. | TRUE = Supported by transceiver and managed by BSW. FALSE = Not managed by BSW.
          boolean CanTrcvPnCanIdIsExtended: post-build-variant-value=true, set at link in variant link-time / post-build in variant post-build / pre-compile in variant pre-compile, default-value=false  # Indicates whether extended or standard ID is used. | TRUE = Extended Can identifier is used. FALSE = Standard Can identifier is used
          boolean CanTrcvPnEnabled: post-build-variant-value=true, set at link in variant link-time / post-build in variant post-build / pre-compile in variant pre-compile, default-value=false  # Indicates whether the selective wake-up function is enabled or disabled in HW. | TRUE = Selective wakeup feature is enabled in the transceiver hardware FALSE = Selective wakeup feature is disabled in the transceiver hardware
          integer CanTrcvPnFrameCanId: 0..4294967295, post-build-variant-value=true, set at link in variant link-time / post-build in variant post-build / pre-compile in variant pre-compile  # CAN ID of the Wake-up Frame (WUF).
          integer CanTrcvPnFrameCanIdMask: 0..4294967295, post-build-variant-value=true, set at link in variant link-time / post-build in variant post-build / pre-compile in variant pre-compile  # ID Mask for the selective activation of the transceiver. It is used to enableFrame Wake-up (WUF) on a group of IDs.
          integer CanTrcvPnFrameDlc: 0..8, post-build-variant-value=true, set at link in variant link-time / post-build in variant post-build / pre-compile in variant pre-compile  # Data Length of the Wake-up Frame (WUF).
          boolean CanTrcvPowerOnFlag: post-build-variant-value=true, set at link in variant link-time / post-build in variant post-build / pre-compile in variant pre-compile, default-value=false  # Description: Indicates if the Power On Reset (POR) flag is available and is managed by the transceiver. | TRUE = Supported by Hardware. FALSE = Not supported by Hardware
          container CanTrcvPnFrameDataMaskSpec [0..8]  # Defines data payload mask to be used on the received payload in order to determine if the transceiver must be woken up by the received Wake-up Frame (WUF).
            integer CanTrcvPnFrameDataMask: 0..255, post-build-variant-value=true, set at link in variant link-time / post-build in variant post-build / pre-compile in variant pre-compile  # Defines the n byte (Byte0 = LSB) of the data payload mask to be used on the received payload in order to determine if the transceiver must be woken up by the received Wake-up Frame (WUF).
            integer CanTrcvPnFrameDataMaskIndex: 0..7, post-build-variant-value=true, set at link in variant link-time / post-build in variant post-build / pre-compile in variant pre-compile  # holds the position n in frame of the mask-part
    container CanTrcvGeneral  # Container gives CAN transceiver driver basic information.
      boolean CanTrcvDevErrorDetect: set at pre-compile, default-value=false  # Switches the development error detection and notification on or off. | * true: detection and notification is enabled. * false: detection and notification is disabled.
      boolean CanTrcvRbCddTrcvIdUsed [0..1]: origin=RB, set at pre-compile, default-value=false  # Enable/disable CanTrcv Channel Id being passed for cdd | * true: Channel Id to be passed * false: Channel Id not passed.
      boolean CanTrcvRbOpModeImmediate [0..1]: multiplicity set at pre-compile, origin=RB, set at pre-compile, default-value=false  # Enable/disable RB specific CanTrcv_SetOpMode_Immediate, CanTrcv_GetOpMode_Immediate APIs | TRUE = Is used. FALSE = Is not used.
      boolean CanTrcvRbGetError [0..1]: multiplicity set at pre-compile, origin=RB, set at pre-compile, default-value=false  # RB Specific API to read Error pin/Status register | TRUE = Is used. FALSE = Is not used.
      integer CanTrcvIndex: 0..255, set at pre-compile  # Specifies the InstanceId of this module instance. If only one instance is present it shall have the Id 0.
      float CanTrcvMainFunctionDiagnosticsPeriod [0..1]: 0..INF, multiplicity set at pre-compile, set at pre-compile  # This parameter describes the period for cyclic call to CanTrcv_MainFunctionDiagnostics. Unit is seconds.
      float CanTrcvMainFunctionPeriod [0..1]: 0..INF, multiplicity set at pre-compile, set at pre-compile  # This parameter describes the period for cyclic call to CanTrcv_MainFunction. Unit is seconds.
      enumeration CanTrcvTimerType [0..1]: {None, Timer_1us16bit}, multiplicity set at pre-compile, set at pre-compile  # Type of the Time Service Predefined Timer.
      boolean CanTrcvVersionInfoApi: set at pre-compile, default-value=false  # Switches version information API on and off. If switched off, function need not be present in compiled code.
      float CanTrcvWaitTime [0..1]: 0..2.55E-4, multiplicity set at pre-compile, set at pre-compile  # Wait time for transceiver state changes in seconds.
      enumeration CanTrcvWakeUpSupport: {CANTRCV_WAKEUP_BY_POLLING, CANTRCV_WAKEUP_NOT_SUPPORTED}, set at pre-compile  # Informs whether wake up is supported by polling or not supported. In case no | wake up is supported by the hardware, setting has to be NOT_SUPPORTED. Only in the case of wake up supported by polling, function CanTrcv_MainFunction has to be present and to be invoked by the scheduler.
      reference CanTrcvEcucPartitionRef [0..0]: scope=ECU, multiplicity set at pre-compile, post-build-variant-multiplicity=true, post-build-variant-value=true, set at pre-compile, destination=EcucPartition  # (Currently Not Supported.) Maps the CAN transceiver driver to zero or multiple ECUC partitions to make the modules API available in this partition. The module will operate as an independent instance in each of the partitions.
