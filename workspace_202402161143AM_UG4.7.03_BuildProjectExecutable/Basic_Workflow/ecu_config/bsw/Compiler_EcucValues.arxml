AUTOSAR XML (schema 00051)
package /ETAS_Project/EcucModuleConfigurationValuess
  module config Compiler_0: definition=Compiler
    CompilerRbSettings_0 (CompilerRbSettings):
      CompilerRbInlineDefinition = __attribute__((always_inline)) inline
      CompilerRbLocalInlineDefinition = __attribute__((always_inline)) static inline
      CompilerRbCompilerAbstraction = DEACTIVATE
