AUTOSAR XML (schema 00051)
package /OS
  module config Os
    OSDEFAULTAPPMODE (OsAppMode)
    OsOS: OsStackMonitoring=false, OsUseGetServiceId=true, OsUseParameterAccess=true, OsUseResScheduler=true, OsStatus=STANDARD
      OsHooks: OsErrorHook=true, OsPostTaskHook=false, OsPreTaskHook=false, OsProtectionHook=false, OsShutdownHook=true, OsStackFaultHook=false, OsStartupHook=true
    OsRTATarget: OsRTATargetName=VRTA, OsRTATargetVariant=MinGW
    OsTask_ASW (OsTask): OsTaskPriority=1, OsTaskActivation=1, OsTaskSchedule=FULL
    OsTask_BSW (OsTask): OsTaskPriority=2, OsTaskActivation=1, OsTaskSchedule=FULL
