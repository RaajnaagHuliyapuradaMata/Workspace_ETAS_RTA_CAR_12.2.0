AUTOSAR XML (schema 00050)
package /AUTOSAR/EcucDestinationUriDefSets
  ecuc destination uri def set RteRipsUriDefSet
    ecuc destination uri def RteRipsInvocationHandler
      destination-uri-policy destination-uri-nesting-contract=LEAF-OF-TARGET-CONTAINER:
        container RteRipsInvocationHandlerFnc [0..*]: multiplicity set at pre-compile  # This container describes an invocation handler function implemented by an RTE Implementation Plug-In to handle the invocation of server runnables and triggered runnables via a transformer.
          function name RteRipsInvocationHandlerFncSymbol: set at pre-compile  # C-Symbol of the Rte_Rips_FillFlushRoutine function.
    ecuc destination uri def RteRipsPlugin
      destination-uri-policy destination-uri-nesting-contract=TARGET-CONTAINER:
        container RteRipsPluginProps  # This container defines the identity of the Rte Implementation Plug-in and provides the RTE relevant parameters of the Rte Implementation Plug-in. | The shortName of the container defines the name of the Rte Implementation Plug-in used for the API infixes.
          boolean RtePluginSupportsIReadIWrite: set at pre-compile, default-value=false  # Denotes if or if not the plug-in supports the Rte_Rips_IRead/IWrite macros for primitive data.
          enumeration RteRipsGlobalCopyInstantiationPolicy: {RTE_RIPS_INSTANTIATION_BY_PLUGIN, RTE_RIPS_INSTANTIATION_BY_RTE}, set at pre-compile, default-value=RTE_RIPS_INSTANTIATION_BY_RTE  # Globally enables or disables the support for Rte Implementation Plug-Ins (RIPS)
          enumeration RteRipsPluginCommunicationScope [0..1]: {RTE_RIPS_CROSS_SW_CLUSTER_COM, RTE_RIPS_LOCAL_SW_CLUSTER_COM}, set at pre-compile, default-value=RTE_RIPS_LOCAL_SW_CLUSTER_COM  # Defines the communication scope for which the Rte Implementation Plug-Ins (RIPS) serves. If this parameter is not set, the default behavior RTE_RIPS_LOCAL_SW_CLUSTER_COM applies.
          container RteRipsPluginCommunicationTypeSupport [0..1]: multiplicity set at pre-compile  # This container defines the different elements of communication graphs that the plugin is responsible for. Tags: atp.Status=draft
            enumeration RteRipsPluginCommunicationType [1..*]: scope=ECU, multiplicity set at pre-compile, set at pre-compile  # The type of the communication. Tags: atp.Status=draft
              INTER_ECU  # Tags: atp.Status=draft
              INTER_PARTITION  # Tags: atp.Status=draft
              INTRA_PARTITION  # Tags: atp.Status=draft
    ecuc destination uri def RteRipsPluginFillFlushRoutine
      destination-uri-policy destination-uri-nesting-contract=TARGET-CONTAINER:
        container RteRipsPluginFillFlushRoutineFnc [0..*]: multiplicity set at pre-compile  # This container describes a Fill-Flush Routine function implemented by a RTE Implementation Plug-In to handle the buffering for implicit communication.
          enumeration RteRipsModeDisablingHandling: {RTE_RIPS_CONSIDER_MODE_DISABLINGS, RTE_RIPS_IGNORE_MODE_DISABLINGS}, set at pre-compile  # This parameter configures whether mode disabling dependencies are considered for the invocation of Rte_Rips_FillFlushRoutines.
          enumeration RteRipsOsSchedulePoint [0..1]: {NONE, UNCONDITIONAL}, multiplicity set at pre-compile, set at pre-compile  # Introduce a schedule point by explicitly calling Os Schedule service after the execution of the Rte_Rips_FillFlushRoutine.
          function name RteRipsPluginFillFlushRoutineSymbol: origin=ETAS, set at pre-compile  # C-Symbol of the Rte_Rips_FillFlushRoutine function.
