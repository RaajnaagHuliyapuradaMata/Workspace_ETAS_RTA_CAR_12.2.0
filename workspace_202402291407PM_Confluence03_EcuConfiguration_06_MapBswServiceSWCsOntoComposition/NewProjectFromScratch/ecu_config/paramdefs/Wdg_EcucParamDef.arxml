AUTOSAR XML (schema 00048)
package /AUTOSAR_Wdg/EcucModuleDefs
  module definition Wdg [0..*]: category=VENDOR_SPECIFIC_MODULE_DEFINITION, post-build-variant-support=true, refined-module-def=Wdg, variants pre-compile  # MCAL Watchdog driver | Configuration of the Wdg module for controlling the watchdog driver(s) on the core.
    container WdgGeneral  # General parameters of Wdg | All general parameters of the watchdog driver are collected here.
      boolean WdgDevErrorDetect: set at pre-compile  # Development error detection | Compile switch to enable / disable development error detection for this module. True: Development error detection enabled False: Development error detection disabled
      boolean WdgDisableAllowed: set at pre-compile  # Disabling Watchdog driver during runtime | Compile switch to allow / forbid disabling the watchdog driver during runtime. True: Disabling the watchdog driver at runtime is allowed. False: Disabling the watchdog driver at runtime is not allowed.
      boolean WdgDynamicPassword [0..1]: set at pre-compile, default-value=false  # Support for Dynamic Password | Optional parameter to be configured: Selection of Watchdog Automatic Password Sequencing True: Automatic Password Sequencing Enabled False: Automatic Password Sequencing Disabled
      integer WdgIndex [0..1]: 0..255, set at pre-compile, symbolic-name-value=true  # Index of watchdog driver | Represents the watchdog driver's ID so that it can be referenced by the watchdog interface.
      float WdgInitialTimeout: 0..10.7, set at pre-compile  # Initial timeout of watchdog timer | The initial timeout (sec) for the trigger condition to be initialized during Init function. It shall be not larger than WdgMaxTimeout.
      boolean WdgLegacyService [0..1]: multiplicity set at pre-compile, origin=RB:0.2.0:2012-11-28, set at pre-compile  # Support for Legacy Service | Selection of Watchdog servicing mechanism. True: Watchdog is serviced by scheduled API (Legacy MEDC17 Watchdog servicing mechanism) False: Watchdog is serviced by Gtm based ISR.
      boolean WdgLegacySupport [0..1]: multiplicity set at pre-compile, origin=RB:0.2.0:2012-11-28, set at pre-compile  # Support for Legacy interfaces | Compile switch to enable / disable the Legacy Interface support True: Enable Legacy Interface support False: Disable Legacy Interface support Legacy Interfaces are: Wdg_6_CoreXInstY_GetTimeOut() X = Core Id, Y = Instance Id
      float WdgMaxTimeout: 0..10.7, set at pre-compile  # Max timeout limit for the wdg timer | The maximum timeout (sec) to which the watchdog trigger condition can be initialized.
      enumeration WdgRunArea [0..0]: set at pre-compile  # Execution area of the watchdog driver | Represents the watchdog driver execution area is either from ROM(Flash) or RAM as required with the particular microcontroller.
        RAM  # Watchdog driver executes from RAM
        ROM  # Watchdog driver executes from ROM
      function name WdgTriggerLocation [0..0]: set at pre-compile  # Memory location of watchdog trigger | Location (memory address) of the watchdog trigger routine.
      boolean WdgVersionInfoApi [0..0]: set at pre-compile  # Version information API | Compile switch to enable / disable the version information API True: API enabled False: API disabled
    container WdgPublishedInformation  # Published Information | Container holding all Wdg specific published information parameters
      enumeration WdgTriggerMode: set at pre-compile  # Trigger Mode | Watchdog trigger mode (toggle/window/both)
        WDG_TOGGLE  # Wdg in toggle mode
    container WdgSettingsConfig  # Hardware Configuration | Configuration items for the different watchdog settings, including those for external watchdog hardware. Note: All postbuild parameters are handled via this container.
      enumeration WdgDefaultMode: post-build-variant-value=true, set at pre-compile  # Watchdog defalut init mode | Default mode for watchdog driver initialization.
        WDGIF_FAST_MODE  # Wdg in fast mode
        WDGIF_OFF_MODE  # Wdg switched OFF
        WDGIF_SLOW_MODE  # Wdg in slow mode
      integer WdgTomChn [0..0]: 0..15, multiplicity set at pre-compile, post-build-variant-multiplicity=true, post-build-variant-value=true, set at pre-compile  # TOM Channel | The configuration parameter-TOM Channel is depreciated. Hint: If required, TOM Channel should be configured in rba_gtm module.
      integer WdgTomMod [0..0]: 0..4, multiplicity set at pre-compile, post-build-variant-multiplicity=true, post-build-variant-value=true, set at pre-compile  # TOM Module | The configuration parameter-TOM Module is depreciated. Hint: If required, TOM Module should be configured in rba_gtm module.
      container WdgExternalConfiguration [0..0]: multiplicity set at pre-compile, post-build-variant-multiplicity=true  # External watchdog configuration | Configuration items for an external watchdog hardware
        choice reference WdgExternalContainerRef [0..0]: multiplicity set at pre-compile, post-build-variant-multiplicity=true, post-build-variant-value=true, set at pre-compile, destination=[DioChannelGroup, SpiSequence]  # External container reference | Reference to either - a DioChannelGroup container in case the hardware watchdog is connected via DIO pins - an SpiSequenceConfiguration container in case the watchdog hardware is accessed via SPI
      container WdgSettingsFast  # Hardware settings for Fast mode | Hardware dependent settings for the watchdog driver's "fast" mode.
        float WdgTimeout: 0..10700, post-build-variant-value=true, set at pre-compile  # Timeout in fast mode | The timeout (milli seconds) to which the watchdog timer has to be set in the fast mode
      container WdgSettingsOff  # Hardware settings for Off mode | Hardware dependent settings for the watchdog driver's "off" mode.
        float WdgTimeout: 0..0, post-build-variant-value=true, set at pre-compile  # Timeout in Off mode | The timeout (milli seconds) to which the watchdog timer has to be set in the fast mode (Should be always 0)
      container WdgSettingsSlow  # Hardware settings for Slow mode | Hardware dependent settings for the watchdog driver's "slow" mode.
        float WdgTimeout: 0..10700, post-build-variant-value=true, set at pre-compile  # Timeout in slow mode | The timeout (milli seconds) to which the watchdog timer has to be set in the slow mode
