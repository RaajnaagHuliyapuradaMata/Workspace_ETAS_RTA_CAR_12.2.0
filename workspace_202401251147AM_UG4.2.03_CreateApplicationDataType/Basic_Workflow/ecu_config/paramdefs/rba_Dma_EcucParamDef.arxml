AUTOSAR XML (schema 00048)
package /RB/RBA/rba_Dma/EcucModuleDefs
  module definition rba_Dma [0..1]: category=VENDOR_SPECIFIC_MODULE_DEFINITION, post-build-variant-support=true, variants pre-compile  # MCAL Dma | Container for DMA configuration.
    container rba_Dma_Cfg: multiplicity set at pre-compile  # DMA configuration | Defines one data set of post-build configuration. Which of these data sets is actually active is controlled by EcuM. Data sets can only be switched at initialization time. Multiple instances of such containers with same identifier are automatically merged. Data set ID is the short name of this container.
      container rba_Dma_Ch [0..*]: multiplicity set at pre-compile, post-build-variant-multiplicity=true  # DMA channel | Container for a DMA channel configuration
        integer rba_Dma_1_Unit: origin=RB:0.1.0:2011-04-19, post-build-variant-value=true, set at pre-compile  # Unit | Selects the DMA move engine (sub block). Range: IFX: 0 ST Centauri: 0, 1 ST P6/X7: 0 .. 3
        integer rba_Dma_2_Ch: origin=RB:0.1.0:2011-04-19, post-build-variant-value=true, set at pre-compile  # Channel | Selects the DMA channel to be configured. Range: IFX: 0 .. 127 ST Centauri: 0 .. 63 ST P6/X7 move engine 0-2: 0 .. 31 ST P6/X7 move engine 3: 0 .. 63 Hint: For ST SR6 controllers all CASCADEMUX inputs need to be configured on any of the channels 0 .. 15!
        string rba_Dma_3_TrgSrc [0..1]: multiplicity set at pre-compile, origin=RB:0.1.0:2011-07-22, post-build-variant-multiplicity=true, post-build-variant-value=true, set at pre-compile, regular-expression=[A-Za-z_][A-Za-z0-9_]*  # Trigger source | Trigger source selection. ST devices use this tag to configure the actual trigger source. Keep in mind that not all trigger sources can be connected to one specific channel, cross-check controller manual for valid settings. Valid examples: SD_ADC_1_EOC GTM_ATOM8_IRQ3 SAR_ADC_12bit_3
        string rba_Dma_4_Irq [0..1]: multiplicity set at pre-compile, origin=RB:0.1.0:2011-05-09, post-build-variant-multiplicity=true, post-build-variant-value=true, set at pre-compile, regular-expression=[A-Za-z_][A-Za-z0-9_]*  # Interrupt generation | This tag is deprecated and not evaluated, use container rba_Dma_Irq instead.
        string rba_Dma_5_LinkCh [0..1]: multiplicity set at pre-compile, origin=RB:3.0.0:2014-04-23, post-build-variant-multiplicity=true, post-build-variant-value=true, set at pre-compile, regular-expression=[A-Za-z_][A-Za-z0-9_]*  # Target linked channel | Specify the target DMA channel name which shall be triggered by this channel.
        integer rba_Dma_6_VmidSel [0..1]: 0..3, multiplicity set at pre-compile, origin=RB:0.1.0:2011-04-19, post-build-variant-multiplicity=true, post-build-variant-value=true, set at pre-compile  # VMID selection | ST SR6P6 (and successors) only: Selects which of the four pre-defined VMIDs this channel shall use for its operation.
        container rba_Dma_Irq [0..1]: multiplicity set at pre-compile, post-build-variant-multiplicity=true  # IRQ trigger | Container for a DMA channel ISR configuration
          string rba_Dma_Irq_IsrFunction: multiplicity set at pre-compile, origin=RB:5.0.0:2021-04-28, post-build-variant-multiplicity=true, post-build-variant-value=true, set at pre-compile  # Interrupt Service Routine | Name of the ISR function to be called on DMA channel events.
          string rba_Dma_Irq_IsrHeader: multiplicity set at pre-compile, origin=RB:5.0.0:2021-04-28, post-build-variant-multiplicity=true, post-build-variant-value=true, set at pre-compile  # ISR Header File | Header file to be included which contains the extern declaration for the configured ISR function.
      container rba_Dma_MeSettingsSt [0..1]: multiplicity set at pre-compile, post-build-variant-multiplicity=true  # Move engine specific configuration (ST) | Move engine specific settings for ST Controllers. Depending on controller / available HW ressources not all configuration tags are evaluated. See controller manual for available features, move engines, channels and channel groups per move engine.
        boolean rba_Dma_Me0DsblSysCall [0..1]: multiplicity set at pre-compile, origin=RB:4.0.0:2021-01-31, post-build-variant-multiplicity=true, post-build-variant-value=true, set at pre-compile, default-value=false  # Move engine 0 Disable SystemCall usage | This tag is used to override System Call usage for this move engine if System Calls are globally enbled. If set to 'TRUE' than no System Calls are used for accessing HW registers of this move engines by SW. If System Calls are globally disabled the setting of this tag has no effect. System Calls can be enabled in component rba_McalSrv and are normally only required in IPP environments.
        boolean rba_Dma_Me0EnblErca [0..1]: multiplicity set at pre-compile, origin=RB:4.0.0:2021-01-31, post-build-variant-multiplicity=true, post-build-variant-value=true, set at pre-compile, default-value=false  # Move engine 0 Enable Round Robin Channel Arbitration | When enabling this option Round-robin arbitration is used for channel selection within each group (see manual).
        boolean rba_Dma_Me0EnblErga [0..1]: multiplicity set at pre-compile, origin=RB:4.0.0:2021-01-31, post-build-variant-multiplicity=true, post-build-variant-value=true, set at pre-compile, default-value=false  # Move engine 0 Enable Round Robin Group Arbitration | When enabling this option Round-robin arbitration is used for selection among the groups (see manual).
        integer rba_Dma_Me0Grp0Pri [0..1]: 0..3, multiplicity set at pre-compile, origin=RB:4.0.0:2021-01-31, post-build-variant-multiplicity=true, post-build-variant-value=true, set at pre-compile, default-value=0  # Move engine 0 group 0 priority (channel 0 .. 15) | Channel group 0 (channels 0 .. 15) priority setting, range 0 .. 3 Note: group priorites must be unique!
        integer rba_Dma_Me0Grp0Vmid [0..1]: 0..255, multiplicity set at pre-compile, origin=RB:4.0.0:2021-01-31, post-build-variant-multiplicity=true, post-build-variant-value=true, set at pre-compile, default-value=0  # Move engine 0 VMID 0 | For SR6X7 this is the group 0 VMID, for all other controllers this is the setting for VMID register 0. If a value is configured here the VMID usage is automatically enabled.
        integer rba_Dma_Me0Grp1Pri [0..1]: 0..3, multiplicity set at pre-compile, origin=RB:4.0.0:2021-01-31, post-build-variant-multiplicity=true, post-build-variant-value=true, set at pre-compile, default-value=1  # Move engine 0 group 1 priority (channel 16 .. 31) | Channel group 1 (channels 16 .. 31) priority setting, range 0 .. 3 Note: group priorites must be unique!
        integer rba_Dma_Me0Grp1Vmid [0..1]: 0..255, multiplicity set at pre-compile, origin=RB:4.0.0:2021-01-31, post-build-variant-multiplicity=true, post-build-variant-value=true, set at pre-compile, default-value=0  # Move engine 0 VMID 1 | For SR6X7 this is the group 1 VMID, for all other controllers this is the setting for VMID register 1. See rba_Dma_Me0Grp0Vmid for further information.
        integer rba_Dma_Me0Grp2Pri [0..1]: 0..3, multiplicity set at pre-compile, origin=RB:4.0.0:2021-01-31, post-build-variant-multiplicity=true, post-build-variant-value=true, set at pre-compile, default-value=2  # Move engine 0 group 2 priority (channel 32 .. 47) | Channel group 2 (channels 32 .. 47) priority setting, range 0 .. 3 Note: group priorites must be unique!
        integer rba_Dma_Me0Grp2Vmid [0..1]: 0..255, multiplicity set at pre-compile, origin=RB:4.0.0:2021-01-31, post-build-variant-multiplicity=true, post-build-variant-value=true, set at pre-compile, default-value=0  # Move engine 0 VMID 2 | This is the setting for VMID register 2. See rba_Dma_Me0Grp0Vmid for further information.
        integer rba_Dma_Me0Grp3Pri [0..1]: 0..3, multiplicity set at pre-compile, origin=RB:4.0.0:2021-01-31, post-build-variant-multiplicity=true, post-build-variant-value=true, set at pre-compile, default-value=3  # Move engine 0 group 3 priority (channel 48 .. 63) | Channel group 3 (channels 48 .. 63) priority setting, range 0 .. 3 Note: group priorites must be unique!
        integer rba_Dma_Me0Grp3Vmid [0..1]: 0..255, multiplicity set at pre-compile, origin=RB:4.0.0:2021-01-31, post-build-variant-multiplicity=true, post-build-variant-value=true, set at pre-compile, default-value=0  # Move engine 0 VMID 3 | This is the setting for VMID register 3. See rba_Dma_Me0Grp0Vmid for further information.
        boolean rba_Dma_Me1DsblSysCall [0..1]: multiplicity set at pre-compile, origin=RB:4.0.0:2021-01-31, post-build-variant-multiplicity=true, post-build-variant-value=true, set at pre-compile, default-value=false  # Move engine 1 Disable SystemCall usage | This tag is used to override System Call usage for this move engine if System Calls are globally enbled. If set to 'TRUE' than no System Calls are used for accessing HW registers of this move engines by SW. If System Calls are globally disabled the setting of this tag has no effect. System Calls can be enabled in component rba_McalSrv and are normally only required in IPP environments.
        boolean rba_Dma_Me1EnblErca [0..1]: multiplicity set at pre-compile, origin=RB:4.0.0:2021-01-31, post-build-variant-multiplicity=true, post-build-variant-value=true, set at pre-compile, default-value=false  # Move engine 1 Enable Round Robin Channel Arbitration | When enabling this option Round-robin arbitration is used for channel selection within each group (see manual).
        boolean rba_Dma_Me1EnblErga [0..1]: multiplicity set at pre-compile, origin=RB:4.0.0:2021-01-31, post-build-variant-multiplicity=true, post-build-variant-value=true, set at pre-compile, default-value=false  # Move engine 1 Enable Round Robin Group Arbitration | When enabling this option Round-robin arbitration is used for selection among the groups (see manual).
        integer rba_Dma_Me1Grp0Pri [0..1]: 0..3, multiplicity set at pre-compile, origin=RB:4.0.0:2021-01-31, post-build-variant-multiplicity=true, post-build-variant-value=true, set at pre-compile, default-value=0  # Move engine 1 group 0 priority (channel 0 .. 15) | Channel group 0 (channels 0 .. 15) priority setting, range 0 .. 3 Note: group priorites must be unique!
        integer rba_Dma_Me1Grp0Vmid [0..1]: 0..255, multiplicity set at pre-compile, origin=RB:4.0.0:2021-01-31, post-build-variant-multiplicity=true, post-build-variant-value=true, set at pre-compile, default-value=0  # Move engine 1 VMID 0 | For SR6X7 this is the group 0 VMID, for all other controllers this is the setting for VMID register 0. See rba_Dma_Me0Grp0Vmid for further information.
        integer rba_Dma_Me1Grp1Pri [0..1]: 0..3, multiplicity set at pre-compile, origin=RB:4.0.0:2021-01-31, post-build-variant-multiplicity=true, post-build-variant-value=true, set at pre-compile, default-value=1  # Move engine 1 group 1 priority (channel 16 .. 31) | Channel group 1 (channels 16 .. 31) priority setting, range 0 .. 3 Note: group priorites must be unique!
        integer rba_Dma_Me1Grp1Vmid [0..1]: 0..255, multiplicity set at pre-compile, origin=RB:4.0.0:2021-01-31, post-build-variant-multiplicity=true, post-build-variant-value=true, set at pre-compile, default-value=0  # Move engine 1 VMID 1 | For SR6X7 this is the group 1 VMID, for all other controllers this is the setting for VMID register 1. See rba_Dma_Me0Grp0Vmid for further information.
        integer rba_Dma_Me1Grp2Pri [0..1]: 0..3, multiplicity set at pre-compile, origin=RB:4.0.0:2021-01-31, post-build-variant-multiplicity=true, post-build-variant-value=true, set at pre-compile, default-value=2  # Move engine 1 group 2 priority (channel 32 .. 47) | Channel group 2 (channels 32 .. 47) priority setting, range 0 .. 3 Note: group priorites must be unique!
        integer rba_Dma_Me1Grp2Vmid [0..1]: 0..255, multiplicity set at pre-compile, origin=RB:4.0.0:2021-01-31, post-build-variant-multiplicity=true, post-build-variant-value=true, set at pre-compile, default-value=0  # Move engine 1 VMID 2 | This is the setting for VMID register 2. See rba_Dma_Me0Grp0Vmid for further information.
        integer rba_Dma_Me1Grp3Pri [0..1]: 0..3, multiplicity set at pre-compile, origin=RB:4.0.0:2021-01-31, post-build-variant-multiplicity=true, post-build-variant-value=true, set at pre-compile, default-value=3  # Move engine 1 group 3 priority (channel 48 .. 63) | Channel group 3 (channels 48 .. 63) priority setting, range 0 .. 3 Note: group priorites must be unique!
        integer rba_Dma_Me1Grp3Vmid [0..1]: 0..255, multiplicity set at pre-compile, origin=RB:4.0.0:2021-01-31, post-build-variant-multiplicity=true, post-build-variant-value=true, set at pre-compile, default-value=0  # Move engine 1 VMID 3 | This is the setting for VMID register 3. See rba_Dma_Me0Grp0Vmid for further information.
        boolean rba_Dma_Me2DsblSysCall [0..1]: multiplicity set at pre-compile, origin=RB:4.0.0:2021-01-31, post-build-variant-multiplicity=true, post-build-variant-value=true, set at pre-compile, default-value=false  # Move engine 2 Disable SystemCall usage | This tag is used to override System Call usage for this move engine if System Calls are globally enbled. If set to 'TRUE' than no System Calls are used for accessing HW registers of this move engines by SW. If System Calls are globally disabled the setting of this tag has no effect. System Calls can be enabled in component rba_McalSrv and are normally only required in IPP environments.
        boolean rba_Dma_Me2EnblErca [0..1]: multiplicity set at pre-compile, origin=RB:4.0.0:2021-01-31, post-build-variant-multiplicity=true, post-build-variant-value=true, set at pre-compile, default-value=false  # Move engine 2 Enable Round Robin Channel Arbitration | When enabling this option Round-robin arbitration is used for channel selection within each group (see manual).
        boolean rba_Dma_Me2EnblErga [0..1]: multiplicity set at pre-compile, origin=RB:4.0.0:2021-01-31, post-build-variant-multiplicity=true, post-build-variant-value=true, set at pre-compile, default-value=false  # Move engine 2 Enable Round Robin Group Arbitration | When enabling this option Round-robin arbitration is used for selection among the groups (see manual).
        integer rba_Dma_Me2Grp0Pri [0..1]: 0..3, multiplicity set at pre-compile, origin=RB:4.0.0:2021-01-31, post-build-variant-multiplicity=true, post-build-variant-value=true, set at pre-compile, default-value=0  # Move engine 2 group 0 priority (channel 0 .. 15) | Channel group 0 (channels 0 .. 15) priority setting, range 0 .. 3 Note: group priorites must be unique!
        integer rba_Dma_Me2Grp0Vmid [0..1]: 0..255, multiplicity set at pre-compile, origin=RB:4.0.0:2021-01-31, post-build-variant-multiplicity=true, post-build-variant-value=true, set at pre-compile, default-value=0  # Move engine 2 VMID 0 | For SR6X7 this is the group 0 VMID, for all other controllers this is the setting for VMID register 0. See rba_Dma_Me0Grp0Vmid for further information.
        integer rba_Dma_Me2Grp1Pri [0..1]: 0..3, multiplicity set at pre-compile, origin=RB:4.0.0:2021-01-31, post-build-variant-multiplicity=true, post-build-variant-value=true, set at pre-compile, default-value=1  # Move engine 2 group 1 priority (channel 16 .. 31) | Channel group 1 (channels 16 .. 31) priority setting, range 0 .. 3 Note: group priorites must be unique!
        integer rba_Dma_Me2Grp1Vmid [0..1]: 0..255, multiplicity set at pre-compile, origin=RB:4.0.0:2021-01-31, post-build-variant-multiplicity=true, post-build-variant-value=true, set at pre-compile, default-value=0  # Move engine 2 VMID 1 | For SR6X7 this is the group 1 VMID, for all other controllers this is the setting for VMID register 1. See rba_Dma_Me0Grp0Vmid for further information.
        integer rba_Dma_Me2Grp2Pri [0..0]: 0..3, multiplicity set at pre-compile, origin=RB:4.0.0:2021-01-31, post-build-variant-multiplicity=true, post-build-variant-value=true, set at pre-compile, default-value=2  # Move engine 2 group 2 priority (channel 32 .. 47) | Channel group 2 (channels 32 .. 47) priority setting, range 0 .. 3 Note: group priorites must be unique!
        integer rba_Dma_Me2Grp2Vmid [0..1]: 0..255, multiplicity set at pre-compile, origin=RB:4.0.0:2021-01-31, post-build-variant-multiplicity=true, post-build-variant-value=true, set at pre-compile, default-value=0  # Move engine 2 VMID 2 | This is the setting for VMID register 2. See rba_Dma_Me0Grp0Vmid for further information.
        integer rba_Dma_Me2Grp3Pri [0..0]: 0..3, multiplicity set at pre-compile, origin=RB:4.0.0:2021-01-31, post-build-variant-multiplicity=true, post-build-variant-value=true, set at pre-compile, default-value=3  # Move engine 2 group 3 priority (channel 48 .. 63) | Channel group 3 (channels 48 .. 63) priority setting, range 0 .. 3 Note: group priorites must be unique!
        integer rba_Dma_Me2Grp3Vmid [0..1]: 0..255, multiplicity set at pre-compile, origin=RB:4.0.0:2021-01-31, post-build-variant-multiplicity=true, post-build-variant-value=true, set at pre-compile, default-value=0  # Move engine 2 VMID 3 | This is the setting for VMID register 3. See rba_Dma_Me0Grp0Vmid for further information.
        boolean rba_Dma_Me3DsblSysCall [0..1]: multiplicity set at pre-compile, origin=RB:4.0.0:2021-01-31, post-build-variant-multiplicity=true, post-build-variant-value=true, set at pre-compile, default-value=false  # Move engine 3 Disable SystemCall usage | This tag is used to override System Call usage for this move engine if System Calls are globally enbled. If set to 'TRUE' than no System Calls are used for accessing HW registers of this move engines by SW. If System Calls are globally disabled the setting of this tag has no effect. System Calls can be enabled in component rba_McalSrv and are normally only required in IPP environments.
        boolean rba_Dma_Me3EnblErca [0..1]: multiplicity set at pre-compile, origin=RB:4.0.0:2021-01-31, post-build-variant-multiplicity=true, post-build-variant-value=true, set at pre-compile, default-value=false  # Move engine 3 Enable Round Robin Channel Arbitration | When enabling this option Round-robin arbitration is used for channel selection within each group (see manual).
        boolean rba_Dma_Me3EnblErga [0..1]: multiplicity set at pre-compile, origin=RB:4.0.0:2021-01-31, post-build-variant-multiplicity=true, post-build-variant-value=true, set at pre-compile, default-value=false  # Move engine 3 Enable Round Robin Group Arbitration | When enabling this option Round-robin arbitration is used for selection among the groups (see manual).
        integer rba_Dma_Me3Grp0Pri [0..1]: 0..3, multiplicity set at pre-compile, origin=RB:4.0.0:2021-01-31, post-build-variant-multiplicity=true, post-build-variant-value=true, set at pre-compile, default-value=0  # Move engine 3 group 0 priority (channel 0 .. 15) | Channel group 0 (channels 0 .. 15) priority setting, range 0 .. 3 Note: group priorites must be unique!
        integer rba_Dma_Me3Grp0Vmid [0..1]: 0..255, multiplicity set at pre-compile, origin=RB:4.0.0:2021-01-31, post-build-variant-multiplicity=true, post-build-variant-value=true, set at pre-compile, default-value=0  # Move engine 3 VMID 0 | For SR6X7 this is the group 0 VMID, for all other controllers this is the setting for VMID register 0. See rba_Dma_Me0Grp0Vmid for further information.
        integer rba_Dma_Me3Grp1Pri [0..1]: 0..3, multiplicity set at pre-compile, origin=RB:4.0.0:2021-01-31, post-build-variant-multiplicity=true, post-build-variant-value=true, set at pre-compile, default-value=1  # Move engine 3 group 1 priority (channel 16 .. 31) | Channel group 1 (channels 16 .. 31) priority setting, range 0 .. 3 Note: group priorites must be unique!
        integer rba_Dma_Me3Grp1Vmid [0..1]: 0..255, multiplicity set at pre-compile, origin=RB:4.0.0:2021-01-31, post-build-variant-multiplicity=true, post-build-variant-value=true, set at pre-compile, default-value=0  # Move engine 3 VMID 1 | For SR6X7 this is the group 1 VMID, for all other controllers this is the setting for VMID register 1. See rba_Dma_Me0Grp0Vmid for further information.
        integer rba_Dma_Me3Grp2Pri [0..1]: 0..3, multiplicity set at pre-compile, origin=RB:4.0.0:2021-01-31, post-build-variant-multiplicity=true, post-build-variant-value=true, set at pre-compile, default-value=2  # Move engine 3 group 2 priority (channel 32 .. 47) | Channel group 2 (channels 32 .. 47) priority setting, range 0 .. 3 Note: group priorites must be unique!
        integer rba_Dma_Me3Grp2Vmid [0..1]: 0..255, multiplicity set at pre-compile, origin=RB:4.0.0:2021-01-31, post-build-variant-multiplicity=true, post-build-variant-value=true, set at pre-compile, default-value=0  # Move engine 3 VMID 2 | For SR6X7 this is the group 2 VMID, for all other controllers this is the setting for VMID register 2.See rba_Dma_Me0Grp0Vmid for further information.
        integer rba_Dma_Me3Grp3Pri [0..1]: 0..3, multiplicity set at pre-compile, origin=RB:4.0.0:2021-01-31, post-build-variant-multiplicity=true, post-build-variant-value=true, set at pre-compile, default-value=3  # Move engine 3 group 3 priority (channel 48 .. 63) | Channel group 3 (channels 48 .. 63) priority setting, range 0 .. 3 Note: group priorites must be unique!
        integer rba_Dma_Me3Grp3Vmid [0..1]: 0..255, multiplicity set at pre-compile, origin=RB:4.0.0:2021-01-31, post-build-variant-multiplicity=true, post-build-variant-value=true, set at pre-compile, default-value=0  # Move engine 3 VMID 3 | For SR6X7 this is the group 3 VMID, for all other controllers this is the setting for VMID register 3. See rba_Dma_Me0Grp0Vmid for further information.
    container rba_Dma_General [0..1]: multiplicity set at pre-compile  # General configuration | General DMA configuration valid for all post build configurations.
      boolean rba_Dma_ActErrDet [0..1]: multiplicity set at pre-compile, origin=RB:0.1.0:2011-04-19, set at pre-compile, default-value=false  # Development error detection | Enables/disables the detection and notification of development errors. If this parameter is enabled, then extended error checking is performed during runtime; This feature should be switched off in series software. --> currently not supported
      boolean rba_Dma_EnblEmlm [0..1]: multiplicity set at pre-compile, origin=RB:1.0.0:2019-07-30, set at pre-compile, default-value=false  # Enable Minor Loop Mapping | Enables Minor Loop Mapping for all Move Engines on ST controllers. Enabling this feature gives additional increment/decrement options at the end of each minor eDMA loop. However, the maximum transfer size per trigger is reduced (see manual).
      enumeration rba_Dma_ErrReaction [0..1]: multiplicity set at pre-compile, origin=RB:2.1.0:2014-02-19, set at pre-compile, default-value=None  # Error Reaction | Selects how rba_Dma shall handle internal DMA errors. If Count/Det is selected a counter is raised and a Det entry will be generated if activated by rba_Dma_ActErrDet. If Reset is selected a configuration of a suitable rba_Reset event is necessary.
        None  # no reaction
        Det  # Count/Det
        Reset  # trigger a Reset
