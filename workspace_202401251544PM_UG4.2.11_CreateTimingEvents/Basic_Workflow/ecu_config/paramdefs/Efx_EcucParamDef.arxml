AUTOSAR XML (schema 4-2-2)
package /AUTOSAR_Efx/EcucModuleDefs
  module definition Efx [0..1]: category=VENDOR_SPECIFIC_MODULE_DEFINITION, refined-module-def=Efx, variants pre-compile  # Extended Fixed Point Library
    container EfxGeneral  # General settings for Efx | General settings for Efx with selections for used controller and activation of GetVersionInfo interface
      enumeration EfxRbOptimization [0..1]: multiplicity set at pre-compile, origin=RB:1.0.0:2010-12-15, set at pre-compile  # Select for which controller optimized implementations shall be used
        ARMV8X32  # ARMV8X32 controllers
        MPCCut2  # JDP MPC Cut2 controller
        MPC57xx  # JDP MPC57xx controller
        NO_OPTIMIZATION  # No optimization, standard C implementations shall be used
        TC17xx  # Tricore TC17xx controller
        TC27xx  # Tricore TC27xx controller
      boolean EfxRbOptimizationMcuExtract [0..1]: multiplicity set at pre-compile, origin=RB:10.0.0:2015-06-18, set at pre-compile, default-value=false  # Select whether to fetch machine type from MCU and configure for controller optimized implementation | If EfxRbOptimizationMcuExtract is chosen as "True", then the controller information will be extracted from MCU.Based on this, optimized implementations will be selected.Hence the user should not configure "EfxRbOptimization".If EfxRbOptimizationMcuExtract is chosen as "False", the controller information will not be extracted from MCU and so the user needs to configure "EfxRbOptimization" manually.
      enumeration Efx_AUTOSAR_Version [0..1]: origin=RB:1.0.0:2021-09-15, set at pre-compile, default-value=EFX_AR45  # Configuration parameter for activation of particular Efx AUTOSAR version functions. | If EfxAUTOSARVersion is set to "EFX_AR42", AR242 related functinality should be activated for the Efx library. If EfxAUTOSARVersion is set to "EFX_AR45", AR45 related functinality should be activated for the Efx library
        EFX_AR42  # Activate AUTOSAR version AR42.
        EFX_AR45  # Activate AUTOSAR version AR45.
      enumeration Efx_VersionInfoAPI: origin=RB:1.0.0:2010-12-15, set at pre-compile  # Configuration parameter for activation of Efx_GetVersionInfo function. | If EfxVersionInfoAPI is set to "ON", the function EfxGetVersionInfo shall return the version information of the Efx library. If EfxVersionInfoAPI is set to "OFF", the Efx library shall not provide the function Efx_GetVersionInfo
        ON  # Activate EfxGetVersionInfo function.
        OFF  # Deactivate EfxGetVersionInfo function.
    container EfxRbMemoryLocations  # Memory locations | Choose memory location settings for each single service
      enumeration efxRbMemLocAdds64s32s64: origin=RB:5.0.0:2012-12-17, set at pre-compile  # Efx_Add_s64s32_s64 | Select one of following values: NORMAL for location in normal flash, FAST for location in fast flash, SLOW for location in slow flash, INLINE for inlining of the service
        NORMAL  # Location in normal flash
        FAST  # Location in fast flash
        SLOW  # Location in slow flash
        INLINE  # Service is inlined
      enumeration efxRbMemLocAdds64s64s64: origin=RB:5.0.0:2012-12-17, set at pre-compile  # Efx_Add_s64s64_s64 | Select one of following values: NORMAL for location in normal flash, FAST for location in fast flash, SLOW for location in slow flash, INLINE for inlining of the service
        NORMAL  # Location in normal flash
        FAST  # Location in fast flash
        SLOW  # Location in slow flash
        INLINE  # Service is inlined
      enumeration efxRbMemLocAdds64u32s64: origin=RB:5.0.0:2012-12-17, set at pre-compile  # Efx_Add_s64u32_s64 | Select one of following values: NORMAL for location in normal flash, FAST for location in fast flash, SLOW for location in slow flash, INLINE for inlining of the service
        NORMAL  # Location in normal flash
        FAST  # Location in fast flash
        SLOW  # Location in slow flash
        INLINE  # Service is inlined
      enumeration efxRbMemLocArccoss16u16: origin=RB:5.0.0:2012-12-17, set at pre-compile  # Efx_Arccos_s16_u16 | Select one of following values: NORMAL for location in normal flash, FAST for location in fast flash, SLOW for location in slow flash
        NORMAL  # Location in normal flash
        FAST  # Location in fast flash
        SLOW  # Location in slow flash
      enumeration efxRbMemLocArccoss32u32: origin=RB:5.0.0:2012-12-17, set at pre-compile  # Efx_Arccos_s32_u32 | Select one of following values: NORMAL for location in normal flash, FAST for location in fast flash, SLOW for location in slow flash
        NORMAL  # Location in normal flash
        FAST  # Location in fast flash
        SLOW  # Location in slow flash
      enumeration efxRbMemLocArccoss8u8: origin=RB:5.0.0:2012-12-17, set at pre-compile  # Efx_Arccos_s8_u8 | Select one of following values: NORMAL for location in normal flash, FAST for location in fast flash, SLOW for location in slow flash
        NORMAL  # Location in normal flash
        FAST  # Location in fast flash
        SLOW  # Location in slow flash
      enumeration efxRbMemLocArcsins16s16: origin=RB:5.0.0:2012-12-17, set at pre-compile  # Efx_Arcsin_s16_s16 | Select one of following values: NORMAL for location in normal flash, FAST for location in fast flash, SLOW for location in slow flash
        NORMAL  # Location in normal flash
        FAST  # Location in fast flash
        SLOW  # Location in slow flash
      enumeration efxRbMemLocArcsins32s32: origin=RB:5.0.0:2012-12-17, set at pre-compile  # Efx_Arcsin_s32_s32 | Select one of following values: NORMAL for location in normal flash, FAST for location in fast flash, SLOW for location in slow flash
        NORMAL  # Location in normal flash
        FAST  # Location in fast flash
        SLOW  # Location in slow flash
      enumeration efxRbMemLocArcsins8s8: origin=RB:5.0.0:2012-12-17, set at pre-compile  # Efx_Arcsin_s8_s8 | Select one of following values: NORMAL for location in normal flash, FAST for location in fast flash, SLOW for location in slow flash
        NORMAL  # Location in normal flash
        FAST  # Location in fast flash
        SLOW  # Location in slow flash
      enumeration efxRbMemLocArrayAverages16s16: origin=RB:1.0.0:2010-12-17, set at pre-compile  # Efx_Array_Average_s16_s16 | Select one of following values: NORMAL for location in normal flash, FAST for location in fast flash, SLOW for location in slow flash, INLINE for inlining of the service
        NORMAL  # Location in normal flash
        FAST  # Location in fast flash
        SLOW  # Location in slow flash
        INLINE  # Service is inlined
      enumeration efxRbMemLocArrayAverages32s32: origin=RB:1.0.0:2010-12-17, set at pre-compile  # Efx_Array_Average_s32_s32 | Select one of following values: NORMAL for location in normal flash, FAST for location in fast flash, SLOW for location in slow flash, INLINE for inlining of the service
        NORMAL  # Location in normal flash
        FAST  # Location in fast flash
        SLOW  # Location in slow flash
        INLINE  # Service is inlined
      enumeration efxRbMemLocAverages32s32: origin=RB:1.0.0:2010-12-17, set at pre-compile  # Efx_Average_s32_s32 | Select one of following values: NORMAL for location in normal flash, FAST for location in fast flash, SLOW for location in slow flash, INLINE for inlining of the service
        NORMAL  # Location in normal flash
        FAST  # Location in fast flash
        SLOW  # Location in slow flash
        INLINE  # Service is inlined
      enumeration efxRbMemLocCalcTeQApps32: origin=RB:1.0.0:2010-12-17, set at pre-compile  # Efx_CalcTeQApp_s32 | Select one of following values: NORMAL for location in normal flash, FAST for location in fast flash, SLOW for location in slow flash, INLINE for inlining of the service
        NORMAL  # Location in normal flash
        FAST  # Location in fast flash
        SLOW  # Location in slow flash
        INLINE  # Service is inlined
      enumeration efxRbMemLocCalcTeQs32: origin=RB:1.0.0:2010-12-17, set at pre-compile  # Efx_CalcTeQ_s32 | Select one of following values: NORMAL for location in normal flash, FAST for location in fast flash, SLOW for location in slow flash, INLINE for inlining of the service
        NORMAL  # Location in normal flash
        FAST  # Location in fast flash
        SLOW  # Location in slow flash
        INLINE  # Service is inlined
      enumeration efxRbMemLocCasts64s32: origin=RB:5.0.0:2012-12-17, set at pre-compile  # Efx_Cast_s64_s32 | Select one of following values: NORMAL for location in normal flash, FAST for location in fast flash, SLOW for location in slow flash, INLINE for inlining of the service
        NORMAL  # Location in normal flash
        FAST  # Location in fast flash
        SLOW  # Location in slow flash
        INLINE  # Service is inlined
      enumeration efxRbMemLocCasts64u32: origin=RB:5.0.0:2012-12-17, set at pre-compile  # Efx_Cast_s64_u32 | Select one of following values: NORMAL for location in normal flash, FAST for location in fast flash, SLOW for location in slow flash, INLINE for inlining of the service
        NORMAL  # Location in normal flash
        FAST  # Location in fast flash
        SLOW  # Location in slow flash
        INLINE  # Service is inlined
      enumeration efxRbMemLocCastu32s64: origin=RB:5.0.0:2012-12-17, set at pre-compile  # Efx_Cast_u32_s64 | Select one of following values: NORMAL for location in normal flash, FAST for location in fast flash, SLOW for location in slow flash, INLINE for inlining of the service
        NORMAL  # Location in normal flash
        FAST  # Location in fast flash
        SLOW  # Location in slow flash
        INLINE  # Service is inlined
      enumeration efxRbMemLocCoss16s16: origin=RB:5.0.0:2012-12-17, set at pre-compile  # Efx_Cos_s16_s16 | Select one of following values: NORMAL for location in normal flash, FAST for location in fast flash, SLOW for location in slow flash
        NORMAL  # Location in normal flash
        FAST  # Location in fast flash
        SLOW  # Location in slow flash
      enumeration efxRbMemLocCoss32s32: origin=RB:5.0.0:2012-12-17, set at pre-compile  # Efx_Cos_s32_s32 | Select one of following values: NORMAL for location in normal flash, FAST for location in fast flash, SLOW for location in slow flash
        NORMAL  # Location in normal flash
        FAST  # Location in fast flash
        SLOW  # Location in slow flash
      enumeration efxRbMemLocCoss8s8: origin=RB:5.0.0:2012-12-17, set at pre-compile  # Efx_Cos_s8_s8 | Select one of following values: NORMAL for location in normal flash, FAST for location in fast flash, SLOW for location in slow flash
        NORMAL  # Location in normal flash
        FAST  # Location in fast flash
        SLOW  # Location in slow flash
      enumeration efxRbMemLocCounterSetu16: origin=RB:5.0.0:2012-12-17, set at pre-compile  # Efx_CounterSet_u16 | Select one of following values: NORMAL for location in normal flash, FAST for location in fast flash, SLOW for location in slow flash, INLINE for inlining of the service
        NORMAL  # Location in normal flash
        FAST  # Location in fast flash
        SLOW  # Location in slow flash
        INLINE  # Service is inlined
      enumeration efxRbMemLocCounterSetu32: origin=RB:5.0.0:2012-12-17, set at pre-compile  # Efx_CounterSet_u32 | Select one of following values: NORMAL for location in normal flash, FAST for location in fast flash, SLOW for location in slow flash, INLINE for inlining of the service
        NORMAL  # Location in normal flash
        FAST  # Location in fast flash
        SLOW  # Location in slow flash
        INLINE  # Service is inlined
      enumeration efxRbMemLocCounterSetu8: origin=RB:5.0.0:2012-12-17, set at pre-compile  # Efx_CounterSet_u8 | Select one of following values: NORMAL for location in normal flash, FAST for location in fast flash, SLOW for location in slow flash, INLINE for inlining of the service
        NORMAL  # Location in normal flash
        FAST  # Location in fast flash
        SLOW  # Location in slow flash
        INLINE  # Service is inlined
      enumeration efxRbMemLocCounteru16u16: origin=RB:1.0.0:2010-12-17, set at pre-compile  # Efx_Counter_u16_u16 | Select one of following values: NORMAL for location in normal flash, FAST for location in fast flash, SLOW for location in slow flash, INLINE for inlining of the service
        NORMAL  # Location in normal flash
        FAST  # Location in fast flash
        SLOW  # Location in slow flash
        INLINE  # Service is inlined
      enumeration efxRbMemLocCounteru32u32: origin=RB:1.0.0:2010-12-17, set at pre-compile  # Efx_Counter_u32_u32 | Select one of following values: NORMAL for location in normal flash, FAST for location in fast flash, SLOW for location in slow flash, INLINE for inlining of the service
        NORMAL  # Location in normal flash
        FAST  # Location in fast flash
        SLOW  # Location in slow flash
        INLINE  # Service is inlined
      enumeration efxRbMemLocCounteru8u8: origin=RB:1.0.0:2010-12-17, set at pre-compile  # Efx_Counter_u8_u8 | Select one of following values: NORMAL for location in normal flash, FAST for location in fast flash, SLOW for location in slow flash, INLINE for inlining of the service
        NORMAL  # Location in normal flash
        FAST  # Location in fast flash
        SLOW  # Location in slow flash
        INLINE  # Service is inlined
      enumeration efxRbMemLocCtrlSetLimits: origin=RB:5.0.0:2012-12-17, set at pre-compile  # Efx_CtrlSetLimits | Select one of following values: NORMAL for location in normal flash, FAST for location in fast flash, SLOW for location in slow flash, INLINE for inlining of the service
        NORMAL  # Location in normal flash
        FAST  # Location in fast flash
        SLOW  # Location in slow flash
        INLINE  # Service is inlined
      enumeration efxRbMemLocDT1Typ1Calc: origin=RB:1.0.0:2010-12-17, set at pre-compile  # Efx_DT1Typ1Calc | Select one of following values: NORMAL for location in normal flash, FAST for location in fast flash, SLOW for location in slow flash, INLINE for inlining of the service
        NORMAL  # Location in normal flash
        FAST  # Location in fast flash
        SLOW  # Location in slow flash
        INLINE  # Service is inlined
      enumeration efxRbMemLocDT1Typ1Outs16: origin=RB:1.0.0:2010-12-17, set at pre-compile  # Efx_DT1Typ1Out_s16 | Select one of following values: NORMAL for location in normal flash, FAST for location in fast flash, SLOW for location in slow flash, INLINE for inlining of the service
        NORMAL  # Location in normal flash
        FAST  # Location in fast flash
        SLOW  # Location in slow flash
        INLINE  # Service is inlined
      enumeration efxRbMemLocDT1Typ1Outs8: origin=RB:1.0.0:2010-12-17, set at pre-compile  # Efx_DT1Typ1Out_s8 | Select one of following values: NORMAL for location in normal flash, FAST for location in fast flash, SLOW for location in slow flash, INLINE for inlining of the service
        NORMAL  # Location in normal flash
        FAST  # Location in fast flash
        SLOW  # Location in slow flash
        INLINE  # Service is inlined
      enumeration efxRbMemLocDT1Typ1SetState: origin=RB:1.0.0:2010-12-17, set at pre-compile  # Efx_DT1Typ1SetState | Select one of following values: NORMAL for location in normal flash, FAST for location in fast flash, SLOW for location in slow flash, INLINE for inlining of the service
        NORMAL  # Location in normal flash
        FAST  # Location in fast flash
        SLOW  # Location in slow flash
        INLINE  # Service is inlined
      enumeration efxRbMemLocDT1Typ2Calc: origin=RB:1.0.0:2010-12-17, set at pre-compile  # Efx_DT1Typ2Calc | Select one of following values: NORMAL for location in normal flash, FAST for location in fast flash, SLOW for location in slow flash, INLINE for inlining of the service
        NORMAL  # Location in normal flash
        FAST  # Location in fast flash
        SLOW  # Location in slow flash
        INLINE  # Service is inlined
      enumeration efxRbMemLocDT1Typ2Outs16: origin=RB:1.0.0:2010-12-17, set at pre-compile  # Efx_DT1Typ2Out_s16 | Select one of following values: NORMAL for location in normal flash, FAST for location in fast flash, SLOW for location in slow flash, INLINE for inlining of the service
        NORMAL  # Location in normal flash
        FAST  # Location in fast flash
        SLOW  # Location in slow flash
        INLINE  # Service is inlined
      enumeration efxRbMemLocDT1Typ2Outs8: origin=RB:1.0.0:2010-12-17, set at pre-compile  # Efx_DT1Typ2Out_s8 | Select one of following values: NORMAL for location in normal flash, FAST for location in fast flash, SLOW for location in slow flash, INLINE for inlining of the service
        NORMAL  # Location in normal flash
        FAST  # Location in fast flash
        SLOW  # Location in slow flash
        INLINE  # Service is inlined
      enumeration efxRbMemLocDT1Typ2SetState: origin=RB:1.0.0:2010-12-17, set at pre-compile  # Efx_DT1Typ2SetState | Select one of following values: NORMAL for location in normal flash, FAST for location in fast flash, SLOW for location in slow flash, INLINE for inlining of the service
        NORMAL  # Location in normal flash
        FAST  # Location in fast flash
        SLOW  # Location in slow flash
        INLINE  # Service is inlined
      enumeration efxRbMemLocDeadTimes16s16: origin=RB:5.0.0:2012-12-17, set at pre-compile  # Efx_DeadTime_s16_s16 | Select one of following values: NORMAL for location in normal flash, FAST for location in fast flash, SLOW for location in slow flash
        NORMAL  # Location in normal flash
        FAST  # Location in fast flash
        SLOW  # Location in slow flash
      enumeration efxRbMemLocDebounceInit: origin=RB:1.0.0:2010-12-17, set at pre-compile  # Efx_DebounceInit | Select one of following values: NORMAL for location in normal flash, FAST for location in fast flash, SLOW for location in slow flash, INLINE for inlining of the service
        NORMAL  # Location in normal flash
        FAST  # Location in fast flash
        SLOW  # Location in slow flash
        INLINE  # Service is inlined
      enumeration efxRbMemLocDebounceSetParam: origin=RB:1.0.0:2010-12-17, set at pre-compile  # Efx_DebounceSetParam | Select one of following values: NORMAL for location in normal flash, FAST for location in fast flash, SLOW for location in slow flash, INLINE for inlining of the service
        NORMAL  # Location in normal flash
        FAST  # Location in fast flash
        SLOW  # Location in slow flash
        INLINE  # Service is inlined
      enumeration efxRbMemLocDebounceu8u8: origin=RB:1.0.0:2010-12-17, set at pre-compile  # Efx_Debounce_u8_u8 | Select one of following values: NORMAL for location in normal flash, FAST for location in fast flash, SLOW for location in slow flash, INLINE for inlining of the service
        NORMAL  # Location in normal flash
        FAST  # Location in fast flash
        SLOW  # Location in slow flash
        INLINE  # Service is inlined
      enumeration efxRbMemLocDivs64s32s32: origin=RB:1.0.0:2010-12-17, set at pre-compile  # Efx_Div_s64s32_s32 | Select one of following values: NORMAL for location in normal flash, FAST for location in fast flash, SLOW for location in slow flash, INLINE for inlining of the service
        NORMAL  # Location in normal flash
        FAST  # Location in fast flash
        SLOW  # Location in slow flash
        INLINE  # Service is inlined
      enumeration efxRbMemLocDivs64s32s64: origin=RB:5.0.0:2012-12-17, set at pre-compile  # Efx_Div_s64s32_s64 | Select one of following values: NORMAL for location in normal flash, FAST for location in fast flash, SLOW for location in slow flash, INLINE for inlining of the service
        NORMAL  # Location in normal flash
        FAST  # Location in fast flash
        SLOW  # Location in slow flash
        INLINE  # Service is inlined
      enumeration efxRbMemLocDivs64s32u32: origin=RB:1.0.0:2010-12-17, set at pre-compile  # Efx_Div_s64s32_u32 | Select one of following values: NORMAL for location in normal flash, FAST for location in fast flash, SLOW for location in slow flash, INLINE for inlining of the service
        NORMAL  # Location in normal flash
        FAST  # Location in fast flash
        SLOW  # Location in slow flash
        INLINE  # Service is inlined
      enumeration efxRbMemLocDivs64u32s32: origin=RB:1.0.0:2010-12-17, set at pre-compile  # Efx_Div_s64u32_s32 | Select one of following values: NORMAL for location in normal flash, FAST for location in fast flash, SLOW for location in slow flash, INLINE for inlining of the service
        NORMAL  # Location in normal flash
        FAST  # Location in fast flash
        SLOW  # Location in slow flash
        INLINE  # Service is inlined
      enumeration efxRbMemLocDivs64u32s64: origin=RB:5.0.0:2012-12-17, set at pre-compile  # Efx_Div_s64u32_s64 | Select one of following values: NORMAL for location in normal flash, FAST for location in fast flash, SLOW for location in slow flash, INLINE for inlining of the service
        NORMAL  # Location in normal flash
        FAST  # Location in fast flash
        SLOW  # Location in slow flash
        INLINE  # Service is inlined
      enumeration efxRbMemLocDivs64u32u32: origin=RB:1.0.0:2010-12-17, set at pre-compile  # Efx_Div_s64u32_u32 | Select one of following values: NORMAL for location in normal flash, FAST for location in fast flash, SLOW for location in slow flash, INLINE for inlining of the service
        NORMAL  # Location in normal flash
        FAST  # Location in fast flash
        SLOW  # Location in slow flash
        INLINE  # Service is inlined
      enumeration efxRbMemLocEdgeBipolu8u8: origin=RB:1.0.0:2010-12-17, set at pre-compile  # Efx_EdgeBipol_u8_u8 | Select one of following values: NORMAL for location in normal flash, FAST for location in fast flash, SLOW for location in slow flash, INLINE for inlining of the service
        NORMAL  # Location in normal flash
        FAST  # Location in fast flash
        SLOW  # Location in slow flash
        INLINE  # Service is inlined
      enumeration efxRbMemLocEdgeFallingu8u8: origin=RB:1.0.0:2010-12-17, set at pre-compile  # Efx_EdgeFalling_u8_u8 | Select one of following values: NORMAL for location in normal flash, FAST for location in fast flash, SLOW for location in slow flash, INLINE for inlining of the service
        NORMAL  # Location in normal flash
        FAST  # Location in fast flash
        SLOW  # Location in slow flash
        INLINE  # Service is inlined
      enumeration efxRbMemLocEdgeRisingu8u8: origin=RB:1.0.0:2010-12-17, set at pre-compile  # Efx_EdgeRising_u8_u8 | Select one of following values: NORMAL for location in normal flash, FAST for location in fast flash, SLOW for location in slow flash, INLINE for inlining of the service
        NORMAL  # Location in normal flash
        FAST  # Location in fast flash
        SLOW  # Location in slow flash
        INLINE  # Service is inlined
      enumeration efxRbMemLocExps32s32: origin=RB:1.0.0:2010-12-17, set at pre-compile  # Efx_Exp_s32_s32 | Select one of following values: NORMAL for location in normal flash, FAST for location in fast flash, SLOW for location in slow flash
        NORMAL  # Location in normal flash
        FAST  # Location in fast flash
        SLOW  # Location in slow flash
      enumeration efxRbMemLocGts64s32u8: origin=RB:5.0.0:2012-12-17, set at pre-compile  # Efx_Gt_s64s32_u8 | Select one of following values: NORMAL for location in normal flash, FAST for location in fast flash, SLOW for location in slow flash, INLINE for inlining of the service
        NORMAL  # Location in normal flash
        FAST  # Location in fast flash
        SLOW  # Location in slow flash
        INLINE  # Service is inlined
      enumeration efxRbMemLocGts64u32u8: origin=RB:5.0.0:2012-12-17, set at pre-compile  # Efx_Gt_s64u32_u8 | Select one of following values: NORMAL for location in normal flash, FAST for location in fast flash, SLOW for location in slow flash, INLINE for inlining of the service
        NORMAL  # Location in normal flash
        FAST  # Location in fast flash
        SLOW  # Location in slow flash
        INLINE  # Service is inlined
      enumeration efxRbMemLocHpFilters16s32: origin=RB:5.0.0:2012-12-17, set at pre-compile  # Efx_HpFilter_s16_s32 | Select one of following values: NORMAL for location in normal flash, FAST for location in fast flash, SLOW for location in slow flash, INLINE for inlining of the service
        NORMAL  # Location in normal flash
        FAST  # Location in fast flash
        SLOW  # Location in slow flash
        INLINE  # Service is inlined
      enumeration efxRbMemLocHpFilters8s16: origin=RB:5.0.0:2012-12-17, set at pre-compile  # Efx_HpFilter_s8_s16 | Select one of following values: NORMAL for location in normal flash, FAST for location in fast flash, SLOW for location in slow flash, INLINE for inlining of the service
        NORMAL  # Location in normal flash
        FAST  # Location in fast flash
        SLOW  # Location in slow flash
        INLINE  # Service is inlined
      enumeration efxRbMemLocHpFilteru16s32: origin=RB:5.0.0:2012-12-17, set at pre-compile  # Efx_HpFilter_u16_s32 | Select one of following values: NORMAL for location in normal flash, FAST for location in fast flash, SLOW for location in slow flash, INLINE for inlining of the service
        NORMAL  # Location in normal flash
        FAST  # Location in fast flash
        SLOW  # Location in slow flash
        INLINE  # Service is inlined
      enumeration efxRbMemLocHpFilteru8s16: origin=RB:5.0.0:2012-12-17, set at pre-compile  # Efx_HpFilter_u8_s16 | Select one of following values: NORMAL for location in normal flash, FAST for location in fast flash, SLOW for location in slow flash, INLINE for inlining of the service
        NORMAL  # Location in normal flash
        FAST  # Location in fast flash
        SLOW  # Location in slow flash
        INLINE  # Service is inlined
      enumeration efxRbMemLocHypotu16u16u16: origin=RB:5.0.0:2012-12-17, set at pre-compile  # Efx_Hypot_u16u16_u16 | Select one of following values: NORMAL for location in normal flash, FAST for location in fast flash, SLOW for location in slow flash, INLINE for inlining of the service
        NORMAL  # Location in normal flash
        FAST  # Location in fast flash
        SLOW  # Location in slow flash
        INLINE  # Service is inlined
      enumeration efxRbMemLocHypotu32u32u32: origin=RB:5.0.0:2012-12-17, set at pre-compile  # Efx_Hypot_u32u32_u32 | Select one of following values: NORMAL for location in normal flash, FAST for location in fast flash, SLOW for location in slow flash, INLINE for inlining of the service
        NORMAL  # Location in normal flash
        FAST  # Location in fast flash
        SLOW  # Location in slow flash
        INLINE  # Service is inlined
      enumeration efxRbMemLocHypotu8u8u8: origin=RB:5.0.0:2012-12-17, set at pre-compile  # Efx_Hypot_u8u8_u8 | Select one of following values: NORMAL for location in normal flash, FAST for location in fast flash, SLOW for location in slow flash, INLINE for inlining of the service
        NORMAL  # Location in normal flash
        FAST  # Location in fast flash
        SLOW  # Location in slow flash
        INLINE  # Service is inlined
      enumeration efxRbMemLocHystCenterHalfDeltas16u8: origin=RB:1.0.0:2010-12-17, set at pre-compile  # Efx_HystCenterHalfDelta_s16_u8 | Select one of following values: NORMAL for location in normal flash, FAST for location in fast flash, SLOW for location in slow flash, INLINE for inlining of the service
        NORMAL  # Location in normal flash
        FAST  # Location in fast flash
        SLOW  # Location in slow flash
        INLINE  # Service is inlined
      enumeration efxRbMemLocHystCenterHalfDeltas32u8: origin=RB:1.0.0:2010-12-17, set at pre-compile  # Efx_HystCenterHalfDelta_s32_u8 | Select one of following values: NORMAL for location in normal flash, FAST for location in fast flash, SLOW for location in slow flash, INLINE for inlining of the service
        NORMAL  # Location in normal flash
        FAST  # Location in fast flash
        SLOW  # Location in slow flash
        INLINE  # Service is inlined
      enumeration efxRbMemLocHystCenterHalfDeltas8u8: origin=RB:1.0.0:2010-12-17, set at pre-compile  # Efx_HystCenterHalfDelta_s8_u8 | Select one of following values: NORMAL for location in normal flash, FAST for location in fast flash, SLOW for location in slow flash, INLINE for inlining of the service
        NORMAL  # Location in normal flash
        FAST  # Location in fast flash
        SLOW  # Location in slow flash
        INLINE  # Service is inlined
      enumeration efxRbMemLocHystCenterHalfDeltau16u8: origin=RB:1.0.0:2010-12-17, set at pre-compile  # Efx_HystCenterHalfDelta_u16_u8 | Select one of following values: NORMAL for location in normal flash, FAST for location in fast flash, SLOW for location in slow flash, INLINE for inlining of the service
        NORMAL  # Location in normal flash
        FAST  # Location in fast flash
        SLOW  # Location in slow flash
        INLINE  # Service is inlined
      enumeration efxRbMemLocHystCenterHalfDeltau32u8: origin=RB:1.0.0:2010-12-17, set at pre-compile  # Efx_HystCenterHalfDelta_u32_u8 | Select one of following values: NORMAL for location in normal flash, FAST for location in fast flash, SLOW for location in slow flash, INLINE for inlining of the service
        NORMAL  # Location in normal flash
        FAST  # Location in fast flash
        SLOW  # Location in slow flash
        INLINE  # Service is inlined
      enumeration efxRbMemLocHystCenterHalfDeltau8u8: origin=RB:1.0.0:2010-12-17, set at pre-compile  # Efx_HystCenterHalfDelta_u8_u8 | Select one of following values: NORMAL for location in normal flash, FAST for location in fast flash, SLOW for location in slow flash, INLINE for inlining of the service
        NORMAL  # Location in normal flash
        FAST  # Location in fast flash
        SLOW  # Location in slow flash
        INLINE  # Service is inlined
      enumeration efxRbMemLocHystDeltaRights16u8: origin=RB:1.0.0:2010-12-17, set at pre-compile  # Efx_HystDeltaRight_s16_u8 | Select one of following values: NORMAL for location in normal flash, FAST for location in fast flash, SLOW for location in slow flash, INLINE for inlining of the service
        NORMAL  # Location in normal flash
        FAST  # Location in fast flash
        SLOW  # Location in slow flash
        INLINE  # Service is inlined
      enumeration efxRbMemLocHystDeltaRights32u8: origin=RB:1.0.0:2010-12-17, set at pre-compile  # Efx_HystDeltaRight_s32_u8 | Select one of following values: NORMAL for location in normal flash, FAST for location in fast flash, SLOW for location in slow flash, INLINE for inlining of the service
        NORMAL  # Location in normal flash
        FAST  # Location in fast flash
        SLOW  # Location in slow flash
        INLINE  # Service is inlined
      enumeration efxRbMemLocHystDeltaRights8u8: origin=RB:1.0.0:2010-12-17, set at pre-compile  # Efx_HystDeltaRight_s8_u8 | Select one of following values: NORMAL for location in normal flash, FAST for location in fast flash, SLOW for location in slow flash, INLINE for inlining of the service
        NORMAL  # Location in normal flash
        FAST  # Location in fast flash
        SLOW  # Location in slow flash
        INLINE  # Service is inlined
      enumeration efxRbMemLocHystDeltaRightu16u8: origin=RB:1.0.0:2010-12-17, set at pre-compile  # Efx_HystDeltaRight_u16_u8 | Select one of following values: NORMAL for location in normal flash, FAST for location in fast flash, SLOW for location in slow flash, INLINE for inlining of the service
        NORMAL  # Location in normal flash
        FAST  # Location in fast flash
        SLOW  # Location in slow flash
        INLINE  # Service is inlined
      enumeration efxRbMemLocHystDeltaRightu32u8: origin=RB:1.0.0:2010-12-17, set at pre-compile  # Efx_HystDeltaRight_u32_u8 | Select one of following values: NORMAL for location in normal flash, FAST for location in fast flash, SLOW for location in slow flash, INLINE for inlining of the service
        NORMAL  # Location in normal flash
        FAST  # Location in fast flash
        SLOW  # Location in slow flash
        INLINE  # Service is inlined
      enumeration efxRbMemLocHystDeltaRightu8u8: origin=RB:1.0.0:2010-12-17, set at pre-compile  # Efx_HystDeltaRight_u8_u8 | Select one of following values: NORMAL for location in normal flash, FAST for location in fast flash, SLOW for location in slow flash, INLINE for inlining of the service
        NORMAL  # Location in normal flash
        FAST  # Location in fast flash
        SLOW  # Location in slow flash
        INLINE  # Service is inlined
      enumeration efxRbMemLocHystLeftDeltas16u8: origin=RB:1.0.0:2010-12-17, set at pre-compile  # Efx_HystLeftDelta_s16_u8 | Select one of following values: NORMAL for location in normal flash, FAST for location in fast flash, SLOW for location in slow flash, INLINE for inlining of the service
        NORMAL  # Location in normal flash
        FAST  # Location in fast flash
        SLOW  # Location in slow flash
        INLINE  # Service is inlined
      enumeration efxRbMemLocHystLeftDeltas32u8: origin=RB:1.0.0:2010-12-17, set at pre-compile  # Efx_HystLeftDelta_s32_u8 | Select one of following values: NORMAL for location in normal flash, FAST for location in fast flash, SLOW for location in slow flash, INLINE for inlining of the service
        NORMAL  # Location in normal flash
        FAST  # Location in fast flash
        SLOW  # Location in slow flash
        INLINE  # Service is inlined
      enumeration efxRbMemLocHystLeftDeltas8u8: origin=RB:1.0.0:2010-12-17, set at pre-compile  # Efx_HystLeftDelta_s8_u8 | Select one of following values: NORMAL for location in normal flash, FAST for location in fast flash, SLOW for location in slow flash, INLINE for inlining of the service
        NORMAL  # Location in normal flash
        FAST  # Location in fast flash
        SLOW  # Location in slow flash
        INLINE  # Service is inlined
      enumeration efxRbMemLocHystLeftDeltau16u8: origin=RB:1.0.0:2010-12-17, set at pre-compile  # Efx_HystLeftDelta_u16_u8 | Select one of following values: NORMAL for location in normal flash, FAST for location in fast flash, SLOW for location in slow flash, INLINE for inlining of the service
        NORMAL  # Location in normal flash
        FAST  # Location in fast flash
        SLOW  # Location in slow flash
        INLINE  # Service is inlined
      enumeration efxRbMemLocHystLeftDeltau32u8: origin=RB:1.0.0:2010-12-17, set at pre-compile  # Efx_HystLeftDelta_u32_u8 | Select one of following values: NORMAL for location in normal flash, FAST for location in fast flash, SLOW for location in slow flash, INLINE for inlining of the service
        NORMAL  # Location in normal flash
        FAST  # Location in fast flash
        SLOW  # Location in slow flash
        INLINE  # Service is inlined
      enumeration efxRbMemLocHystLeftDeltau8u8: origin=RB:1.0.0:2010-12-17, set at pre-compile  # Efx_HystLeftDelta_u8_u8 | Select one of following values: NORMAL for location in normal flash, FAST for location in fast flash, SLOW for location in slow flash, INLINE for inlining of the service
        NORMAL  # Location in normal flash
        FAST  # Location in fast flash
        SLOW  # Location in slow flash
        INLINE  # Service is inlined
      enumeration efxRbMemLocHystLeftRights16u8: origin=RB:1.0.0:2010-12-17, set at pre-compile  # Efx_HystLeftRight_s16_u8 | Select one of following values: NORMAL for location in normal flash, FAST for location in fast flash, SLOW for location in slow flash, INLINE for inlining of the service
        NORMAL  # Location in normal flash
        FAST  # Location in fast flash
        SLOW  # Location in slow flash
        INLINE  # Service is inlined
      enumeration efxRbMemLocHystLeftRights32u8: origin=RB:1.0.0:2010-12-17, set at pre-compile  # Efx_HystLeftRight_s32_u8 | Select one of following values: NORMAL for location in normal flash, FAST for location in fast flash, SLOW for location in slow flash, INLINE for inlining of the service
        NORMAL  # Location in normal flash
        FAST  # Location in fast flash
        SLOW  # Location in slow flash
        INLINE  # Service is inlined
      enumeration efxRbMemLocHystLeftRights8u8: origin=RB:1.0.0:2010-12-17, set at pre-compile  # Efx_HystLeftRight_s8_u8 | Select one of following values: NORMAL for location in normal flash, FAST for location in fast flash, SLOW for location in slow flash, INLINE for inlining of the service
        NORMAL  # Location in normal flash
        FAST  # Location in fast flash
        SLOW  # Location in slow flash
        INLINE  # Service is inlined
      enumeration efxRbMemLocHystLeftRightu16u8: origin=RB:1.0.0:2010-12-17, set at pre-compile  # Efx_HystLeftRight_u16_u8 | Select one of following values: NORMAL for location in normal flash, FAST for location in fast flash, SLOW for location in slow flash, INLINE for inlining of the service
        NORMAL  # Location in normal flash
        FAST  # Location in fast flash
        SLOW  # Location in slow flash
        INLINE  # Service is inlined
      enumeration efxRbMemLocHystLeftRightu32u8: origin=RB:1.0.0:2010-12-17, set at pre-compile  # Efx_HystLeftRight_u32_u8 | Select one of following values: NORMAL for location in normal flash, FAST for location in fast flash, SLOW for location in slow flash, INLINE for inlining of the service
        NORMAL  # Location in normal flash
        FAST  # Location in fast flash
        SLOW  # Location in slow flash
        INLINE  # Service is inlined
      enumeration efxRbMemLocHystLeftRightu8u8: origin=RB:1.0.0:2010-12-17, set at pre-compile  # Efx_HystLeftRight_u8_u8 | Select one of following values: NORMAL for location in normal flash, FAST for location in fast flash, SLOW for location in slow flash, INLINE for inlining of the service
        NORMAL  # Location in normal flash
        FAST  # Location in fast flash
        SLOW  # Location in slow flash
        INLINE  # Service is inlined
      enumeration efxRbMemLocHysteresiss16s16: origin=RB:4.0.0:2016-12-18, set at pre-compile  # Efx_Hysteresis_s16_s16 | Select one of following values: NORMAL for location in normal flash, FAST for location in fast flash, SLOW for location in slow flash, INLINE for inlining of the service
        NORMAL  # Location in normal flash
        FAST  # Location in fast flash
        SLOW  # Location in slow flash
        INLINE  # Service is inlined
      enumeration efxRbMemLocHysteresiss32s32: origin=RB:4.0.0:2016-12-18, set at pre-compile  # Efx_Hysteresis_s32_s32 | Select one of following values: NORMAL for location in normal flash, FAST for location in fast flash, SLOW for location in slow flash, INLINE for inlining of the service
        NORMAL  # Location in normal flash
        FAST  # Location in fast flash
        SLOW  # Location in slow flash
        INLINE  # Service is inlined
      enumeration efxRbMemLocHysteresiss8s8: origin=RB:4.0.0:2016-12-18, set at pre-compile  # Efx_Hysteresis_s8_s8 | Select one of following values: NORMAL for location in normal flash, FAST for location in fast flash, SLOW for location in slow flash, INLINE for inlining of the service
        NORMAL  # Location in normal flash
        FAST  # Location in fast flash
        SLOW  # Location in slow flash
        INLINE  # Service is inlined
      enumeration efxRbMemLocHysteresisu16u16: origin=RB:4.0.0:2016-12-18, set at pre-compile  # Efx_Hysteresis_u16_u16 | Select one of following values: NORMAL for location in normal flash, FAST for location in fast flash, SLOW for location in slow flash, INLINE for inlining of the service
        NORMAL  # Location in normal flash
        FAST  # Location in fast flash
        SLOW  # Location in slow flash
        INLINE  # Service is inlined
      enumeration efxRbMemLocHysteresisu32u32: origin=RB:4.0.0:2016-12-18, set at pre-compile  # Efx_Hysteresis_u32_u32 | Select one of following values: NORMAL for location in normal flash, FAST for location in fast flash, SLOW for location in slow flash, INLINE for inlining of the service
        NORMAL  # Location in normal flash
        FAST  # Location in fast flash
        SLOW  # Location in slow flash
        INLINE  # Service is inlined
      enumeration efxRbMemLocHysteresisu8u8: origin=RB:4.0.0:2016-12-18, set at pre-compile  # Efx_Hysteresis_u8_u8 | Select one of following values: NORMAL for location in normal flash, FAST for location in fast flash, SLOW for location in slow flash, INLINE for inlining of the service
        NORMAL  # Location in normal flash
        FAST  # Location in fast flash
        SLOW  # Location in slow flash
        INLINE  # Service is inlined
      enumeration efxRbMemLocICalc: origin=RB:1.0.0:2010-12-17, set at pre-compile  # Efx_ICalc | Select one of following values: NORMAL for location in normal flash, FAST for location in fast flash, SLOW for location in slow flash
        NORMAL  # Location in normal flash
        FAST  # Location in fast flash
        SLOW  # Location in slow flash
      enumeration efxRbMemLocILimCalc: origin=RB:1.0.0:2010-12-17, set at pre-compile  # Efx_ILimCalc | Select one of following values: NORMAL for location in normal flash, FAST for location in fast flash, SLOW for location in slow flash
        NORMAL  # Location in normal flash
        FAST  # Location in fast flash
        SLOW  # Location in slow flash
      enumeration efxRbMemLocIOuts16: origin=RB:1.0.0:2010-12-17, set at pre-compile  # Efx_IOut_s16 | Select one of following values: NORMAL for location in normal flash, FAST for location in fast flash, SLOW for location in slow flash, INLINE for inlining of the service
        NORMAL  # Location in normal flash
        FAST  # Location in fast flash
        SLOW  # Location in slow flash
        INLINE  # Service is inlined
      enumeration efxRbMemLocIOuts8: origin=RB:1.0.0:2010-12-17, set at pre-compile  # Efx_IOut_s8 | Select one of following values: NORMAL for location in normal flash, FAST for location in fast flash, SLOW for location in slow flash, INLINE for inlining of the service
        NORMAL  # Location in normal flash
        FAST  # Location in fast flash
        SLOW  # Location in slow flash
        INLINE  # Service is inlined
      enumeration efxRbMemLocISetState: origin=RB:1.0.0:2010-12-17, set at pre-compile  # Efx_ISetState | Select one of following values: NORMAL for location in normal flash, FAST for location in fast flash, SLOW for location in slow flash, INLINE for inlining of the service
        NORMAL  # Location in normal flash
        FAST  # Location in fast flash
        SLOW  # Location in slow flash
        INLINE  # Service is inlined
      enumeration efxRbMemLocIntervalCloseds32u8: origin=RB:1.0.0:2010-12-17, set at pre-compile  # Efx_IntervalClosed_s32_u8 | Select one of following values: NORMAL for location in normal flash, FAST for location in fast flash, SLOW for location in slow flash, INLINE for inlining of the service
        NORMAL  # Location in normal flash
        FAST  # Location in fast flash
        SLOW  # Location in slow flash
        INLINE  # Service is inlined
      enumeration efxRbMemLocIntervalClosedu32u8: origin=RB:1.0.0:2010-12-17, set at pre-compile  # Efx_IntervalClosed_u32_u8 | Select one of following values: NORMAL for location in normal flash, FAST for location in fast flash, SLOW for location in slow flash, INLINE for inlining of the service
        NORMAL  # Location in normal flash
        FAST  # Location in fast flash
        SLOW  # Location in slow flash
        INLINE  # Service is inlined
      enumeration efxRbMemLocIntervalLeftOpens32u8: origin=RB:1.0.0:2010-12-17, set at pre-compile  # Efx_IntervalLeftOpen_s32_u8 | Select one of following values: NORMAL for location in normal flash, FAST for location in fast flash, SLOW for location in slow flash, INLINE for inlining of the service
        NORMAL  # Location in normal flash
        FAST  # Location in fast flash
        SLOW  # Location in slow flash
        INLINE  # Service is inlined
      enumeration efxRbMemLocIntervalLeftOpenu32u8: origin=RB:1.0.0:2010-12-17, set at pre-compile  # Efx_IntervalLeftOpen_u32_u8 | Select one of following values: NORMAL for location in normal flash, FAST for location in fast flash, SLOW for location in slow flash, INLINE for inlining of the service
        NORMAL  # Location in normal flash
        FAST  # Location in fast flash
        SLOW  # Location in slow flash
        INLINE  # Service is inlined
      enumeration efxRbMemLocIntervalOpens32u8: origin=RB:1.0.0:2010-12-17, set at pre-compile  # Efx_IntervalOpen_s32_u8 | Select one of following values: NORMAL for location in normal flash, FAST for location in fast flash, SLOW for location in slow flash, INLINE for inlining of the service
        NORMAL  # Location in normal flash
        FAST  # Location in fast flash
        SLOW  # Location in slow flash
        INLINE  # Service is inlined
      enumeration efxRbMemLocIntervalOpenu32u8: origin=RB:1.0.0:2010-12-17, set at pre-compile  # Efx_IntervalOpen_u32_u8 | Select one of following values: NORMAL for location in normal flash, FAST for location in fast flash, SLOW for location in slow flash, INLINE for inlining of the service
        NORMAL  # Location in normal flash
        FAST  # Location in fast flash
        SLOW  # Location in slow flash
        INLINE  # Service is inlined
      enumeration efxRbMemLocIntervalRightOpens32u8: origin=RB:1.0.0:2010-12-17, set at pre-compile  # Efx_IntervalRightOpen_s32_u8 | Select one of following values: NORMAL for location in normal flash, FAST for location in fast flash, SLOW for location in slow flash, INLINE for inlining of the service
        NORMAL  # Location in normal flash
        FAST  # Location in fast flash
        SLOW  # Location in slow flash
        INLINE  # Service is inlined
      enumeration efxRbMemLocIntervalRightOpenu32u8: origin=RB:1.0.0:2010-12-17, set at pre-compile  # Efx_IntervalRightOpen_u32_u8 | Select one of following values: NORMAL for location in normal flash, FAST for location in fast flash, SLOW for location in slow flash, INLINE for inlining of the service
        NORMAL  # Location in normal flash
        FAST  # Location in fast flash
        SLOW  # Location in slow flash
        INLINE  # Service is inlined
      enumeration efxRbMemLocLpFilterFac1s16s16s16s16: origin=RB:5.0.0:2012-12-17, set at pre-compile  # Efx_LpFilterFac1_s16s16s16_s16 | Select one of following values: NORMAL for location in normal flash, FAST for location in fast flash, SLOW for location in slow flash, INLINE for inlining of the service
        NORMAL  # Location in normal flash
        FAST  # Location in fast flash
        SLOW  # Location in slow flash
        INLINE  # Service is inlined
      enumeration efxRbMemLocLpFilterFac1s16s16u16s16: origin=RB:5.0.0:2012-12-17, set at pre-compile  # Efx_LpFilterFac1_s16s16u16_s16 | Select one of following values: NORMAL for location in normal flash, FAST for location in fast flash, SLOW for location in slow flash, INLINE for inlining of the service
        NORMAL  # Location in normal flash
        FAST  # Location in fast flash
        SLOW  # Location in slow flash
        INLINE  # Service is inlined
      enumeration efxRbMemLocLpFilterFac1s32s16u16s32: origin=RB:5.0.0:2012-12-17, set at pre-compile  # Efx_LpFilterFac1_s32s16u16_s32 | Select one of following values: NORMAL for location in normal flash, FAST for location in fast flash, SLOW for location in slow flash, INLINE for inlining of the service
        NORMAL  # Location in normal flash
        FAST  # Location in fast flash
        SLOW  # Location in slow flash
        INLINE  # Service is inlined
      enumeration efxRbMemLocLpFilterFac1s32s32u16s32: origin=RB:5.0.0:2012-12-17, set at pre-compile  # Efx_LpFilterFac1_s32s32u16_s32 | Select one of following values: NORMAL for location in normal flash, FAST for location in fast flash, SLOW for location in slow flash, INLINE for inlining of the service
        NORMAL  # Location in normal flash
        FAST  # Location in fast flash
        SLOW  # Location in slow flash
        INLINE  # Service is inlined
      enumeration efxRbMemLocLpFilterFac1u16u16s16u16: origin=RB:5.0.0:2012-12-17, set at pre-compile  # Efx_LpFilterFac1_u16u16s16_u16 | Select one of following values: NORMAL for location in normal flash, FAST for location in fast flash, SLOW for location in slow flash, INLINE for inlining of the service
        NORMAL  # Location in normal flash
        FAST  # Location in fast flash
        SLOW  # Location in slow flash
        INLINE  # Service is inlined
      enumeration efxRbMemLocLpFilterFac1u16u16u16u16: origin=RB:5.0.0:2012-12-17, set at pre-compile  # Efx_LpFilterFac1_u16u16u16_u16 | Select one of following values: NORMAL for location in normal flash, FAST for location in fast flash, SLOW for location in slow flash, INLINE for inlining of the service
        NORMAL  # Location in normal flash
        FAST  # Location in fast flash
        SLOW  # Location in slow flash
        INLINE  # Service is inlined
      enumeration efxRbMemLocLpFilterFac1u32u16u16u32: origin=RB:5.0.0:2012-12-17, set at pre-compile  # Efx_LpFilterFac1_u32u16u16_u32 | Select one of following values: NORMAL for location in normal flash, FAST for location in fast flash, SLOW for location in slow flash, INLINE for inlining of the service
        NORMAL  # Location in normal flash
        FAST  # Location in fast flash
        SLOW  # Location in slow flash
        INLINE  # Service is inlined
      enumeration efxRbMemLocLpFilterFac1u32u32u16u32: origin=RB:5.0.0:2012-12-17, set at pre-compile  # Efx_LpFilterFac1_u32u32u16_u32 | Select one of following values: NORMAL for location in normal flash, FAST for location in fast flash, SLOW for location in slow flash, INLINE for inlining of the service
        NORMAL  # Location in normal flash
        FAST  # Location in fast flash
        SLOW  # Location in slow flash
        INLINE  # Service is inlined
      enumeration efxRbMemLocLpFilterFac1u32u32u32u32: origin=RB:5.0.0:2012-12-17, set at pre-compile  # Efx_LpFilterFac1_u32u32u32_u32 | Select one of following values: NORMAL for location in normal flash, FAST for location in fast flash, SLOW for location in slow flash, INLINE for inlining of the service
        NORMAL  # Location in normal flash
        FAST  # Location in fast flash
        SLOW  # Location in slow flash
        INLINE  # Service is inlined
      enumeration efxRbMemLocLpFilterFac1u8u8u8u8: origin=RB:5.0.0:2012-12-17, set at pre-compile  # Efx_LpFilterFac1_u8u8u8_u8 | Select one of following values: NORMAL for location in normal flash, FAST for location in fast flash, SLOW for location in slow flash, INLINE for inlining of the service
        NORMAL  # Location in normal flash
        FAST  # Location in fast flash
        SLOW  # Location in slow flash
        INLINE  # Service is inlined
      enumeration efxRbMemLocLpFilters32s32: origin=RB:5.0.0:2012-12-17, set at pre-compile  # Efx_LpFilter_s32_s32 | Select one of following values: NORMAL for location in normal flash, FAST for location in fast flash, SLOW for location in slow flash, INLINE for inlining of the service
        NORMAL  # Location in normal flash
        FAST  # Location in fast flash
        SLOW  # Location in slow flash
        INLINE  # Service is inlined
      enumeration efxRbMemLocLpFilteru32u32: origin=RB:5.0.0:2012-12-17, set at pre-compile  # Efx_LpFilter_u32_u32 | Select one of following values: NORMAL for location in normal flash, FAST for location in fast flash, SLOW for location in slow flash, INLINE for inlining of the service
        NORMAL  # Location in normal flash
        FAST  # Location in fast flash
        SLOW  # Location in slow flash
        INLINE  # Service is inlined
      enumeration efxRbMemLocMedianSorts16s16: origin=RB:1.0.0:2010-12-17, set at pre-compile  # Efx_MedianSort_s16_s16 | Select one of following values: NORMAL for location in normal flash, FAST for location in fast flash, SLOW for location in slow flash
        NORMAL  # Location in normal flash
        FAST  # Location in fast flash
        SLOW  # Location in slow flash
      enumeration efxRbMemLocMedianSorts32s32: origin=RB:1.0.0:2010-12-17, set at pre-compile  # Efx_MedianSort_s32_s32 | Select one of following values: NORMAL for location in normal flash, FAST for location in fast flash, SLOW for location in slow flash
        NORMAL  # Location in normal flash
        FAST  # Location in fast flash
        SLOW  # Location in slow flash
      enumeration efxRbMemLocMedianSorts8s8: origin=RB:1.0.0:2010-12-17, set at pre-compile  # Efx_MedianSort_s8_s8 | Select one of following values: NORMAL for location in normal flash, FAST for location in fast flash, SLOW for location in slow flash
        NORMAL  # Location in normal flash
        FAST  # Location in fast flash
        SLOW  # Location in slow flash
      enumeration efxRbMemLocMedianSortu16u16: origin=RB:1.0.0:2010-12-17, set at pre-compile  # Efx_MedianSort_u16_u16 | Select one of following values: NORMAL for location in normal flash, FAST for location in fast flash, SLOW for location in slow flash
        NORMAL  # Location in normal flash
        FAST  # Location in fast flash
        SLOW  # Location in slow flash
      enumeration efxRbMemLocMedianSortu32u32: origin=RB:1.0.0:2010-12-17, set at pre-compile  # Efx_MedianSort_u32_u32 | Select one of following values: NORMAL for location in normal flash, FAST for location in fast flash, SLOW for location in slow flash
        NORMAL  # Location in normal flash
        FAST  # Location in fast flash
        SLOW  # Location in slow flash
      enumeration efxRbMemLocMedianSortu8u8: origin=RB:1.0.0:2010-12-17, set at pre-compile  # Efx_MedianSort_u8_u8 | Select one of following values: NORMAL for location in normal flash, FAST for location in fast flash, SLOW for location in slow flash
        NORMAL  # Location in normal flash
        FAST  # Location in fast flash
        SLOW  # Location in slow flash
      enumeration efxRbMemLocMovingAverages16s16: origin=RB:1.0.0:2010-12-17, set at pre-compile  # Efx_MovingAverage_s16_s16 | Select one of following values: NORMAL for location in normal flash, FAST for location in fast flash, SLOW for location in slow flash, INLINE for inlining of the service
        NORMAL  # Location in normal flash
        FAST  # Location in fast flash
        SLOW  # Location in slow flash
        INLINE  # Service is inlined
      enumeration efxRbMemLocMovingAverages32s32: origin=RB:1.0.0:2010-12-17, set at pre-compile  # Efx_MovingAverage_s32_s32 | Select one of following values: NORMAL for location in normal flash, FAST for location in fast flash, SLOW for location in slow flash, INLINE for inlining of the service
        NORMAL  # Location in normal flash
        FAST  # Location in fast flash
        SLOW  # Location in slow flash
        INLINE  # Service is inlined
      enumeration efxRbMemLocMuls64s32s64: origin=RB:5.0.0:2012-12-17, set at pre-compile  # Efx_Mul_s64s32_s64 | Select one of following values: NORMAL for location in normal flash, FAST for location in fast flash, SLOW for location in slow flash, INLINE for inlining of the service
        NORMAL  # Location in normal flash
        FAST  # Location in fast flash
        SLOW  # Location in slow flash
        INLINE  # Service is inlined
      enumeration efxRbMemLocMuls64s64s64: origin=RB:5.0.0:2012-12-17, set at pre-compile  # Efx_Mul_s64s64_s64 | Select one of following values: NORMAL for location in normal flash, FAST for location in fast flash, SLOW for location in slow flash, INLINE for inlining of the service
        NORMAL  # Location in normal flash
        FAST  # Location in fast flash
        SLOW  # Location in slow flash
        INLINE  # Service is inlined
      enumeration efxRbMemLocMuls64u32s64: origin=RB:5.0.0:2012-12-17, set at pre-compile  # Efx_Mul_s64u32_s64 | Select one of following values: NORMAL for location in normal flash, FAST for location in fast flash, SLOW for location in slow flash, INLINE for inlining of the service
        NORMAL  # Location in normal flash
        FAST  # Location in fast flash
        SLOW  # Location in slow flash
        INLINE  # Service is inlined
      enumeration efxRbMemLocPCalc: origin=RB:1.0.0:2010-12-17, set at pre-compile  # Efx_PCalc | Select one of following values: NORMAL for location in normal flash, FAST for location in fast flash, SLOW for location in slow flash, INLINE for inlining of the service
        NORMAL  # Location in normal flash
        FAST  # Location in fast flash
        SLOW  # Location in slow flash
        INLINE  # Service is inlined
      enumeration efxRbMemLocPDCalc: origin=RB:1.0.0:2010-12-17, set at pre-compile  # Efx_PDCalc | Select one of following values: NORMAL for location in normal flash, FAST for location in fast flash, SLOW for location in slow flash, INLINE for inlining of the service
        NORMAL  # Location in normal flash
        FAST  # Location in fast flash
        SLOW  # Location in slow flash
        INLINE  # Service is inlined
      enumeration efxRbMemLocPDOuts16: origin=RB:1.0.0:2010-12-17, set at pre-compile  # Efx_PDOut_s16 | Select one of following values: NORMAL for location in normal flash, FAST for location in fast flash, SLOW for location in slow flash, INLINE for inlining of the service
        NORMAL  # Location in normal flash
        FAST  # Location in fast flash
        SLOW  # Location in slow flash
        INLINE  # Service is inlined
      enumeration efxRbMemLocPDOuts8: origin=RB:1.0.0:2010-12-17, set at pre-compile  # Efx_PDOut_s8 | Select one of following values: NORMAL for location in normal flash, FAST for location in fast flash, SLOW for location in slow flash, INLINE for inlining of the service
        NORMAL  # Location in normal flash
        FAST  # Location in fast flash
        SLOW  # Location in slow flash
        INLINE  # Service is inlined
      enumeration efxRbMemLocPDSetParam: origin=RB:1.0.0:2010-12-17, set at pre-compile  # Efx_PDSetParam | Select one of following values: NORMAL for location in normal flash, FAST for location in fast flash, SLOW for location in slow flash, INLINE for inlining of the service
        NORMAL  # Location in normal flash
        FAST  # Location in fast flash
        SLOW  # Location in slow flash
        INLINE  # Service is inlined
      enumeration efxRbMemLocPDSetState: origin=RB:1.0.0:2010-12-17, set at pre-compile  # Efx_PDSetState | Select one of following values: NORMAL for location in normal flash, FAST for location in fast flash, SLOW for location in slow flash, INLINE for inlining of the service
        NORMAL  # Location in normal flash
        FAST  # Location in fast flash
        SLOW  # Location in slow flash
        INLINE  # Service is inlined
      enumeration efxRbMemLocPIDOuts16: origin=RB:1.0.0:2010-12-17, set at pre-compile  # Efx_PIDOut_s16 | Select one of following values: NORMAL for location in normal flash, FAST for location in fast flash, SLOW for location in slow flash, INLINE for inlining of the service
        NORMAL  # Location in normal flash
        FAST  # Location in fast flash
        SLOW  # Location in slow flash
        INLINE  # Service is inlined
      enumeration efxRbMemLocPIDOuts8: origin=RB:1.0.0:2010-12-17, set at pre-compile  # Efx_PIDOut_s8 | Select one of following values: NORMAL for location in normal flash, FAST for location in fast flash, SLOW for location in slow flash, INLINE for inlining of the service
        NORMAL  # Location in normal flash
        FAST  # Location in fast flash
        SLOW  # Location in slow flash
        INLINE  # Service is inlined
      enumeration efxRbMemLocPIDSetParam: origin=RB:1.0.0:2010-12-17, set at pre-compile  # Efx_PIDSetParam | Select one of following values: NORMAL for location in normal flash, FAST for location in fast flash, SLOW for location in slow flash, INLINE for inlining of the service
        NORMAL  # Location in normal flash
        FAST  # Location in fast flash
        SLOW  # Location in slow flash
        INLINE  # Service is inlined
      enumeration efxRbMemLocPIDSetState: origin=RB:1.0.0:2010-12-17, set at pre-compile  # Efx_PIDSetState | Select one of following values: NORMAL for location in normal flash, FAST for location in fast flash, SLOW for location in slow flash, INLINE for inlining of the service
        NORMAL  # Location in normal flash
        FAST  # Location in fast flash
        SLOW  # Location in slow flash
        INLINE  # Service is inlined
      enumeration efxRbMemLocPIDTyp1Calc: origin=RB:1.0.0:2010-12-17, set at pre-compile  # Efx_PIDTyp1Calc | Select one of following values: NORMAL for location in normal flash, FAST for location in fast flash, SLOW for location in slow flash
        NORMAL  # Location in normal flash
        FAST  # Location in fast flash
        SLOW  # Location in slow flash
      enumeration efxRbMemLocPIDTyp1LimCalc: origin=RB:1.0.0:2010-12-17, set at pre-compile  # Efx_PIDTyp1LimCalc | Select one of following values: NORMAL for location in normal flash, FAST for location in fast flash, SLOW for location in slow flash
        NORMAL  # Location in normal flash
        FAST  # Location in fast flash
        SLOW  # Location in slow flash
      enumeration efxRbMemLocPIDTyp2Calc: origin=RB:1.0.0:2010-12-17, set at pre-compile  # Efx_PIDTyp2Calc | Select one of following values: NORMAL for location in normal flash, FAST for location in fast flash, SLOW for location in slow flash
        NORMAL  # Location in normal flash
        FAST  # Location in fast flash
        SLOW  # Location in slow flash
      enumeration efxRbMemLocPIDTyp2LimCalc: origin=RB:1.0.0:2010-12-17, set at pre-compile  # Efx_PIDTyp2LimCalc | Select one of following values: NORMAL for location in normal flash, FAST for location in fast flash, SLOW for location in slow flash
        NORMAL  # Location in normal flash
        FAST  # Location in fast flash
        SLOW  # Location in slow flash
      enumeration efxRbMemLocPIOuts16: origin=RB:1.0.0:2010-12-17, set at pre-compile  # Efx_PIOut_s16 | Select one of following values: NORMAL for location in normal flash, FAST for location in fast flash, SLOW for location in slow flash, INLINE for inlining of the service
        NORMAL  # Location in normal flash
        FAST  # Location in fast flash
        SLOW  # Location in slow flash
        INLINE  # Service is inlined
      enumeration efxRbMemLocPIOuts8: origin=RB:1.0.0:2010-12-17, set at pre-compile  # Efx_PIOut_s8 | Select one of following values: NORMAL for location in normal flash, FAST for location in fast flash, SLOW for location in slow flash, INLINE for inlining of the service
        NORMAL  # Location in normal flash
        FAST  # Location in fast flash
        SLOW  # Location in slow flash
        INLINE  # Service is inlined
      enumeration efxRbMemLocPISetParam: origin=RB:1.0.0:2010-12-17, set at pre-compile  # Efx_PISetParam | Select one of following values: NORMAL for location in normal flash, FAST for location in fast flash, SLOW for location in slow flash, INLINE for inlining of the service
        NORMAL  # Location in normal flash
        FAST  # Location in fast flash
        SLOW  # Location in slow flash
        INLINE  # Service is inlined
      enumeration efxRbMemLocPISetState: origin=RB:1.0.0:2010-12-17, set at pre-compile  # Efx_PISetState | Select one of following values: NORMAL for location in normal flash, FAST for location in fast flash, SLOW for location in slow flash, INLINE for inlining of the service
        NORMAL  # Location in normal flash
        FAST  # Location in fast flash
        SLOW  # Location in slow flash
        INLINE  # Service is inlined
      enumeration efxRbMemLocPITyp1Calc: origin=RB:1.0.0:2010-12-17, set at pre-compile  # Efx_PITyp1Calc | Select one of following values: NORMAL for location in normal flash, FAST for location in fast flash, SLOW for location in slow flash
        NORMAL  # Location in normal flash
        FAST  # Location in fast flash
        SLOW  # Location in slow flash
      enumeration efxRbMemLocPITyp1LimCalc: origin=RB:1.0.0:2010-12-17, set at pre-compile  # Efx_PITyp1LimCalc | Select one of following values: NORMAL for location in normal flash, FAST for location in fast flash, SLOW for location in slow flash
        NORMAL  # Location in normal flash
        FAST  # Location in fast flash
        SLOW  # Location in slow flash
      enumeration efxRbMemLocPITyp2Calc: origin=RB:1.0.0:2010-12-17, set at pre-compile  # Efx_PITyp2Calc | Select one of following values: NORMAL for location in normal flash, FAST for location in fast flash, SLOW for location in slow flash
        NORMAL  # Location in normal flash
        FAST  # Location in fast flash
        SLOW  # Location in slow flash
      enumeration efxRbMemLocPITyp2LimCalc: origin=RB:1.0.0:2010-12-17, set at pre-compile  # Efx_PITyp2LimCalc | Select one of following values: NORMAL for location in normal flash, FAST for location in fast flash, SLOW for location in slow flash
        NORMAL  # Location in normal flash
        FAST  # Location in fast flash
        SLOW  # Location in slow flash
      enumeration efxRbMemLocPOuts16: origin=RB:1.0.0:2010-12-17, set at pre-compile  # Efx_POut_s16 | Select one of following values: NORMAL for location in normal flash, FAST for location in fast flash, SLOW for location in slow flash, INLINE for inlining of the service
        NORMAL  # Location in normal flash
        FAST  # Location in fast flash
        SLOW  # Location in slow flash
        INLINE  # Service is inlined
      enumeration efxRbMemLocPOuts8: origin=RB:1.0.0:2010-12-17, set at pre-compile  # Efx_POut_s8 | Select one of following values: NORMAL for location in normal flash, FAST for location in fast flash, SLOW for location in slow flash, INLINE for inlining of the service
        NORMAL  # Location in normal flash
        FAST  # Location in fast flash
        SLOW  # Location in slow flash
        INLINE  # Service is inlined
      enumeration efxRbMemLocPSetState: origin=RB:1.0.0:2010-12-17, set at pre-compile  # Efx_PSetState | Select one of following values: NORMAL for location in normal flash, FAST for location in fast flash, SLOW for location in slow flash, INLINE for inlining of the service
        NORMAL  # Location in normal flash
        FAST  # Location in fast flash
        SLOW  # Location in slow flash
        INLINE  # Service is inlined
      enumeration efxRbMemLocPT1Calc: origin=RB:1.0.0:2010-12-17, set at pre-compile  # Efx_PT1Calc | Select one of following values: NORMAL for location in normal flash, FAST for location in fast flash, SLOW for location in slow flash
        NORMAL  # Location in normal flash
        FAST  # Location in fast flash
        SLOW  # Location in slow flash
      enumeration efxRbMemLocPT1Outs16: origin=RB:1.0.0:2010-12-17, set at pre-compile  # Efx_PT1Out_s16 | Select one of following values: NORMAL for location in normal flash, FAST for location in fast flash, SLOW for location in slow flash, INLINE for inlining of the service
        NORMAL  # Location in normal flash
        FAST  # Location in fast flash
        SLOW  # Location in slow flash
        INLINE  # Service is inlined
      enumeration efxRbMemLocPT1Outs8: origin=RB:1.0.0:2010-12-17, set at pre-compile  # Efx_PT1Out_s8 | Select one of following values: NORMAL for location in normal flash, FAST for location in fast flash, SLOW for location in slow flash, INLINE for inlining of the service
        NORMAL  # Location in normal flash
        FAST  # Location in fast flash
        SLOW  # Location in slow flash
        INLINE  # Service is inlined
      enumeration efxRbMemLocPT1SetState: origin=RB:1.0.0:2010-12-17, set at pre-compile  # Efx_PT1SetState | Select one of following values: NORMAL for location in normal flash, FAST for location in fast flash, SLOW for location in slow flash, INLINE for inlining of the service
        NORMAL  # Location in normal flash
        FAST  # Location in fast flash
        SLOW  # Location in slow flash
        INLINE  # Service is inlined
      enumeration efxRbMemLocPT1Typ1Calc: origin=RB:1.0.0:2021-06-30, set at pre-compile  # Efx_PT1Typ1Calc | Select one of following values: NORMAL for location in normal flash, FAST for location in fast flash, SLOW for location in slow flash
        NORMAL  # Location in normal flash
        FAST  # Location in fast flash
        SLOW  # Location in slow flash
      enumeration efxRbMemLocRSFlipFlop: origin=RB:1.0.0:2010-12-17, set at pre-compile  # Efx_RSFlipFlop | Select one of following values: NORMAL for location in normal flash, FAST for location in fast flash, SLOW for location in slow flash, INLINE for inlining of the service
        NORMAL  # Location in normal flash
        FAST  # Location in fast flash
        SLOW  # Location in slow flash
        INLINE  # Service is inlined
      enumeration efxRbMemLocRampCalc: origin=RB:1.0.0:2010-12-17, set at pre-compile  # Efx_RampCalc | Select one of following values: NORMAL for location in normal flash, FAST for location in fast flash, SLOW for location in slow flash, INLINE for inlining of the service
        NORMAL  # Location in normal flash
        FAST  # Location in fast flash
        SLOW  # Location in slow flash
        INLINE  # Service is inlined
      enumeration efxRbMemLocRampCalcJump: origin=RB:1.0.0:2010-12-17, set at pre-compile  # Efx_RampCalcJump | Select one of following values: NORMAL for location in normal flash, FAST for location in fast flash, SLOW for location in slow flash, INLINE for inlining of the service
        NORMAL  # Location in normal flash
        FAST  # Location in fast flash
        SLOW  # Location in slow flash
        INLINE  # Service is inlined
      enumeration efxRbMemLocRampCalcSwitch: origin=RB:5.0.0:2012-12-17, set at pre-compile  # Efx_RampCalcSwitch | Select one of following values: NORMAL for location in normal flash, FAST for location in fast flash, SLOW for location in slow flash, INLINE for inlining of the service
        NORMAL  # Location in normal flash
        FAST  # Location in fast flash
        SLOW  # Location in slow flash
        INLINE  # Service is inlined
      enumeration efxRbMemLocRampCheckActivity: origin=RB:1.0.0:2010-12-17, set at pre-compile  # Efx_RampCheckActivity | Select one of following values: NORMAL for location in normal flash, FAST for location in fast flash, SLOW for location in slow flash, INLINE for inlining of the service
        NORMAL  # Location in normal flash
        FAST  # Location in fast flash
        SLOW  # Location in slow flash
        INLINE  # Service is inlined
      enumeration efxRbMemLocRampGetSwitchPos: origin=RB:1.0.0:2010-12-17, set at pre-compile  # Efx_RampGetSwitchPos | Select one of following values: NORMAL for location in normal flash, FAST for location in fast flash, SLOW for location in slow flash, INLINE for inlining of the service
        NORMAL  # Location in normal flash
        FAST  # Location in fast flash
        SLOW  # Location in slow flash
        INLINE  # Service is inlined
      enumeration efxRbMemLocRampInitState: origin=RB:1.0.0:2010-12-17, set at pre-compile  # Efx_RampInitState | Select one of following values: NORMAL for location in normal flash, FAST for location in fast flash, SLOW for location in slow flash, INLINE for inlining of the service
        NORMAL  # Location in normal flash
        FAST  # Location in fast flash
        SLOW  # Location in slow flash
        INLINE  # Service is inlined
      enumeration efxRbMemLocRampOuts32: origin=RB:1.0.0:2010-12-17, set at pre-compile  # Efx_RampOut_s32 | Select one of following values: NORMAL for location in normal flash, FAST for location in fast flash, SLOW for location in slow flash, INLINE for inlining of the service
        NORMAL  # Location in normal flash
        FAST  # Location in fast flash
        SLOW  # Location in slow flash
        INLINE  # Service is inlined
      enumeration efxRbMemLocRampSetParam: origin=RB:1.0.0:2010-12-17, set at pre-compile  # Efx_RampSetParam | Select one of following values: NORMAL for location in normal flash, FAST for location in fast flash, SLOW for location in slow flash, INLINE for inlining of the service
        NORMAL  # Location in normal flash
        FAST  # Location in fast flash
        SLOW  # Location in slow flash
        INLINE  # Service is inlined
      enumeration efxRbMemLocSins16s16: origin=RB:5.0.0:2012-12-17, set at pre-compile  # Efx_Sin_s16_s16 | Select one of following values: NORMAL for location in normal flash, FAST for location in fast flash, SLOW for location in slow flash
        NORMAL  # Location in normal flash
        FAST  # Location in fast flash
        SLOW  # Location in slow flash
      enumeration efxRbMemLocSins32s32: origin=RB:5.0.0:2012-12-17, set at pre-compile  # Efx_Sin_s32_s32 | Select one of following values: NORMAL for location in normal flash, FAST for location in fast flash, SLOW for location in slow flash
        NORMAL  # Location in normal flash
        FAST  # Location in fast flash
        SLOW  # Location in slow flash
      enumeration efxRbMemLocSins8s8: origin=RB:5.0.0:2012-12-17, set at pre-compile  # Efx_Sin_s8_s8 | Select one of following values: NORMAL for location in normal flash, FAST for location in fast flash, SLOW for location in slow flash
        NORMAL  # Location in normal flash
        FAST  # Location in fast flash
        SLOW  # Location in slow flash
      enumeration efxRbMemLocSlewRates16: origin=RB:5.0.0:2012-12-17, set at pre-compile  # Efx_SlewRate_s16 | Select one of following values: NORMAL for location in normal flash, FAST for location in fast flash, SLOW for location in slow flash
        NORMAL  # Location in normal flash
        FAST  # Location in fast flash
        SLOW  # Location in slow flash
      enumeration efxRbMemLocSlewRates32: origin=RB:5.0.0:2012-12-17, set at pre-compile  # Efx_SlewRate_s32 | Select one of following values: NORMAL for location in normal flash, FAST for location in fast flash, SLOW for location in slow flash
        NORMAL  # Location in normal flash
        FAST  # Location in fast flash
        SLOW  # Location in slow flash
      enumeration efxRbMemLocSlewRateu16: origin=RB:5.0.0:2012-12-17, set at pre-compile  # Efx_SlewRate_u16 | Select one of following values: NORMAL for location in normal flash, FAST for location in fast flash, SLOW for location in slow flash
        NORMAL  # Location in normal flash
        FAST  # Location in fast flash
        SLOW  # Location in slow flash
      enumeration efxRbMemLocSlewRateu32: origin=RB:5.0.0:2012-12-17, set at pre-compile  # Efx_SlewRate_u32 | Select one of following values: NORMAL for location in normal flash, FAST for location in fast flash, SLOW for location in slow flash
        NORMAL  # Location in normal flash
        FAST  # Location in fast flash
        SLOW  # Location in slow flash
      enumeration efxRbMemLocSortAscends16: origin=RB:1.0.0:2010-12-17, set at pre-compile  # Efx_SortAscend_s16 | Select one of following values: NORMAL for location in normal flash, FAST for location in fast flash, SLOW for location in slow flash
        NORMAL  # Location in normal flash
        FAST  # Location in fast flash
        SLOW  # Location in slow flash
      enumeration efxRbMemLocSortAscends32: origin=RB:1.0.0:2010-12-17, set at pre-compile  # Efx_SortAscend_s32 | Select one of following values: NORMAL for location in normal flash, FAST for location in fast flash, SLOW for location in slow flash
        NORMAL  # Location in normal flash
        FAST  # Location in fast flash
        SLOW  # Location in slow flash
      enumeration efxRbMemLocSortAscends8: origin=RB:1.0.0:2010-12-17, set at pre-compile  # Efx_SortAscend_s8 | Select one of following values: NORMAL for location in normal flash, FAST for location in fast flash, SLOW for location in slow flash
        NORMAL  # Location in normal flash
        FAST  # Location in fast flash
        SLOW  # Location in slow flash
      enumeration efxRbMemLocSortAscendu16: origin=RB:1.0.0:2010-12-17, set at pre-compile  # Efx_SortAscend_u16 | Select one of following values: NORMAL for location in normal flash, FAST for location in fast flash, SLOW for location in slow flash
        NORMAL  # Location in normal flash
        FAST  # Location in fast flash
        SLOW  # Location in slow flash
      enumeration efxRbMemLocSortAscendu32: origin=RB:1.0.0:2010-12-17, set at pre-compile  # Efx_SortAscend_u32 | Select one of following values: NORMAL for location in normal flash, FAST for location in fast flash, SLOW for location in slow flash
        NORMAL  # Location in normal flash
        FAST  # Location in fast flash
        SLOW  # Location in slow flash
      enumeration efxRbMemLocSortAscendu8: origin=RB:1.0.0:2010-12-17, set at pre-compile  # Efx_SortAscend_u8 | Select one of following values: NORMAL for location in normal flash, FAST for location in fast flash, SLOW for location in slow flash
        NORMAL  # Location in normal flash
        FAST  # Location in fast flash
        SLOW  # Location in slow flash
      enumeration efxRbMemLocSortDescends16: origin=RB:1.0.0:2010-12-17, set at pre-compile  # Efx_SortDescend_s16 | Select one of following values: NORMAL for location in normal flash, FAST for location in fast flash, SLOW for location in slow flash
        NORMAL  # Location in normal flash
        FAST  # Location in fast flash
        SLOW  # Location in slow flash
      enumeration efxRbMemLocSortDescends32: origin=RB:1.0.0:2010-12-17, set at pre-compile  # Efx_SortDescend_s32 | Select one of following values: NORMAL for location in normal flash, FAST for location in fast flash, SLOW for location in slow flash
        NORMAL  # Location in normal flash
        FAST  # Location in fast flash
        SLOW  # Location in slow flash
      enumeration efxRbMemLocSortDescends8: origin=RB:1.0.0:2010-12-17, set at pre-compile  # Efx_SortDescend_s8 | Select one of following values: NORMAL for location in normal flash, FAST for location in fast flash, SLOW for location in slow flash
        NORMAL  # Location in normal flash
        FAST  # Location in fast flash
        SLOW  # Location in slow flash
      enumeration efxRbMemLocSortDescendu16: origin=RB:1.0.0:2010-12-17, set at pre-compile  # Efx_SortDescend_u16 | Select one of following values: NORMAL for location in normal flash, FAST for location in fast flash, SLOW for location in slow flash
        NORMAL  # Location in normal flash
        FAST  # Location in fast flash
        SLOW  # Location in slow flash
      enumeration efxRbMemLocSortDescendu32: origin=RB:1.0.0:2010-12-17, set at pre-compile  # Efx_SortDescend_u32 | Select one of following values: NORMAL for location in normal flash, FAST for location in fast flash, SLOW for location in slow flash
        NORMAL  # Location in normal flash
        FAST  # Location in fast flash
        SLOW  # Location in slow flash
      enumeration efxRbMemLocSortDescendu8: origin=RB:1.0.0:2010-12-17, set at pre-compile  # Efx_SortDescend_u8 | Select one of following values: NORMAL for location in normal flash, FAST for location in fast flash, SLOW for location in slow flash
        NORMAL  # Location in normal flash
        FAST  # Location in fast flash
        SLOW  # Location in slow flash
      enumeration efxRbMemLocSqrtu16u16: origin=RB:2.0.0:2011-06-30, set at pre-compile  # Efx_Sqrt_u16_u16 | Select one of following values: NORMAL for location in normal flash, FAST for location in fast flash, SLOW for location in slow flash
        NORMAL  # Location in normal flash
        FAST  # Location in fast flash
        SLOW  # Location in slow flash
      enumeration efxRbMemLocSqrtu32u32: origin=RB:2.0.0:2011-06-30, set at pre-compile  # Efx_Sqrt_u32_u32 | Select one of following values: NORMAL for location in normal flash, FAST for location in fast flash, SLOW for location in slow flash
        NORMAL  # Location in normal flash
        FAST  # Location in fast flash
        SLOW  # Location in slow flash
      enumeration efxRbMemLocSqrtu8u8: origin=RB:2.0.0:2011-06-30, set at pre-compile  # Efx_Sqrt_u8_u8 | Select one of following values: NORMAL for location in normal flash, FAST for location in fast flash, SLOW for location in slow flash
        NORMAL  # Location in normal flash
        FAST  # Location in fast flash
        SLOW  # Location in slow flash
      enumeration efxRbMemLocTypeLimiters16s8: origin=RB:2.0.0:2017-06-16, set at pre-compile  # Efx_TypeLimiter_s16_s8 | Select one of following values: NORMAL for location in normal flash, FAST for location in fast flash, SLOW for location in slow flash, INLINE for inlining of the service
        NORMAL  # Location in normal flash
        FAST  # Location in fast flash
        SLOW  # Location in slow flash
        INLINE  # Service is inlined
      enumeration efxRbMemLocTypeLimiters16u16: origin=RB:2.0.0:2017-06-16, set at pre-compile  # Efx_TypeLimiter_s16_u16 | Select one of following values: NORMAL for location in normal flash, FAST for location in fast flash, SLOW for location in slow flash, INLINE for inlining of the service
        NORMAL  # Location in normal flash
        FAST  # Location in fast flash
        SLOW  # Location in slow flash
        INLINE  # Service is inlined
      enumeration efxRbMemLocTypeLimiters16u8: origin=RB:2.0.0:2017-06-16, set at pre-compile  # Efx_TypeLimiter_s16_u8 | Select one of following values: NORMAL for location in normal flash, FAST for location in fast flash, SLOW for location in slow flash, INLINE for inlining of the service
        NORMAL  # Location in normal flash
        FAST  # Location in fast flash
        SLOW  # Location in slow flash
        INLINE  # Service is inlined
      enumeration efxRbMemLocTypeLimiters32s16: origin=RB:1.0.0:2010-12-17, set at pre-compile  # Efx_TypeLimiter_s32_s16 | Select one of following values: NORMAL for location in normal flash, FAST for location in fast flash, SLOW for location in slow flash, INLINE for inlining of the service
        NORMAL  # Location in normal flash
        FAST  # Location in fast flash
        SLOW  # Location in slow flash
        INLINE  # Service is inlined
      enumeration efxRbMemLocTypeLimiters32s8: origin=RB:1.0.0:2010-12-17, set at pre-compile  # Efx_TypeLimiter_s32_s8 | Select one of following values: NORMAL for location in normal flash, FAST for location in fast flash, SLOW for location in slow flash, INLINE for inlining of the service
        NORMAL  # Location in normal flash
        FAST  # Location in fast flash
        SLOW  # Location in slow flash
        INLINE  # Service is inlined
      enumeration efxRbMemLocTypeLimiters32u16: origin=RB:1.0.0:2010-12-17, set at pre-compile  # Efx_TypeLimiter_s32_u16 | Select one of following values: NORMAL for location in normal flash, FAST for location in fast flash, SLOW for location in slow flash, INLINE for inlining of the service
        NORMAL  # Location in normal flash
        FAST  # Location in fast flash
        SLOW  # Location in slow flash
        INLINE  # Service is inlined
      enumeration efxRbMemLocTypeLimiters32u32: origin=RB:1.0.0:2010-12-17, set at pre-compile  # Efx_TypeLimiter_s32_u32 | Select one of following values: NORMAL for location in normal flash, FAST for location in fast flash, SLOW for location in slow flash, INLINE for inlining of the service
        NORMAL  # Location in normal flash
        FAST  # Location in fast flash
        SLOW  # Location in slow flash
        INLINE  # Service is inlined
      enumeration efxRbMemLocTypeLimiters32u8: origin=RB:1.0.0:2010-12-17, set at pre-compile  # Efx_TypeLimiter_s32_u8 | Select one of following values: NORMAL for location in normal flash, FAST for location in fast flash, SLOW for location in slow flash, INLINE for inlining of the service
        NORMAL  # Location in normal flash
        FAST  # Location in fast flash
        SLOW  # Location in slow flash
        INLINE  # Service is inlined
      enumeration efxRbMemLocTypeLimiters8u8: origin=RB:2.0.0:2017-06-16, set at pre-compile  # Efx_TypeLimiter_s8_u8 | Select one of following values: NORMAL for location in normal flash, FAST for location in fast flash, SLOW for location in slow flash, INLINE for inlining of the service
        NORMAL  # Location in normal flash
        FAST  # Location in fast flash
        SLOW  # Location in slow flash
        INLINE  # Service is inlined
      enumeration efxRbMemLocTypeLimiteru16s16: origin=RB:2.0.0:2017-06-16, set at pre-compile  # Efx_TypeLimiter_u16_s16 | Select one of following values: NORMAL for location in normal flash, FAST for location in fast flash, SLOW for location in slow flash, INLINE for inlining of the service
        NORMAL  # Location in normal flash
        FAST  # Location in fast flash
        SLOW  # Location in slow flash
        INLINE  # Service is inlined
      enumeration efxRbMemLocTypeLimiteru16s8: origin=RB:2.0.0:2017-06-16, set at pre-compile  # Efx_TypeLimiter_u16_s8 | Select one of following values: NORMAL for location in normal flash, FAST for location in fast flash, SLOW for location in slow flash, INLINE for inlining of the service
        NORMAL  # Location in normal flash
        FAST  # Location in fast flash
        SLOW  # Location in slow flash
        INLINE  # Service is inlined
      enumeration efxRbMemLocTypeLimiteru16u8: origin=RB:2.0.0:2017-06-16, set at pre-compile  # Efx_TypeLimiter_u16_u8 | Select one of following values: NORMAL for location in normal flash, FAST for location in fast flash, SLOW for location in slow flash, INLINE for inlining of the service
        NORMAL  # Location in normal flash
        FAST  # Location in fast flash
        SLOW  # Location in slow flash
        INLINE  # Service is inlined
      enumeration efxRbMemLocTypeLimiteru32s16: origin=RB:1.0.0:2010-12-17, set at pre-compile  # Efx_TypeLimiter_u32_s16 | Select one of following values: NORMAL for location in normal flash, FAST for location in fast flash, SLOW for location in slow flash, INLINE for inlining of the service
        NORMAL  # Location in normal flash
        FAST  # Location in fast flash
        SLOW  # Location in slow flash
        INLINE  # Service is inlined
      enumeration efxRbMemLocTypeLimiteru32s32: origin=RB:1.0.0:2010-12-17, set at pre-compile  # Efx_TypeLimiter_u32_s32 | Select one of following values: NORMAL for location in normal flash, FAST for location in fast flash, SLOW for location in slow flash, INLINE for inlining of the service
        NORMAL  # Location in normal flash
        FAST  # Location in fast flash
        SLOW  # Location in slow flash
        INLINE  # Service is inlined
      enumeration efxRbMemLocTypeLimiteru32s8: origin=RB:1.0.0:2010-12-17, set at pre-compile  # Efx_TypeLimiter_u32_s8 | Select one of following values: NORMAL for location in normal flash, FAST for location in fast flash, SLOW for location in slow flash, INLINE for inlining of the service
        NORMAL  # Location in normal flash
        FAST  # Location in fast flash
        SLOW  # Location in slow flash
        INLINE  # Service is inlined
      enumeration efxRbMemLocTypeLimiteru32u16: origin=RB:1.0.0:2010-12-17, set at pre-compile  # Efx_TypeLimiter_u32_u16 | Select one of following values: NORMAL for location in normal flash, FAST for location in fast flash, SLOW for location in slow flash, INLINE for inlining of the service
        NORMAL  # Location in normal flash
        FAST  # Location in fast flash
        SLOW  # Location in slow flash
        INLINE  # Service is inlined
      enumeration efxRbMemLocTypeLimiteru32u8: origin=RB:1.0.0:2010-12-17, set at pre-compile  # Efx_TypeLimiter_u32_u8 | Select one of following values: NORMAL for location in normal flash, FAST for location in fast flash, SLOW for location in slow flash, INLINE for inlining of the service
        NORMAL  # Location in normal flash
        FAST  # Location in fast flash
        SLOW  # Location in slow flash
        INLINE  # Service is inlined
      enumeration efxRbMemLocTypeLimiteru8s8: origin=RB:2.0.0:2017-06-16, set at pre-compile  # Efx_TypeLimiter_u8_s8 | Select one of following values: NORMAL for location in normal flash, FAST for location in fast flash, SLOW for location in slow flash, INLINE for inlining of the service
        NORMAL  # Location in normal flash
        FAST  # Location in fast flash
        SLOW  # Location in slow flash
        INLINE  # Service is inlined
