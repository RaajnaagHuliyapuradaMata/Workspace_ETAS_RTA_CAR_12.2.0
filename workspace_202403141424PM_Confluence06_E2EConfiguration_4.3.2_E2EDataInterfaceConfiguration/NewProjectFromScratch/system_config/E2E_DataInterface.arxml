AUTOSAR XML (schema 00051)
package /PortInterfaces
  sender receiver interface E2E_DataInterface
    data CKS: type=uint8
    data Alive_Cnt: type=uint8
    data Data: type=uint8
