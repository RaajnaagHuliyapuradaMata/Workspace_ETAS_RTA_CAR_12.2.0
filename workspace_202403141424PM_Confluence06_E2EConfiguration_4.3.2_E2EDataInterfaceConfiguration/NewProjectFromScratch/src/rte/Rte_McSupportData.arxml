AUTOSAR XML (schema 4-2-2)
package /AUTOSAR_Rte/BswImplementations
  bsw implementation Rte: mc-support=mc-sw-emulation-method-support=category=NONE
package /AUTOSAR_Rte/Units
  173 x unit:
    AUTOSAR_CanIf_Units_NoUnit: display-name=noUnit, factor-si-to-unit=1.0, offset-si-to-unit=0.0, physical-dimension=AUTOSAR_CanIf_PhysicalDimensions_NoUnit  # No Unit
    AUTOSAR_CanSM_Units_NoUnit: display-name=noUnit, factor-si-to-unit=1.0, offset-si-to-unit=0.0, physical-dimension=AUTOSAR_CanSM_PhysicalDimensions_NoUnit  # No Unit
    AUTOSAR_ComM_Units_NoUnit: display-name=noUnit, factor-si-to-unit=1.0, offset-si-to-unit=0.0, physical-dimension=AUTOSAR_ComM_PhysicalDimensions_NoUnit  # No Unit
    AUTOSAR_Com_Units_NoUnit: display-name=noUnit, factor-si-to-unit=1.0, offset-si-to-unit=0.0, physical-dimension=AUTOSAR_Com_PhysicalDimensions_NoUnit  # No Unit
    AUTOSAR_Fls_Units_NoUnit: display-name=noUnit, factor-si-to-unit=1.0, offset-si-to-unit=0.0, physical-dimension=AUTOSAR_Fls_PhysicalDimensions_NoUnit  # No Unit
    AUTOSAR_PduR_Units_NoUnit: display-name=noUnit, factor-si-to-unit=1.0, offset-si-to-unit=0.0, physical-dimension=AUTOSAR_PduR_PhysicalDimensions_NoUnit  # No Unit
    AUTOSAR_AISpecification_Units_Ampr: display-name=A, factor-si-to-unit=1.0, offset-si-to-unit=0.0, physical-dimension=AUTOSAR_AISpecification_PhysicalDimensions_I1  # Ampere
    AUTOSAR_AISpecification_Units_AmprPerSec: display-name=A/s, factor-si-to-unit=1.0, offset-si-to-unit=0.0, physical-dimension=AUTOSAR_AISpecification_PhysicalDimensions_TiNeg1I1  # Ampere Per Second
    AUTOSAR_AISpecification_Units_AmprSec: display-name=As, factor-si-to-unit=1.0, offset-si-to-unit=0.0, physical-dimension=AUTOSAR_AISpecification_PhysicalDimensions_T1I1  # Amperesecond
    AUTOSAR_AISpecification_Units_Bar: display-name=bar, factor-si-to-unit=1.0E-5, offset-si-to-unit=0.0, physical-dimension=AUTOSAR_AISpecification_PhysicalDimensions_LenNeg1M1TiNeg2  # Bar
    AUTOSAR_AISpecification_Units_BarPerSec: display-name=bar/s, factor-si-to-unit=1.0E-5, offset-si-to-unit=0.0, physical-dimension=AUTOSAR_AISpecification_PhysicalDimensions_LenNeg1M1TiNeg3  # Bar Per Second
    AUTOSAR_AISpecification_Units_Bel: display-name=B, factor-si-to-unit=1.0, offset-si-to-unit=0.0, physical-dimension=AUTOSAR_AISpecification_PhysicalDimensions_NoDimension_5  # Bel
    AUTOSAR_AISpecification_Units_Bit: display-name=bit, factor-si-to-unit=1.0, offset-si-to-unit=0.0, physical-dimension=AUTOSAR_AISpecification_PhysicalDimensions_NoDimension_6  # Bit
    AUTOSAR_AISpecification_Units_BitPerSec: display-name=bit/s, factor-si-to-unit=1.0, offset-si-to-unit=0.0, physical-dimension=AUTOSAR_AISpecification_PhysicalDimensions_TiNeg1_3  # Bit Per Second
    AUTOSAR_AISpecification_Units_BytPerSec: display-name=Byte/s, factor-si-to-unit=0.125, offset-si-to-unit=0.0, physical-dimension=AUTOSAR_AISpecification_PhysicalDimensions_TiNeg1_3  # Byte Per Second
    AUTOSAR_AISpecification_Units_Byte: display-name=Byte, factor-si-to-unit=0.125, offset-si-to-unit=0.0, physical-dimension=AUTOSAR_AISpecification_PhysicalDimensions_NoDimension_6  # Byte
    AUTOSAR_AISpecification_Units_Cd: display-name=cd, factor-si-to-unit=1.0, offset-si-to-unit=0.0, physical-dimension=AUTOSAR_AISpecification_PhysicalDimensions_Illmn1  # Candela
    AUTOSAR_AISpecification_Units_CentiMtr: display-name=cm, factor-si-to-unit=100.0, offset-si-to-unit=0.0, physical-dimension=AUTOSAR_AISpecification_PhysicalDimensions_Len1  # Centimeter
    AUTOSAR_AISpecification_Units_CentiMtrSqd: display-name=cm^2, factor-si-to-unit=10000.0, offset-si-to-unit=0.0, physical-dimension=AUTOSAR_AISpecification_PhysicalDimensions_Len2  # Square Centimeter
    AUTOSAR_AISpecification_Units_Coulomb: display-name=C, factor-si-to-unit=1.0, offset-si-to-unit=0.0, physical-dimension=AUTOSAR_AISpecification_PhysicalDimensions_T1I1  # Coulomb
    AUTOSAR_AISpecification_Units_Day: display-name=d, factor-si-to-unit=1.15740740740741E-5, offset-si-to-unit=0.0, physical-dimension=AUTOSAR_AISpecification_PhysicalDimensions_Ti1  # Day
    AUTOSAR_AISpecification_Units_DeciBel: display-name=dB, factor-si-to-unit=10.0, offset-si-to-unit=0.0, physical-dimension=AUTOSAR_AISpecification_PhysicalDimensions_NoDimension_5  # Decibel
    AUTOSAR_AISpecification_Units_Deg: display-name=°, factor-si-to-unit=360.0, offset-si-to-unit=0.0, physical-dimension=AUTOSAR_AISpecification_PhysicalDimensions_NoDimension_2  # Degree
    AUTOSAR_AISpecification_Units_DegCgrd: display-name=°C, factor-si-to-unit=1.0, offset-si-to-unit=-273.15, physical-dimension=AUTOSAR_AISpecification_PhysicalDimensions_T1  # Degree Celsius(Absolute Temperature)
    AUTOSAR_AISpecification_Units_DegPerSec: display-name=°/s, factor-si-to-unit=360.0, offset-si-to-unit=0.0, physical-dimension=AUTOSAR_AISpecification_PhysicalDimensions_TiNeg1_2  # Degree Per Sec
    AUTOSAR_AISpecification_Units_Frd: display-name=F, factor-si-to-unit=1.0, offset-si-to-unit=0.0, physical-dimension=AUTOSAR_AISpecification_PhysicalDimensions_LenNeg2MNeg1Ti4I2  # Farad
    AUTOSAR_AISpecification_Units_Gr: display-name=g, factor-si-to-unit=1000.0, offset-si-to-unit=0.0, physical-dimension=AUTOSAR_AISpecification_PhysicalDimensions_M1  # Gram
    AUTOSAR_AISpecification_Units_GrPerLtr: display-name=g/l, factor-si-to-unit=1.0, offset-si-to-unit=0.0, physical-dimension=AUTOSAR_AISpecification_PhysicalDimensions_LenNeg3M1  # Gram Per Liter
    AUTOSAR_AISpecification_Units_GrPerMol: display-name=g/mol, factor-si-to-unit=1000.0, offset-si-to-unit=0.0, physical-dimension=AUTOSAR_AISpecification_PhysicalDimensions_M1AmntNeg1  # Gram Per Mole
    AUTOSAR_AISpecification_Units_GrPerSec: display-name=g/s, factor-si-to-unit=1000.0, offset-si-to-unit=0.0, physical-dimension=AUTOSAR_AISpecification_PhysicalDimensions_M1TiNeg1  # Gram Per Second
    AUTOSAR_AISpecification_Units_HectoPa: display-name=hPa, factor-si-to-unit=0.01, offset-si-to-unit=0.0, physical-dimension=AUTOSAR_AISpecification_PhysicalDimensions_LenNeg1M1TiNeg2  # Hectopascal
    AUTOSAR_AISpecification_Units_HectoPaPerSec: display-name=hPa/s, factor-si-to-unit=0.01, offset-si-to-unit=0.0, physical-dimension=AUTOSAR_AISpecification_PhysicalDimensions_LenNeg1M1TiNeg3  # Hectopascal Per Second
    AUTOSAR_AISpecification_Units_HectoPaPerVolt: display-name=hPa/V, factor-si-to-unit=0.01, offset-si-to-unit=0.0, physical-dimension=AUTOSAR_AISpecification_PhysicalDimensions_LenNeg3Ti1I1_1  # Hectopascal Per Volt
    AUTOSAR_AISpecification_Units_HectoPaSecPerMtrCubd: display-name=hPa/((m^3)/s), factor-si-to-unit=0.01, offset-si-to-unit=0.0, physical-dimension=AUTOSAR_AISpecification_PhysicalDimensions_LenNeg4M1TiNeg1  # Hectopascal Per Cubic Meter Per Second
    AUTOSAR_AISpecification_Units_Henry: display-name=H, factor-si-to-unit=1.0, offset-si-to-unit=0.0, physical-dimension=AUTOSAR_AISpecification_PhysicalDimensions_Len2M1TiNeg2INeg2  # Henry
    AUTOSAR_AISpecification_Units_HenryPerMtr: display-name=H/m, factor-si-to-unit=1.0, offset-si-to-unit=0.0, physical-dimension=AUTOSAR_AISpecification_PhysicalDimensions_Len1M1TiNeg2INeg2  # Henry Per Meter
    AUTOSAR_AISpecification_Units_Hr: display-name=h, factor-si-to-unit=2.77777777777778E-4, offset-si-to-unit=0.0, physical-dimension=AUTOSAR_AISpecification_PhysicalDimensions_Ti1  # Hour
    AUTOSAR_AISpecification_Units_Hz: display-name=Hz, factor-si-to-unit=1.0, offset-si-to-unit=0.0, physical-dimension=AUTOSAR_AISpecification_PhysicalDimensions_TiNeg1  # Hertz
    AUTOSAR_AISpecification_Units_Jou: display-name=J, factor-si-to-unit=1.0, offset-si-to-unit=0.0, physical-dimension=AUTOSAR_AISpecification_PhysicalDimensions_Len2M1TiNeg2_1  # Joule
    AUTOSAR_AISpecification_Units_JouPerKelvin: display-name=J/K, factor-si-to-unit=1.0, offset-si-to-unit=0.0, physical-dimension=AUTOSAR_AISpecification_PhysicalDimensions_Len2M1TiNeg2TNeg1  # Joule Per Kelvin
    AUTOSAR_AISpecification_Units_JouPerKiloGr: display-name=J/kg, factor-si-to-unit=1.0, offset-si-to-unit=0.0, physical-dimension=AUTOSAR_AISpecification_PhysicalDimensions_Len2TiNeg2  # Joule Per Kilogram
    AUTOSAR_AISpecification_Units_JouPerKiloGrPerKelvin: display-name=J/(kg*K), factor-si-to-unit=1.0, offset-si-to-unit=0.0, physical-dimension=AUTOSAR_AISpecification_PhysicalDimensions_Len2TiNeg2TNeg1  # Joule Per Kilogram Per Kelvin
    AUTOSAR_AISpecification_Units_JouPerMol: display-name=J/mol, factor-si-to-unit=1.0, offset-si-to-unit=0.0, physical-dimension=AUTOSAR_AISpecification_PhysicalDimensions_Len2M1TiNeg2AmntNeg1  # Joule Per Mole
    AUTOSAR_AISpecification_Units_JouPerMolPerKelvin: display-name=J/(mol*K), factor-si-to-unit=1.0, offset-si-to-unit=0.0, physical-dimension=AUTOSAR_AISpecification_PhysicalDimensions_Len2M1TiNeg2TNeg1AmntNeg1  # Joule Per Mole Per Kelvin
    AUTOSAR_AISpecification_Units_Kat: display-name=kat, factor-si-to-unit=1.0, offset-si-to-unit=0.0, physical-dimension=AUTOSAR_AISpecification_PhysicalDimensions_TiNeg1Amnt1  # Katal
    AUTOSAR_AISpecification_Units_KelvinAbslt: display-name=K, factor-si-to-unit=1.0, offset-si-to-unit=0.0, physical-dimension=AUTOSAR_AISpecification_PhysicalDimensions_T1  # Kelvin (Absolute Temperature)
    AUTOSAR_AISpecification_Units_KelvinPerSec: display-name=K/s, factor-si-to-unit=1.0, offset-si-to-unit=0.0, physical-dimension=AUTOSAR_AISpecification_PhysicalDimensions_TiNeg1T1  # Kelvin Per Second
    AUTOSAR_AISpecification_Units_KelvinRel: display-name=K, factor-si-to-unit=1.0, offset-si-to-unit=0.0, physical-dimension=AUTOSAR_AISpecification_PhysicalDimensions_T1_1  # Kelvin (Relative Temperature,Temperature Difference)
    AUTOSAR_AISpecification_Units_KiloBitPerSec: display-name=kbit/s, factor-si-to-unit=0.001, offset-si-to-unit=0.0, physical-dimension=AUTOSAR_AISpecification_PhysicalDimensions_TiNeg1_3  # Kilobit Per Second
    AUTOSAR_AISpecification_Units_KiloGr: display-name=kg, factor-si-to-unit=1.0, offset-si-to-unit=0.0, physical-dimension=AUTOSAR_AISpecification_PhysicalDimensions_M1  # Kilogram
    AUTOSAR_AISpecification_Units_KiloGrPerHr: display-name=kg/h, factor-si-to-unit=3600.0, offset-si-to-unit=0.0, physical-dimension=AUTOSAR_AISpecification_PhysicalDimensions_M1TiNeg1  # Kilogram Per Hour
    AUTOSAR_AISpecification_Units_KiloGrPerMtrCubd: display-name=kg/(m^3), factor-si-to-unit=1.0, offset-si-to-unit=0.0, physical-dimension=AUTOSAR_AISpecification_PhysicalDimensions_LenNeg3M1  # Kilogram Per Cubic Meter
    AUTOSAR_AISpecification_Units_KiloGrPerSec: display-name=kg/s, factor-si-to-unit=1.0, offset-si-to-unit=0.0, physical-dimension=AUTOSAR_AISpecification_PhysicalDimensions_M1TiNeg1  # Kilogram Per Second
    AUTOSAR_AISpecification_Units_KiloGrSqrMtr: display-name=kg*(m^2), factor-si-to-unit=1.0, offset-si-to-unit=0.0, physical-dimension=AUTOSAR_AISpecification_PhysicalDimensions_Len2M1  # Kilogram Square Meter
    AUTOSAR_AISpecification_Units_KiloHz: display-name=kHz, factor-si-to-unit=0.001, offset-si-to-unit=0.0, physical-dimension=AUTOSAR_AISpecification_PhysicalDimensions_TiNeg1  # Kilohertz
    AUTOSAR_AISpecification_Units_KiloJou: display-name=kJ, factor-si-to-unit=0.001, offset-si-to-unit=0.0, physical-dimension=AUTOSAR_AISpecification_PhysicalDimensions_Len2M1TiNeg2_1  # Kilojoule
    AUTOSAR_AISpecification_Units_KiloMtr: display-name=km, factor-si-to-unit=0.001, offset-si-to-unit=0.0, physical-dimension=AUTOSAR_AISpecification_PhysicalDimensions_Len1  # Kilometer
    AUTOSAR_AISpecification_Units_KiloMtrPerHr: display-name=km/h, factor-si-to-unit=3.6, offset-si-to-unit=0.0, physical-dimension=AUTOSAR_AISpecification_PhysicalDimensions_Len1TiNeg1  # Kilometer Per Hour
    AUTOSAR_AISpecification_Units_KiloMtrPerHrPerSec: display-name=(km/h)/s, factor-si-to-unit=3.6, offset-si-to-unit=0.0, physical-dimension=AUTOSAR_AISpecification_PhysicalDimensions_Len1TiNeg2  # Kilometer Per Hour Per Second
    AUTOSAR_AISpecification_Units_KiloNwt: display-name=kN, factor-si-to-unit=0.001, offset-si-to-unit=0.0, physical-dimension=AUTOSAR_AISpecification_PhysicalDimensions_Len1M1TiNeg2  # Kilonewton
    AUTOSAR_AISpecification_Units_KiloNwtMtrPerSec: display-name=(kN*m)/s, factor-si-to-unit=0.001, offset-si-to-unit=0.0, physical-dimension=AUTOSAR_AISpecification_PhysicalDimensions_Len2M1TiNeg3  # Kilonewtonmeter Per Second
    AUTOSAR_AISpecification_Units_KiloOhm: display-name=kO, factor-si-to-unit=0.001, offset-si-to-unit=0.0, physical-dimension=AUTOSAR_AISpecification_PhysicalDimensions_Len2M1TiNeg3INeg2  # Kiloohm
    AUTOSAR_AISpecification_Units_KiloVolt: display-name=kV, factor-si-to-unit=0.001, offset-si-to-unit=0.0, physical-dimension=AUTOSAR_AISpecification_PhysicalDimensions_Len2M1TiNeg3INeg1  # Kilovolt
    AUTOSAR_AISpecification_Units_KiloWatt: display-name=kW, factor-si-to-unit=0.001, offset-si-to-unit=0.0, physical-dimension=AUTOSAR_AISpecification_PhysicalDimensions_Len2M1TiNeg3_1  # Kilowatt
    AUTOSAR_AISpecification_Units_KiloWattHr: display-name=kWh, factor-si-to-unit=2.77777777777778E-7, offset-si-to-unit=0.0, physical-dimension=AUTOSAR_AISpecification_PhysicalDimensions_Len2M1TiNeg2_1  # Kilowatthour
    AUTOSAR_AISpecification_Units_KiloWattHrPer100KiloMtr: display-name=kWh/(100*km), factor-si-to-unit=0.0277777777777778, offset-si-to-unit=0.0, physical-dimension=AUTOSAR_AISpecification_PhysicalDimensions_Len1M1TiNeg2_1  # Kilowatthour Per 100 Kilometer
    AUTOSAR_AISpecification_Units_Ltr: display-name=l, factor-si-to-unit=1000.0, offset-si-to-unit=0.0, physical-dimension=AUTOSAR_AISpecification_PhysicalDimensions_Len3  # Liter
    AUTOSAR_AISpecification_Units_LtrPer100KiloMtr: display-name=l/(100km), factor-si-to-unit=1.0E8, offset-si-to-unit=0.0, physical-dimension=AUTOSAR_AISpecification_PhysicalDimensions_Len2_1  # Liter Per 100 Kilometer
    AUTOSAR_AISpecification_Units_LtrPerHr: display-name=l/h, factor-si-to-unit=3600000.0, offset-si-to-unit=0.0, physical-dimension=AUTOSAR_AISpecification_PhysicalDimensions_Len3TiNeg1  # Liter Per Hour
    AUTOSAR_AISpecification_Units_LtrPerKiloMtr: display-name=l/km, factor-si-to-unit=1000000.0, offset-si-to-unit=0.0, physical-dimension=AUTOSAR_AISpecification_PhysicalDimensions_Len2_1  # Liter Per Kilometer
    AUTOSAR_AISpecification_Units_MegaBitPerSec: display-name=Mbit/s, factor-si-to-unit=1.0E-6, offset-si-to-unit=0.0, physical-dimension=AUTOSAR_AISpecification_PhysicalDimensions_TiNeg1_3  # Megabit Per Second
    AUTOSAR_AISpecification_Units_MegaHz: display-name=MHz, factor-si-to-unit=1.0E-6, offset-si-to-unit=0.0, physical-dimension=AUTOSAR_AISpecification_PhysicalDimensions_TiNeg1  # Megahertz
    AUTOSAR_AISpecification_Units_MegaJou: display-name=MJ, factor-si-to-unit=1.0E-6, offset-si-to-unit=0.0, physical-dimension=AUTOSAR_AISpecification_PhysicalDimensions_Len2M1TiNeg2_1  # Megajoule
    AUTOSAR_AISpecification_Units_MegaOhm: display-name=MO, factor-si-to-unit=1.0E-6, offset-si-to-unit=0.0, physical-dimension=AUTOSAR_AISpecification_PhysicalDimensions_Len2M1TiNeg3INeg2  # Megaohm
    AUTOSAR_AISpecification_Units_MegaPa: display-name=MPa, factor-si-to-unit=1.0E-6, offset-si-to-unit=0.0, physical-dimension=AUTOSAR_AISpecification_PhysicalDimensions_LenNeg1M1TiNeg2  # Megapascal
    AUTOSAR_AISpecification_Units_MegaWatt: display-name=MW, factor-si-to-unit=1.0E-6, offset-si-to-unit=0.0, physical-dimension=AUTOSAR_AISpecification_PhysicalDimensions_Len2M1TiNeg3_1  # Megawatt
    AUTOSAR_AISpecification_Units_MicroAmpr: display-name=µA, factor-si-to-unit=1000000.0, offset-si-to-unit=0.0, physical-dimension=AUTOSAR_AISpecification_PhysicalDimensions_I1  # Microampere
    AUTOSAR_AISpecification_Units_MicroFrd: display-name=µF, factor-si-to-unit=1000000.0, offset-si-to-unit=0.0, physical-dimension=AUTOSAR_AISpecification_PhysicalDimensions_LenNeg2MNeg1Ti4I2  # Microfarad
    AUTOSAR_AISpecification_Units_MicroGr: display-name=µg, factor-si-to-unit=1.0E9, offset-si-to-unit=0.0, physical-dimension=AUTOSAR_AISpecification_PhysicalDimensions_M1  # Microgram
    AUTOSAR_AISpecification_Units_MicroJou: display-name=µJ, factor-si-to-unit=1000000.0, offset-si-to-unit=0.0, physical-dimension=AUTOSAR_AISpecification_PhysicalDimensions_Len2M1TiNeg2_1  # Microjoule
    AUTOSAR_AISpecification_Units_MicroLtr: display-name=µl, factor-si-to-unit=1.0E9, offset-si-to-unit=0.0, physical-dimension=AUTOSAR_AISpecification_PhysicalDimensions_Len3  # Microliter
    AUTOSAR_AISpecification_Units_MicroLtrPerSec: display-name=µl/s, factor-si-to-unit=1.0E9, offset-si-to-unit=0.0, physical-dimension=AUTOSAR_AISpecification_PhysicalDimensions_Len3TiNeg1  # Microliter Per Second
    AUTOSAR_AISpecification_Units_MicroMtr: display-name=µm, factor-si-to-unit=1000000.0, offset-si-to-unit=0.0, physical-dimension=AUTOSAR_AISpecification_PhysicalDimensions_Len1  # Micrometer
    AUTOSAR_AISpecification_Units_MicroSec: display-name=µs, factor-si-to-unit=1000000.0, offset-si-to-unit=0.0, physical-dimension=AUTOSAR_AISpecification_PhysicalDimensions_Ti1  # Microsecond
    AUTOSAR_AISpecification_Units_MicroTesla: display-name=µT, factor-si-to-unit=1000000.0, offset-si-to-unit=0.0, physical-dimension=AUTOSAR_AISpecification_PhysicalDimensions_M1TiNeg2INeg1  # Microtesla
    AUTOSAR_AISpecification_Units_MilliAmpr: display-name=mA/s, factor-si-to-unit=1000.0, offset-si-to-unit=0.0, physical-dimension=AUTOSAR_AISpecification_PhysicalDimensions_I1  # Milliampere
    AUTOSAR_AISpecification_Units_MilliAmprPerSec: display-name=mA/s, factor-si-to-unit=1000.0, offset-si-to-unit=0.0, physical-dimension=AUTOSAR_AISpecification_PhysicalDimensions_TiNeg1I1  # Milliampere Per Second
    AUTOSAR_AISpecification_Units_MilliBar: display-name=mbar, factor-si-to-unit=0.01, offset-si-to-unit=0.0, physical-dimension=AUTOSAR_AISpecification_PhysicalDimensions_LenNeg1M1TiNeg2  # Millibar
    AUTOSAR_AISpecification_Units_MilliFrd: display-name=mF, factor-si-to-unit=1000.0, offset-si-to-unit=0.0, physical-dimension=AUTOSAR_AISpecification_PhysicalDimensions_LenNeg2MNeg1Ti4I2  # Millifarad
    AUTOSAR_AISpecification_Units_MilliGr: display-name=mg, factor-si-to-unit=1000000.0, offset-si-to-unit=0.0, physical-dimension=AUTOSAR_AISpecification_PhysicalDimensions_M1  # Milligram
    AUTOSAR_AISpecification_Units_MilliGrPerSec: display-name=mg/s, factor-si-to-unit=1000000.0, offset-si-to-unit=0.0, physical-dimension=AUTOSAR_AISpecification_PhysicalDimensions_M1TiNeg1  # Milligram Per Second
    AUTOSAR_AISpecification_Units_MilliJou: display-name=mJ, factor-si-to-unit=1000.0, offset-si-to-unit=0.0, physical-dimension=AUTOSAR_AISpecification_PhysicalDimensions_Len2M1TiNeg2_1  # Millijoule
    AUTOSAR_AISpecification_Units_MilliLtr: display-name=ml, factor-si-to-unit=1000000.0, offset-si-to-unit=0.0, physical-dimension=AUTOSAR_AISpecification_PhysicalDimensions_Len3  # Milliliter
    AUTOSAR_AISpecification_Units_MilliMtr: display-name=mm, factor-si-to-unit=1000.0, offset-si-to-unit=0.0, physical-dimension=AUTOSAR_AISpecification_PhysicalDimensions_Len1  # Millimeter
    AUTOSAR_AISpecification_Units_MilliMtrCubd: display-name=mm^3, factor-si-to-unit=1.0E9, offset-si-to-unit=0.0, physical-dimension=AUTOSAR_AISpecification_PhysicalDimensions_Len3  # Cubic Millimeter
    AUTOSAR_AISpecification_Units_MilliMtrCubdPerSec: display-name=(mm^3)/s, factor-si-to-unit=1.0E9, offset-si-to-unit=0.0, physical-dimension=AUTOSAR_AISpecification_PhysicalDimensions_Len3TiNeg1  # Cubic Millimeter Per Second
    AUTOSAR_AISpecification_Units_MilliOhm: display-name=m?, factor-si-to-unit=1000.0, offset-si-to-unit=0.0, physical-dimension=AUTOSAR_AISpecification_PhysicalDimensions_Len2M1TiNeg3INeg2  # Milliohm
    AUTOSAR_AISpecification_Units_MilliSec: display-name=ms, factor-si-to-unit=1000.0, offset-si-to-unit=0.0, physical-dimension=AUTOSAR_AISpecification_PhysicalDimensions_Ti1  # Millisecond
    AUTOSAR_AISpecification_Units_MilliTesla: display-name=mT, factor-si-to-unit=1000.0, offset-si-to-unit=0.0, physical-dimension=AUTOSAR_AISpecification_PhysicalDimensions_M1TiNeg2INeg1  # Millitesla
    AUTOSAR_AISpecification_Units_MilliVolt: display-name=mV, factor-si-to-unit=1000.0, offset-si-to-unit=0.0, physical-dimension=AUTOSAR_AISpecification_PhysicalDimensions_Len2M1TiNeg3INeg1  # Millivolt
    AUTOSAR_AISpecification_Units_MilliVoltPerSec: display-name=mV/s, factor-si-to-unit=1000.0, offset-si-to-unit=0.0, physical-dimension=AUTOSAR_AISpecification_PhysicalDimensions_Len2M1TiNeg4INeg1  # Millivolt Per Second
    AUTOSAR_AISpecification_Units_MilliWatt: display-name=mW, factor-si-to-unit=1000.0, offset-si-to-unit=0.0, physical-dimension=AUTOSAR_AISpecification_PhysicalDimensions_Len2M1TiNeg3_1  # Milliwatt
    AUTOSAR_AISpecification_Units_Mins: display-name=min, factor-si-to-unit=0.0166666666666667, offset-si-to-unit=0.0, physical-dimension=AUTOSAR_AISpecification_PhysicalDimensions_Ti1  # Minute
    AUTOSAR_AISpecification_Units_Ml: display-name=mile, factor-si-to-unit=6.21371192237333E-4, offset-si-to-unit=0.0, physical-dimension=AUTOSAR_AISpecification_PhysicalDimensions_Len1  # Mile
    AUTOSAR_AISpecification_Units_MlPerHr: display-name=mph, factor-si-to-unit=2.2369362920544, offset-si-to-unit=0.0, physical-dimension=AUTOSAR_AISpecification_PhysicalDimensions_Len1TiNeg1  # Miles Per Hour
    AUTOSAR_AISpecification_Units_Mol: display-name=mol, factor-si-to-unit=1.0, offset-si-to-unit=0.0, physical-dimension=AUTOSAR_AISpecification_PhysicalDimensions_Amnt1  # Mole
    AUTOSAR_AISpecification_Units_MolPerLtr: display-name=mol/l, factor-si-to-unit=0.001, offset-si-to-unit=0.0, physical-dimension=AUTOSAR_AISpecification_PhysicalDimensions_LenNeg3Amnt1  # Mole Per Liter
    AUTOSAR_AISpecification_Units_MolPerLtrPerSec: display-name=(mol/l)/s, factor-si-to-unit=0.001, offset-si-to-unit=0.0, physical-dimension=AUTOSAR_AISpecification_PhysicalDimensions_LenNeg3TiNeg1Amnt1  # Mol Per Liter Per Second
    AUTOSAR_AISpecification_Units_MolPerMtrCubd: display-name=mol/(m^3), factor-si-to-unit=1.0, offset-si-to-unit=0.0, physical-dimension=AUTOSAR_AISpecification_PhysicalDimensions_LenNeg3Amnt1  # Mole Per Cubic Meter
    AUTOSAR_AISpecification_Units_MolPerSec: display-name=mol/s, factor-si-to-unit=1.0, offset-si-to-unit=0.0, physical-dimension=AUTOSAR_AISpecification_PhysicalDimensions_TiNeg1Amnt1  # Mole Per Second
    AUTOSAR_AISpecification_Units_Mtr: display-name=m, factor-si-to-unit=1.0, offset-si-to-unit=0.0, physical-dimension=AUTOSAR_AISpecification_PhysicalDimensions_Len1  # Meter
    AUTOSAR_AISpecification_Units_MtrCubd: display-name=m^3, factor-si-to-unit=1.0, offset-si-to-unit=0.0, physical-dimension=AUTOSAR_AISpecification_PhysicalDimensions_Len3  # Cubic Meter
    AUTOSAR_AISpecification_Units_MtrCubdPerHr: display-name=(m^3)/h, factor-si-to-unit=3600.0, offset-si-to-unit=0.0, physical-dimension=AUTOSAR_AISpecification_PhysicalDimensions_Len3TiNeg1  # Cubic Meter Per Hour
    AUTOSAR_AISpecification_Units_MtrCubdPerHrPerSec: display-name=(m^3)/(h*s), factor-si-to-unit=3600.0, offset-si-to-unit=0.0, physical-dimension=AUTOSAR_AISpecification_PhysicalDimensions_Len3TiNeg2  # Cubic Meter Per Hour Per Second
    AUTOSAR_AISpecification_Units_MtrCubdPerKiloGr: display-name=(m^3)/kg, factor-si-to-unit=1.0, offset-si-to-unit=0.0, physical-dimension=AUTOSAR_AISpecification_PhysicalDimensions_Len3MNeg1  # Cubic Meter Per Kilogram
    AUTOSAR_AISpecification_Units_MtrPerSec: display-name=m/s, factor-si-to-unit=1.0, offset-si-to-unit=0.0, physical-dimension=AUTOSAR_AISpecification_PhysicalDimensions_Len1TiNeg1  # Meter Per Second
    AUTOSAR_AISpecification_Units_MtrPerSecCubd: display-name=m/(s^3), factor-si-to-unit=1.0, offset-si-to-unit=0.0, physical-dimension=AUTOSAR_AISpecification_PhysicalDimensions_Len1TiNeg3  # Meter Per Cubic Second
    AUTOSAR_AISpecification_Units_MtrPerSecSqd: display-name=m/(s^2), factor-si-to-unit=1.0, offset-si-to-unit=0.0, physical-dimension=AUTOSAR_AISpecification_PhysicalDimensions_Len1TiNeg2  # Meter Per Square Second
    AUTOSAR_AISpecification_Units_MtrSqd: display-name=m^2, factor-si-to-unit=1.0, offset-si-to-unit=0.0, physical-dimension=AUTOSAR_AISpecification_PhysicalDimensions_Len2  # Square Meter
    AUTOSAR_AISpecification_Units_MtrSqdPerSec: display-name=(m^2)/s, factor-si-to-unit=1.0, offset-si-to-unit=0.0, physical-dimension=AUTOSAR_AISpecification_PhysicalDimensions_Len2Ti1  # Square Meter Per Second
    AUTOSAR_AISpecification_Units_NanoFrd: display-name=nF, factor-si-to-unit=1.0E9, offset-si-to-unit=0.0, physical-dimension=AUTOSAR_AISpecification_PhysicalDimensions_LenNeg2MNeg1Ti4I2  # Nanofarad
    AUTOSAR_AISpecification_Units_NanoSec: display-name=ns, factor-si-to-unit=1.0E9, offset-si-to-unit=0.0, physical-dimension=AUTOSAR_AISpecification_PhysicalDimensions_Ti1  # Nanosecond
    AUTOSAR_AISpecification_Units_NoUnit: display-name=-, factor-si-to-unit=1.0, offset-si-to-unit=0.0, physical-dimension=AUTOSAR_AISpecification_PhysicalDimensions_NoDimension  # Neither Physical nor Mathematical Unit
    AUTOSAR_AISpecification_Units_Nwt: display-name=N, factor-si-to-unit=1.0, offset-si-to-unit=0.0, physical-dimension=AUTOSAR_AISpecification_PhysicalDimensions_Len1M1TiNeg2  # Newton
    AUTOSAR_AISpecification_Units_NwtMtr: display-name=Nm, factor-si-to-unit=1.0, offset-si-to-unit=0.0, physical-dimension=AUTOSAR_AISpecification_PhysicalDimensions_Len2M1TiNeg2  # Newtonmeter
    AUTOSAR_AISpecification_Units_NwtMtrPerRpm: display-name=Nm/rpm, factor-si-to-unit=0.0166666666666667, offset-si-to-unit=0.0, physical-dimension=AUTOSAR_AISpecification_PhysicalDimensions_Len2M1TiNeg1  # Newtonmeter Per Rpm
    AUTOSAR_AISpecification_Units_NwtMtrPerRpmPerSec: display-name=Nm/(rpm/s), factor-si-to-unit=0.0166666666666667, offset-si-to-unit=0.0, physical-dimension=AUTOSAR_AISpecification_PhysicalDimensions_Len2M1  # Newtonmeter Per Rpm Per Second
    AUTOSAR_AISpecification_Units_NwtMtrPerSec: display-name=(N*m)/s, factor-si-to-unit=1.0, offset-si-to-unit=0.0, physical-dimension=AUTOSAR_AISpecification_PhysicalDimensions_Len2M1TiNeg3  # Newtonmeter Per Second
    AUTOSAR_AISpecification_Units_NwtMtrSec: display-name=Nm*s, factor-si-to-unit=1.0, offset-si-to-unit=0.0, physical-dimension=AUTOSAR_AISpecification_PhysicalDimensions_Len2M1TiNeg1  # Newtonmeter Second
    AUTOSAR_AISpecification_Units_NwtMtrSqrSec: display-name=Nm*(s^2), factor-si-to-unit=1.0, offset-si-to-unit=0.0, physical-dimension=AUTOSAR_AISpecification_PhysicalDimensions_Len2M1  # Newtonmeter Square Second
    AUTOSAR_AISpecification_Units_NwtPerMtr: display-name=N/m, factor-si-to-unit=1.0, offset-si-to-unit=0.0, physical-dimension=AUTOSAR_AISpecification_PhysicalDimensions_M1TiNeg2  # Newton Per Meter
    AUTOSAR_AISpecification_Units_NwtSecPerMtr: display-name=Ns/m, factor-si-to-unit=1.0, offset-si-to-unit=0.0, physical-dimension=AUTOSAR_AISpecification_PhysicalDimensions_M1TiNeg1_1  # Newtonsecond Per Meter
    AUTOSAR_AISpecification_Units_Ohm: display-name=?, factor-si-to-unit=1.0, offset-si-to-unit=0.0, physical-dimension=AUTOSAR_AISpecification_PhysicalDimensions_Len2M1TiNeg3INeg2  # Ohm
    AUTOSAR_AISpecification_Units_Pa: display-name=Pa, factor-si-to-unit=1.0, offset-si-to-unit=0.0, physical-dimension=AUTOSAR_AISpecification_PhysicalDimensions_LenNeg1M1TiNeg2  # Pascal
    AUTOSAR_AISpecification_Units_PaPerMtrCubdPerSec: display-name=Pa/((m^3)/s), factor-si-to-unit=1.0, offset-si-to-unit=0.0, physical-dimension=AUTOSAR_AISpecification_PhysicalDimensions_LenNeg4M1TiNeg1  # Pascal Per Cubic Meter Per Second
    AUTOSAR_AISpecification_Units_PaPerSec: display-name=Pa/s, factor-si-to-unit=1.0, offset-si-to-unit=0.0, physical-dimension=AUTOSAR_AISpecification_PhysicalDimensions_LenNeg1M1TiNeg3  # Pascal Per Second
    AUTOSAR_AISpecification_Units_PaSec: display-name=Pa*s, factor-si-to-unit=1.0, offset-si-to-unit=0.0, physical-dimension=AUTOSAR_AISpecification_PhysicalDimensions_LenNeg1M1TiNeg1  # Pascal Second
    AUTOSAR_AISpecification_Units_PerMille: display-name=‰, factor-si-to-unit=1000.0, offset-si-to-unit=0.0, physical-dimension=AUTOSAR_AISpecification_PhysicalDimensions_NoDimension_1  # Permille
    AUTOSAR_AISpecification_Units_PerMin: display-name=1/min, factor-si-to-unit=60.0, offset-si-to-unit=0.0, physical-dimension=AUTOSAR_AISpecification_PhysicalDimensions_TiNeg1_2  # Per Minute
    AUTOSAR_AISpecification_Units_PerMtr: display-name=1/m, factor-si-to-unit=1.0, offset-si-to-unit=0.0, physical-dimension=AUTOSAR_AISpecification_PhysicalDimensions_LenNeg1  # Per Meter
    AUTOSAR_AISpecification_Units_PerSec: display-name=1/s, factor-si-to-unit=1.0, offset-si-to-unit=0.0, physical-dimension=AUTOSAR_AISpecification_PhysicalDimensions_TiNeg1_2  # Per Second
    AUTOSAR_AISpecification_Units_PerSecSqd: display-name=1/(s^2), factor-si-to-unit=1.0, offset-si-to-unit=0.0, physical-dimension=AUTOSAR_AISpecification_PhysicalDimensions_TiNeg2  # Per Square Second
    AUTOSAR_AISpecification_Units_Perc: display-name=%, factor-si-to-unit=100.0, offset-si-to-unit=0.0, physical-dimension=AUTOSAR_AISpecification_PhysicalDimensions_NoDimension_1  # Percent
    AUTOSAR_AISpecification_Units_PercPerMilliSec: display-name=%/ms, factor-si-to-unit=0.1, offset-si-to-unit=0.0, physical-dimension=AUTOSAR_AISpecification_PhysicalDimensions_TiNeg1_1  # Percent Per Millisecond
    AUTOSAR_AISpecification_Units_PercPerSec: display-name=%/s, factor-si-to-unit=100.0, offset-si-to-unit=0.0, physical-dimension=AUTOSAR_AISpecification_PhysicalDimensions_TiNeg1_1  # Percent Per Second
    AUTOSAR_AISpecification_Units_PicoFrd: display-name=pF, factor-si-to-unit=1.0E12, offset-si-to-unit=0.0, physical-dimension=AUTOSAR_AISpecification_PhysicalDimensions_LenNeg2MNeg1Ti4I2  # Picofarad
    AUTOSAR_AISpecification_Units_PicoSec: display-name=ps, factor-si-to-unit=1.0E12, offset-si-to-unit=0.0, physical-dimension=AUTOSAR_AISpecification_PhysicalDimensions_Ti1  # Picosecond
    AUTOSAR_AISpecification_Units_Ppm: display-name=ppm, factor-si-to-unit=1000000.0, offset-si-to-unit=0.0, physical-dimension=AUTOSAR_AISpecification_PhysicalDimensions_NoDimension_1  # Parts Per Million
    AUTOSAR_AISpecification_Units_Rad: display-name=rad, factor-si-to-unit=6.28318530717958, offset-si-to-unit=0.0, physical-dimension=AUTOSAR_AISpecification_PhysicalDimensions_NoDimension_2  # Radian
    AUTOSAR_AISpecification_Units_RadPerSec: display-name=rad/s, factor-si-to-unit=6.28318530717958, offset-si-to-unit=0.0, physical-dimension=AUTOSAR_AISpecification_PhysicalDimensions_TiNeg1_2  # Radian Per Second
    AUTOSAR_AISpecification_Units_RadPerSecSqd: display-name=rad/(s^2), factor-si-to-unit=6.28318530717958, offset-si-to-unit=0.0, physical-dimension=AUTOSAR_AISpecification_PhysicalDimensions_TiNeg2  # Radian Per Square Second
    AUTOSAR_AISpecification_Units_Rpm: display-name=rpm, factor-si-to-unit=60.0, offset-si-to-unit=0.0, physical-dimension=AUTOSAR_AISpecification_PhysicalDimensions_TiNeg1_2  # Revolutions Per Minute
    AUTOSAR_AISpecification_Units_RpmPerSec: display-name=rpm/s, factor-si-to-unit=60.0, offset-si-to-unit=0.0, physical-dimension=AUTOSAR_AISpecification_PhysicalDimensions_TiNeg2  # Revolutions Per Minute Per Second
    AUTOSAR_AISpecification_Units_S: display-name=S, factor-si-to-unit=1.0, offset-si-to-unit=0.0, physical-dimension=AUTOSAR_AISpecification_PhysicalDimensions_LenNeg2MNeg1Ti3I2  # Siemens
    AUTOSAR_AISpecification_Units_SPerMtr: display-name=S/m, factor-si-to-unit=1.0, offset-si-to-unit=0.0, physical-dimension=AUTOSAR_AISpecification_PhysicalDimensions_LenNeg3MNeg1Ti3I2  # Siemens Per Meter
    AUTOSAR_AISpecification_Units_SPerMtrPerSec: display-name=S/(m*s), factor-si-to-unit=1.0, offset-si-to-unit=0.0, physical-dimension=AUTOSAR_AISpecification_PhysicalDimensions_LenNeg3MNeg1Ti2I2  # Siemens Per Meter Per Second
    AUTOSAR_AISpecification_Units_Sec: display-name=s, factor-si-to-unit=1.0, offset-si-to-unit=0.0, physical-dimension=AUTOSAR_AISpecification_PhysicalDimensions_Ti1  # Second
    AUTOSAR_AISpecification_Units_Tesla: display-name=T, factor-si-to-unit=1.0, offset-si-to-unit=0.0, physical-dimension=AUTOSAR_AISpecification_PhysicalDimensions_M1TiNeg2INeg1  # Tesla
    AUTOSAR_AISpecification_Units_Tonne: display-name=t, factor-si-to-unit=0.001, offset-si-to-unit=0.0, physical-dimension=AUTOSAR_AISpecification_PhysicalDimensions_M1  # Tonne
    AUTOSAR_AISpecification_Units_Volt: display-name=V, factor-si-to-unit=1.0, offset-si-to-unit=0.0, physical-dimension=AUTOSAR_AISpecification_PhysicalDimensions_Len2M1TiNeg3INeg1  # Volt
    AUTOSAR_AISpecification_Units_VoltPerMilliSec: display-name=V/ms, factor-si-to-unit=0.001, offset-si-to-unit=0.0, physical-dimension=AUTOSAR_AISpecification_PhysicalDimensions_Len2M1TiNeg4INeg1  # Volt Per Millisecond
    AUTOSAR_AISpecification_Units_VoltPerMtr: display-name=V/m, factor-si-to-unit=1.0, offset-si-to-unit=0.0, physical-dimension=AUTOSAR_AISpecification_PhysicalDimensions_Len1M1TiNeg3INeg1  # Volt Per Meter
    AUTOSAR_AISpecification_Units_VoltPerSec: display-name=V/s, factor-si-to-unit=1.0, offset-si-to-unit=0.0, physical-dimension=AUTOSAR_AISpecification_PhysicalDimensions_Len2M1TiNeg4INeg1  # Volt Per Second
    AUTOSAR_AISpecification_Units_Watt: display-name=W, factor-si-to-unit=1.0, offset-si-to-unit=0.0, physical-dimension=AUTOSAR_AISpecification_PhysicalDimensions_Len2M1TiNeg3_1  # Watt
    AUTOSAR_AISpecification_Units_WattPerKelvinPerMtrSqd: display-name=W/(K*m^2), factor-si-to-unit=1.0, offset-si-to-unit=0.0, physical-dimension=AUTOSAR_AISpecification_PhysicalDimensions_M1TiNeg3TNeg1  # Watt Per Kelvin Per Square Meter
    AUTOSAR_AISpecification_Units_WattPerMtrPerKelvin: display-name=W/(m*K), factor-si-to-unit=1.0, offset-si-to-unit=0.0, physical-dimension=AUTOSAR_AISpecification_PhysicalDimensions_Len1M1TiNeg3TNeg1  # Watt Per Meter Per Kelvin
    AUTOSAR_AISpecification_Units_WattPerSec: display-name=W/s, factor-si-to-unit=1.0, offset-si-to-unit=0.0, physical-dimension=AUTOSAR_AISpecification_PhysicalDimensions_Len2M1TiNeg4  # Watt Per Second
    AUTOSAR_AISpecification_Units_WattSec: display-name=Ws, factor-si-to-unit=1.0, offset-si-to-unit=0.0, physical-dimension=AUTOSAR_AISpecification_PhysicalDimensions_Len2M1TiNeg2_1  # Wattsecond
    AUTOSAR_AISpecification_Units_Wb: display-name=Wb, factor-si-to-unit=1.0, offset-si-to-unit=0.0, physical-dimension=AUTOSAR_AISpecification_PhysicalDimensions_Len2M1TiNeg2INeg1  # Weber
    AUTOSAR_AISpecification_Units_Yr: display-name=a, factor-si-to-unit=3.16880878140289E-8, offset-si-to-unit=0.0, physical-dimension=AUTOSAR_AISpecification_PhysicalDimensions_Ti1  # Year
    RB_RBA_Common_CentralElements_Units_NoUnit: display-name=noUnit, factor-si-to-unit=1.0, offset-si-to-unit=0.0, physical-dimension=RB_RBA_Common_CentralElements_PhysicalDimensions_NoUnit  # No Unit
    AUTOSAR_NvM_Units_NoUnit: display-name=noUnit, factor-si-to-unit=1.0, offset-si-to-unit=0.0, physical-dimension=AUTOSAR_NvM_PhysicalDimensions_NoUnit  # No Unit
    RB_RBA_rba_MemLib_Units_Mem_NoUnit: display-name=Mem_NoUnit, factor-si-to-unit=1.0, offset-si-to-unit=0.0, physical-dimension=RB_RBA_rba_MemLib_PhysicalDimensions_Mem_NoPhysDim  # Mem No Unit / 1:1 / Identical
package /AUTOSAR_Rte/PhysicalDimensions
  82 x physical dimension:
    AUTOSAR_CanIf_PhysicalDimensions_NoUnit: length-exp=0
    AUTOSAR_CanSM_PhysicalDimensions_NoUnit: length-exp=0
    AUTOSAR_ComM_PhysicalDimensions_NoUnit: length-exp=0
    AUTOSAR_Com_PhysicalDimensions_NoUnit: length-exp=0
    AUTOSAR_Fls_PhysicalDimensions_NoUnit: length-exp=0
    AUTOSAR_PduR_PhysicalDimensions_NoUnit: length-exp=0
    AUTOSAR_AISpecification_PhysicalDimensions_I1: length-exp=0, mass-exp=0, time-exp=0, current-exp=1, temperature-exp=0, molar-amount-exp=0, luminous-intensity-exp=0  # Electric Current
    AUTOSAR_AISpecification_PhysicalDimensions_TiNeg1I1: length-exp=0, mass-exp=0, time-exp=-1, current-exp=1, temperature-exp=0, molar-amount-exp=0, luminous-intensity-exp=0  # Electric Current Gradient
    AUTOSAR_AISpecification_PhysicalDimensions_T1I1: length-exp=0, mass-exp=0, time-exp=1, current-exp=1, temperature-exp=0, molar-amount-exp=0, luminous-intensity-exp=0  # Electric Charge
    AUTOSAR_AISpecification_PhysicalDimensions_LenNeg1M1TiNeg2: length-exp=-1, mass-exp=1, time-exp=-2, current-exp=0, temperature-exp=0, molar-amount-exp=0, luminous-intensity-exp=0  # Pressure
    AUTOSAR_AISpecification_PhysicalDimensions_LenNeg1M1TiNeg3: length-exp=-1, mass-exp=1, time-exp=-3, current-exp=0, temperature-exp=0, molar-amount-exp=0, luminous-intensity-exp=0  # Pressure Gradient
    AUTOSAR_AISpecification_PhysicalDimensions_NoDimension_5: length-exp=0, mass-exp=0, time-exp=0, current-exp=0, temperature-exp=0, molar-amount-exp=0, luminous-intensity-exp=0  # Logarithmic Ratio
    AUTOSAR_AISpecification_PhysicalDimensions_NoDimension_6: length-exp=0, mass-exp=0, time-exp=0, current-exp=0, temperature-exp=0, molar-amount-exp=0, luminous-intensity-exp=0  # Amount of Data
    AUTOSAR_AISpecification_PhysicalDimensions_TiNeg1_3: length-exp=0, mass-exp=0, time-exp=-1, current-exp=0, temperature-exp=0, molar-amount-exp=0, luminous-intensity-exp=0  # Transfer Rate
    AUTOSAR_AISpecification_PhysicalDimensions_Illmn1: length-exp=0, mass-exp=0, time-exp=0, current-exp=0, temperature-exp=0, molar-amount-exp=0, luminous-intensity-exp=1  # Luminous intensity
    AUTOSAR_AISpecification_PhysicalDimensions_Len1: length-exp=1, mass-exp=0, time-exp=0, current-exp=0, temperature-exp=0, molar-amount-exp=0, luminous-intensity-exp=0  # Length
    AUTOSAR_AISpecification_PhysicalDimensions_Len2: length-exp=2, mass-exp=0, time-exp=0, current-exp=0, temperature-exp=0, molar-amount-exp=0, luminous-intensity-exp=0  # Area
    AUTOSAR_AISpecification_PhysicalDimensions_Ti1: length-exp=0, mass-exp=0, time-exp=1, current-exp=0, temperature-exp=0, molar-amount-exp=0, luminous-intensity-exp=0  # Time
    AUTOSAR_AISpecification_PhysicalDimensions_NoDimension_2: length-exp=0, mass-exp=0, time-exp=0, current-exp=0, temperature-exp=0, molar-amount-exp=0, luminous-intensity-exp=0  # Angle
    AUTOSAR_AISpecification_PhysicalDimensions_T1: length-exp=0, mass-exp=0, time-exp=0, current-exp=0, temperature-exp=1, molar-amount-exp=0, luminous-intensity-exp=0  # Absolute Temperature
    AUTOSAR_AISpecification_PhysicalDimensions_TiNeg1_2: length-exp=0, mass-exp=0, time-exp=-1, current-exp=0, temperature-exp=0, molar-amount-exp=0, luminous-intensity-exp=0  # Rotational Speed
    AUTOSAR_AISpecification_PhysicalDimensions_LenNeg2MNeg1Ti4I2: length-exp=-2, mass-exp=-1, time-exp=4, current-exp=2, temperature-exp=0, molar-amount-exp=0, luminous-intensity-exp=0  # Capacitance
    AUTOSAR_AISpecification_PhysicalDimensions_M1: length-exp=0, mass-exp=1, time-exp=0, current-exp=0, temperature-exp=0, molar-amount-exp=0, luminous-intensity-exp=0  # Mass
    AUTOSAR_AISpecification_PhysicalDimensions_LenNeg3M1: length-exp=-3, mass-exp=1, time-exp=0, current-exp=0, temperature-exp=0, molar-amount-exp=0, luminous-intensity-exp=0  # Mass Density
    AUTOSAR_AISpecification_PhysicalDimensions_M1AmntNeg1: length-exp=0, mass-exp=1, time-exp=0, current-exp=0, temperature-exp=0, molar-amount-exp=-1, luminous-intensity-exp=0  # Molar Mass
    AUTOSAR_AISpecification_PhysicalDimensions_M1TiNeg1: length-exp=0, mass-exp=1, time-exp=-1, current-exp=0, temperature-exp=0, molar-amount-exp=0, luminous-intensity-exp=0  # Mass Flow
    AUTOSAR_AISpecification_PhysicalDimensions_LenNeg3Ti1I1_1: length-exp=-3, mass-exp=0, time-exp=1, current-exp=1, temperature-exp=0, molar-amount-exp=0, luminous-intensity-exp=0  # Pressure per Voltage
    AUTOSAR_AISpecification_PhysicalDimensions_LenNeg4M1TiNeg1: length-exp=-4, mass-exp=1, time-exp=-1, current-exp=0, temperature-exp=0, molar-amount-exp=0, luminous-intensity-exp=0  # Pressure per Volumetric Flow / Flow Resistance
    AUTOSAR_AISpecification_PhysicalDimensions_Len2M1TiNeg2INeg2: length-exp=2, mass-exp=1, time-exp=-2, current-exp=-2, temperature-exp=0, molar-amount-exp=0, luminous-intensity-exp=0  # Inductance
    AUTOSAR_AISpecification_PhysicalDimensions_Len1M1TiNeg2INeg2: length-exp=1, mass-exp=1, time-exp=-2, current-exp=-2, temperature-exp=0, molar-amount-exp=0, luminous-intensity-exp=0  # Permeability
    AUTOSAR_AISpecification_PhysicalDimensions_TiNeg1: length-exp=0, mass-exp=0, time-exp=-1, current-exp=0, temperature-exp=0, molar-amount-exp=0, luminous-intensity-exp=0  # Frequency
    AUTOSAR_AISpecification_PhysicalDimensions_Len2M1TiNeg2_1: length-exp=2, mass-exp=1, time-exp=-2, current-exp=0, temperature-exp=0, molar-amount-exp=0, luminous-intensity-exp=0  # Energy
    AUTOSAR_AISpecification_PhysicalDimensions_Len2M1TiNeg2TNeg1: length-exp=2, mass-exp=1, time-exp=-2, current-exp=0, temperature-exp=-1, molar-amount-exp=0, luminous-intensity-exp=0  # Heat Capacity
    AUTOSAR_AISpecification_PhysicalDimensions_Len2TiNeg2: length-exp=2, mass-exp=0, time-exp=-2, current-exp=0, temperature-exp=0, molar-amount-exp=0, luminous-intensity-exp=0  # Specific Heat
    AUTOSAR_AISpecification_PhysicalDimensions_Len2TiNeg2TNeg1: length-exp=2, mass-exp=0, time-exp=-2, current-exp=0, temperature-exp=-1, molar-amount-exp=0, luminous-intensity-exp=0  # Specific Heat Capacity
    AUTOSAR_AISpecification_PhysicalDimensions_Len2M1TiNeg2AmntNeg1: length-exp=2, mass-exp=1, time-exp=-2, current-exp=0, temperature-exp=0, molar-amount-exp=-1, luminous-intensity-exp=0  # Molar Energy
    AUTOSAR_AISpecification_PhysicalDimensions_Len2M1TiNeg2TNeg1AmntNeg1: length-exp=2, mass-exp=1, time-exp=-2, current-exp=0, temperature-exp=-1, molar-amount-exp=-1, luminous-intensity-exp=0  # Molar Heat Capacity
    AUTOSAR_AISpecification_PhysicalDimensions_TiNeg1Amnt1: length-exp=0, mass-exp=0, time-exp=-1, current-exp=0, temperature-exp=0, molar-amount-exp=1, luminous-intensity-exp=0  # Catalytic Activity
    AUTOSAR_AISpecification_PhysicalDimensions_TiNeg1T1: length-exp=0, mass-exp=0, time-exp=-1, current-exp=0, temperature-exp=1, molar-amount-exp=0, luminous-intensity-exp=0  # Temperature Gradient
    AUTOSAR_AISpecification_PhysicalDimensions_T1_1: length-exp=0, mass-exp=0, time-exp=0, current-exp=0, temperature-exp=1, molar-amount-exp=0, luminous-intensity-exp=0  # Relative Temperature, Temperature Difference
    AUTOSAR_AISpecification_PhysicalDimensions_Len2M1: length-exp=2, mass-exp=1, time-exp=0, current-exp=0, temperature-exp=0, molar-amount-exp=0, luminous-intensity-exp=0  # Moment of Inertia
    AUTOSAR_AISpecification_PhysicalDimensions_Len1TiNeg1: length-exp=1, mass-exp=0, time-exp=-1, current-exp=0, temperature-exp=0, molar-amount-exp=0, luminous-intensity-exp=0  # Velocity
    AUTOSAR_AISpecification_PhysicalDimensions_Len1TiNeg2: length-exp=1, mass-exp=0, time-exp=-2, current-exp=0, temperature-exp=0, molar-amount-exp=0, luminous-intensity-exp=0  # Acceleration
    AUTOSAR_AISpecification_PhysicalDimensions_Len1M1TiNeg2: length-exp=1, mass-exp=1, time-exp=-2, current-exp=0, temperature-exp=0, molar-amount-exp=0, luminous-intensity-exp=0  # Force
    AUTOSAR_AISpecification_PhysicalDimensions_Len2M1TiNeg3: length-exp=2, mass-exp=1, time-exp=-3, current-exp=0, temperature-exp=0, molar-amount-exp=0, luminous-intensity-exp=0  # Torque Time Gradient
    AUTOSAR_AISpecification_PhysicalDimensions_Len2M1TiNeg3INeg2: length-exp=2, mass-exp=1, time-exp=-3, current-exp=-2, temperature-exp=0, molar-amount-exp=0, luminous-intensity-exp=0  # Electric Resistance
    AUTOSAR_AISpecification_PhysicalDimensions_Len2M1TiNeg3INeg1: length-exp=2, mass-exp=1, time-exp=-3, current-exp=-1, temperature-exp=0, molar-amount-exp=0, luminous-intensity-exp=0  # Voltage
    AUTOSAR_AISpecification_PhysicalDimensions_Len2M1TiNeg3_1: length-exp=2, mass-exp=1, time-exp=-3, current-exp=0, temperature-exp=0, molar-amount-exp=0, luminous-intensity-exp=0  # Power
    AUTOSAR_AISpecification_PhysicalDimensions_Len1M1TiNeg2_1: length-exp=1, mass-exp=1, time-exp=-2, current-exp=0, temperature-exp=0, molar-amount-exp=0, luminous-intensity-exp=0  # Electrical Energy Consumption
    AUTOSAR_AISpecification_PhysicalDimensions_Len3: length-exp=3, mass-exp=0, time-exp=0, current-exp=0, temperature-exp=0, molar-amount-exp=0, luminous-intensity-exp=0  # Volume
    AUTOSAR_AISpecification_PhysicalDimensions_Len2_1: length-exp=2, mass-exp=0, time-exp=0, current-exp=0, temperature-exp=0, molar-amount-exp=0, luminous-intensity-exp=0  # Volume Per Distance / Fuel Consumption
    AUTOSAR_AISpecification_PhysicalDimensions_Len3TiNeg1: length-exp=3, mass-exp=0, time-exp=-1, current-exp=0, temperature-exp=0, molar-amount-exp=0, luminous-intensity-exp=0  # Volumetric Flow
    AUTOSAR_AISpecification_PhysicalDimensions_M1TiNeg2INeg1: length-exp=0, mass-exp=1, time-exp=-2, current-exp=-1, temperature-exp=0, molar-amount-exp=0, luminous-intensity-exp=0  # Magnetic Flux Density, Magnetic Induction
    AUTOSAR_AISpecification_PhysicalDimensions_Len2M1TiNeg4INeg1: length-exp=2, mass-exp=1, time-exp=-4, current-exp=-1, temperature-exp=0, molar-amount-exp=0, luminous-intensity-exp=0  # Voltage Time Gradient
    AUTOSAR_AISpecification_PhysicalDimensions_Amnt1: length-exp=0, mass-exp=0, time-exp=0, current-exp=0, temperature-exp=0, molar-amount-exp=1, luminous-intensity-exp=0  # Quantity of substance
    AUTOSAR_AISpecification_PhysicalDimensions_LenNeg3Amnt1: length-exp=-3, mass-exp=0, time-exp=0, current-exp=0, temperature-exp=0, molar-amount-exp=1, luminous-intensity-exp=0  # Concentration
    AUTOSAR_AISpecification_PhysicalDimensions_LenNeg3TiNeg1Amnt1: length-exp=-3, mass-exp=0, time-exp=-1, current-exp=0, temperature-exp=0, molar-amount-exp=1, luminous-intensity-exp=0  # Reaction Rate
    AUTOSAR_AISpecification_PhysicalDimensions_Len3TiNeg2: length-exp=3, mass-exp=0, time-exp=-2, current-exp=0, temperature-exp=0, molar-amount-exp=0, luminous-intensity-exp=0  # Volumetric Flow Gradient
    AUTOSAR_AISpecification_PhysicalDimensions_Len3MNeg1: length-exp=3, mass-exp=-1, time-exp=0, current-exp=0, temperature-exp=0, molar-amount-exp=0, luminous-intensity-exp=0  # Specific Volume
    AUTOSAR_AISpecification_PhysicalDimensions_Len1TiNeg3: length-exp=1, mass-exp=0, time-exp=-3, current-exp=0, temperature-exp=0, molar-amount-exp=0, luminous-intensity-exp=0  # Acceleration Time Gradient
    AUTOSAR_AISpecification_PhysicalDimensions_Len2Ti1: length-exp=2, mass-exp=0, time-exp=-1, current-exp=0, temperature-exp=0, molar-amount-exp=0, luminous-intensity-exp=0  # Kinematic Viscosity
    AUTOSAR_AISpecification_PhysicalDimensions_NoDimension: length-exp=0, mass-exp=0, time-exp=0, current-exp=0, temperature-exp=0, molar-amount-exp=0, luminous-intensity-exp=0  # Dimensionless
    AUTOSAR_AISpecification_PhysicalDimensions_Len2M1TiNeg2: length-exp=2, mass-exp=1, time-exp=-2, current-exp=0, temperature-exp=0, molar-amount-exp=0, luminous-intensity-exp=0  # Torque
    AUTOSAR_AISpecification_PhysicalDimensions_Len2M1TiNeg1: length-exp=2, mass-exp=1, time-exp=-1, current-exp=0, temperature-exp=0, molar-amount-exp=0, luminous-intensity-exp=0  # Angular Momentum
    AUTOSAR_AISpecification_PhysicalDimensions_M1TiNeg2: length-exp=0, mass-exp=1, time-exp=-2, current-exp=0, temperature-exp=0, molar-amount-exp=0, luminous-intensity-exp=0  # Surface Tension
    AUTOSAR_AISpecification_PhysicalDimensions_M1TiNeg1_1: length-exp=0, mass-exp=1, time-exp=-1, current-exp=0, temperature-exp=0, molar-amount-exp=0, luminous-intensity-exp=0  # Translational Dumping
    AUTOSAR_AISpecification_PhysicalDimensions_LenNeg1M1TiNeg1: length-exp=-1, mass-exp=1, time-exp=-1, current-exp=0, temperature-exp=0, molar-amount-exp=0, luminous-intensity-exp=0  # Dynamic Viscosity
    AUTOSAR_AISpecification_PhysicalDimensions_NoDimension_1: length-exp=0, mass-exp=0, time-exp=0, current-exp=0, temperature-exp=0, molar-amount-exp=0, luminous-intensity-exp=0  # Ratio
    AUTOSAR_AISpecification_PhysicalDimensions_LenNeg1: length-exp=-1, mass-exp=0, time-exp=0, current-exp=0, temperature-exp=0, molar-amount-exp=0, luminous-intensity-exp=0  # Inverse Length
    AUTOSAR_AISpecification_PhysicalDimensions_TiNeg2: length-exp=0, mass-exp=0, time-exp=-2, current-exp=0, temperature-exp=0, molar-amount-exp=0, luminous-intensity-exp=0  # Rotational Speed Gradient
    AUTOSAR_AISpecification_PhysicalDimensions_TiNeg1_1: length-exp=0, mass-exp=0, time-exp=-1, current-exp=0, temperature-exp=0, molar-amount-exp=0, luminous-intensity-exp=0  # Ratio Gradient
    AUTOSAR_AISpecification_PhysicalDimensions_LenNeg2MNeg1Ti3I2: length-exp=-2, mass-exp=-1, time-exp=3, current-exp=2, temperature-exp=0, molar-amount-exp=0, luminous-intensity-exp=0  # Electrical Conductance
    AUTOSAR_AISpecification_PhysicalDimensions_LenNeg3MNeg1Ti3I2: length-exp=-3, mass-exp=-1, time-exp=3, current-exp=2, temperature-exp=0, molar-amount-exp=0, luminous-intensity-exp=0  # Electrical Conductivity
    AUTOSAR_AISpecification_PhysicalDimensions_LenNeg3MNeg1Ti2I2: length-exp=-3, mass-exp=-1, time-exp=2, current-exp=2, temperature-exp=0, molar-amount-exp=0, luminous-intensity-exp=0  # Electrical Conductivity Gradient
    AUTOSAR_AISpecification_PhysicalDimensions_Len1M1TiNeg3INeg1: length-exp=1, mass-exp=1, time-exp=-3, current-exp=-1, temperature-exp=0, molar-amount-exp=0, luminous-intensity-exp=0  # Electric Field Strength / Electric intensity
    AUTOSAR_AISpecification_PhysicalDimensions_M1TiNeg3TNeg1: length-exp=0, mass-exp=1, time-exp=-3, current-exp=0, temperature-exp=-1, molar-amount-exp=0, luminous-intensity-exp=0  # Heat Transfer Coefficient
    AUTOSAR_AISpecification_PhysicalDimensions_Len1M1TiNeg3TNeg1: length-exp=1, mass-exp=1, time-exp=-3, current-exp=0, temperature-exp=-1, molar-amount-exp=0, luminous-intensity-exp=0  # Thermal Conductivity
    AUTOSAR_AISpecification_PhysicalDimensions_Len2M1TiNeg4: length-exp=2, mass-exp=1, time-exp=-4, current-exp=0, temperature-exp=0, molar-amount-exp=0, luminous-intensity-exp=0  # Power Time Gradient
    AUTOSAR_AISpecification_PhysicalDimensions_Len2M1TiNeg2INeg1: length-exp=2, mass-exp=1, time-exp=-2, current-exp=-1, temperature-exp=0, molar-amount-exp=0, luminous-intensity-exp=0  # Magnetic Flux
    RB_RBA_Common_CentralElements_PhysicalDimensions_NoUnit: length-exp=0
    AUTOSAR_NvM_PhysicalDimensions_NoUnit: length-exp=0
    RB_RBA_rba_MemLib_PhysicalDimensions_Mem_NoPhysDim: length-exp=0
