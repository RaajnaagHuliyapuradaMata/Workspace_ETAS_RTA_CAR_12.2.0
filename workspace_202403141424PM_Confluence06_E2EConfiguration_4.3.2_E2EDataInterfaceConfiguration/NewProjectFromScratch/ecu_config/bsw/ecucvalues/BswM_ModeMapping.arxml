AUTOSAR XML (schema 00051)
package /AUTOSAR_BswM/ModeDeclarationGroups
  mode declaration group MDG_ECUM_STATE: category=ALPHABETIC_ORDER, initial-mode=ECU_STARTUP_ONE
    7 x mode:
      ECU_STARTUP_ONE
      ECU_STARTUP_TWO
      ECU_RUN
      ECU_APP_RUN
      ECU_APP_POST_RUN
      ECU_GO_OFF_ONE
      ECU_GO_OFF_TWO
  data type mapping set ECUM_STATE_Mapping: mode-request-type-map{implementation-data-type=uint8, mode-group=MDG_ECUM_STATE}
