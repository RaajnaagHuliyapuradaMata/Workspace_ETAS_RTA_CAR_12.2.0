AUTOSAR XML (schema 4-2-2)
package /AUTOSAR_Fee/EcucModuleDefs
  module definition Fee [0..254]: category=VENDOR_SPECIFIC_MODULE_DEFINITION, refined-module-def=Fee, variants pre-compile  # Memory: Flash EEPROM Emulation | Configuration of the Fee (Flash eeprom emulation) module.
    container FeeBlockConfiguration [1..65535]: multiplicity set at pre-compile  # FeeBlockConfiguration. | Configuration of block specific parameters for the Flash EEPROM Emulation module.
      integer FeeBlockNumber [0..1]: 1..65534, multiplicity set at pre-compile, set at pre-compile, symbolic-name-value=true  # Block identifier. | This tag has currently no effect, the FeeRbBlockPersistentId has to be configured instead. The FeeBlockNumber will be calculated by the Fee automatically. This can be used as a parameter in the user interfaces in order to identify the relevant block. | 0x0000 and 0xFFFF shall not be used for block numbers (see FEE006). Range: min = 2^NVM_DATASET_SELECTION_BITS, max = 0xFFFF - 2^NVM_DATASET_SELECTION_BITS. Note: Depending on the number of bits set aside for dataset selection several other block numbers shall also be left out to ease implementation.
      integer FeeBlockSize: 1..65535, multiplicity set at pre-compile, set at pre-compile  # Data size of the block. | Size of a logical block in bytes.
      boolean FeeImmediateData: multiplicity set at pre-compile, set at pre-compile  # Marker for high priority data. | If the Fee's queue contains more than one order, high priority data will be favored. | true: Block contains immediate data. false: Block does not contain immediate data.
      integer FeeNumberOfWriteCycles: 0..4294967295, multiplicity set at pre-compile, set at pre-compile  # Number of block write cycles over ECU lifetime. | Number of write cycles (app.) required for this block (during the complete ECU lifetime). This tag is used for calculating the reachable driving cycles in some product lines.
      integer FeeRbBlockPersistentId: 1..65534, multiplicity set at pre-compile, origin=RB:1.0.0:2011-09-09, set at pre-compile  # Permanent block ID. | Permanent block ID which is stored in the medium ("UUID"). | Permanent block id which is used for storage in medium ("UUID").
      string FeeRbCallbackEnd [0..0]: multiplicity set at pre-compile, origin=RB:1.0.0:2011-09-09, set at link in variant link-time / pre-compile in variant pre-compile  # Callback function for successful jobs. | Feature was removed and is not supported anymore. Use FeeUpdateModel.java file to update configuration.
      string FeeRbCallbackError [0..0]: multiplicity set at pre-compile, origin=RB:1.0.0:2011-09-09, set at link in variant link-time / pre-compile in variant pre-compile  # Callback function for failed jobs. | Feature was removed and is not supported anymore. Use FeeUpdateModel.java file to update configuration.
      enumeration FeeRbDataFilterType [0..0]: multiplicity set at pre-compile, origin=RB:1.0.0:2011-09-09, set at pre-compile  # Data Filter Type (data classification). | Feature was removed and is not supported anymore. Use FeeUpdateModel.java file to update configuration.
        DYNAMIC  # Dynamic (standard, anybody can erase this block (e.g. during migration)
        STATIC  # Static (only certain users can erase this block, e.g. repair shops)
        PERMANENT  # Permanent (only very certain users can erase this block, e.g. OEM)
        SUPER_PERMANENT  # Super Permanent (block can never be erased)
      integer FeeRbDeviceIndex [0..1]: 0..254, multiplicity set at pre-compile, origin=RB:1.0.0:2011-09-09, set at pre-compile, default-value=0  # Rb special device index in integer. | This information is needed by the NVRAM manager respectively the Memory Abstraction Interface to address a certain logical block. | Range: 0 .. 254 (0xFF reserved for broadcast call to GetStatus function). This tag has currently no effect.
      boolean FeeRbFirstReadDataMigration [0..1]: multiplicity set at pre-compile, origin=RB:1.0.0:2011-09-09, set at pre-compile, default-value=false  # First Read Data Migration | Pre-processor config parameter to activate or deactivate the First Read Data Migration feature. | false: First Read Data Migration is disabled (default). true: First Read Data Migration is enabled.
      boolean FeeRbNoFallback [0..1]: multiplicity set at pre-compile, origin=RB:1.0.0:2011-09-09, set at pre-compile, default-value=false  # NoFallback attribute | Pre-processor config parameter to activate or deactivate a fall back mechanism to older copies of the same block in case the latest block is corrupted. By default a fall back to old copies is possible. The NoFallback feature is available only for Renesas R1x / P1x as well as TI controllers. It is activated only when at least one block is configured as NoFallback. The API Fee_Rb_BlockMaintenance() needs to be activated and called during shutdown when this feature is used. This is necessary to repair double storage NoFallback blocks which are corrupted due to write interruptions. | false: If the latest copy is corrupted an older valid copy of the same block is read (default). true: If the latest copy is corrupted all available older copies of the same block are ignored. Behavior during layout change: Parameter gets activated in the new layout (true): Old copies are still readable since the evaluation is done on the block properties from the data flash. New copies are written with an activated NoFallback setting. Parameter gets deactivated in the new layout (false) but the feature itself is still activated: Only the last valid copy which was also readable with an activated NoFallback setting is readable. New copies are written with a deactivated NoFallback setting.Parameter gets deactivated in the new layout (false) and the feature itself is deactivated: All old copies are readable.
      enumeration FeeRbOrigin: multiplicity set at pre-compile, origin=RB:1.0.0:2011-09-09, set at pre-compile  # Responsible module for this configuration. | NVM / Adapter / Fee-internal block type. | Origin (owner) of the block. NVM: Block belongs to NvM, query its job result with Fee_GetJobResult API. ADAPTER: Block belongs to Eep_Adapter / PDM_Adapter; query its job result with Fee_Rb_GetAdapterJobResult API. FEE: Block belongs to Fee; there is no public API to query its job result (DO NOT USE THIS SETTING)!
        NVM  # NvM block
        ADAPTER  # Eep_Adapter block / PDM_Adapter block
        FEE  # Fee-internal block (DO NOT USE THIS SETTING)
      boolean FeeRbRobustness [0..1]: multiplicity set at pre-compile, origin=RB:1.0.0:2011-09-09, set at pre-compile, default-value=false  # Block robustness attribute. | This tag improves the robustness against a data modification during write executions by adding an additional checksum to the block data which is calculated over an internal buffer that is used for writing the block data step by step. | true: Feature enabled (block will be increased by 4 bytes). false: Feature disabled. Note: Behavior for rba_FeeFs1 during layout change: 1. Parameter gets activated in the new layout (true): Old copies are still readable since the evaluation is done on the block properties from the data flash. New copies are written with an activated robustness setting. 2. Parameter gets deactivated in the new layout (false): Only the last valid copy which was also readable with an activated robustness setting is readable. New copies are written with a deactivated robustness setting.
      integer FeeRbSecLevel: 1..2, multiplicity set at pre-compile, origin=RB:1.0.0:2011-09-09, set at pre-compile  # Redundant data storage. | Security Level of the block | Range: 1 = Block has one copy in flash, 2 = Block has two identical copies in flash
      boolean FeeRbSurvival [0..1]: multiplicity set at pre-compile, origin=RB:1.0.0:2011-09-09, set at pre-compile, default-value=false  # Block survival attribute. | This tag changes the reorganization behaviour for this block in case it is not within the layout. | true: Sector reorganization will not delete this block, even if it is not part of the layout. false: Sector reorganization will delete this block if it is not part of the layout.
      boolean FeeRbVarBlockLength [0..1]: multiplicity set at pre-compile, origin=RB:1.0.0:2011-09-09, set at pre-compile, default-value=false  # Variable Block Length | This tag marks that the block length is variable and calculated on runtime. | false: Block length is numeric literal and calculated at compile time (default). true: Block length is variable and calculated on runtime.
      symbolic name reference FeeDeviceIndex [0..0]: multiplicity set at pre-compile, set at pre-compile, destination=FlsGeneral  # Block Device index. | This information is defined but not used. | This tag has currently no effect.
    container FeeGeneral: multiplicity set at pre-compile  # Container for general parameters. These parameters are not specific to a block.
      integer FeeBufferAlignmentValueRef [0..0]: multiplicity set at pre-compile, set at pre-compile  # Buffer Alignment | Parameter determines the alignment of the start address that Fee buffers need to have.Value shall be inherited from MemAccBufferAlignmentValue. This parameter is not supported by the Fee. Instead the MemMap section FEE_START_SEC_VAR_SECURED_CACHED_RAM_ALIGNED_CLEARED_UNSPECIFIED can be used to specifically align Fee buffers containing data which is forward to lower layers.
      boolean FeeDevErrorDetect: multiplicity set at pre-compile, set at pre-compile  # Development Error Detection setting. | Pre-processor config parameter to enable or disable development error detection. | true: Development error detection enabled. false: Development error detection detection disabled.
      integer FeeIndex [0..0]: multiplicity set at pre-compile, set at pre-compile  # Instance ID (obselete and not used) | Parameter is obsolete and is not supported anymore. Use FeeUpdateModel.java file to update configuration.
      float FeeMainFunctionPeriod: 0..1, multiplicity set at pre-compile, origin=RB:18.1.0:2021-08-30, set at pre-compile, default-value=0  # MainFunction Period | The period between successive calls to the main function in seconds.
      integer FeeMinimumReadPageSize [0..0]: multiplicity set at pre-compile, set at pre-compile  # Minimum Read Page Size | Minimum Page size will be a multiple of the minimum page size. Fee shall align read requests to this size. This features is not supported. The Fee assumes the lower layer can handle read requests in any granularity.
      function name FeeNvmJobEndNotification [0..0]: multiplicity set at pre-compile, set at pre-compile, default-value=NULL_PTR  # Job End notification function. | This feature is not supported.
      function name FeeNvmJobErrorNotification [0..0]: multiplicity set at pre-compile, set at pre-compile, default-value=NULL_PTR  # Job Error notification function. | This feature is not supported.
      boolean FeePollingMode: multiplicity set at pre-compile, set at pre-compile  # Polling mode setting. | Pre-processor config parameter to enable or disable the polling mode for this module (usage of the job result functionality). | true: Polling mode enabled, callback functions (provided to FLS module) disabled. false: Polling mode disabled, callback functions (provided to FLS module) enabled.
      boolean FeeRbActEraseSuspension [0..0]: multiplicity set at pre-compile, origin=RB:1.0.0:2011-09-09, set at pre-compile  # Erase suspension active (only for Ti devices). | Feature was removed and is not supported anymore. Use FeeUpdateModel.java file to update configuration.
      boolean FeeRbActSafetyChecks [0..0]: multiplicity set at pre-compile, origin=RB:1.0.0:2011-09-09, set at pre-compile  # Internal Safety Check setting. | Feature was removed and is not supported anymore. Use FeeUpdateModel.java file to update configuration.
      boolean FeeRbActSurvivalEval [0..1]: multiplicity set at pre-compile, origin=RB:1.0.0:2011-09-09, set at pre-compile, default-value=false  # Activation of the "partial afterburner". | Pre-processor config parameter to enable or disable an additional block specific reorganization for unknown blocks with an active survival setting ("FeeRbSurvival") in the medium. | true: Feature enabled ("block specific afterburner" on for blocks with active survival setting). false: Feature disabled ("block specific afterburner" off for blocks with active survival setting). Hint: If activated, this block will be overtaken independent from the "FeeRbActUnknownBlockReorg" setting ("general afterburner").
      boolean FeeRbActUnknownBlockReorg [0..1]: multiplicity set at pre-compile, origin=RB:1.0.0:2011-09-09, set at pre-compile, default-value=false  # Activation of the "global afterburner". | Pre-processor config parameter to enable or disable an additional reorganization for any unknown block in the medium. Only the CB (Customer Block) is allowed to enable this feature, because this is affecting the thresholds of the sector reorganization to a special safety level. It must be deactivated (default) for the ASW! | true: Feature enabled ("general afterburner" on for all unknown blocks). false: Feature disabled ("general afterburner" off for all unknown blocks). Hints: If activated, all unknown blocks will be overtaken independent from the "FeeRbActSurvivalEval" setting ("block specific afterburner"). If deactivated and with active survival evaluation ("FeeRbActSurvivalEval" == TRUE), only blocks with an active survival setting ("FeeRbSurvival" == TRUE) will be overtaken. Only the CB (Customer Block) is allowed to enable this feature, because this is affecting the thresholds of the sector reorganization to a special safety level. It must be deactivated (default) for the ASW!
      integer FeeRbActUnknownBlockReorgCacheSize [0..1]: 0..393210, multiplicity set at pre-compile, origin=RB:6.0.0:2015-07-31, set at pre-compile, default-value=1800  # Available cache size for faster sector reorganisation for "global afterburner" feature (FeeFs1, FeeFs1x). | Pre-processor config parameter to enable or disable an additional optimisation in reorganization for any unknown block in the dflash. This feature fastens the sector reorganisation for unknown blocks by scanning the sector and building up a cache for unknown block. In this config parameter, project can configure the amount of RAM space that can be used for the unknown block cache. Feature is to be used either in Boot mode with global afterburner feature activated (FeeRbActUnknownBlockReorg = TRUE) or in application software when using survival feature is used (FeeRbActSurvivalEval = TRUE). Currently only FeeFs1 and FeeFs1x supports this parameter. For FeeFs2 please use parameter FeeRbUnknownBlockCacheSize. | Hints: 1. Default value of the tag when only survival feature is activated is the space needed for one unknown block cache entry (For Fee1.0= 6 bytes and Fee1x = 12bytes per cache entry). 2. Default value when global after burner feature is activated is 1800 bytes. 3. For best performance project must allocate enough cache size to store information of all unknown blocks (one more then actual number of unknown blocks). Example: Project has 250 unknown blocks then for Fee1.0 at least 251*6 = 1506 bytes and for Fee1x: 251*12 = 3012 bytes to be allocated. 4. The unknown block reorganisation will also work when the cache size is smaller then actual number of unknown blocks in dflash. But will be slower.
      boolean FeeRbAddonsCCAS [0..0]: multiplicity set at pre-compile, origin=RB:1.0.0:2011-09-09, set at pre-compile  # Activation of the CC-AS specific add-ons. | Feature was moved to rba_FeeAddonsAS component - use provided template file to update config and activate the feature.
      enumeration FeeRbBlockTableLocation [0..1]: multiplicity set at pre-compile, origin=RB:15.0.2:2020-02-17, set at pre-compile, default-value=RAM  # Selected Location for Block Properties Table | Select Fee Block Properties Location - Keep default setting "RAM" to optimize the runtime of the code. Use "ROM" setting in case of reduction of RAM consumption only. | RAM: RAM Location of Fee Block Properties. ROM: ROM Location of Fee Block Properties. default: RAM
        RAM  # Use RAM location for Fee Blockproperties Table
        ROM  # Use ROM location for Fee Blockproperties Table
      boolean FeeRbCancel [0..1]: multiplicity set at pre-compile, origin=RB:21.1.0:2023-03-23, set at pre-compile, default-value=false  # Activation for cancel feature | Pre-processor config parameter to enable/disable the cancel feature for different jobs (internal and externally requested user jobs). Its purpose is to save code space when the feature is not needed. When the feature is activated and the cancel API is called, the ongoing job is canceled and Fee state machines are reset to start with a new job. Refer to documentation for more details on how cancel feature works. Note: To be backward + AUTOSAR compatible, the API for cancel feature is always available for NvM user Jobs. But the actual functionality is available only when this config parameter is set to true. Feature not supported for Fee1.0 file system. | true: Feature to cancel ongoing job enabled. false: Feature to cancel ongoing job disabled.
      boolean FeeRbChunkJobApis [0..1]: multiplicity set at pre-compile, origin=RB:18.1.0:2020-07-14, set at pre-compile, default-value=false  # API activation for chunk-wise job processing | Pre-processor config parameter to enable/disable the APIs for chunk-wise job processing. Note: When the feature is used to write unknown blocks (example for restoring the blocks from rba_MemBckp in Boot mode), the unknown block reorganisation feature should also be activated (FeeRbActUnknownBlockReorg to be set to true). This is done to avoid risk of losing the unknown blocks during reorganisation. To write survival unknown block in application mode, the survival feature should be activated (FeeRbActSurvivalEval to be set to true). If the unknown block reorg or survival reorg is not activated, requests on unknown block are rejected and error is reported to DET. | true: APIs for chunk-wise job processing enabled. false: APIs for chunk-wise job processing disabled.
      enumeration FeeRbChunkJobFeatureRequested [0..1]: multiplicity set at pre-compile, origin=RB:19.1.0:2022-03-28, set at pre-compile, default-value=FEE_RB_CHUNK_FEATURE_LEVEL1  # Features requested via chunk API | This configuration parameter selects the different features that the chunk APIs shall support. It is introduced for early identification (during BCT build time) whether or not the requested features are supported by the selected file system. Build aborts when the requested feature is not yet supported. | This feature can be configured only when chunk API is activated (config parameter FeeRbChunkJobAPIs is set to TRUE). Single chunk read and write operations for known blocks are possible by default (FEE_RB_CHUNK_FEATURE_LEVEL1).
        FEE_RB_CHUNK_FEATURE_LEVEL1  # L1 = Writing and reading of known blocks in single chunk via chunk APIs
        FEE_RB_CHUNK_FEATURE_LEVEL2  # L2 = Writing of known and unknown blocks + reading of known blocks in single chunk via chunk APIs
        FEE_RB_CHUNK_FEATURE_LEVEL3  # L3 = Writing of known and unknown blocks in single and multiple chunks + reading of known blocks in single chunk via chunk APIs
        FEE_RB_CHUNK_FEATURE_LEVEL4  # L4 = Writing of known and unknown blocks + reading of known blocks in single and multiple chunks via chunk APIs
        FEE_RB_CHUNK_FEATURE_LEVEL5  # L5 = Writing of known and unknown blocks + reading of known and unknown blocks in single and multiple chunks via chunk APIs
      boolean FeeRbConfirmSingleStorageBlockloss [0..1]: multiplicity set at pre-compile, origin=RB:19.1.0:2022-03-28, set at pre-compile, default-value=false  # Confirmation: Weakness Single Storage Blockloss | If FS1, FS1x or FS2 is selected as filesystem: Blocks configured with single storage have a very low probability to get lost even during regular operation. Background: In case an abort (reset or power loss) happens during physically charging the cells of the last page of a block then the data can be left weakly programmed and be lost during later operation. Because of this reason it is recommented that critical data is configured as double storage. For more information please check the known weakness for rba_FeeFs1, rba_FeeFs1x and/or rba_FeeFs2 in Connect. By setting this tag to true you confirm that the weakness is considered in the block configuration. If this is not done the build will abort. This is done due to a quality measure to ensure the knowledge about this information is spread in the organization. | true: FS1 and FS2 reset weakness for single storage blocks is considered in the block configuration. false: FS1 and FS2 reset weakness for single storage blocks is not considered in the block configuration
      boolean FeeRbConfirmUseGetSystemJobResult [0..1]: multiplicity set at pre-compile, origin=RB:19.1.0:2022-02-24, set at pre-compile, default-value=false  # Confirmation: Use Fee_Rb_GetSystemJobResult for system jobs | If FS1x is selected as filesystem and a forced sector reorganization shall be triggered (FeeRbTriggerReorgApi = true) or driver shall be stopped (FeeRbEnterStopModeApi = true). Then for getting the actual job status the API Fee_Rb_GetSystemJobResult() has to be used. Previously used Fee_Rb_GetAdapterJobResult() will return the wrong status of job execution for these jobs. | true: Yes, Fee_Rb_GetSystemJobResult() is used for getting the status of system jobs. false: It is not yet checked, that Fee_Rb_GetSystemJobResult() is used for getting the status of system jobs.
      boolean FeeRbDetailedBlkInfoApi [0..1]: multiplicity set at pre-compile, origin=RB:19.0.0:2021-11-08, set at pre-compile, default-value=false  # API activation Detailed Block Info API | Activation of Detailed Block Info API. In case of Block inconsistency, detailed block info API can be used to get a more detailed reason for block inconistency. | True: API for cDetailed Block Info enabled. False: API for cDetailed Block Info disabled.
      boolean FeeRbEnableRuntimeErrorReporting [0..1]: multiplicity set at pre-compile, origin=RB:18.1.0:2021-09-22, set at pre-compile, default-value=true  # Enable reporting of run time error | Pre-processor switch to enable or disable run time error reporting. By default run time errors are reported. However, by this switch the reporting can be disabled by project. Note: The switch is applicable only for AUTOSAR version greater then and equal to AR4.4. For older AUTOSAR version, this parameter is ignored. | true: run time error reporting enabled. false: run time error reporting disabled.
      boolean FeeRbEnterAndExitHighSpeedModeApis [0..1]: multiplicity set at pre-compile, origin=RB:21.1.0:2023-03-10, set at pre-compile, default-value=false  # API activation to Enter and Exit high speed mode | Pre-processor config parameter to enter or exit high speed execution mode API functionality of the FEE module. If the enter high speed execution API is called, Fee state machines are set to execute the job in fastest possible way. Refer documentation for more details about what the API does. Feature not supported for Fee1.0 file system. | true: Enter and Exit high speed mode API enabled. false: Enter and Exit high speed mode API disabled.
      boolean FeeRbEnterStopModeApi [0..1]: multiplicity set at pre-compile, origin=RB:7.0.0:2015-11-13, set at pre-compile, default-value=false  # API activation for Fee_Rb_EnterStopMode() | Pre-processor config parameter to enable/disable the stop mode functionality of the FEE module. For all file systems except FS1: If the stop mode API is called, the Fee is finishing the current job and afterwards locking itself. As soon as the Fee is locked, no further Fls requests are given until the Fee is initialized again. (the stop mode cannot be left) For Fs1 only: Fs1 does only support stop mode by writing TRUE to public variable Fee_Rb_stRequestStopMode_b. When using rba_FeeAddonsAS, FeeRbEnterStopModeApi needs to be activated. | true: Stop mode feature enabled. false: Stop mode feature disabled.
      enumeration FeeRbFsSelect [0..1]: multiplicity set at pre-compile, origin=RB:7.0.0:2015-11-13, set at pre-compile, default-value=FS1  # Selected Filesystem. | Specifies the actual layout of the data on the flash.
        FS1  # Fee 1.0 layout - round robin, management and user data one next to the other
        FS1X  # Fee1x driver (compatible to Fee1.0 layout)- round robin, management and user data one next to the other
        FS2  # Fee 2.0 layout - seperate sectors for management and user data.
        FS3  # PCM Memory Management Layout - Memory separated into two halfs
      integer FeeRbGeneralDeviceIndex [0..1]: 0..254, multiplicity set at pre-compile, origin=RB:7.0.0:2015-11-13, set at pre-compile  # Device id when multi instance of Fee is used | Specifies the InstanceId of this module instance. Note: This parameter is mandatory when more than one instance of FEE module is configured. For single instance when only one instance of FEE module is present, the device id will be ignored and will be always 0.
      string FeeRbGeneralDeviceNickName [0..1]: multiplicity set at pre-compile, origin=RB:7.0.0:2015-11-13, set at pre-compile  # Device nick name when multi instance of Fee is used | Specifies the nick name of the FEE module instance which is used for the API/Interface-name generation. Note: This parameter is mandatory when more than one instance of FEE module is configured. The instance with FeeRbGeneralDeviceIndex = 0 will not use the nick name for the API/Interface-name generation. For single instance when only one instance of FEE module is present, the nick name will be ignored.
      boolean FeeRbGetFreeSpaceApi [0..1]: multiplicity set at pre-compile, origin=RB:7.0.0:2015-11-13, set at pre-compile, default-value=false  # API activation to get number of free bytes in DFlash | Pre-processor config parameter to enable/disable the API to return amount of free bytes in the DFLASH area. | true: Free space API enabled. false: Free space API disabled.
      boolean FeeRbGetNrFreeBytesAndFatEntriesApi [0..1]: multiplicity set at pre-compile, origin=RB:16.0.0:2020-06-25, set at pre-compile, default-value=false  # API activation to get number of free bytes and FAT entries in Dflash | Pre-processor config parameter to enable/disable the API to return the amount of free bytes and FAT entries in the DFLASH area until a hard reorganization or an erase operation starts. This API applies only to FeeFs2. | true: Number free bytes and FAT entries API enabled. false: Number free bytes FAT entries API disabled.
      boolean FeeRbGetNrSectorErases [0..1]: multiplicity set at pre-compile, origin=RB:7.0.0:2015-11-13, set at pre-compile, default-value=false  # Calculate the number of performed sector specific erase cycles | Pre-processor config parameter to enable/disable the determination of the sector specific number of erase cycles. Only available for FeeFs2. number of erase cycles is stored to Dflash in background. Default: disabled | true: determine sector specific number of erase cycles. false: do not determine sector specific number of erase cycles.
      boolean FeeRbGetSectStateApi [0..1]: multiplicity set at pre-compile, origin=RB:20.1.0:2022-07-14, set at pre-compile, default-value=false  # API activation to get the state of sector/row | Pre-processor config parameter to enable/disable the API to return the state of sector/row. In Fee1x and Fee2, the API returns the state of the sector and for Fee3, it returns the state of the row. | true: get sector/row state API enabled. false: get sector/row state API disabled.
      boolean FeeRbInclPrjHeader [0..1]: multiplicity set at pre-compile, origin=RB:20.1.0:2022-07-14, set at pre-compile, default-value=false  # Activate optional project extension header include | This switch can be used to activate the optional #include Fee_Rb_Prj.h (see template folder) to activate/modify internal functionality within the FeeHL and the FeeFsX. Note: when activating this switch, you have to provide this header file in your project.
      enumeration FeeRbMachineType [0..1]: multiplicity set at pre-compile, origin=RB:1.0.0:2011-09-09, set at pre-compile  # Machine Type | Controller type to be configured in case no MCU module is present.
        FEE_RB_IFX_TC26X  # Infineon TC26X/Device 2
        FEE_RB_IFX_TC27X  # Infineon TC27X/Device 3
        FEE_RB_IFX_TC27X_HSM  # Infineon TC27X HSM/Device 3 HSM
        FEE_RB_IFX_TC29X  # Infineon TC29X/Device 4
        FEE_RB_IFX_TC29X_HSM  # Infineon TC29X HSM/Device 4 HSM
        FEE_RB_IFX_TC33X_CMPL  # Infineon TC33x Complementary
        FEE_RB_IFX_TC33X_SE  # Infineon TC33x Single Ended
        FEE_RB_IFX_TC35X_CMPL  # Infineon TC35x Complementary
        FEE_RB_IFX_TC35X_SE  # Infineon TC35x Single Ended
        FEE_RB_IFX_TC37X_CMPL  # Infineon TC37x Complementary
        FEE_RB_IFX_TC37X_SE  # Infineon TC37x Single Ended
        FEE_RB_IFX_TC38X_CMPL  # Infineon TC38x Complementary
        FEE_RB_IFX_TC38X_SE  # Infineon TC38x Single Ended
        FEE_RB_IFX_TC39X_CMPL  # Infineon TC39x Complementary
        FEE_RB_IFX_TC39X_SE  # FEE_RB_IFX_TC39X_40NM_SE
        FEE_RB_IFX_TC3EX_CMPL  # Infineon TC3Ex Complementary
        FEE_RB_IFX_TC3EX_SE  # Infineon TC3Ex Single Ended
        FEE_RB_IFX_TC3XX_SE_HSM  # Infineon TC3xx Aurix2 HSM Single Ended
        FEE_RB_IFX_TC3XX_CMPL_HSM  # Infineon TC3xx Aurix2 HSM Complementary
        FEE_RB_IFX_TC49X  # Infineon TC49x
        FEE_RB_IFX_TC4XX_HSM  # Infineon TC4XX CSRM
        FEE_RB_JDP_MPC5726  # JDP MPC5726/SPC572L Device 1
        FEE_RB_JDP_MPC5744  # JDP MPC5744/SPC574K Device 2
        FEE_RB_JDP_MPC5746B  # JDP MPC5746B Device 3
        FEE_RB_JDP_MPC5746B_HSM  # JDP MPC5746B HSM Device 3
        FEE_RB_JDP_MPC5777  # JDP MPC5777 Device 4
        FEE_RB_JDP_MPC5777_HSM  # JDP MPC5777 HSM Device 4
        FEE_RB_ST_SPC58XNX  # ST SPC58xNx Device 3_40 Bernina
        FEE_RB_ST_SPC58XNX_HSM  # ST SPC58xNx HSM Device 3_40 Bernina
        FEE_RB_ST_SPC58XBX  # ST SPC58xBx (Chorus B-Line)
        FEE_RB_ST_SPC58XCX  # ST SPC58xCx (Chorus C-Line)
        FEE_RB_ST_SPC58X_GH_X  # ST SPC58xGx SPC58xHx (Chorus G/H-Line)
        FEE_RB_ST_SPC58XXX_HSM  # ST SPC58xCx/SPC58xGx/SPC58xHx HSM (Chorus C/G/H-Line)
        FEE_RB_ST_CENTAURI  # ST Centauri
        FEE_RB_ST_CENTAURI_HSM  # ST Centauri HSM
        FEE_RB_ST_SR6P3  # ST SR6P3
        FEE_RB_ST_SR6P3_HSM  # ST SR6P3 HSM
        FEE_RB_ST_SR6P6  # ST SR6P6
        FEE_RB_ST_SR6P6_HSM  # ST SR6P6 HSM
        FEE_RB_ST_SR6P7  # ST SR6P7
        FEE_RB_ST_SR6P7_HSM  # ST SR6P7 HSM
        FEE_RB_ST_SR6X7  # ST SR6X7/SR6P7G7
        FEE_RB_ST_SR6X7_HSM  # ST SR6X7/SR6P7G7 HSM
        FEE_RB_NXP_MPC5746C  # NXP MPC5746C
        FEE_RB_NXP_MPC5746C_HSM  # NXP MPC5746C HSM
        FEE_RB_REN_RH850R1X_512KB_4S_8KB  # Renesas RH850R1X 512KB - 4 sectors, 32kB useable
        FEE_RB_REN_RH850R1X_512KB_4S_7_5KB  # Renesas RH850R1X 512KB - 4 sectors, 30kB useable
        FEE_RB_REN_RH850R1X_1MB_4S_8KB  # Renesas RH850R1X 1MB - 4 sectors, 32kB useable
        FEE_RB_REN_RH850R1X_1MB_4S_7_5KB  # Renesas RH850R1X 1MB - 4 sectors, 30kB useable
        FEE_RB_REN_RH850F1KM_S1_4S_16KB  # Renesas RH850F1KM-S1 - 4 sectors, 64kB useable
        FEE_RB_REN_RH850F1KM_S1_4S_15_5KB  # Renesas RH850F1KM-S1 - 4 sectors, 62kB useable
        FEE_RB_REN_RH850F1KM_S1_4S_15KB  # Renesas RH850F1KM-S1 - 4 sectors, 60kB useable
        FEE_RB_REN_RH850F1KM_S4_6S_17_375KB  # Renesas RH850F1KM-S4 - 6 sectors, 104.25kB useable
        FEE_RB_REN_RH850F1KM_S4_4S_5_9375KB_HSM  # Renesas RH850F1KM-S4 HSM - 4 sectors, 23.75kB useable
        FEE_RB_REN_RH850F1KM_S2_6S_17_375KB  # Renesas RH850F1KM-S2 - 6 sectors, 104.25kB useable
        FEE_RB_REN_RH850F1KM_S2_4S_5_9375KB_HSM  # Renesas RH850F1KM-S2 HSM - 4 sectors, 23.75kB useable
        FEE_RB_CYP_CYT2B6X_6S_8K  # Cypress Traveo 2 CYT2B6x - 3 sectors, 48kB useable
        FEE_RB_CYP_CYT2B6X_4S_4K_HSM  # Cypress Traveo 2 CYT2B6x HSM- 2 sectors, 16kB useable
        FEE_RB_CYP_CYT2B7X_4S_18K  # Cypress Traveo 2 CYT2B7x - 4 sectors, 72kB useable
        FEE_RB_CYP_CYT2B7X_4S_6K_HSM  # Cypress Traveo 2 CYT2B7x HSM - 4 sectors, 24kB useable
        FEE_RB_CYP_CYT2B9X_6S_16K  # Cypress Traveo 2 CYT2B9x - 6 sectors, 96kB useable
        FEE_RB_CYP_CYT2B9X_4S_8K_HSM  # Cypress Traveo 2 CYT2B9x HSM- 4 sectors, 32kB useable
        FEE_RB_CYP_CYT2BLX_6S_16K  # Cypress Traveo 2 CYT2BLx - 6 sectors, 96kB useable
        FEE_RB_CYP_CYT2BLX_4S_8K_HSM  # Cypress Traveo 2 CYT2BLx HSM - 4 sectors, 32kB useable
        FEE_RB_CYP_CYT2BLX_6S_16K_HSM  # Cypress Traveo 2 INV CYT2BLx HSM - 6 sectors, 96kB useable
        FEE_RB_CYP_CYT2BLX_4S_8K  # Cypress Traveo 2 INV CYT2BLx - 4 sectors, 32kB useable
        FEE_RB_CYP_CYT3BBX_12S_16K  # Cypress Traveo 2 CYT3BBx - 12 sectors, 192kB useable
        FEE_RB_CYP_CYT3BBX_8S_8K_HSM  # Cypress Traveo 2 CYT3BBx HSM- 8 sectors, 64kB useable
        FEE_RB_CYP_CYT3BBX_12S_16K_HSM  # Cypress Traveo 2 INV CYT3BBx HSM - 12 sectors, 192kB useable
        FEE_RB_CYP_CYT3BBX_8S_8K  # Cypress Traveo 2 INV CYT3BBx - 8 sectors, 64kB useable
        FEE_RB_EXT_CYP_S25FS256_INT_REN_RCAR  # External QSPI Flash - Cypress S25FS256 (32MB) + Renesas R-Car
        FEE_RB_EXT_CYP_S25FS512_INT_REN_RCAR  # External QSPI Flash - Cypress S25FS512 (64MB) + Renesas R-Car
        FEE_RB_EXT_CYP_S70FS01GS_INT_REN_RCAR  # External QSPI Flash - Cypress S70FS01GS (128MB) + Renesas R-Car
        FEE_RB_EXT_CYP_S70FS01GS_INT_REN_RCAR_HSM  # External QSPI Flash - Cypress S70FS01GS (128MB) + Renesas R-Car HSM
        FEE_RB_EXT_CYP_S25HS01GT_INT_REN_RCAR  # External QSPI Flash - Cypress S25HS01GT (128MB) + Renesas R-Car
        FEE_RB_EXT_CYP_S25HS01GT_INT_REN_RCAR_HSM  # External QSPI Flash - Cypress S25HS01GT (128MB) + Renesas R-Car HSM
        FEE_RB_EXT_WIN_W25Q128JV_INT_XIL_ZYNQ  # External QSPI Flash - Winbond W25Q128JV (16MB) + Xilinx Zynq
        FEE_RB_EXT_WIN_W25Q256JV_INT_XIL_ZYNQ  # External QSPI Flash - Winbond W25Q256JV (32MB) + Xilinx Zynq
        FEE_RB_EXT_CYP_S70FS01GS_INT_XIL_ZYNQ  # External QSPI Flash - Cypress S70FS01GS (128MB) + Xilinx Zynq
        FEE_RB_EXT_CYP_S25FS512S_INT_XIL_ZYNQ  # External QSPI Flash - Cypress S25FS512 (64MB) + Xilinx Zynq
        FEE_RB_EXT_MIC_MT25QU01G_INT_XIL_ZYNQ  # External QSPI Flash - Micron MT25QU01G (128MB) + Xilinx Zynq
        FEE_RB_EXT_MIC_MT25QU02G_INT_XIL_ZYNQ  # External QSPI Flash - Micron MT25QU02G (256MB) + Xilinx Zynq
        FEE_RB_EXT_MAC_MX66U1G_INT_XIL_ZYNQ  # External QSPI Flash - Macronix MX66U1G (128MB) + Xilinx Zynq
        FEE_RB_EXT_MAC_MX66U2G_INT_XIL_ZYNQ  # External QSPI Flash - Macronix MX66U2G (256MB) + Xilinx Zynq
        FEE_RB_EXT_MIC_MT35XU512_INT_NXP_S32  # External QSPI Flash - Micron MT35XU512 (64MB) + NXP S32
        FEE_RB_EXT_MIC_MT35XU02G_INT_TI_JACINTO  # External OSPI Flash - Micron MT35XU02G (256MB) + TI JACINTO
        FEE_RB_REN_RH850U2A16_4S_60KB  # Renesas RH850U2A16 - 4 sectors, 240kB useable
        FEE_RB_REN_RH850U2A16_4S_16KB_HSM  # Renesas RH850U2A16 HSM - 4 sectors, 64kB useable
        FEE_RB_REN_RH850U2A8_4S_60KB  # Renesas RH850U2A8 - 4 sectors, 240kB useable
        FEE_RB_REN_RH850U2A8_4S_16KB_HSM  # Renesas RH850U2A8 HSM - 4 sectors, 64kB useable
        FEE_RB_REN_RH850U2A6_4S_44KB  # Renesas RH850U2A6 - 4 sectors, 176kB useable
        FEE_RB_REN_RH850U2A6_4S_16KB_HSM  # Renesas RH850U2A6 HSM - 4 sectors, 64kB useable
        FEE_RB_REN_RH850U2B2X_4S_120KB  # Renesas RH850U2B2X - 4 sectors, 480kB useable (for U2B24, U2B20)
        FEE_RB_REN_RH850U2B24_4S_40KB_HSM  # Renesas RH850U2B24 HSM - 4 sectors, 160kB useable
        FEE_RB_REN_RH850U2B20_4S_24KB_HSM  # Renesas RH850U2B20 HSM - 4 sectors, 96kB useable
        FEE_RB_REN_RH850U2B10_4S_32KB  # Renesas RH850U2B10 - 4 sectors, 128kB useable
        FEE_RB_REN_RH850U2B10_4S_16KB_HSM  # Renesas RH850U2B10 HSM - 4 sectors, 64kB useable
        FEE_RB_REN_RH850U2B6_6S_16KB  # Renesas RH850U2B6 - 6 sectors, 96kB useable
        FEE_RB_REN_RH850U2B6_4S_16KB_HSM  # Renesas RH850U2B6 HSM - 4 sectors, 64kB useable
        FEE_RB_REN_RH850E2GUH_4S_60KB  # Renesas RH850E2GUH - 4 sectors, 240kB useable
        FEE_RB_REN_RH850E2GUH_4S_16KB_HSM  # Renesas RH850E2GUH HSM - 4 sectors, 64kB useable
        FEE_RB_REN_RH850E2M_6S_24KB  # Renesas RH850E2M - 6 sectors, 144kB useable
        FEE_RB_REN_RH850E2M_4S_8KB_HSM  # Renesas RH850E2M HSM- 4 sectors, 32kB useable
        FEE_RB_REN_RH850P1LC_D1_4S_7_75KB  # Renesas RH850P1L-C (32kB DFLASH) / CC Cube Dev1 - 4 sectors, 31kB useable
        FEE_RB_REN_RH850P1LC_D2_4S_15_75KB  # Renesas RH850P1L-C (64kB DFLASH) / CC Cube Dev2 - 4 sectors, 63kB useable
        FEE_RB_REN_RH850P1M_4S_8KB  # Renesas RH850P1M - 4 sectors, 64kB useable
        FEE_RB_REN_RH850P1XC_D3_4S_15_75KB  # Renesas RH850P1X-C (64kB DFLASH) / CC Cube Dev3 - 4 sectors, 63kB useable
        FEE_RB_REN_RH850P1XC_D3_6S_10_5KB  # Renesas RH850P1X-C (64kB DFLASH) / CC Cube Dev3 - 6 sectors, 63kB useable
        FEE_RB_REN_RH850P1XC_D3_4S_14_75KB  # Renesas RH850P1X-C (64kB DFLASH) / CC Cube Dev3 - 4 sectors, 59kB useable
        FEE_RB_REN_RH850P1XC_D3_6S_9_8125KB  # Renesas RH850P1X-C (64kB DFLASH) / CC Cube Dev3 - 6 sectors, 59kB useable
        FEE_RB_REN_RH850P1XC_D3_4S_9_75KB  # Renesas RH850P1X-C (64kB DFLASH) / CC Cube Dev3 - 4 sectors, 39kB useable
        FEE_RB_REN_RH850P1XC_D3_2S_15_5KB_HSM  # Renesas RH850P1X-C HSM (32kB DFLASH) / CC Cube Dev3 HSM - 2 sectors, 31kB useable
        FEE_RB_REN_RH850P1XC_D4_4S_31_75KB  # Renesas RH850P1X-C (128kB DFLASH) / CC Cube Dev4 - 4 sectors, 127kB useable
        FEE_RB_REN_RH850P1XC_D4_4S_30_75KB  # Renesas RH850P1X-C (128kB DFLASH) / CC Cube Dev4 - 4 sectors, 123kB useable
        FEE_RB_REN_RH850P1XC_D4_2S_15_5KB_HSM  # Renesas RH850P1X-C HSM (32kB DFLASH) / CC Cube Dev4 HSM - 2 sectors, 31kB useable
        FEE_RB_REN_RH850P1XC_D5_8S_23_875KB  # Renesas RH850P1X-C (192kB DFLASH) / CC Cube Dev5 - 8 sectors, 191kB useable
        FEE_RB_REN_RH850P1XC_D5_8S_23_375KB  # Renesas RH850P1X-C (192kB DFLASH) / CC Cube Dev5 - 8 sectors, 187kB useable
        FEE_RB_REN_RH850P1XC_D5_2S_15_5KB_HSM  # Renesas RH850P1X-C HSM (32kB DFLASH) / CC Cube Dev5 HSM - 2 sectors, 31kB useable
        FEE_RB_EXT_MAC_MX25L32_INT_REN_RH850P1XC  # External QSPI Flash - Macronix MX25L32(4MB) + Renesas RH850P1X-C
        FEE_RB_PC_6S_64KB  # PC-based simulation environment - 6 sectors, 384kB useable
        FEE_RB_PC_6S_64KB_16BP  # PC-based simulation environment - 6 sectors, 384kB useable, 16B pagesize
        FEE_RB_PC_2S_64KB  # PC-based simulation environment - 2 sectors, 128kB useable
        FEE_RB_PC_4S_24KB  # PC-based simulation environment - 4 sectors, 96kB useable
        FEE_RB_PC_4S_64KB  # PC-based simulation environment - 4 sectors, 256kB useable
        FEE_RB_PC_4S_256KB  # PC-based simulation environment - 4 sectors, 1MB useable
        FEE_RB_PC_6S_128KB  # PC-based simulation environment - 6 sectors, 768kB useable
        FEE_RB_PC_8S_8KB  # PC-based simulation environment - 8 sectors, 64kB useable
        FEE_RB_PC_8S_16KB  # PC-based simulation environment - 8 sectors, 128kB useable
        FEE_RB_PC_8S_32KB  # PC-based simulation environment - 8 sectors, 256kB useable
        FEE_RB_PC_8S_64KB  # PC-based simulation environment - 8 sectors, 512kB useable
        FEE_RB_FULL_MANUAL_CFG  # Full manual configuration for first prototyping
      enumeration FeeRbMainFunctionScheduling [0..1]: multiplicity set at pre-compile, origin=RB:18.1.0:2021-08-30, set at pre-compile, default-value=FEE_RB_MAINFUNC_SCHEDULING_RTE_TIMED  # MainFunction Scheduling Type | Selection on type of scheduling required for the Fee_MainFunction
        FEE_RB_MAINFUNC_SCHEDULING_RTE_BACKGROUND  # RTE Background task
        FEE_RB_MAINFUNC_SCHEDULING_RTE_TIMED  # RTE Timed task
        FEE_RB_MAINFUNC_SCHEDULING_MANUAL  # Manual Scheduling
      boolean FeeRbMaintainRedundantBlocks [0..1]: multiplicity set at pre-compile, origin=RB:7.0.0:2015-11-13, set at pre-compile, default-value=false  # API activation for Fee_Rb_BlockMaintenance(). | Pre-processor config parameter to enable/disable the API to maintain the redundant blocks. Hint: If NvM is used this switch must be set to "TRUE"! | true: Maintain API enabled. false: Maintain API disabled.
      integer FeeRbNrBytesBtwSSRAndHSR [0..1]: 0.., multiplicity set at pre-compile, origin=RB:22.0.0:2023-04-27, set at pre-compile  # Number of bytes between Soft Reorganisation and Hard Reorganisation Threshold | Pre-processor config parameter to determine the gap between Soft Sector Reorganisation and Hard Sector Reorganisation threshold. | Note: 1. When the parameter is not configured, soft reorganisation threshold are calculated internally as a factor of hard reorganisation threshold. Ex. SSR = 1.5 * HSR, when no unknown block handling is needed or SSR = 1.2 * 1.5 * HSR, when unknown block handling is activated. 2. Two sector emulation has no softreorganisation. so this tag is ignored for such dflash layout. 3. A higher SSR threshold value would mean lesser layout size that project can configure and earlier reorganization. A lower SSR value would mean higher chances of getting into hard reorganization. So please check the impact of the threshold change. 4. If unknown blocks are to be handled (when config parameter FeeRbActSurvivalEval or FeeRbActUnknownBlockReorg is set to true). Consider the additional space needed for the unknown blocks.
      integer FeeRbNrOfUnknownBlockCacheEntries [0..1]: 1..65534, multiplicity set at pre-compile, origin=RB:19.0.0:2021-12-14, set at pre-compile, default-value=300  # Cache size for "global afterburner" and "partial afterburner" feature (FeeFs2). | Pre-processor config parameter to determine the size of the cache used for the reorganization of unknown blocks which are stored in the flash eeprom emulation area. By scanning the flash content and building up the cache with the location information of the identified unknown blocks, the reorganizations of these blocks will essentially speed up. With this configuration parameter the project can configure the number of unknown blocks which can be managed within one cache build iteration. To reach the best performance set this value to the number of unknown blocks defined in your project + 1. This means that all blocks can be covered without intermediate cache build ups. This parameter has to be used either in Boot mode with global afterburner feature activated (FeeRbActUnknownBlockReorg = TRUE) or in application software when using partial afterburner (survival) feature (FeeRbActSurvivalEval = TRUE). Currently only FeeFs2 supports this parameter. For FeeFs1 and FeeFs1x please use parameter FeeRbActUnknownBlockReorgCacheSize. | Hints: 1. Default value when global afterburner feature is activated is 300 blocks. 2. When survival feature is activated exclusively the configuration of this parameter is mandatory, the default value will not be taken. 3. For best performance project must allocate space for all available unknown blocks + 1 (one more then actual number of unknown blocks). 4. The size of one cache entry for FeeFs2 is 4 bytes. This means if 250 is configured the unknown block cache will consume 250*4=1000 bytes. 5. The unknown block handling will also work when the cache size is smaller then the actual number of unknown blocks in the dflash. But it will slow down which each additional cache buildup iteration.
      integer FeeRbPageBufferSize [0..1]: 256.., multiplicity set at pre-compile, origin=RB:7.1.0:2016-04-09, set at pre-compile, default-value=1024  # Size of internal page buffer. | Size of buffer for communication between flash driver and Fee.If there is no configuration value for this parameter, the default (1024) will be automatically used. | The value has to be a multiple of virtual page size for writing into flash and a multiple of cache line size for reading from an external flash.
      boolean FeeRbReadForce [0..0]: multiplicity set at pre-compile, origin=RB:7.0.0:2015-11-13, set at pre-compile  # Forced read setting. | Feature was removed and is not supported anymore. Use FeeUpdateModel.java file to update configuration.
      boolean FeeRbRestrictDirectMemoryAccess [0..1]: multiplicity set at pre-compile, origin=RB:20.1.0:2022-08-15, set at pre-compile, default-value=false  # Config parameter is used to enable/disable direct memory access | true = direct memory access not allowed, always use flash driver. false = direct memory access allowed, provided the Fee and the hardware supports it
      string FeeRbSchedTriggerFeeRbEndInit [0..1]: multiplicity set at pre-compile, origin=RB:7.0.0:2015-11-13, set at pre-compile, default-value=empty  # ETO for Fee_Rb_EndInit | In case the function Fee_Rb_EndInit shall be scheduled using AUTOSAR the function Fee_Rb_EndInit will be generated as External Trigger Occured function. The name the external trigger can be configured here. If left empty then Fee_Rb_EndInit will not be mentioned in BSWMD. In this case manual scheduling of Fee_Rb_EndInit has to be done. This feature is supported only in case of exactly one Fee instance (no multi instance) which must not be configured for FS1 in FeeRbFsSelect. | 1. Create extern trigger outside of the Mem stack. 2. Select trigger name here
      integer FeeRbSecondPageBufferSize [0..1]: 0.., multiplicity set at pre-compile, origin=RB:7.1.0:2021-06-29, set at pre-compile, default-value=1024  # Size of second internal page buffer. | Size of second buffer for communication between flash driver and Fee to reduce the duration of a reorg in FeeFs2, or of a defragmentation in FeeFs3. This parameter does not apply to other file systems. If no value is set in FeeFs2, the second buffer is enabled and generated with its default size 1024. In FeeFs3, the second buffer is only beneficial in systems, where Fee_MainFunction is not scheduled in background, but in a slower cyclic process. Therefore, it is disabled by default - independent of the default value. I.e. if no value is set in FeeFs3, only one buffer is used. If the value 0 is set, only one buffer is used for either file system. | In FeeFs2, the value has to be a multiple of the virtual page size for writing into flash, and a multiple of the cache line size for reading from an external flash. In FeeFs3, the value has to be equal to the logical row size.
      boolean FeeRbSetAndGetJobModeApi [0..1]: multiplicity set at pre-compile, origin=RB:7.1.0:2021-07-16, set at pre-compile, default-value=false  # Activation of set and get job mode APIs | Pre-processor config parameter to enable/disable the APIs to set and get the job modes. | true: Job mode set and get APIs are enabled. false: Both the job mode and set APIs are disabled.
      boolean FeeRbStressMeasmt [0..1]: multiplicity set at pre-compile, origin=RB:22.0.0:2023-05-24, set at pre-compile, default-value=false  # Activation of stress measurement and driving cycle prediction | Pre-processor config parameter to enable/disable stress measurement and driving cycle prediction. | true: Stress measurement and driving cycle prediction are enabled. false: Stress measurement and driving cycle prediction are both disabled.
      function name FeeRbSyncFlsMainLoopHook [0..1]: multiplicity set at pre-compile, origin=RB:7.0.0:2015-11-13, set at pre-compile, default-value=(void)0  # Hook into synchronous Fls_MainFunction loop | A hook function can be configured, which will be called in the synchronous Fls_MainFunction loop used for all flash access operations during Fee initialization. This can be useful especially for projects, where the flash is accessed concurrently by different cores at initialization time. HW limitations due to shared logic can block one user until the job of the other user finishes. This impacts the runtime of the loop and consequently extends the runtime of the entire Fee initialization. No other task can be scheduled in between, which may cause a Watchdog reset or impacts the system behaviour in a different way. The user can use the hook function to take all necessary actions to keep the system stable. | 1. Integrate the function into your build environment. 2. Write the function name of your hook function to the configuration parameter. 3. Build the software 4. Run the software, the hook function will be called once per loop cycle
      boolean FeeRbTriggerReorgApi [0..1]: multiplicity set at pre-compile, origin=RB:7.0.0:2015-11-13, set at pre-compile, default-value=false  # API activation for Fee_Rb_TriggerReorg(), Fee_Rb_TriggerReorgFat(), Fee_Rb_TriggerReorgDat() | Pre-processor config parameter to enable/disable the "Forced reorganisation followed by a sector erase" functionality for FeeFs1x. For FeeFs2 the "Forced reorganization of the FAT and DAT sector" functionality is enabled. Succeeding sector erase of the reorganized sector is not part of the FAT, DAT sector reorganization. | true: Forced reorganisation feature enabled (one force reorg per call). false: Forced reorganisation feature disabled.
      boolean FeeRbUseRelativeAddressing [0..1]: multiplicity set at pre-compile, origin=RB:20.1.0:2022-08-15, set at pre-compile, default-value=false  # Activation of the relative Addressing Mode | This mode is used for AR compatibility check of the Fee. It is only working if all users of one API interface have the relative mode activated | True: The relative addressing is used False: Absolute Addressing is used
      boolean FeeSetModeSupported: multiplicity set at pre-compile, set at pre-compile  # API activation for Fee_SetMode(). | Pre-processor config parameter to enable/disable the "SetMode" functionality of the FEE module. | true: SetMode functionality enabled / code present. false: SetMode functionality disabled / code not present. Note: This configuration setting has to be consistent with that of all underlying flash device drivers (configuration parameter FlsSetModeApi).
      boolean FeeVersionInfoApi: multiplicity set at pre-compile, set at pre-compile  # API activation for Fee_GetVersionInfo(). | Pre-processor config parameter to enable/disable the API to read out the modules version information. | true: Version info API enabled. false: Version info API disabled.
      integer FeeVirtualPageSize: 0..65535, multiplicity set at pre-compile, set at pre-compile  # Virtual page size setting. | The size in bytes to which logical blocks shall be aligned. The correct value is automatically taken internally from Fee. Hint: If 0 is configured, the Fee will search for the largest configured (HW) page size within the complete sector configuration and define it as the virtual page size automatically.
      container FeeRbHighSpeedModeWriteDetails [0..1]: multiplicity set at pre-compile  # Details of number of bytes to be reserved during high speed mode operation | Pre-processor config parameters to to configure number of bytes to be reserved during high speed mode exeuction (ex. during crash). The soft and hard reorganisation thresholds are shifted based on the configured values below. Using this feature could reduce the total layout size that can be used (because now a bigger area is reserved to store the data during crash). One option to overcome this limitation is to reconfigure the sector size (using config parameter FeeRbDeviceFsXSectorList) and shift to smaller but more number of loglcal sectors. This feature is currently supported for Fee1x only. This sub-container will be ignored when configured for other file system. | If these config parameters are not configured but high speed mode is used, then, there is a risk that crash data will be written in last logical sector, which could be lost in case memory gets full.
        integer FeeRbNrBytesInHighSpeedMode: multiplicity set at pre-compile, origin=RB:22.0.0:2023-04-27, set at pre-compile  # Total number of bytes to be stored during high speed mode | Total number of bytes calculated over all write request that will be written during high speed mode operation. This size shall also include the additional bytes needed per block for redundant blocks (FeeRbSecLevel = 2 or NvMBlockManagementType = NVM_BLOCK_REDUNDANT) and round off of the data to logical page size.
        integer FeeRbNrWritesInHighSpeedMode: 0..65535, multiplicity set at pre-compile, origin=RB:22.0.0:2023-04-27, set at pre-compile  # Total number of writes during high speed mode | Total number of write request during high speed mode operation
    container FeePublishedInformation [0..1]: multiplicity set at pre-compile  # FeePublishedInformation. | Additional published parameters not covered by CommonPublishedInformation container. | Note that these parameters do not have any configuration class setting, since they are published information.
      integer FeeBlockOverhead [0..0]: 0..65535, multiplicity set at pre-compile, set at published-information  # Block overhead. | Management overhead per logical block in bytes (block header size). | Note: If the management overhead depends on the block size or block location a formula has to be provided that allows the configurator to calculate the management overhead correctly. This tag is currently ignored.
      integer FeePageOverhead [0..0]: 0..65535, multiplicity set at pre-compile, set at published-information  # Page overhead. | Management overhead per page in bytes. | Note: If the management overhead depends on the block size or block location a formula has to be provided that allows the configurator to calculate the management overhead correctly. This tag is currently ignored.
    container FeeRbDebug [0..1]: multiplicity set at pre-compile  # Fee Debugging | Container for debugging switches.
      boolean FeeRbDebugBlock [0..1]: multiplicity set at pre-compile, set at pre-compile, default-value=false  # Own debugging block to keep debugging information over resets. | Enables a Fee block owned by the Fee itself. This block holds the information about timing measurements and erase counters over resets. | true: Fee debug block enabled. false: Fee debug block disabled.
      boolean FeeRbDebugDump [0..1]: multiplicity set at pre-compile, set at pre-compile, default-value=false  # Dump the DFLASH on unexpected errors. | Whenever internally an unexpected error happens the DFLASH is dumped to a text file. This feature makes only sense when the Fee is running in a simulation on the PC. | true: Dump on unexpected error enabled false: Dump on unexpected error disabled.
      boolean FeeRbDebugTime [0..1]: multiplicity set at pre-compile, set at pre-compile, default-value=false  # Enable timing measurements. | Pre-processor config parameter to enable and disable timing measurements. | true: Timing measurements enabled. false: Timing measurements disabled. In case timing measurement is enabled the following operations are measured: Main Function duration ( Init, Read, Write, Invalidate, Data sector change, FAT sector change)
      integer FeeRbDebugTimeHistogramSize [0..1]: 1..50, multiplicity set at pre-compile, origin=RB:7.0.0:2015-11-13, set at pre-compile, symbolic-name-value=true, default-value=1  # Size of the timing measurement histogram. | Number of slots in the histogram for timing measurement. | When time measurement is enabled a histogram for timing measurement will be maintained for all measured operations. The unit in this histogram is microseconds and it is log(2) scaled where the first basket has an offset of 0. The bigger this histogram is, the bigger are the maximum values it can hold. On the other hand more RAM is consumed and the debug block (in case it is enabled) will also grow bigger to store the histogram. Every slot consumes 4 bytes (uint32). When timing measurement is turned off then this value has no effect.
      boolean FeeRbGrayBoxTest [0..1]: multiplicity set at pre-compile, origin=RB:7.0.0:2015-11-13, set at pre-compile, default-value=false  # Enable gray box test | Pre-processor config parameter to enable/disable gray box test. | TRUE : Gray box test is active FALSE : Gray box test is not active
    container FeeRbDevice [0..1]: multiplicity set at pre-compile  # Fee Device | Container for manual Fee device. Partital configuration (Fs1x/Fs2 only): Use existing Fee machine type and use following parameters to overwrite sectorization ( FeeRbDeviceFsXSectorSize, FeeRbDeviceFsXSectorStrtAddr, FeeRbDeviceFsXPageSize, FeeRbDeviceFsXPhySectorSize, FeeRbDeviceFs1xSoftSectorReorgThd (optional, Fs1x only), FeeRbDeviceFs2SoftSectorReorgThd (optional, Fs2 only)) - Full manual config: Use machine type FEE_RB_FULL_MANUAL_CFG and configure all relevant parameters for the used filesystem. Use for prototyping only!
      boolean FeeRbDeviceFs1xDirectMemAccess [0..1]: multiplicity set at pre-compile, origin=RB:13.1.0:2019-04-30, set at pre-compile  # Fs1x: Direct memory access (only valid in case of machine type set to full manual configuration) | Device allows direct memory access to DFLASH. This setting needs to be set according to used device. | Configure for Fs1x full manual config only.
      boolean FeeRbDeviceFs1xHdrRecheck [0..1]: multiplicity set at pre-compile, origin=RB:13.1.0:2019-04-30, set at pre-compile  # Fs1x: Header Recheck (only valid in case of machine type set to full manual configuration) | Device requires blank check to verify if the page is programmed or erased. This setting needs to be set according to used device. | Configure for Fs1x full manual config only.
      boolean FeeRbDeviceFs1xNoFallbackSuprtd [0..1]: multiplicity set at pre-compile, origin=RB:13.1.0:2019-04-30, set at pre-compile  # Fs1x: No-Fallback possible (only valid in case of machine type set to full manual configuration) | Device allows the use of the no-fallback feature. This setting needs to be set according to used device. | Configure for Fs1x full manual config only.
      integer FeeRbDeviceFs2MaxEraseDisturbs [0..1]: multiplicity set at pre-compile, origin=RB:13.1.0:2019-04-30, set at pre-compile  # Fs2: Max erase disturbs (only valid in case of machine type set to full manual configuration) | This parameter configures the maximum erase distance between the flash sectors. | All sectors must be used round-robin in order to prevent the accumulation of erase disturbs in static sectors. This information may be provided in the flash device sheet. Configure for Fs2 full manual config only.
      integer FeeRbDeviceFs2MaxWordlineDfcts [0..1]: multiplicity set at pre-compile, origin=RB:13.1.0:2019-04-30, set at pre-compile  # Fs2: Max wordline defects (only valid in case of machine type set to full manual configuration) | This parameter configures the maximum wordline defects to be handled. | Configure for Fs2 full manual config only.
      integer FeeRbDeviceFs2SftySpa [0..1]: multiplicity set at pre-compile, origin=RB:13.1.0:2019-04-30, set at pre-compile  # Fs2: Safety space (only valid in case of machine type set to full manual configuration) | This parameter configures the number of bytes to be considered as safety space when starting a data sector reorganization. | Configure for Fs2 full manual config only.
      integer FeeRbDeviceFs2SoftSectorReorgThd [0..1]: multiplicity set at pre-compile, origin=RB:13.1.0:2019-04-30, set at pre-compile  # Fs2: Soft sector reorganization threshold | This parameter configures the soft sector reorganization threshold. | When the threshold is reached, soft sector reorganization will be issued. Hints: The threshold shall not be greater than the available effective flash memory space for data minus the size of the data layout. The threshold shall not be lower than the effective size of one logical sector. Configure for Fs2 full manual and partitial config.
      integer FeeRbDeviceFs2WordlineSize [0..1]: multiplicity set at pre-compile, origin=RB:21.1.0:2023-03-07, set at pre-compile  # Fs2: Wordline size (only valid in case of machine type set to full manual configuration) | This parameter configures the wordline size of Dflash in bytes. Specify the wordline size given in device datasheet in bytes. When wordline handling / robust programming is not needed (e.g. on non-Infineon devices), the feature can be disabled by setting 0 (default behavior) | This activates wordline handling / robust programming of wordlines commonly used on Infineon TC2xx/TC3xx devices. Wordline failures, which can occur during high voltage conditions present during programming or erase operations, may result in a complete wordline which can no longer be programmed or erased and the data within the failed wordline may not be able to be read correctly e.g. already written data in the wordline will be lost. Therefore when enabled (Size > 0) before programming into a wordline, the complete wordline will be backed up and restored in case of wordline failure.
      integer FeeRbDeviceFs3PhyRowSize [0..1]: multiplicity set at pre-compile, origin=RB:13.1.0:2019-04-30, set at pre-compile  # Fs3: Physical row size (only valid in case of machine type set to full manual configuration) | This parameter configures the physical row size of device. | This value must be derived from uC flash layout given in the flash device datasheet. Configure for Fs3 full manual config only.
      integer FeeRbDeviceFs3RowThdRot [0..1]: multiplicity set at pre-compile, origin=RB:13.1.0:2019-04-30, set at pre-compile  # Fs3: Row threshold rotation (only valid in case of machine type set to full manual configuration) | This parameter configures the row threshold rotation. Additonal moves of rows will be performed when configured threshold is exceeded. | This value must be derived from uC flash layout given in the flash device datasheet. Configure for Fs3 full manual config only.
      integer FeeRbDeviceFsXEraseCycles [0..1]: multiplicity set at pre-compile, origin=RB:13.1.0:2019-04-30, set at pre-compile  # Max number of erase cycles (only valid in case of machine type set to full manual configuration) | The maximum number of program/erase cycles of each flash cell. | This number is provided in the flash device sheet.
      string FeeRbDeviceFsXFlsDeviceType [0..1]: multiplicity set at pre-compile, origin=RB:13.1.0:2019-04-30, set at pre-compile  # Fls device type (only valid in case of machine type set to full manual configuration) | This parameter configures the device type to be used by flash driver Fls. | Each flash device is separated into sub device types which have a dedicated address range and a page width for programming (smallest programmable unit). Please refer to flash driver documentation.
      string FeeRbDeviceFsXFlsMachineType [0..1]: multiplicity set at pre-compile, origin=RB:13.1.0:2019-04-30, set at pre-compile  # Fls machine type (only valid in case of machine type set to full manual configuration) | This parameter configures the machine type to be used by flash driver Fls. | Controller type to be configured. Please refer to flash driver documentation.
      boolean FeeRbDeviceFsXIsBigEndian [0..1]: multiplicity set at pre-compile, origin=RB:19.0.0:2021-11-15, set at pre-compile  # Device endianness (only valid in case of machine type set to full manual configuration) | This parameter configures the endianness for the used device. | Endianness is provided in the device datasheet. Currently only used for FeeFs3.
      boolean FeeRbDeviceFsXIsDifferential [0..1]: multiplicity set at pre-compile, origin=RB:18.0.0:2021-05-25, set at pre-compile  # Technology of the flash is differential (only valid in case of machine type set to full manual configuration) | This parameter configures the flash technology for the used device. | true: Flash hardware technology is differential. false: Flash hardware technology is single ended. Currently only used for FeeFs2.
      boolean FeeRbDeviceFsXIsOverprogmForInvldOk [0..1]: multiplicity set at pre-compile, origin=RB:18.0.0:2021-05-25, set at pre-compile  # Overprogramming for invalidation allowed (only valid in case of machine type set to full manual configuration) | This parameter configures if the pages of the flash can be overprogrammed for invalidation purpose. | true: Overprogramming of flash pages can be done to invalidate the content. false: Overprogramming of flash pages is not allowed. Currently only used for FeeFs2.
      integer FeeRbDeviceFsXPageSize [0..1]: multiplicity set at pre-compile, origin=RB:13.1.0:2019-04-30, set at pre-compile  # Page size (only valid in case of machine type set to full manual configuration or partital configuration) | This parameter configures the minimum number of bytes to be written within one write operation. | This is considered as the logical page size which shall be configured as multiples of the physical page size.
      integer FeeRbDeviceFsXPatErased [0..1]: multiplicity set at pre-compile, origin=RB:13.1.0:2019-04-30, set at pre-compile  # Erase pattern (only valid in case of machine type set to full manual configuration) | This parameter configures the pattern for an erased byte in the flash. | Erase pattern is provided in the flash device sheet.
      integer FeeRbDeviceFsXPhySectorSize [0..1]: multiplicity set at pre-compile, origin=RB:13.1.0:2019-04-30, set at pre-compile  # Physical sector size (only valid in case of machine type set to full manual configuration or partital configuration) | This parameter configures the physical sector size of one sector in the flash. | Physical sector size is provided in the flash device sheet. Currently only used for FeeFs1x and FeeFs2 partital configuration.
      integer FeeRbDeviceFsXSectorSize [0..1]: multiplicity set at pre-compile, origin=RB:13.1.0:2019-04-30, set at pre-compile  # Logical sector size (only valid in case of machine type set to full manual configuration or partital configuration) | This parameter configures the logical sector size of one sector in the flash. | Must be configured as multiples of the physical sector size. Physical sector size is provided in the flash device sheet.
      container FeeRbDeviceFsXSectorList [0..1]: multiplicity set at pre-compile  # Sector list | List of logical Fee sectors. | Configure for full manual and partitial config.
        container FeeRbDeviceFsXSectorDesc [0..32]: multiplicity set at pre-compile  # Sector descriptor | Sector descriptor. | Configure for full manual and partitial config.
          integer FeeRbDeviceFsXSectorStrtAddr [0..1]: multiplicity set at pre-compile, origin=RB:13.1.0:2019-04-30, set at pre-compile  # Sector start address (only valid in case of machine type set to full manual configuration or partital configuration) | This parameter configures the start address of each logical sector. | Configure for full manual and partitial config.
