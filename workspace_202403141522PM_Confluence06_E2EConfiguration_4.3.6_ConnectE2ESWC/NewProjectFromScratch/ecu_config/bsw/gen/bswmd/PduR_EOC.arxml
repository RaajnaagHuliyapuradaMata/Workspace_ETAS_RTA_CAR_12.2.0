AUTOSAR XML (schema 4-2-2)
package /AUTOSAR_PduR/TimingExtensions
  bsw module timing PduR_BswModuleTiming: behavior=BswInternalBehavior
    timing-requirements:
      execution order constraint EOC_EcuM_Init: execution-order-constraint-type=ORDINARY-EOC, is-event=false, permit-multiple-references-to-ee=false
        ordered-elements:
          eoc executable entity ref EOCEERef_CE_PduR_Init: bsw-module-instance=PduR, executable=CE_Init
