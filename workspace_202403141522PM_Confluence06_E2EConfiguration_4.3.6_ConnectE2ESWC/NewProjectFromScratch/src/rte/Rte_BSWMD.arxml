AUTOSAR XML (schema 00051)
standard types defined: uint8, boolean
package /AUTOSAR_Rte/BswModuleDescriptions
  bsw module description Rte: outgoing-callbacks=[Rte_StartHook_Return, Rte_StartHook_Start, Rte_StopHook_Return, Rte_StopHook_Start, Rte_Task_Activate]
    provided-entrys:
      Rte_ActivateRE
      Rte_Call_CPT_MyReceivingSWC_ApplicationEcu_R_NvMService_0_EraseBlock
      Rte_Call_CPT_MyReceivingSWC_ApplicationEcu_R_NvMService_0_GetDataIndex
      Rte_Call_CPT_MyReceivingSWC_ApplicationEcu_R_NvMService_0_GetErrorStatus
      Rte_Call_CPT_MyReceivingSWC_ApplicationEcu_R_NvMService_0_InvalidateNvBlock
      Rte_Call_CPT_MyReceivingSWC_ApplicationEcu_R_NvMService_0_ReadBlock
      Rte_Call_CPT_MyReceivingSWC_ApplicationEcu_R_NvMService_0_ReadPRAMBlock
      Rte_Call_CPT_MyReceivingSWC_ApplicationEcu_R_NvMService_0_RestoreBlockDefaults
      Rte_Call_CPT_MyReceivingSWC_ApplicationEcu_R_NvMService_0_RestorePRAMBlockDefaults
      Rte_Call_CPT_MyReceivingSWC_ApplicationEcu_R_NvMService_0_SetDataIndex
      Rte_Call_CPT_MyReceivingSWC_ApplicationEcu_R_NvMService_0_SetRamBlockStatus
      Rte_Call_CPT_MyReceivingSWC_ApplicationEcu_R_NvMService_0_WriteBlock
      Rte_Call_CPT_MyReceivingSWC_ApplicationEcu_R_NvMService_0_WritePRAMBlock
      Rte_DecrementWaitingCount
      Rte_GetCurrentTaskIndex
      Rte_MainFunction
      Rte_Mode_BswM_RP_BswM_MRP_SwcModeRequest_MDGP_MSI_ShutDown
      Rte_ReadQueue
      Rte_SetEvent
      Rte_Start
      Rte_Stop
      Rte_WaitWithTimeout
      Rte_WriteQueue
      Rte_WriteQueue_GetProtection
      Rte_WriteQueue_ReleaseProtection
      Rte_Write_CPT_MyTransmittingSWC_ApplicationEcu_PPortPrototype_0_DE_MyDataElement
      Rte_memcpy
      SchM_Deinit
      SchM_IModeInit
      SchM_Init
      SchM_Mode_BswM_MDGR_BswM_MRP_BswM_MDG
    bsw module dependency AUTOSAR_Os: target-module-id=1
    bsw module dependency AUTOSAR_Com: target-module-id=50
    bsw internal behavior RteInternalBehavior
      constant-memorys:
        15 x parameter data prototype:
          Rte_Inst_BswM: type=Rte_CDS_BswM
          Rte_Inst_ComM: type=Rte_CDS_ComM
          Rte_Inst_EcuM: type=Rte_CDS_EcuM
          Rte_Inst_NvM: type=Rte_CDS_NvM
          Rte_Inst_rba_DiagLib: type=Rte_CDS_rba_DiagLib
          Rte_Instance_CPT_MyReceivingSWC_ApplicationEcu: type=Rte_CDS_MyReceivingSWC
          Rte_Instance_CPT_MyTransmittingSWC_ApplicationEcu: type=Rte_CDS_MyTransmittingSWC
          Rte_Self_CPT_ComM: type=Rte_SelfType_ComM
          Rte_Self_CPT_MyReceivingSWC_ApplicationEcu: type=Rte_SelfType_MyReceivingSWC
          Rte_Self_CPT_MyTransmittingSWC_ApplicationEcu: type=Rte_SelfType_MyTransmittingSWC
          Rte_Self_SWCI3: type=Rte_SelfType_rba_DiagLib
          Rte_Self_SWCI4: type=Rte_SelfType_BswM
          Rte_Self_SWCI5: type=Rte_SelfType_EcuM
          Rte_Self_SWCI6: type=Rte_SelfType_NvM
          Rte_Tasks: type=Rte_TaskInfo
      static-memorys:
        10 x data:
          Rte_CPim_CPT_MyReceivingSWC_ApplicationEcu_PIM_01: type=Rte_PimType_MyReceivingSWC_boolean
          Rte_CPim_CPT_MyReceivingSWC_ApplicationEcu_PIM_02: type=Rte_PimType_MyReceivingSWC_uint8
          Rte_ImplicitBufs: type=Rte_ImplicitBufsType
          Rte_ModeCurrent_{0..2}: type=uint8
          Rte_ModeNext_2: type=uint8
          Rte_ModeSchMNext_1: type=uint8
          Rte_RECount_OsTask_BSW_divby10_0: type=uint8
          Rte_Rx_000000: type=uint8
      31 x bsw called entity, all with sw-addr-method=CODE:
        Rte_ActivateRE: implemented-entry=Rte_ActivateRE
        Rte_Call_CPT_MyReceivingSWC_ApplicationEcu_R_NvMService_0_EraseBlock: implemented-entry=Rte_Call_CPT_MyReceivingSWC_ApplicationEcu_R_NvMService_0_EraseBlock
        Rte_Call_CPT_MyReceivingSWC_ApplicationEcu_R_NvMService_0_GetDataIndex: implemented-entry=Rte_Call_CPT_MyReceivingSWC_ApplicationEcu_R_NvMService_0_GetDataIndex
        Rte_Call_CPT_MyReceivingSWC_ApplicationEcu_R_NvMService_0_GetErrorStatus: implemented-entry=Rte_Call_CPT_MyReceivingSWC_ApplicationEcu_R_NvMService_0_GetErrorStatus
        Rte_Call_CPT_MyReceivingSWC_ApplicationEcu_R_NvMService_0_InvalidateNvBlock: implemented-entry=Rte_Call_CPT_MyReceivingSWC_ApplicationEcu_R_NvMService_0_InvalidateNvBlock
        Rte_Call_CPT_MyReceivingSWC_ApplicationEcu_R_NvMService_0_ReadBlock: implemented-entry=Rte_Call_CPT_MyReceivingSWC_ApplicationEcu_R_NvMService_0_ReadBlock
        Rte_Call_CPT_MyReceivingSWC_ApplicationEcu_R_NvMService_0_ReadPRAMBlock: implemented-entry=Rte_Call_CPT_MyReceivingSWC_ApplicationEcu_R_NvMService_0_ReadPRAMBlock
        Rte_Call_CPT_MyReceivingSWC_ApplicationEcu_R_NvMService_0_RestoreBlockDefaults: implemented-entry=Rte_Call_CPT_MyReceivingSWC_ApplicationEcu_R_NvMService_0_RestoreBlockDefaults
        Rte_Call_CPT_MyReceivingSWC_ApplicationEcu_R_NvMService_0_RestorePRAMBlockDefaults: implemented-entry=Rte_Call_CPT_MyReceivingSWC_ApplicationEcu_R_NvMService_0_RestorePRAMBlockDefaults
        Rte_Call_CPT_MyReceivingSWC_ApplicationEcu_R_NvMService_0_SetDataIndex: implemented-entry=Rte_Call_CPT_MyReceivingSWC_ApplicationEcu_R_NvMService_0_SetDataIndex
        Rte_Call_CPT_MyReceivingSWC_ApplicationEcu_R_NvMService_0_SetRamBlockStatus: implemented-entry=Rte_Call_CPT_MyReceivingSWC_ApplicationEcu_R_NvMService_0_SetRamBlockStatus
        Rte_Call_CPT_MyReceivingSWC_ApplicationEcu_R_NvMService_0_WriteBlock: implemented-entry=Rte_Call_CPT_MyReceivingSWC_ApplicationEcu_R_NvMService_0_WriteBlock
        Rte_Call_CPT_MyReceivingSWC_ApplicationEcu_R_NvMService_0_WritePRAMBlock: implemented-entry=Rte_Call_CPT_MyReceivingSWC_ApplicationEcu_R_NvMService_0_WritePRAMBlock
        Rte_DecrementWaitingCount: implemented-entry=Rte_DecrementWaitingCount
        Rte_GetCurrentTaskIndex: implemented-entry=Rte_GetCurrentTaskIndex
        Rte_MainFunction: implemented-entry=Rte_MainFunction
        Rte_Mode_BswM_RP_BswM_MRP_SwcModeRequest_MDGP_MSI_ShutDown: implemented-entry=Rte_Mode_BswM_RP_BswM_MRP_SwcModeRequest_MDGP_MSI_ShutDown
        Rte_ReadQueue: implemented-entry=Rte_ReadQueue
        Rte_SetEvent: implemented-entry=Rte_SetEvent
        Rte_Start: implemented-entry=Rte_Start
        Rte_Stop: implemented-entry=Rte_Stop
        Rte_WaitWithTimeout: implemented-entry=Rte_WaitWithTimeout
        Rte_WriteQueue: implemented-entry=Rte_WriteQueue
        Rte_WriteQueue_GetProtection: implemented-entry=Rte_WriteQueue_GetProtection
        Rte_WriteQueue_ReleaseProtection: implemented-entry=Rte_WriteQueue_ReleaseProtection
        Rte_Write_CPT_MyTransmittingSWC_ApplicationEcu_PPortPrototype_0_DE_MyDataElement: implemented-entry=Rte_Write_CPT_MyTransmittingSWC_ApplicationEcu_PPortPrototype_0_DE_MyDataElement
        Rte_memcpy: implemented-entry=Rte_memcpy
        SchM_Deinit: implemented-entry=SchM_Deinit
        SchM_IModeInit: implemented-entry=SchM_IModeInit
        SchM_Init: implemented-entry=SchM_Init
        SchM_Mode_BswM_MDGR_BswM_MRP_BswM_MDG: implemented-entry=SchM_Mode_BswM_MDGR_BswM_MRP_BswM_MDG
package /AUTOSAR_Rte/BswModuleEntrys
  36 x bsw module entry:
    Rte_ActivateRE: call-type=REGULAR
    Rte_Call_CPT_MyReceivingSWC_ApplicationEcu_R_NvMService_0_EraseBlock: call-type=REGULAR
    Rte_Call_CPT_MyReceivingSWC_ApplicationEcu_R_NvMService_0_GetDataIndex: call-type=REGULAR
    Rte_Call_CPT_MyReceivingSWC_ApplicationEcu_R_NvMService_0_GetErrorStatus: call-type=REGULAR
    Rte_Call_CPT_MyReceivingSWC_ApplicationEcu_R_NvMService_0_InvalidateNvBlock: call-type=REGULAR
    Rte_Call_CPT_MyReceivingSWC_ApplicationEcu_R_NvMService_0_ReadBlock: call-type=REGULAR
    Rte_Call_CPT_MyReceivingSWC_ApplicationEcu_R_NvMService_0_ReadPRAMBlock: call-type=REGULAR
    Rte_Call_CPT_MyReceivingSWC_ApplicationEcu_R_NvMService_0_RestoreBlockDefaults: call-type=REGULAR
    Rte_Call_CPT_MyReceivingSWC_ApplicationEcu_R_NvMService_0_RestorePRAMBlockDefaults: call-type=REGULAR
    Rte_Call_CPT_MyReceivingSWC_ApplicationEcu_R_NvMService_0_SetDataIndex: call-type=REGULAR
    Rte_Call_CPT_MyReceivingSWC_ApplicationEcu_R_NvMService_0_SetRamBlockStatus: call-type=REGULAR
    Rte_Call_CPT_MyReceivingSWC_ApplicationEcu_R_NvMService_0_WriteBlock: call-type=REGULAR
    Rte_Call_CPT_MyReceivingSWC_ApplicationEcu_R_NvMService_0_WritePRAMBlock: call-type=REGULAR
    Rte_DecrementWaitingCount: call-type=REGULAR
    Rte_GetCurrentTaskIndex: call-type=REGULAR
    Rte_MainFunction: call-type=REGULAR
    Rte_Mode_BswM_RP_BswM_MRP_SwcModeRequest_MDGP_MSI_ShutDown: call-type=REGULAR
    Rte_ReadQueue: call-type=REGULAR
    Rte_SetEvent: call-type=REGULAR
    Rte_Start: call-type=REGULAR
    Rte_StartHook_Return: call-type=CALLBACK
    Rte_StartHook_Start: call-type=CALLBACK
    Rte_Stop: call-type=REGULAR
    Rte_StopHook_Return: call-type=CALLBACK
    Rte_StopHook_Start: call-type=CALLBACK
    Rte_Task_Activate: call-type=CALLBACK
    Rte_WaitWithTimeout: call-type=REGULAR
    Rte_WriteQueue: call-type=REGULAR
    Rte_WriteQueue_GetProtection: call-type=REGULAR
    Rte_WriteQueue_ReleaseProtection: call-type=REGULAR
    Rte_Write_CPT_MyTransmittingSWC_ApplicationEcu_PPortPrototype_0_DE_MyDataElement: call-type=REGULAR
    Rte_memcpy: call-type=REGULAR
    SchM_Deinit: call-type=REGULAR
    SchM_IModeInit: call-type=REGULAR
    SchM_Init: call-type=REGULAR
    SchM_Mode_BswM_MDGR_BswM_MRP_BswM_MDG: call-type=REGULAR
package /AUTOSAR_Rte/BswImplementations
  bsw implementation Rte: programming-language=C, sw-version=0.0.0, used-code-generator=ETAS RTEGen, vendor-id=11, ar-release-version=4.0.0, behavior=RteInternalBehavior
    generated-artifacts:
      55 x dependency on artifact:
        BswM_MemMap_h: artifact-descriptor={short-label=BswM_MemMap_h, category=SWHDR, domain=AUTOSAR}
        Com_h: artifact-descriptor={short-label=Com_h, category=SWHDR, domain=AUTOSAR}
        ComM_MemMap_h: artifact-descriptor={short-label=ComM_MemMap_h, category=SWHDR, domain=AUTOSAR}
        EcuM_MemMap_h: artifact-descriptor={short-label=EcuM_MemMap_h, category=SWHDR, domain=AUTOSAR}
        Ioc_h: artifact-descriptor={short-label=Ioc_h, category=SWHDR, domain=AUTOSAR}
        MyReceivingSWC_MemMap_h: artifact-descriptor={short-label=MyReceivingSWC_MemMap_h, category=SWHDR, domain=AUTOSAR}
        MyTransmittingSWC_MemMap_h: artifact-descriptor={short-label=MyTransmittingSWC_MemMap_h, category=SWHDR, domain=AUTOSAR}
        NvM_h: artifact-descriptor={short-label=NvM_h, category=SWHDR, domain=AUTOSAR}
        NvM_MemMap_h: artifact-descriptor={short-label=NvM_MemMap_h, category=SWHDR, domain=AUTOSAR}
        Os_h: artifact-descriptor={short-label=Os_h, category=SWHDR, domain=AUTOSAR}
        OsTask_ASW_h: artifact-descriptor={short-label=OsTask_ASW_h, category=SWHDR, domain=AUTOSAR}
        OsTask_BSW_h: artifact-descriptor={short-label=OsTask_BSW_h, category=SWHDR, domain=AUTOSAR}
        Rte_c: artifact-descriptor={short-label=Rte_c, category=SWSRC, domain=AUTOSAR}
        Rte_h: artifact-descriptor={short-label=Rte_h, category=SWHDR, domain=AUTOSAR}
        Rte_BswM_h: artifact-descriptor={short-label=Rte_BswM_h, category=SWHDR, domain=AUTOSAR}
        Rte_BswM_Type_h: artifact-descriptor={short-label=Rte_BswM_Type_h, category=SWHDR, domain=AUTOSAR}
        Rte_Cbk_h: artifact-descriptor={short-label=Rte_Cbk_h, category=SWHDR, domain=AUTOSAR}
        Rte_Cfg_h: artifact-descriptor={short-label=Rte_Cfg_h, category=SWHDR, domain=AUTOSAR}
        Rte_ComM_h: artifact-descriptor={short-label=Rte_ComM_h, category=SWHDR, domain=AUTOSAR}
        Rte_ComM_Type_h: artifact-descriptor={short-label=Rte_ComM_Type_h, category=SWHDR, domain=AUTOSAR}
        Rte_Const_h: artifact-descriptor={short-label=Rte_Const_h, category=SWHDR, domain=AUTOSAR}
        Rte_DataHandleType_h: artifact-descriptor={short-label=Rte_DataHandleType_h, category=SWHDR, domain=AUTOSAR}
        Rte_EcuM_h: artifact-descriptor={short-label=Rte_EcuM_h, category=SWHDR, domain=AUTOSAR}
        Rte_EcuM_Type_h: artifact-descriptor={short-label=Rte_EcuM_Type_h, category=SWHDR, domain=AUTOSAR}
        Rte_Hook_h: artifact-descriptor={short-label=Rte_Hook_h, category=SWHDR, domain=AUTOSAR}
        Rte_Intl_h: artifact-descriptor={short-label=Rte_Intl_h, category=SWHDR, domain=AUTOSAR}
        Rte_Lib_c: artifact-descriptor={short-label=Rte_Lib_c, category=SWSRC, domain=AUTOSAR}
        Rte_Main_h: artifact-descriptor={short-label=Rte_Main_h, category=SWHDR, domain=AUTOSAR}
        Rte_MemMap_h: artifact-descriptor={short-label=Rte_MemMap_h, category=SWHDR, domain=AUTOSAR}
        Rte_MyReceivingSWC_h: artifact-descriptor={short-label=Rte_MyReceivingSWC_h, category=SWHDR, domain=AUTOSAR}
        Rte_MyReceivingSWC_Type_h: artifact-descriptor={short-label=Rte_MyReceivingSWC_Type_h, category=SWHDR, domain=AUTOSAR}
        Rte_MyTransmittingSWC_h: artifact-descriptor={short-label=Rte_MyTransmittingSWC_h, category=SWHDR, domain=AUTOSAR}
        Rte_MyTransmittingSWC_Type_h: artifact-descriptor={short-label=Rte_MyTransmittingSWC_Type_h, category=SWHDR, domain=AUTOSAR}
        Rte_NvM_h: artifact-descriptor={short-label=Rte_NvM_h, category=SWHDR, domain=AUTOSAR}
        Rte_NvM_Type_h: artifact-descriptor={short-label=Rte_NvM_Type_h, category=SWHDR, domain=AUTOSAR}
        Rte_Type_h: artifact-descriptor={short-label=Rte_Type_h, category=SWHDR, domain=AUTOSAR}
        Rte_rba_DiagLib_h: artifact-descriptor={short-label=Rte_rba_DiagLib_h, category=SWHDR, domain=AUTOSAR}
        Rte_rba_DiagLib_Type_h: artifact-descriptor={short-label=Rte_rba_DiagLib_Type_h, category=SWHDR, domain=AUTOSAR}
        SchM_BswM_h: artifact-descriptor={short-label=SchM_BswM_h, category=SWHDR, domain=AUTOSAR}
        SchM_BswM_Type_h: artifact-descriptor={short-label=SchM_BswM_Type_h, category=SWHDR, domain=AUTOSAR}
        SchM_Can_h: artifact-descriptor={short-label=SchM_Can_h, category=SWHDR, domain=AUTOSAR}
        SchM_CanSM_h: artifact-descriptor={short-label=SchM_CanSM_h, category=SWHDR, domain=AUTOSAR}
        SchM_CanSM_Type_h: artifact-descriptor={short-label=SchM_CanSM_Type_h, category=SWHDR, domain=AUTOSAR}
        SchM_Can_Type_h: artifact-descriptor={short-label=SchM_Can_Type_h, category=SWHDR, domain=AUTOSAR}
        SchM_Com_h: artifact-descriptor={short-label=SchM_Com_h, category=SWHDR, domain=AUTOSAR}
        SchM_ComM_h: artifact-descriptor={short-label=SchM_ComM_h, category=SWHDR, domain=AUTOSAR}
        SchM_ComM_Type_h: artifact-descriptor={short-label=SchM_ComM_Type_h, category=SWHDR, domain=AUTOSAR}
        SchM_Com_Type_h: artifact-descriptor={short-label=SchM_Com_Type_h, category=SWHDR, domain=AUTOSAR}
        SchM_EcuM_h: artifact-descriptor={short-label=SchM_EcuM_h, category=SWHDR, domain=AUTOSAR}
        SchM_EcuM_Type_h: artifact-descriptor={short-label=SchM_EcuM_Type_h, category=SWHDR, domain=AUTOSAR}
        SchM_MemIf_h: artifact-descriptor={short-label=SchM_MemIf_h, category=SWHDR, domain=AUTOSAR}
        SchM_MemIf_Type_h: artifact-descriptor={short-label=SchM_MemIf_Type_h, category=SWHDR, domain=AUTOSAR}
        SchM_NvM_h: artifact-descriptor={short-label=SchM_NvM_h, category=SWHDR, domain=AUTOSAR}
        SchM_NvM_Type_h: artifact-descriptor={short-label=SchM_NvM_Type_h, category=SWHDR, domain=AUTOSAR}
        rba_DiagLib_MemMap_h: artifact-descriptor={short-label=rba_DiagLib_MemMap_h, category=SWHDR, domain=AUTOSAR}
    resource consumption ResConsumption
      17 x memory section:
        RTE_BSWM_CODE: executable-entity=[Rte_Mode_BswM_RP_BswM_MRP_SwcModeRequest_MDGP_MSI_ShutDown, SchM_Mode_BswM_MDGR_BswM_MRP_BswM_MDG], prefix=RTE_BSWM, sw-addrmethod=CODE, symbol=CODE
        RTE_EXT_CODE: executable-entity=[Rte_ActivateRE, Rte_SetEvent, Rte_WriteQueue, Rte_WriteQueue_GetProtection, Rte_WriteQueue_ReleaseProtection], prefix=RTE_EXT, sw-addrmethod=CODE, symbol=CODE
        RTE_LIB_CODE: executable-entity=[Rte_GetCurrentTaskIndex, Rte_memcpy], prefix=RTE_LIB, sw-addrmethod=CODE, symbol=CODE
        RTE_MAIN_CODE: executable-entity=[Rte_MainFunction, Rte_Start, Rte_Stop, SchM_Deinit, SchM_Init], prefix=RTE_MAIN, sw-addrmethod=CODE, symbol=CODE
        RTE_MYRECEIVINGSWC_CODE:
          executable-entity=[Rte_Call_CPT_MyReceivingSWC_ApplicationEcu_R_NvMService_0_EraseBlock, Rte_Call_CPT_MyReceivingSWC_ApplicationEcu_R_NvMService_0_GetDataIndex, Rte_Call_CPT_MyReceivingSWC_ApplicationEcu_R_NvMService_0_GetErrorStatus, Rte_Call_CPT_MyReceivingSWC_ApplicationEcu_R_NvMService_0_InvalidateNvBlock, Rte_Call_CPT_MyReceivingSWC_ApplicationEcu_R_NvMService_0_ReadBlock, Rte_Call_CPT_MyReceivingSWC_ApplicationEcu_R_NvMService_0_ReadPRAMBlock, Rte_Call_CPT_MyReceivingSWC_ApplicationEcu_R_NvMService_0_RestoreBlockDefaults, Rte_Call_CPT_MyReceivingSWC_ApplicationEcu_R_NvMService_0_RestorePRAMBlockDefaults, Rte_Call_CPT_MyReceivingSWC_ApplicationEcu_R_NvMService_0_SetDataIndex, Rte_Call_CPT_MyReceivingSWC_ApplicationEcu_R_NvMService_0_SetRamBlockStatus, Rte_Call_CPT_MyReceivingSWC_ApplicationEcu_R_NvMService_0_WriteBlock, Rte_Call_CPT_MyReceivingSWC_ApplicationEcu_R_NvMService_0_WritePRAMBlock]
          prefix=RTE_MYRECEIVINGSWC
          sw-addrmethod=CODE
          symbol=CODE
        RTE_MYTRANSMITTINGSWC_CODE: executable-entity=Rte_Write_CPT_MyTransmittingSWC_ApplicationEcu_PPortPrototype_0_DE_MyDataElement, prefix=RTE_MYTRANSMITTINGSWC, sw-addrmethod=CODE, symbol=CODE
        RTE_SIG_S_APPLICATIONECU_SG_TESTRESULT_TX_CAN_NETWORK_CHANNEL_CAN_TX_CODE: executable-entity=Rte_COMCbk_S_ApplicationECU_SG_TestResult_Tx_Can_Network_Channel_CAN_Tx, prefix=RTE_SIG_S_APPLICATIONECU_SG_TESTRESULT_TX_CAN_NETWORK_CHANNEL_CAN_TX, sw-addrmethod=CODE, symbol=CODE
        RTE_SIG_S_TESTECU_SG_TESTCODE_TX_CAN_NETWORK_CHANNEL_CAN_RX_CODE: executable-entity=Rte_COMCbk_S_TestECU_SG_TestCode_Tx_Can_Network_Channel_CAN_Rx, prefix=RTE_SIG_S_TESTECU_SG_TESTCODE_TX_CAN_NETWORK_CHANNEL_CAN_RX, sw-addrmethod=CODE, symbol=CODE
        RTE_SYS_CODE: executable-entity=[Rte_DecrementWaitingCount, Rte_ReadQueue, Rte_WaitWithTimeout, SchM_IModeInit], prefix=RTE_SYS, sw-addrmethod=CODE, symbol=CODE
        CONST_UNSPECIFIED: alignment=UNSPECIFIED, sw-addrmethod=CONST
        VAR_CLEARED_16: alignment=16, sw-addrmethod=VAR_CLEARED
        RTE_SYS_VAR_CLEARED_32: alignment=32, prefix=RTE_SYS, sw-addrmethod=VAR_CLEARED, symbol=VAR_CLEARED_32
        VAR_CLEARED_8: alignment=8, sw-addrmethod=VAR_CLEARED
        RTE_OSTASK_BSW_VAR_CLEARED_8: alignment=8, prefix=RTE_OSTASK_BSW, sw-addrmethod=VAR_CLEARED, symbol=VAR_CLEARED_8
        VAR_CLEARED_BOOLEAN: alignment=BOOLEAN, sw-addrmethod=VAR_CLEARED
        VAR_INIT_8: alignment=8, sw-addrmethod=VAR_INIT
        VAR_INIT_UNSPECIFIED: alignment=UNSPECIFIED, sw-addrmethod=VAR_INIT
      10 x section name prefix:
        RTE_BSWM
        RTE_EXT
        RTE_LIB
        RTE_MAIN
        RTE_MYRECEIVINGSWC
        RTE_MYTRANSMITTINGSWC
        RTE_OSTASK_BSW
        RTE_SIG_S_APPLICATIONECU_SG_TESTRESULT_TX_CAN_NETWORK_CHANNEL_CAN_TX
        RTE_SIG_S_TESTECU_SG_TESTCODE_TX_CAN_NETWORK_CHANNEL_CAN_RX
        RTE_SYS
package /AUTOSAR_Rte/Units
  unit AUTOSAR_AISpecification_Units_NoUnit: display-name=-, factor-si-to-unit=1.0, offset-si-to-unit=0.0, physical-dimension=AUTOSAR_AISpecification_PhysicalDimensions_NoDimension  # Neither Physical nor Mathematical Unit
package /AUTOSAR_Rte/CompuMethods
  compu method AUTOSAR_NvM_CompuMethods_NvM_RequestResultType: 0=NVM_REQ_OK, 1=NVM_REQ_NOT_OK, 2=NVM_REQ_PENDING, 3=NVM_REQ_INTEGRITY_FAILED, 4=NVM_REQ_BLOCK_SKIPPED, 5=NVM_REQ_NV_INVALIDATED, 6=NVM_REQ_CANCELED, 7=NVM_REQ_REDUNDANCY_FAILED, 8=NVM_REQ_RESTORED_FROM_ROM; unit AUTOSAR_AISpecification_Units_NoUnit  # Computation method for the type of the block request result.
  compu method AUTOSAR_Platform_CompuMethods_boolean: 0=FALSE, 1=TRUE
package /AUTOSAR_Rte/ImplementationDataTypes
  43 x impl type:
    Rte_PimType_MyReceivingSWC_boolean: implementation-data-type=boolean
    Rte_PimType_MyReceivingSWC_uint8: implementation-data-type=PduR_uint8_impl
    Rte_DE_uint8: category=STRUCTURE
      element value: implementation-data-type=uint8
    Rte_TDB_OsTask_ASW: category=STRUCTURE
      element rbuf0: implementation-data-type=Rte_DE_uint8
    Rte_ISA_1: category=UNION
      element Rte_OsTask_ASW: implementation-data-type=Rte_TDB_OsTask_ASW
    Rte_ImplicitBufsType: category=STRUCTURE
      element isa_1: implementation-data-type=Rte_ISA_1
    Rte_CDS_BswM: category=STRUCTURE
      element Rte_Dummy: implementation-data-type=uint8
    Rte_CDS_ComM: category=STRUCTURE
      element Rte_Dummy: implementation-data-type=uint8
    Rte_CDS_EcuM: category=STRUCTURE
      element Rte_Dummy: implementation-data-type=uint8
    Rte_CDS_NvM: category=STRUCTURE
      element Rte_Dummy: implementation-data-type=uint8
    Rte_CDS_rba_DiagLib: category=STRUCTURE
      element Rte_Dummy: implementation-data-type=uint8
    Rte_PDS_MyReceivingSWC_My_SR_Interface_R: category=STRUCTURE
      element Rte_Dummy: implementation-data-type=uint8
    Rte_PDS_MyReceivingSWC_My_SR_Interface_RA: category=ARRAY
      element Rte_PDS_MyReceivingSWC_My_SR_Interface_RAElement: array-size=1, array-size-semantics=FIXED-SIZE, implementation-data-type=Rte_PDS_MyReceivingSWC_My_SR_Interface_R
    Rte_CallFP_MyReceivingSWC_NvMService_EraseBlock: category=FUNCTION_REFERENCE
    Rte_CallFP_MyReceivingSWC_NvMService_GetDataIndex: category=FUNCTION_REFERENCE
    NvM_RequestResultType: compu-method=AUTOSAR_NvM_CompuMethods_NvM_RequestResultType, implementation-data-type=uint8
    Rte_CallFP_MyReceivingSWC_NvMService_GetErrorStatus: category=FUNCTION_REFERENCE
    Rte_CallFP_MyReceivingSWC_NvMService_InvalidateNvBlock: category=FUNCTION_REFERENCE
    NvM_Rb_VoidPtr: category=DATA_REFERENCE, sw-pointer-target-props={base-type=AUTOSAR_Platform_BaseTypes_void, "Written By SwDataDefProps written by RTEGen"}
    Rte_CallFP_MyReceivingSWC_NvMService_ReadBlock: category=FUNCTION_REFERENCE
    Rte_CallFP_MyReceivingSWC_NvMService_ReadPRAMBlock: category=FUNCTION_REFERENCE
    Rte_CallFP_MyReceivingSWC_NvMService_RestoreBlockDefaults: category=FUNCTION_REFERENCE
    Rte_CallFP_MyReceivingSWC_NvMService_RestorePRAMBlockDefaults: category=FUNCTION_REFERENCE
    Rte_CallFP_MyReceivingSWC_NvMService_SetDataIndex: category=FUNCTION_REFERENCE
    Rte_CallFP_MyReceivingSWC_NvMService_SetRamBlockStatus: category=FUNCTION_REFERENCE
    NvM_Rb_ConstVoidPtr: category=DATA_REFERENCE, sw-pointer-target-props={base-type=AUTOSAR_Platform_BaseTypes_void, sw-impl-policy=CONST, "Written By SwDataDefProps written by RTEGen"}
    Rte_CallFP_MyReceivingSWC_NvMService_WriteBlock: category=FUNCTION_REFERENCE
    Rte_CallFP_MyReceivingSWC_NvMService_WritePRAMBlock: category=FUNCTION_REFERENCE
    Rte_PDS_MyReceivingSWC_NvMService_R: category=STRUCTURE
      12 x element, all with category=TYPE_REFERENCE:
        Call_EraseBlock: implementation-data-type=Rte_CallFP_MyReceivingSWC_NvMService_EraseBlock
        Call_GetDataIndex: implementation-data-type=Rte_CallFP_MyReceivingSWC_NvMService_GetDataIndex
        Call_GetErrorStatus: implementation-data-type=Rte_CallFP_MyReceivingSWC_NvMService_GetErrorStatus
        Call_InvalidateNvBlock: implementation-data-type=Rte_CallFP_MyReceivingSWC_NvMService_InvalidateNvBlock
        Call_ReadBlock: implementation-data-type=Rte_CallFP_MyReceivingSWC_NvMService_ReadBlock
        Call_ReadPRAMBlock: implementation-data-type=Rte_CallFP_MyReceivingSWC_NvMService_ReadPRAMBlock
        Call_RestoreBlockDefaults: implementation-data-type=Rte_CallFP_MyReceivingSWC_NvMService_RestoreBlockDefaults
        Call_RestorePRAMBlockDefaults: implementation-data-type=Rte_CallFP_MyReceivingSWC_NvMService_RestorePRAMBlockDefaults
        Call_SetDataIndex: implementation-data-type=Rte_CallFP_MyReceivingSWC_NvMService_SetDataIndex
        Call_SetRamBlockStatus: implementation-data-type=Rte_CallFP_MyReceivingSWC_NvMService_SetRamBlockStatus
        Call_WriteBlock: implementation-data-type=Rte_CallFP_MyReceivingSWC_NvMService_WriteBlock
        Call_WritePRAMBlock: implementation-data-type=Rte_CallFP_MyReceivingSWC_NvMService_WritePRAMBlock
    Rte_PDS_MyReceivingSWC_NvMService_RA: category=ARRAY
      element Rte_PDS_MyReceivingSWC_NvMService_RAElement: array-size=1, array-size-semantics=FIXED-SIZE, implementation-data-type=Rte_PDS_MyReceivingSWC_NvMService_R
    Rte_CDS_MyReceivingSWC: category=STRUCTURE
      5 x element, all with category=TYPE_REFERENCE:
        RE_Rx_RPortPrototype_0_DE_MyDataElement: implementation-data-type=Rte_DE_uint8
        Pim_PIM_01: implementation-data-type=Rte_PimType_MyReceivingSWC_boolean
        Pim_PIM_02: implementation-data-type=Rte_PimType_MyReceivingSWC_uint8
        RPortPrototype_0: implementation-data-type=Rte_PDS_MyReceivingSWC_My_SR_Interface_RA
        R_NvMService_0: implementation-data-type=Rte_PDS_MyReceivingSWC_NvMService_RA
    Rte_WriteFP_MyTransmittingSWC_My_SR_Interface_DE_MyDataElement: category=FUNCTION_REFERENCE
    Rte_PDS_MyTransmittingSWC_My_SR_Interface_P: category=STRUCTURE
      element Write_DE_MyDataElement: implementation-data-type=Rte_WriteFP_MyTransmittingSWC_My_SR_Interface_DE_MyDataElement
    Rte_PDS_MyTransmittingSWC_My_SR_Interface_PA: category=ARRAY
      element Rte_PDS_MyTransmittingSWC_My_SR_Interface_PAElement: array-size=1, array-size-semantics=FIXED-SIZE, implementation-data-type=Rte_PDS_MyTransmittingSWC_My_SR_Interface_P
    Rte_CDS_MyTransmittingSWC: category=STRUCTURE
      element PPortPrototype_0: implementation-data-type=Rte_PDS_MyTransmittingSWC_My_SR_Interface_PA
    Rte_SelfType_ComM: implementation-data-type=Rte_CDS_ComM
    Rte_SelfType_MyReceivingSWC: implementation-data-type=Rte_CDS_MyReceivingSWC
    Rte_SelfType_MyTransmittingSWC: implementation-data-type=Rte_CDS_MyTransmittingSWC
    Rte_SelfType_rba_DiagLib: implementation-data-type=Rte_CDS_rba_DiagLib
    Rte_SelfType_BswM: implementation-data-type=Rte_CDS_BswM
    Rte_SelfType_EcuM: implementation-data-type=Rte_CDS_EcuM
    Rte_SelfType_NvM: implementation-data-type=Rte_CDS_NvM
    Rte_TaskInfo: category=VALUE  # This is an external type, i.e. it is declared in the Rte Library and not in the XML. RTEGen does not have any information about this type apart from its name.
package /AUTOSAR_Rte/SwAddrMethods
  6 x sw addr method:
    CODE: memory-allocation-keyword-policy=ADDR-METHOD-SHORT-NAME, section-type=CODE
    CODE_OSTASK_ASW: memory-allocation-keyword-policy=ADDR-METHOD-SHORT-NAME, section-type=CODE
    CODE_OSTASK_BSW: memory-allocation-keyword-policy=ADDR-METHOD-SHORT-NAME, section-type=CODE
    CONST: memory-allocation-keyword-policy=ADDR-METHOD-SHORT-NAME-AND-ALIGNMENT, section-type=CONST
    VAR_CLEARED: memory-allocation-keyword-policy=ADDR-METHOD-SHORT-NAME-AND-ALIGNMENT, section-initialization-policy=CLEARED, section-type=VAR
    VAR_INIT: memory-allocation-keyword-policy=ADDR-METHOD-SHORT-NAME-AND-ALIGNMENT, section-initialization-policy=INIT, section-type=VAR
package /AUTOSAR_Rte/SwBaseTypes
  base type AUTOSAR_Platform_BaseTypes_uint8: category=FIXED_LENGTH, base-type-size=8, base-type-encoding=NONE, mem-alignment=8, native-declaration=uint8  # unsigned integer 8bit | This standard AUTOSAR type shall be of 8 bit unsigned.
  base type AUTOSAR_Platform_BaseTypes_void: category=FIXED_LENGTH, base-type-size=0, base-type-encoding=VOID, native-declaration=void  # void to be used as pointer target
  base type AUTOSAR_Platform_BaseTypes_boolean: category=FIXED_LENGTH, base-type-size=8, base-type-encoding=BOOLEAN, native-declaration=Boolean  # Boolean | The boolean type shall always be mapped to a platform specific type where pointers can be applied to enable a passing of parameters via API. There are specific BIT types of some HW platforms which are very efficient but where no pointers can point to. This standard AUTOSAR type shall only be used together with the definitions TRUE and FALSE. See PLATFORM027 for implementation and usage.
