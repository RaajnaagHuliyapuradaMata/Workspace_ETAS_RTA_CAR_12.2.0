AUTOSAR XML (schema 00051)
package /ETAS_Project/EcucModuleConfigurationValuess
  module config EcuM
    EcuMConfiguration_0 (EcuMConfiguration)
      EcuMCommonConfiguration_0 (EcuMCommonConfiguration): EcuMIgnoreWakeupEvValOffPreOS=0, EcuMDefaultAppMode=OSDEFAULTAPPMODE
        EcuMDefaultShutdownTarget_0 (EcuMDefaultShutdownTarget): EcuMDefaultState=EcuMStateOff
        EcuMWakeupSource_0 (EcuMWakeupSource): EcuMCheckWakeupTimeout=0.0
      EcuMFlexConfiguration_0 (EcuMFlexConfiguration)
        EcuMFlexUserConfig_0 (EcuMFlexUserConfig)
        EcuMResetMode_0 (EcuMResetMode)
        EcuMShutdownCause_0 (EcuMShutdownCause)
    EcuMGeneral_0 (EcuMGeneral):
      EcuMDevErrorDetect = 0
      EcuMRbConfigCCASInit = 0
      EcuMRbDisableNvM = 0
      EcuMRbIncludeComm = 1
      EcuMRbModeSwitchQueueLength = 1
      EcuMRbSlaveCoreEarlierStart = 0
      EcuMRbStartupDuration = 0
      EcuMRbUserTypeUpdate = 0
      EcuMVersionInfoApi = 0
      EcuMIncludeDet = false
      EcuMMainFunctionPeriod = 0.01
      EcuMRbIncludeHeaderList_0 (EcuMRbIncludeHeaderList): EcuMRbModuleHeader=EcuM_User
