AUTOSAR XML (schema 4-2-2)
package /RB/RBA/rba_Stm/EcucModuleDefs
  module definition rba_Stm: category=VENDOR_SPECIFIC_MODULE_DEFINITION, post-build-variant-support=true, refined-module-def=rba_Stm, variants pre-compile  # MCAL rba_Stm Driver | Configuration of the MCAL STM (System Timer Module) component
    container rba_StmRbConfigSet  # Stm configuration data set | Defines one data set of post-build configuration. Which of these data sets is actually active is controlled by EcuM. Data sets can only be switched at initialization time.
      container rba_StmRbGptChannel [1..1000]: multiplicity set at pre-compile  # Stm Gpt channel | This is the container for Stm channel selected by Gpt.
        integer rba_StmRbGptChannelCompareRegister: 0..3, origin=RB:v0.1.0:2015-03-28, post-build-variant-value=true, set at pre-compile, with-auto=true  # Stm Compare register selected by Gpt | This is the Stm channel used by Gpt component.Nothing to configure here,since it is forwarded from Gpt.
        string rba_StmRbGptChannelIndex: origin=RB:v0.1.0:2015-03-28, post-build-variant-value=true, set at pre-compile, with-auto=true  # Stm Channel Index selected by Gpt | This is the Stm channel status used by Gpt component.Nothing to configure here,since it is forwarded from Gpt.
        integer rba_StmRbGptChannelInstance: 0..1, origin=RB:v0.1.0:2015-03-28, post-build-variant-value=true, set at pre-compile, with-auto=true  # Stm HwInstance selected by Gpt | This is the Stm instance used by Gpt component.Nothing to configure here,since it is forwarded from Gpt.
        string rba_StmRbGptChannelInterrupt: origin=RB:v0.1.0:2015-03-29, post-build-variant-value=true, set at pre-compile, with-auto=true  # Stm Interrupt Number selected by Gpt | This is the Stm instance used by Gpt component.Nothing to configure here,since it is forwarded from Gpt.
        integer rba_StmRbGptChannelNumber: 0..3, origin=RB:v0.1.0:2015-03-28, post-build-variant-value=true, set at pre-compile, with-auto=true  # Stm Channel number selected by Gpt | This is the Stm Channel number used by Gpt component.Nothing to configure here,since it is forwarded from Gpt.
    container rba_StmRbConfigurationOfOptApiServices  # Stm configuration of optional API services | This container contains all configuration switches for
      boolean rba_StmRbEnDisExtInt: origin=RB.v0.1.0.2018-07-20, set at pre-compile  # Enable external interrupt | Enables / disables the usage of external interrupt
      boolean rba_StmRbVersionInfoApi: origin=RB:v0.1.0:2015-04-15, set at pre-compile  # Enable version information API | Adds / removes the service rba_Stm_GetVersionInfo() API.
    container rba_StmRbDriverConfiguration  # Stm driver configuration | Stm general configuration parameter
      enumeration rba_StmRbBuildEnvironment: origin=RB:v0.1.0:2015-04-14, set at pre-compile  # Compilation and Build Environment | Selection of Post build time or Pre compile time environment.
        GPT_RB_POSTBUILD  # Change configuration sets during run time
        GPT_RB_PRECOMPILE  # Project runs with only one configuration set
      boolean rba_StmRbCheckAutosarVersion: origin=RB:v0.1.0:2015-04-15, set at pre-compile  # Enable AUTOSAR version checking | Enables/ disables AUTOSAR file version checking.
      enumeration rba_StmRbCounter_64_Enable: origin=RB:v0.1.0:2016-10-4, post-build-variant-value=true, set at pre-compile  # Stm Gpt channel is 64bit value | This field has to selected same as selected in GPT layer
        Uint64  # Uint64 -- ONLY channel Zero can be configured in his mode
        Uint32  # Uint32 -- Except channel zero other channels can be configured
      boolean rba_StmRbDevErrorDetect: origin=RB:v0.1.0:2015-04-15, set at pre-compile  # Enable development error detection | Enables / disables the detection and notification of development errors. If this parameter is enabled, extended error checking will be performed during runtime. Any errors detected by these checks are reported to the DET module. This feature should be switched off for production software.
