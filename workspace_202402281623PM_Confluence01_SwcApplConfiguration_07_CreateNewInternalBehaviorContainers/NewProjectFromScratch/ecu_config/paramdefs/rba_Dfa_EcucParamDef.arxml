AUTOSAR XML (schema 00048)
package /RB/RBA/rba_Dfa/EcucModuleDefs
  module definition rba_Dfa [0..1]: category=VENDOR_SPECIFIC_MODULE_DEFINITION, post-build-variant-support=true, variants pre-compile  # MCAL Dataflow Architecture | Configuration of the MCAL module for the programmable hardware accelerator DFA (Dataflow Architecture).
    container rba_Dfa_ConfigSet: multiplicity set at pre-compile  # Configuration data set | This is the base container that contains the post-build selectable configuration parameters
      container rba_Dfa_FFTCalculations [0..*]: multiplicity set at pre-compile, post-build-variant-multiplicity=true  # FFT Calculation | This is the container for the FFT algorithm specific parameters.
        enumeration rba_Dfa_FFTCalculationMode: multiplicity set at pre-compile, origin=RB, post-build-variant-multiplicity=true, post-build-variant-value=true, set at pre-compile  # Calculation Mode | Select in which mode this Model is to be calculated: A: Synchronous B: Asynchronous
          RBA_DFA_CALCULATION_MODE_FFT_SYNC  # Synchronous
          RBA_DFA_CALCULATION_MODE_FFT_ASYNC  # Asynchronous
        integer rba_Dfa_FFTDimension: 7..11, multiplicity set at pre-compile, origin=RB, post-build-variant-multiplicity=true, post-build-variant-value=true, set at pre-compile  # Dimension | Size of the Vector (log2).
        integer rba_Dfa_FFTInputType: 0..23, multiplicity set at pre-compile, origin=RB, post-build-variant-multiplicity=true, post-build-variant-value=true, set at pre-compile  # InputType | This parameter specifies the Input Type: if "Input Type== 0": float32 if "1 <= selInputType_u32 <= 23": uint<selInputType_u32> selInputType_u32 == nr of bits, being stored inside LSBs of uint32 input value, an internal normalization to output values < 1.0f is done
        boolean rba_Dfa_FFTOutputSpectrumHalf: multiplicity set at pre-compile, origin=RB, post-build-variant-multiplicity=true, post-build-variant-value=true, set at pre-compile  # OutputSpectrumHalf | flag to enable writing half of the real / imag. result vectors only
        integer rba_Dfa_FFTOutputType: 0..23, multiplicity set at pre-compile, origin=RB, post-build-variant-multiplicity=true, post-build-variant-value=true, set at pre-compile  # OutputType | This parameter specifies the Output Type: if "selOutPutType == 0": float32 if "1 <= selOutputType_u32 <= 23": uint selOutputType_u32 == nr of bits, being stored inside LSBs of uint32 output value, it is strictly required that the input values are scaled to values < 1.0f, otherwise the output values overflow
        integer rba_Dfa_FFTPriority [0..1]: 0..3, multiplicity set at pre-compile, origin=RB, post-build-variant-multiplicity=true, post-build-variant-value=true, set at pre-compile, default-value=0  # Priority | Priority of the FFT calculation : 0 := lowest to 3 := highest priority. The lowest priority shall be used for most cases.
      container rba_Dfa_GaussModels [0..*]: multiplicity set at pre-compile, post-build-variant-multiplicity=true  # GaussianRBF Calculation | This is the container for the Gaussian RBF model specific parameters.
        integer rba_Dfa_GaussianPriority [0..1]: 0..3, multiplicity set at pre-compile, origin=RB, post-build-variant-multiplicity=true, post-build-variant-value=true, set at pre-compile, default-value=0  # Priority | Priority of the GaussianRBF calculation : 0 := lowest to 3 := highest priority. The lowest priority shall be used for most cases.
        enumeration rba_Dfa_ModelCalculationMode: multiplicity set at pre-compile, origin=RB, post-build-variant-multiplicity=true, post-build-variant-value=true, set at pre-compile  # Calculation Mode | Select in which mode this Model is to be calculated: A: Synchronous B: Asynchronous
          RBA_DFA_CALCULATION_MODE_GAUSSIAN_RBF_SYNC  # Synchronous
          RBA_DFA_CALCULATION_MODE_GAUSSIAN_RBF_ASYNC  # Asynchronous
        integer rba_Dfa_ModelDataDimension: 1..32, multiplicity set at pre-compile, origin=RB, post-build-variant-multiplicity=true, post-build-variant-value=true, set at pre-compile  # Model Dimension | Dimension of the GaussianRBF Model
      container rba_Dfa_MultilayerPerceptron [0..*]: multiplicity set at pre-compile, post-build-variant-multiplicity=true  # MLP Calculation | This is the container for the MLP specific parameters.
        integer rba_Dfa_MlpPriority [0..1]: 0..3, multiplicity set at pre-compile, origin=RB, post-build-variant-multiplicity=true, post-build-variant-value=true, set at pre-compile, default-value=0  # Priority | Priority of the MLP calculation: 0 := lowest to 3 := highest priority. The lowest priority shall be used for most cases.
        enumeration rba_Dfa_MultilayerPerceptronCalculationMode: multiplicity set at pre-compile, origin=RB, post-build-variant-multiplicity=true, post-build-variant-value=true, set at pre-compile  # Calculation Mode | Select in which mode this MultilayerPerceptron is to be calculated: A: Synchronous B: Asynchronous
          RBA_DFA_CALCULATION_MODE_MULTILAYERPERCEPTRON_SYNC  # Synchronous
          RBA_DFA_CALCULATION_MODE_MULTILAYERPERCEPTRON_ASYNC  # Asynchronous
    container rba_Dfa_General [0..1]: multiplicity set at pre-compile  # General settings | Container with general configuration (parameters) of the Dfa Driver software module.
      boolean rba_Dfa_DevErrorDetect: origin=RB, set at pre-compile  # Development error detection | Enables/disables the detection and notification of development errors. If this parameter is enabled, then extended error checking is performed during runtime; any errors detected by these checks are reported to the Det module. This feature should be switched off in series software.
      integer rba_Dfa_MonLvl [0..1]: 0..1, multiplicity set at pre-compile, origin=RB, set at pre-compile, default-value=0  # Monitoring level | Selection of the monitoring level for the calculation time: 0: Monitoring is disabled (default) 1: Common monitoring
