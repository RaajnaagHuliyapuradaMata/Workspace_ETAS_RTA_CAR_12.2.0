AUTOSAR XML (schema 00051)
package /OS
  module config Os
    OSDEFAULTAPPMODE (OsAppMode)
    OsOS:
      OsStackMonitoring = false
      OsUseGetServiceId = true
      OsUseParameterAccess = true
      OsUseResScheduler = true
      OsStatus = STANDARD
      OsScalabilityClass = SC1
      OsNumberOfCores = 1
      OsHooks: OsErrorHook=true, OsPostTaskHook=false, OsPreTaskHook=false, OsProtectionHook=false, OsShutdownHook=true, OsStackFaultHook=false, OsStartupHook=true
    OsRTATarget: OsRTATargetName=VRTA, OsRTATargetVariant=MinGW
    3 x OsTask, all with OsTaskCanCallSchedule=false, OsTaskActivation=1, OsTaskSchedule=FULL:
      InitTask: OsTaskPriority=3
        OsTaskAutostart: OsTaskAppModeRef=OSDEFAULTAPPMODE
      OsTask_ASW: OsTaskPriority=1
      OsTask_BSW: OsTaskPriority=2
