AUTOSAR XML (schema 00048)
package /AUTOSAR_Dlt/EcucModuleDefs
  module definition Dlt [0..1]: category=VENDOR_SPECIFIC_MODULE_DEFINITION, post-build-variant-support=true, refined-module-def=Dlt, variants link-time/post-build/pre-compile
    container DltConfigSet  # This container lists all the global Dlt functionalities that can be enabled or disabled at pre-compile time to optimize resource consumption.
      container DltLogLevelSetting  # Contains settings for thresholds.
        enumeration DltDefaultLogLevel: {DLT_LOG_DEBUG, DLT_LOG_ERROR, DLT_LOG_FATAL, DLT_LOG_INFO, DLT_LOG_OFF, DLT_LOG_VERBOSE, DLT_LOG_WARN}, scope=ECU, post-build-variant-value=true, set at link in variant link-time / post-build in variant post-build / pre-compile in variant pre-compile  # This is the effective log level used in case no filter matches the given AppicationId and ContextId. This can be seen as a fall-through filter definition with wildcard for AppicationId and ContextId, which will be used, when no other filter matches.
        container DltRbLogLevelThreshold [0..*]: multiplicity set at link in variant link-time / post-build in variant post-build / pre-compile in variant pre-compile, post-build-variant-multiplicity=true  # This container contains a preconfiguration of ApplicationId / ContextId pairs and their assigned log level.
          enumeration DltRbThreshold: {DLT_LOG_DEBUG, DLT_LOG_ERROR, DLT_LOG_FATAL, DLT_LOG_INFO, DLT_LOG_OFF, DLT_LOG_VERBOSE, DLT_LOG_WARN}, scope=ECU, origin=RB:42.4.0.0:2018-03-01, post-build-variant-value=true, set at link in variant link-time / post-build in variant post-build / pre-compile in variant pre-compile  # This is the effective log level used for given AppicationId and ContextId
          reference DltRbLogLevelThresholdSwcContextRef: origin=RB:42.4.0.0:2018-03-01, post-build-variant-value=true, set at link in variant link-time / post-build in variant post-build / pre-compile in variant pre-compile, destination=DltSwcContext  # Reference to an ApplicationId/ContextId pair to which a DltLogLevelThreshold is assigned.
      container DltLogOutput  # Contains settings for log/trace message output
        reference DltDefaultLogChannelRef: post-build-variant-value=true, set at link in variant link-time / post-build in variant post-build / pre-compile in variant pre-compile, destination=DltLogChannel  # Reference to the default log channel, which has to be used for a log/trace output, if no other match has been found.
        container DltLogChannel [1..*]  # Contains settings for log/trace message output
          float DltLogChannelBufferOverflowTimer: 0.001..1, scope=ECU, post-build-variant-value=true, set at link in variant link-time / post-build in variant post-build / pre-compile in variant pre-compile  # Specifies the cycle time in seconds for resetting the buffer overflow flag in case a buffer overflow occurred.
          integer DltLogChannelBufferSize: 0..65534, scope=ECU, set at pre-compile  # Buffer size in bytes for the LogChannel specific message buffer.
          string DltLogChannelId: scope=ECU, post-build-variant-value=true, set at link in variant link-time / post-build in variant post-build / pre-compile in variant pre-compile  # This is the 4 ASCII character long name of the log channel as used in the Dlt control messages as parameter name Dlt_interface
          integer DltLogChannelMaxMessageLength: 8..65534, scope=ECU, post-build-variant-value=true, set at link in variant link-time / pre-compile in variant post-build+pre-compile  # The maximum length of a Dlt log or trace message.
          integer DltLogChannelMaxNumOfRetries: 0..255, scope=ECU, post-build-variant-value=true, set at link in variant link-time / post-build in variant post-build / pre-compile in variant pre-compile, default-value=0  # The maximum length of a Dlt log or trace message.
          enumeration DltLogChannelThreshold: {DLT_LOG_DEBUG, DLT_LOG_ERROR, DLT_LOG_FATAL, DLT_LOG_INFO, DLT_LOG_OFF, DLT_LOG_VERBOSE, DLT_LOG_WARN}, scope=ECU, post-build-variant-value=true, set at link in variant link-time / post-build in variant post-build / pre-compile in variant pre-compile  # LogLevel Threshold
          integer DltLogChannelTrafficShapingBandwidth [0..1]: 0..18446744073709551615, multiplicity set at link in variant link-time / post-build in variant post-build / pre-compile in variant pre-compile, post-build-variant-multiplicity=true, post-build-variant-value=true, set at link in variant link-time / post-build in variant post-build / pre-compile in variant post-build+pre-compile  # Set the maximum possible bandwith in bit/s.
          float DltLogChannelTransmitCycle: 0.001..1, scope=ECU, post-build-variant-value=true, set at link in variant link-time / post-build in variant post-build / pre-compile in variant pre-compile  # Specifies the cycle time in seconds of the transmit functionality of this log channel.
          boolean DltLogTraceStatusFlag: post-build-variant-value=true, set at link in variant link-time / post-build in variant post-build / pre-compile in variant pre-compile  # Parameter to turn on/off on this LogChannel completely.
          container DltTxPdu  # Contains the configuration parameters of the AUTOSAR Dlt module's Tx Pdus.
            integer DltTxPduId [0..1]: 0..65535, scope=ECU, multiplicity set at link in variant link-time / post-build in variant post-build / pre-compile in variant pre-compile, post-build-variant-multiplicity=true, post-build-variant-value=true, set at link in variant link-time / post-build in variant post-build / pre-compile in variant pre-compile, symbolic-name-value=true  # The numerical value used as the ID of this I-PDU. | This handle Id is used for the APIs calls Dlt_TxConfirmation, Dlt_TriggerTransmit, Dlt_TriggerIPDUSend or Dlt_TriggerIPDUSendWithMetaData, Dlt_CopyTxData and Dlt_TpTxConfirmation to transmit respectively confirm transmissions of I-PDUs.
            boolean DltTxPduUsesTp [0..0]: post-build-variant-value=true, set at link in variant link-time / post-build in variant post-build / pre-compile in variant pre-compile  # If set to TRUE, the PDU is transmitted using the TP API. If FALSE, the IF API is used.
            reference DltTxPduRef: post-build-variant-value=true, set at link in variant link-time / post-build in variant post-build / pre-compile in variant pre-compile, destination=Pdu  # Reference to the "global" Pdu structure to allow harmonization of handle IDs in the COM-Stack.
        container DltLogChannelAssignment [0..*]: multiplicity set at link in variant link-time / post-build in variant post-build / pre-compile in variant pre-compile, post-build-variant-multiplicity=true  # This container contains a preconfiguration of ApplicationId / ContextId pairs and their assigned log channel.
          reference DltLogChannelAssignmentSwcContextRef: post-build-variant-value=true, set at link in variant link-time / post-build in variant post-build / pre-compile in variant pre-compile, destination=DltSwcContext  # Reference to an ApplicationId/ContextId pair that is assigned to a DltLogChannel.
          reference DltLogChannelRef: post-build-variant-value=true, set at link in variant link-time / post-build in variant post-build / pre-compile in variant pre-compile, destination=DltLogChannel  # Reference to a DltLogChannel that is assigned to an ApplicationId / ContextId pair.
      container DltProtocol  # Configuration parameters for handling the specific protocol variants.
        boolean DltHeaderUseEcuId: scope=ECU, post-build-variant-value=true, set at link in variant link-time / post-build in variant post-build / pre-compile in variant pre-compile  # Corresponds to field WEID (With ECU ID). If set ECU ID shall be placed in the header, else not. | If the parameter DltGeneralNvRamRef is used this parameter defines the initial value for the corresponding NVRam entry. If the parameter DltGeneralNvRamRef is not set, Link-Time or Post-Build configuration shall be used.
        boolean DltHeaderUseSessionID: scope=ECU, post-build-variant-value=true, set at link in variant link-time / post-build in variant post-build / pre-compile in variant pre-compile  # Corresponds to field WSID (with Session ID). If set the Session ID shall be placed in the header, else not. | If the parameter DltGeneralNvRamRef is used this parameter defines the initial value for the corresponding NVRam entry. If the parameter DltGeneralNvRamRef is not set, Link-Time or Post-Build configuration shall be used.
        boolean DltHeaderUseTimestamp: scope=ECU, post-build-variant-value=true, set at link in variant link-time / post-build in variant post-build / pre-compile in variant pre-compile  # Corresponds to field WTMS (With Timestamp). If set the timestamp shall be placed in the header, else not. | If the parameter DltGeneralNvRamRef is used this parameter defines the initial value for the corresponding NVRam entry. If the parameter DltGeneralNvRamRef is not set, Link-Time or Post-Build configuration shall be used.
        boolean DltUseExtHeaderInNonVerbMode: scope=ECU, post-build-variant-value=true, set at link in variant link-time / post-build in variant post-build / pre-compile in variant pre-compile  # Non Verbose messages (opposed to verbose messages) do not need an extended header. If this flag is set to true the extended header shall also be used for non verbose messages. | If DltGeneralNvRAMSupport is enabled this parameter is the initial value for the corresponding NVRam entry. If DltGeneralNvRAMSupport is not set, Link-Time or Post-Build configuration shall be used.
        boolean DltUseVerboseMode [0..0]: scope=ECU, post-build-variant-value=true, set at link in variant link-time / post-build in variant post-build / pre-compile in variant pre-compile  # If this flag is set to TRUE, the payload shall be transmitted in verbose mode, else the payload shall be transmitted in none-verbose mode.
        choice container DltEcuId  # This is a choice container to choose between a EcuId value or a callout to get the EcuId.
          container DltEcuIdCalloutChoice [0..1]  # EcuId via user defined callout.
            function name DltEcuIdCallout: scope=ECU, set at pre-compile  # If this choice is used the EcuId shall be fetched by calling the here configured callout function.
          container DltEcuIdValueChoice [0..1]  # EcuId value configuration
            string DltEcuIdValue: scope=ECU, set at pre-compile  # If this choice is used the EcuId shall be taken from the configured string. | This is the name of the ECU for use within the Dlt protocol. If you want to use a number representation type this as character.
      container DltRxPdu [0..*]: multiplicity set at link in variant link-time / post-build in variant post-build / pre-compile in variant pre-compile, post-build-variant-multiplicity=true  # Contains the Pdu IDs to be used for Dlt control messages reception.
        integer DltRxPduId [0..1]: 0..65535, scope=ECU, multiplicity set at link in variant link-time / post-build in variant post-build / pre-compile in variant pre-compile, post-build-variant-multiplicity=true, post-build-variant-value=true, set at link in variant link-time / post-build in variant post-build / pre-compile in variant pre-compile, symbolic-name-value=true  # The numerical value used as the ID of this I-PDU. The DltRxPduHandleId is required by the API calls Dlt_RxIndication, Dlt_TpRxIndication, Dlt_StartOfReception and Dlt_CopyRxData to receive I-PDUs from the PduR.
        boolean DltRxPduUsesTp [0..0]: post-build-variant-value=true, set at link in variant link-time / post-build in variant post-build / pre-compile in variant pre-compile  # If set to TRUE, the PDU is received using the TP API. If FALSE, the IF API is used.
        reference DltRxPduRef: post-build-variant-value=true, set at link in variant link-time / post-build in variant post-build / pre-compile in variant pre-compile, destination=Pdu  # Reference to the "global" Pdu structure to allow harmonization of handle IDs in the COM-Stack.
      container DltTraceStatusSetting  # Contains settings for trace status
        boolean DltDefaultTraceStatus: scope=ECU, post-build-variant-value=true, set at link in variant link-time / post-build in variant post-build / pre-compile in variant pre-compile  # This is the effective trace status used in case no filter matches the given ApplicationId and ContextId. This can be seen as a fall-through filter definition with wildcard for ApplicationId and ContextId, which will be used, when no other filter matches.
        container DltTraceStatusAssignment [0..*]: multiplicity set at link in variant link-time / post-build in variant post-build / pre-compile in variant pre-compile, post-build-variant-multiplicity=true  # This container contains a preconfiguration of ApplicationId / ContextId pairs and their assigned trace status.
          boolean DltTraceStatus: scope=ECU, post-build-variant-value=true, set at link in variant link-time / post-build in variant post-build / pre-compile in variant pre-compile  # Trace status for the given ApplicationId/ContextId tuple.
          reference DltTraceStatusAssignmentSwcContextRef: post-build-variant-value=true, set at link in variant link-time / post-build in variant post-build / pre-compile in variant pre-compile, destination=DltSwcContext  # Reference to an ApplicationId/ContextId pair to which a DltTraceStatus is assigned.
    container DltGeneral  # This container lists all the global Dlt functionalities that can be enabled or disabled at pre-compile time to optimize resource consumption.
      boolean DltGeneralDevErrorDetect: set at pre-compile  # If the Default Error Tracer (Det) shall be used, this parameter shall be set to TRUE. Otherwise, it shall be set to FALSE.
      boolean DltGeneralInjectionSupport: set at pre-compile, default-value=false  # Enables or disables the Dlt Injection feature.
      boolean DltGeneralRegisterContextNotification: set at pre-compile, default-value=false  # If this parameter is set to TRUE, a Dlt Control Message is sent every time a SWC registeres and/or de-registers at/from the Dlt Module. Else, this notification is not sent.
      boolean DltGeneralRxDataPathSupport: set at pre-compile, default-value=false  # Enables or disables the Rx Data Path to control the Dlt module.
      float DltGeneralStartUpDelayTimer [0..1]: 0.001..10, multiplicity set at pre-compile, set at pre-compile  # Configurable delay in s of starting the transmission of Log and Trace messages after the Dlt module has been initialized.
      boolean DltGeneralTimeStampSupport: set at pre-compile, default-value=false  # If a Time Stamp shall be added to the Dlt messages, this configuration parameter shall be set to TRUE. | Otherwise, it shall be set to FALSE.
      boolean DltGeneralTrafficShapingSupport: set at pre-compile, default-value=true  # Enables or disables the TrafficShaping feature to limit the maximum bandwidth for Dlt messages. If enabled, the maximum bandwidth can be configured per LogChannel.
      boolean DltGeneralVersionInfoApi [0..1]: multiplicity set at pre-compile, set at pre-compile  # Pre-processor switch for enabling Version Info API support. | * True: version information API activated * False: version information API deactivated
      reference DltGeneralGptChannelRef [0..1]: multiplicity set at pre-compile, set at pre-compile, destination=GptChannelConfiguration  # If TimeStampSupport is used the Dlt module shall fetch the time from the Gpt module by calling Gpt_GetTimeElapsed with the here referenced GptChannel. The tick duration can be deduced from the GptChannelTickFrequency parameter of the GptChannelConfiguration container. This is necessary to calculate the microsecond resolution timestamp output in the Dlt message. | A GPT timer shall be used which starts with value 0 at ECU start-up according to the PRS Dlt Protocol Specification.
      reference DltGeneralNvRamRef [0..1]: multiplicity set at pre-compile, set at pre-compile, destination=NvMBlockDescriptor  # If the Dlt module shall be able to store modified parameters during runtime persistently, this reference shall be set and shall point to the NvmBlock.
      reference DltGeneralStbMTimeBaseRef [0..1]: multiplicity set at pre-compile, set at pre-compile, destination=StbMSynchronizedTimeBase  # If TimeStampSupport is used the Dlt module shall fetch the time from the StbM module by calling StbM_GetCurrentTime with the here referenced StbMSynchronizedTimeBase.
      container DltRbGeneral  # This container contains RB specific configuration parameters.
        boolean DltRbComSupportSoADPduHeaderEnable [0..1]: origin=RB:AR45.2.0.0:2020-08-, set at pre-compile, default-value=true  # This parameter is used to indicate whether PDU Header is enabled or not when SoAD is used as transport protocol. Set to true if PDU header is enabled, Set to false when PDU header is disabled e.g, when DltViewer is used.
        integer DltRbMaxControlSize [0..1]: 0..254, origin=RB:42.9.0.0:2020-09-22, set at pre-compile, default-value=43  # This RB-specific configuration parameter specifies the maximum size in bytes of a control message that DLT can receive. This parameter shall only be updated if the project uses DLT viewer and Trace message is also sent along with Log Message.
        float DltRbTaskTime: 0.001..0.1, origin=RB:42.2.0.0:2017-07-04, set at pre-compile  # This RB-specific configuration parameter specifies Dlt task time. It allows to configure the time for the periodic cyclic task. Please note: this configuration value shall be equal to the value in the Basic Software Scheduler configuration of the RTE module. The AUTOSAR configuration standard is to use SI units, so this parameter is defined as float value in seconds. Exactly one task time must be specified per configuration.
        boolean DltRbImplementVfbTrace [0..1]: origin=RB:AR47.2.1.0:2022-12-13, set at pre-compile, default-value=false  # This parameter is used to indicate whether VFB trace is used or not.It is used to enable the VFB trace functionality
        integer DltRbVFBHooks_ArrayLength [0..1]: 1..65535, origin=RB:AR47.2.1.0:2022-12-13, set at link in variant link-time / pre-compile in variant post-build+pre-compile, default-value=1  # Size of buffer in Byte. Hint: To be able to trace the Hook Parameters, an array is needed, The length of this array which is common for all hooks, Is The maximum value between all the hook functions parameters Length. Example Hoohfunction1(Parameter1,Parameter2), hookfunction2(Parameter3,Parameter4) DltVFBHooks_ArrayLength = MAX of((Sizeof(Parameter1) + Sizeof(Parameter2)) and ((Sizeof(Parameter1) + Sizeof(Parameter2)))), Sizeof(Parameter1) = 10 , Sizeof(Parameter2) = 5 , Sizeof(Parameter3)=10 , Sizeof(Parameter4)=6 then DltVFBHooks_ArrayLength = 16 .
        container DltRbVfbTrace [0..*]  # All functions to trace from the VFB by the Dlt.
          function name DltRbVfbTraceFunction: origin=RB:AR47.2.1.0:2022-12-13, set at pre-compile  # The Dlt generator shall enable VFB tracing for a given hook function when there is a #define in the Dlt-VFB configuration header file for the hook function name and tracing is globally enabled. | Example: #define Dlt_Rte WriteHook i1 p1 a Start. Also the corresponding function shall be generated. The exact argument description for the function is to take from the provieded BSWModudulDescription from the RTE module.
          boolean Activate: origin=RB:AR47.2.1.0:2022-12-13, set at pre-compile  # Active or deactive the hook function.
          function name DltRbVfbHookContexID [0..1]: origin=RB:AR47.2.1.0:2022-12-13, set at pre-compile  # 4 letter as ContexId, this ContextID will be send to the Viewr and ApplicationId is always "VFBT". | Example: "ESP1"
          foreign reference DltRbBswModuleEntryRef [0..1]: origin=RB:AR47.2.1.0:2022-12-13, set at pre-compile, destination-type=BSW-MODULE-ENTRY  # Foreign reference to the BSWModuleEntry describing the trace function implementation.
          container ArgumentParameter [0..20]  # Hook functions parameter | Note that this container definition does not explicitly define a symbolic name parameter. Instead, the short name of the container will be used in the Ecu Configuration Description to specify the symbolic name of the SessionId Parameter.
            string ImplementationDataType: origin=RB:AR47.2.1.0:2022-12-13, set at link in variant link-time / post-build in variant post-build / pre-compile in variant pre-compile  # Type Of the Parameter e.g. unit8, uint16, uint32 etc.
            string ImplementationDataTypeCategory: origin=RB:AR47.2.1.0:2022-12-13, set at link in variant link-time / post-build in variant post-build / pre-compile in variant pre-compile  # Implementation Type Category.
            integer ArrayLength [0..1]: 0..32767, origin=RB:AR47.2.1.0:2022-12-13, set at link in variant link-time / pre-compile in variant post-build+pre-compile  # Lenght of the Array . | Unit: byte
            enumeration Direction: {IN, OUT, INOUT}, origin=RB:AR47.2.1.0:2022-12-13, set at pre-compile  # Determines the Direction of the parameter.
    container DltSwc [0..*]: multiplicity set at link in variant link-time / post-build in variant post-build / pre-compile in variant pre-compile, post-build-variant-multiplicity=true  # Contains necessary configuration parameters of the AUTOSAR Dlt module to interact with SWCs.
      integer DltSwcSessionId: 0..18446744073709551615, set at link in variant link-time+post-build / pre-compile in variant pre-compile  # An ECU wide unique ID to identify the port a SWC (instance) uses.
      boolean DltSwcSupportLogLevelAndTraceStatusChangeNotification: set at link in variant link-time+post-build / pre-compile in variant pre-compile, default-value=false  # Flag indicating, whether Dlt has to provide a R-Port for the notification of the SWC about LogLevel or TraceStatus changes.
      integer MaxSwcLogMessageLength: 8..65535, set at link in variant link-time+post-build / pre-compile in variant pre-compile  # Defines the maximum allowed length (uint16) for LogMessages. The upper limit for the range of this parameter is currently defined by the range of the data type. The actual upper limit for the range of this parameter is identical to the maximum length of all configured Dlt log or trace messages, which is known when all log or trace messages are configured.
      integer MaxSwcTraceMessageLength: 8..65535, set at link in variant link-time+post-build / pre-compile in variant pre-compile  # Defines the maximum allowed length (uint16) for TraceMessages.The upper limit for the range of this parameter is currently defined by the range of the data type. The actual upper limit for the range of this parameter is identical to the maximum length of all configured Dlt log or trace messages, which is known when all log or trace messages are configured.
      container DltSwcContext [0..*]: multiplicity set at link in variant link-time / post-build in variant post-build / pre-compile in variant pre-compile, post-build-variant-multiplicity=true  # This container contains the configuration of ApplicationId / ContextId pairs which are supported by this SWC.
        string DltSwcApplicationId: post-build-variant-value=true, set at link in variant link-time / post-build in variant post-build / pre-compile in variant pre-compile  # Abbreviation for the SWC (4 characters)
        string DltSwcContextId: post-build-variant-value=true, set at link in variant link-time / post-build in variant post-build / pre-compile in variant pre-compile  # Abbreviation for the ContextId (4 characters)
