AUTOSAR XML (schema 4-2-2)
package /RB/RBA/rba_MemLib/EcucModuleDefs
  module definition rba_MemLib [0..1]: category=VENDOR_SPECIFIC_MODULE_DEFINITION, variants pre-compile  # Memory: Library | Configuration of the rba_MemLib component
    container rba_MemLibCentral [0..1]: multiplicity set at pre-compile  # Memory Library Central Settings | Central configuration parameters applying to the whole Mem stack
      boolean rba_MemLibCentralEnableMeas [0..1]: multiplicity set at pre-compile, origin=RB:19.0.0:2021-10-21, set at pre-compile  # Memory Library Enable Measurements | Enable or disable the measurement capability for the Mem stack components (via calibratrion tooling). Please note that it is required to set parameter rba_MemLibEnumFlexible correctly.IF function is enabled.
      boolean rba_MemLibCentralEnablePrototype [0..1]: multiplicity set at pre-compile, origin=RB:14.1.0:2019-09-20, set at pre-compile, default-value=false  # Memory Library Enable Prototypes | Enable or disable prototypes in the Memstack. IF THIS IS SET TO TRUE THEN THE MEM PACKAGE CAN NO LONGER BE USED FOR SERIES PRODUCTION!
      boolean rba_MemLibCrcSupport [0..1]: multiplicity set at pre-compile, origin=RB:17.1.0:2021-04-01, set at pre-compile  # Memory Library Crc Support | Enable or disable the Crc calculation support function. Automatic Detection when Fee is available.
      boolean rba_MemLibEnableBypassMem [0..1]: multiplicity set at pre-compile, origin=RB:19.0.0:2021-12-03, set at pre-compile  # Memory Library Enable MemSet/Copy Bypass | Enable or disable the bypass functionality of the MemLib internal MemSet/MemCopy/MemCompare functions. If enabled then the integrator has to provide the mapping in rba_MemLib_Cfg_Mem_Callout.h.
      boolean rba_MemLibEnableCodeSizeOptimize [0..1]: multiplicity set at pre-compile, origin=RB:19.0.0:2021-12-03, set at pre-compile  # Memory Library Enable CodeSize optimization | Enable or disable the code size optimization (versus speed) of the internal routines
      boolean rba_MemLibEnableMemAccBuild [0..1]: multiplicity set at pre-compile, origin=RB:19.1.0:2022-03-22, set at pre-compile  # Memory Library Enable MemAcc Build | Enable or disable the use of MemAcc in the build instead of Fls/Eep. If enabled: Fls will be bypassed/eventually simulated by MemAcc. If disabled: Fls will be build, MemAcc is not used | This switch is intended for the Fls/MemAcc layer. If enabled, the user of this layer still has the possibility to selected between the simulated Fls or the MemAcc interfaces
      boolean rba_MemLibEnableMemAccUsage [0..1]: multiplicity set at pre-compile, origin=RB:19.1.0:2022-03-22, set at pre-compile  # Memory Library Select MemAcc Usage | Enable or disable the usage of the MemAcc on higher-level modules (Fee/Ea etc). If enabled: Higher-Level modules should use MemAcc interface. If disabled: Higher-Level modules shall NOT use MemAcc interface. | This switch is intended for the Fee/Ea layer. It is evaluated only if rba_MemLibEnableMemAcc=true.
      boolean rba_MemLibEnableMemMapGeneration [0..1]: multiplicity set at pre-compile, origin=RB:19.1.0:2022-03-22, set at pre-compile  # MemLib Enable MemMap Generation | Enable or disable the generation of MemMap-files for the complete MemStack (if disabled the related MemMap files have to be manually be derived from provided templates). Default: enabled
      boolean rba_MemLibEnableSpecialModulo [0..1]: multiplicity set at pre-compile, origin=RB:19.0.0:2021-12-03, set at pre-compile  # Memory Library Enable Special Modulo Calculation | Enable or disable the special modulo calculation instead of the standard C-function "%". Attention: this is only useful in some special uC architectures.
      boolean rba_MemLibEnableTimer [0..1]: multiplicity set at pre-compile, origin=RB:19.0.0:2021-11-29, set at pre-compile  # Memory Library Enable Timer Usage | Enable or disable of Timer integration in MemStack. This is necessary to enable for some timeout functions within the MemStack. If enabled, the integrator has to provide the interface to the physical timer via rba_MemLib_Cfg_Timer_Callout.h
      boolean rba_MemLibEnumFlexible [0..1]: multiplicity set at pre-compile, origin=RB:19.0.0:2021-10-25, set at pre-compile  # Memory Library use flexible enum size (1/2/4byte) | Enum can have a compiler or even option specific behavior.In order to define the behavior it is necessary to select between: FALSE = fixed size=4byte (C-Standard) TRUE = flexible size (1/2/4 byte) - Note: This setting is for a target compiler and not for a simulation environment. Note: parameter only needed if the measurement feature is enabled.
      enumeration rba_MemLibForcedArRelease [0..1]: {AR42_Rev2, AR45_Rev0, AR46_Rev0, AR47_Rev0, AR48_Rev0}, multiplicity set at pre-compile, origin=RB:18.0.0:2021-05-28, set at pre-compile  # MemLib Forced AR Version | Per default the AR version is determined from EcuC component. However it is also possible to overrule this setting for the MemStack by using this selection.
      boolean rba_MemLibInternalUsage [0..1]: multiplicity set at pre-compile, origin=RB:16.1.0:2020-09-12, set at pre-compile, with-auto=true, default-value=false  # MemLib Internal usage information | (do not activate)
      boolean rba_MemLibVersionInfoApi [0..1]: multiplicity set at pre-compile, origin=RB:15.0.0:2019-10-21, set at pre-compile, default-value=false  # MemLibVersionInfoApi | Enable or disable version information
    container rba_MemLibPublished [0..1]: multiplicity set at pre-compile  # Memory Library Published Parameters | Generated configuration parameters which can be used by other Mem components
      integer rba_MemLibPublishedARMajorVersion [0..1]: multiplicity set at pre-compile, origin=RB:15.0.0:2019-11-25, set at pre-compile  # MemLib Published AR Release Major Version | Generated AR release major version info
      integer rba_MemLibPublishedARMinorVersion [0..1]: multiplicity set at pre-compile, origin=RB:15.0.0:2019-11-25, set at pre-compile  # MemLib Published AR Release Minor Version | Generated AR release minor version info
      integer rba_MemLibPublishedARRevisionVersion [0..1]: multiplicity set at pre-compile, origin=RB:15.0.0:2019-11-25, set at pre-compile  # MemLib Published AR Release Revision Version | Generated AR release revision version info
      string rba_MemLibPublishedArxmlVersion [0..1]: multiplicity set at pre-compile, origin=RB:19.0.0:2021-11-25, set at pre-compile  # MemLib Published arxml header version | String used to generate the arxml files with a dedicated DTD version. Example: 4-0-3, 4-2-2
      boolean rba_MemLibPublishedEnableMeas [0..1]: multiplicity set at pre-compile, origin=RB:19.0.0:2021-10-21, set at pre-compile  # MemLib Published Enable Measurement | Enable or disable of Measurement in MemStack components (via calibration tooling)
      boolean rba_MemLibPublishedEnableMemAccBuild [0..1]: multiplicity set at pre-compile, origin=RB:19.1.0:2022-03-22, set at pre-compile  # MemLib Published Enable MemAcc Build | Enable or disable the use of MemAcc in build instead of Fls/Eep layer. If enabled: Fls will be bypassed/eventually simulated by MemAcc. If disabled: Fls will be build, MemAcc is not used | This switch is intended for the Fls/MemAcc layer. If enabled, the user of this layer still has the possibility to selected between the simulated Fls or the MemAcc interfaces
      boolean rba_MemLibPublishedEnableMemAccUsage [0..1]: multiplicity set at pre-compile, origin=RB:19.1.0:2022-03-22, set at pre-compile  # MemLib Published Select MemAcc Usage | Enable or disable the usage of the MemAcc on higher-level modules (Fee/Ea etc). If enabled: Higher-Level modules should use MemAcc interface. If disabled: Higher-Level modules shall NOT use MemAcc interface. | This switch is intended for the Fee/Ea layer.
      boolean rba_MemLibPublishedEnableMemMapGeneration [0..1]: multiplicity set at pre-compile, origin=RB:19.1.0:2022-03-22, set at pre-compile  # MemLib Published MemMap Generation | Enable or disable the generation of MemMap-files for the complete MemStack (if disabled the related MemMap files have to be manually be derived from provided templates). Default: enabled
      boolean rba_MemLibPublishedEnablePrototype [0..1]: multiplicity set at pre-compile, origin=RB:15.0.0:2019-10-21, set at pre-compile  # MemLib Published Enable Prototype | Enable or disable prototype handling for the Memstack
      boolean rba_MemLibPublishedEnableRte [0..1]: multiplicity set at pre-compile, origin=RB:16.1.0:2020-09-12, set at pre-compile  # MemLib Published Enable Rte | Indication whether the Rte is considered to be enabled or not.
      boolean rba_MemLibPublishedEnableRteFound [0..1]: multiplicity set at pre-compile, origin=RB:17.1.0:2021-02-16, set at pre-compile  # MemLib Published Enable Rte Switch Found | Indication whether the Rte is actively enabled or disabled via EcuC
      boolean rba_MemLibPublishedEnableTimer [0..1]: multiplicity set at pre-compile, origin=RB:19.0.0:2021-11-29, set at pre-compile  # MemLib Published Enable Timer Usage | Enable or disable of Timer integration in MemStack. If enabled, the integrator has provided the timer low-level interfaces as integration code.
      boolean rba_MemLibPublishedEnableVecu [0..1]: multiplicity set at pre-compile, origin=RB:16.1.0:2020-09-12, set at pre-compile  # MemLib Published Force Enable Vecu | true=Forced unconditional enable of the Vecu-support within the Memstack (via Ecuc), false=per default not actived, but activatable via compiler switch RBA_VECU_ENABLED.
      integer rba_MemLibPublishedSizeEnum16 [0..1]: multiplicity set at pre-compile, origin=RB:19.0.0:2021-10-25, set at pre-compile  # MemLib Published enum16 size | Size of an 8bit enum (1byte or 4 bytes) of the target controller
      integer rba_MemLibPublishedSizeEnum8 [0..1]: multiplicity set at pre-compile, origin=RB:19.0.0:2021-10-25, set at pre-compile  # MemLib Published enum8 size | Size of an 16bit enum (2byte or 4 bytes) of the target controller
      integer rba_MemLibPublishedSwMajorVersion [0..1]: multiplicity set at pre-compile, origin=RB:15.0.0:2019-11-25, set at pre-compile  # MemLib Published Sw Major Version | Generated software major version info
      integer rba_MemLibPublishedSwMinorVersion [0..1]: multiplicity set at pre-compile, origin=RB:15.0.0:2019-11-25, set at pre-compile  # MemLib Published Sw Minor Version | Generated software minor version info
      integer rba_MemLibPublishedSwPatchVersion [0..1]: multiplicity set at pre-compile, origin=RB:15.0.0:2019-11-25, set at pre-compile  # MemLib Published Sw Patch Version | Generated software patch version info
    container rba_MemLibValidated [0..1]: multiplicity set at pre-compile  # Memory Library Validation Parameters | Generated configuration parameters which can be used by other Mem components
      integer rba_MemLibValidatedSwMajorVersion [0..1]: 0..100, multiplicity set at pre-compile, origin=RB:21.0.0:2022-12-01, set at pre-compile  # Validated Mem-SwMajorVersion | Validated software major version to check differences from an old to the current software version. The current SW-version is available in parameter rba_MemLibPublishedSwMajorVersion.
