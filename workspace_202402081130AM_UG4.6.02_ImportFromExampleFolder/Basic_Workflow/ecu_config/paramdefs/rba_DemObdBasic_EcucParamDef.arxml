AUTOSAR XML (schema 4-2-2)
package /AUTOSAR_Dem/EcucModuleDefs
  module definition Dem: category=VENDOR_SPECIFIC_MODULE_DEFINITION, refined-module-def=Dem  # Configuration of the Dem (Diagnostic Event Manager) module.
    container DemConfigSet  # This container contains the configuration parameters and sub containers of the Dem module supporting multiple configuration sets.
      container DemEventParameter  # This container contains the configuration (parameters) for events.
        boolean DemRbIgnorePFCCycleQualificationForPDTCRemoval [0..1]: origin=RB:AR45.4.1.0:2023-03-06, set at pre-compile, default-value=false  # This parameter defines whether the deletion of the permanent DTC subsequent to a code clear requires the PFC cycle qualification to be satisfied as well (see DemOBDPFCCycleRef). This parameter is relevant only for OBD relevant events and only when Permanent DTC feature is enabled (see DemMaxNumberEventEntryPermanent). | true: The PFC cycle qualification is not necessary for the PDTC removal following a code clear. false: The PFC cycle qualification is required for the PDTC removal following a code clear.
    container DemGeneral  # This container contains the configuration (parameters) of the BSW Dem.
      container DemGeneralOBD  # This container contains the Rb configuration (parameters) of the BSW Dem.
        container DemRbGeneralOBD  # This container contains the configuration (parameters) of the BSW Dem. Delete container if ObdBasic is not required.
          boolean DemRbEnableApiSignalEndOfOBDIgnitionCycle [0..1]: multiplicity set at pre-compile, origin=RB:2019-04-25, set at pre-compile, default-value=false  # This configuration switch enables or disables the functionality of the API "Dem_SignalEndOfOBDIgnitionCycle". This API can be used to explicitly signal the end of the ignition cycle. Basically this API controls the storing and visibility of Permanent DTCs (see DemRbOBDPermanentDTCVisibilityTiming). TRUE: The storing and visibility of permanent DTCs is updated when the API Dem_SignalEndOfOBDIgnitionCycle gets called. FALSE: The storing and visibility of permanent DTCs is updated when the ignition cycle is restarted (see DemRbOBDIgnitionCycleRef).
          boolean DemRbOBDCalculatePID4D [0..1]: multiplicity set at pre-compile, origin=RB:AR45.0.1.0:2021-06-07, set at pre-compile, default-value=false  # [NON-AUTOSAR] This configuration switch enables or disables the calculationf of PID4D
          boolean DemRbOBDCalculatePID4E [0..1]: multiplicity set at pre-compile, origin=RB:AR45.0.1.0:2021-06-07, set at pre-compile, default-value=false  # [NON-AUTOSAR] This configuration switch enables or disables the calculationf of PID4E
          boolean DemRbOBDDtcCodesConfigurable [0..1]: multiplicity set at pre-compile, origin=RB:AR40.8.0.0:2014-02-01, set at pre-compile, default-value=true  # This configuration switch defines whether the OBD Dtc codes are configuratble or not. If configurable, the DemDtcCode has to be entered in the DemDtcClass. If not configurable, the 2 higher bytes of the DemDtc is the OBD Dtc code.
          enumeration DemRbOBDFreezeFrameCapture [0..1]: {DEM_TRIGGER_CONFIRMEDDTC, DEM_TRIGGER_PENDINGDTC}, multiplicity set at pre-compile, origin=RB:AR40.5.0.0:2013-01-01, set at pre-compile, default-value=DEM_TRIGGER_PENDINGDTC  # [NON-AUTOSAR] This parameter defines the point in time, when the OBD freeze frame data collection is done for the initial event memory entry.
          enumeration DemRbOBDFreezeFrameVisibility [0..1]: {DEM_OBDFF_PENDING_AND_CONFIRMED_DTCS, DEM_OBDFF_CONFIRMED_DTCS}, multiplicity set at pre-compile, origin=RB:AR40.10.0.0:2015-04-02, set at pre-compile, default-value=DEM_OBDFF_CONFIRMED_DTCS  # [NON-AUTOSAR] This parameter defines the point of time, when the OBD freeze frame data is visible to scan tool tester.
          enumeration DemRbOBDPermanentDTCVisibilityTiming [0..1]: {END_OF_CYCLE, IMMEDIATELY}, multiplicity set at pre-compile, origin=RB:AR42.7.0.0:2019-11-06, set at pre-compile, default-value=IMMEDIATELY  # [NON-AUTOSAR] This configuration switch defines whether the permanent DTCs are visible immediately, or only after the next init of the Dem or at the end of Ignition Cycle.
          boolean DemRbOBDPid01MisfireMonitorForcedReady [0..1]: multiplicity set at pre-compile, origin=RB-AR45.5.0.0:2023-04-21, set at pre-compile, default-value=false  # This parameter controls whether the misfire monitoring group within PID $01 is always indicated as "ready". This parameter is relevant only for compression ignition vehicles. For spark ignition vehicles, the misfire group is automatically indicated as "ready" in PID$01, if it is supported. True: Misfire group status is forced as "ready" False: Misfire group status is not forced as "ready"
          enumeration DemRbOBDProtocol [0..1]: {DEM_RB_J1979, DEM_RB_J1979_2, DEM_RB_BOTH_PROTOCOL}, multiplicity set at pre-compile, origin=RB:RT8 2022.07:2022-07-06, set at pre-compile, default-value=DEM_RB_J1979  # This parameter defines which OBD protocol shall be used for readiness computation (1) DEM_RB_J1979 (OBD Standard) (2) DEM_RB_J1979_2 (OBDonUDS) (3) DEM_BOTH_PROTOCOL(switch between OBD standard and OBD on UDS in runtime)
          function name DemRbOBDProtocolFnc [0..1]: multiplicity set at pre-compile, origin=RB:RT8 2022.07:2022-07-06, set at pre-compile  # Specifies the name of the function which returns the OBD protocol (refer to data type DemRb_ObdProtocolType for implementation) to be used for readiness computation. This parameter is optional, but becomes mandatory if demRbOBDProtocol is set to DEM_RB_BOTH_PROTOCOL.
          boolean DemRbOBDSupportBlockingPermanentDTC [0..1]: multiplicity set at pre-compile, origin=RB-AR40.13.0.0:2016-10-04, set at pre-compile, default-value=false  # This configuration switch enables the feature to block storing of OBD DTCs to Permanent memory.CAUTION: THIS FEATURE MUST USED ONLY DURING PRODUCTION.!!! OTHERWISE OBD CONFORMITY IS VIOLATED.See document description of the callback API rba_DemObdBasic_IsPermanentDTCStorageDisabled
          boolean DemRbOBDSupportObdVariantCoding [0..1]: multiplicity set at pre-compile, origin=RB-AR40.12.0.0:2016-04-12, set at pre-compile, default-value=false  # This configuration switch enables the feature to deactivate the OBD functionality. This feature could be used for variant coding to dynamically switch an OBD project to behave like a non OBD variant. This feature only controls the MIL status. Project specific implementation is necessary. Refer the interface documentation of the API rba_DemObdBasic_IsObdDeactivatedByVariant provided as a template file.
          reference DemRbOBDonUDSFreezeFrameClassRef [0..1]: multiplicity set at post-build in variant post-build / pre-compile in variant pre-compile, post-build-variant-multiplicity=true, set at pre-compile, destination=DemFreezeFrameClass  # This reference defines the link to the freeze frame for emission related diagnostics over UDS.
          reference DemRbOBDIgnitionCycleRef [0..1]: origin=RB:2019-04-25, set at pre-compile, destination=DemOperationCycle  # References the operationCycle which denotes the OBD ignition cycle. The OBD Ignition Cycle is required to compute the ignition cycle counter. It is also used to control the visibility of Permanent DTCs (see DemRbEnableApiSignalEndOfOBDIgnitionCycle)
          reference DemRbOBDSecondIgnitionCycleRef [0..1]: origin=RB:2022-05-11, set at pre-compile, destination=DemOperationCycle  # References the operationCycle which can be used in hybrid vehicles for the fueled engine operation ignition cycle.
