AUTOSAR XML (schema 00048)
package /AUTOSAR_EthSM/EcucModuleDefs
  module definition EthSM [0..1]: category=VENDOR_SPECIFIC_MODULE_DEFINITION, refined-module-def=EthSM, variants pre-compile  # Configuration of the Ethernet State Manager
    container EthSMGeneral  # This container contains the global parameter of the Ethernet State Manager.
      boolean EthSMDevErrorDetect: set at pre-compile, default-value=false  # Switches the Default Error Tracer (Det) notification ON or OFF. | * true: detection and notification is enabled. * false: notification is disabled (detection remains active).
      boolean EthSMDummyMode: set at pre-compile  # EthSMDummyMode (currently unused) | Disables the API to the EthIf. The API to the ComM is available but the functionality is deactivated. The function calls from the ComM will be answered with the return value E_OK.
      float EthSMMainFunctionPeriod: 0..INF, set at pre-compile  # Specifies the period in seconds that the MainFunction has to be triggered with.
      boolean EthSMVersionInfoApi: set at pre-compile, default-value=false  # Enables and disables the version info API.
    container EthSMNetwork [1..*]: multiplicity set at pre-compile  # This container contains the Ethernet network-specific parameters of each Ethernet network. It also contains the reference to combination of controller and transceiver assigned to an Ethernet network.
      boolean EthSMForwardSilentCommunicationEnabled [0..0]: set at pre-compile, default-value=false  # EthSMForwardSilentCommunicationEnabled (currently unused) | Specifies if a request COMM_SILENT_COMMUNICATION shall be forwarded to the corresponding EthIfController. | If the parameter is set to TRUE and EthSM in called with COMM_SILENT_COMMUNICATION, then EthSM call the corresponding EthIfController with ETH_MODE_ACTIVE_TX_OFFLINE to reject any transmission request. Therefore, only reception handling of Ethernet frames is performed. If the parameter is set to FALSE and EthSM in called with COMM_SILENT_COMMUNICATION, then EthSM will NOT forward the call to EthIf. Therefore, transmission AND reception handling of Ethernet frames is performed.
      boolean EthSMWakeupSleepOnDatalineEnabled [0..0]: set at pre-compile, default-value=false  # EthSMWakeupSleepOnDatalineEnabled (currently unused) | Specifies if an active communication request shall be forwarded to the lower layer to trigger a wake-up on the Ethernet network, e.g. trigger a wake-up on dataline if OA TC10 compliant Ethernet hardware is used. | If the parameter is set to TRUE and EthSM in called with COMM_FULL_COMMUNICATION_WITH_WAKEUP_REQUEST, then EthSM call the corresponding EthIfController everytime with ETH_MODE_ACTIVE_WITH_WAKEUP_REQUEST to trigger an wake-up request in the lower layer.
      reference EthSMComMNetworkHandleRef: set at pre-compile, requires-symbolic-name-value=true, destination=ComMChannel  # Unique handle to identify one certain Ethernet network. Reference to one of the network handles configured for the ComM.
      reference EthSMEthIfControllerRef: set at pre-compile, requires-symbolic-name-value=true, destination=EthIfController  # Reference to EthIfCtrl container where a physical Ethernet controller and Ethernet Transceiver (optional) or Ethernet Switch (optional) or Ethernet Switch Port Group (optional) combination is configured.
      reference EthSMNetworkUserRef [1..*]: multiplicity set at pre-compile, origin=RB:42.1.0.0:2016-06-30, set at pre-compile, requires-symbolic-name-value=true, destination=EthSMNetworkUserConfig  # RB (Vendor06) specific parameter: Reference to EthSM Network user container. The referenced container has the user specific TrcvLinkStateChg function and header file.
      container EthSMDemEventParameterRefs [0..1]: multiplicity set at pre-compile  # Container for the references to DemEventParameter elements which shall be invoked using the API Dem_ReportErrorStatus in case the corresponding error occurs. The EventId is taken from the referenced DemEventParameter's DemEventId symbolic value. The standardized errors are provided in this container and can be extended by vendor-specific error references.
        enumeration EthSMRbDynCreateEvent [0..1]: {Standard, Disabled}, multiplicity set at pre-compile, origin=RB:42.3.4.0:2017-30-10, set at pre-compile, default-value=Disabled  # RB (Vendor06) Selects the way how the EthSM DemEvents are created. If set to "Disabled" no DemEvent is automatically created. If configured to "Standard", the reference to a DemEvent is also automatically created and shall therefore not to be set manually.
        reference ETHSM_E_LINK_DOWN [0..1]: multiplicity set at pre-compile, set at pre-compile, requires-symbolic-name-value=true, destination=DemEventParameter  # Reference to configured DEM event to report bus off errors for this Eth network.
    container EthSMNetworkUserConfig [1..*]: multiplicity set at pre-compile  # RB (Vendor06) specific container: This container contains configuration of EthSM Network Users.
      string EthSMNetworkUserHeaderFileName [0..1]: multiplicity set at pre-compile, origin=RB:42.1.0.0:2016-06-30, set at pre-compile, max-length=32, min-length=1  # RB (Vendor06) specific parameter: This parameter specifies the name of the header file containing the definition of the User_TrcvLinkStateChg function.The range of characters is 1 to 32. This parameter shall only be configurable if NetworkUserType is set to CDD.
      enumeration EthSMNetworkUserType: {CDD, TCPIP}, origin=RB:42.1.0.0:2016-06-30, set at pre-compile  # RB (Vendor06) specific parameter: This parameter specifies the EthSM network user module. | * TCPIP : Transmission Control Protocol / Internet Protocol (TcpIp is currently a mandatory module for EthSM and thus one and only one EthSMNetworkUser of type TCPIP shall be configured in EthSMNetworkUserConfig). * CDD : Complex Device Driver (for example, EthTSyn is a CDD, it is possible to configure 0..* Complex Device Drivers in EthSMNetworkUserConfig).
      function name EthSMUserTrcvLinkStateChgFunction [0..1]: multiplicity set at pre-compile, origin=RB:42.1.0.0:2016-06-30, set at pre-compile  # RB (Vendor06) specific parameter: This parameter defines the name of the User_TrcvLinkStateChg function of the Network User module. This parameter shall only be configurable if NetworkUserType is set to CDD.
