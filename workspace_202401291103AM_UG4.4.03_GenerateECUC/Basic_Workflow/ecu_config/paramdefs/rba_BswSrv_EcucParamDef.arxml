AUTOSAR XML (schema 00048)
package /RB/RBA/rba_BswSrv/EcucModuleDefs
  module definition rba_BswSrv [0..1]: category=VENDOR_SPECIFIC_MODULE_DEFINITION, variants pre-compile  # BswLib BswSrv | BswSrv config package
    container rba_BswSrv_Config [0..1]  # Configuration data set | Configuration data of BswSrv
      multiline string rba_BswSrv_Config_Compatibility [0..1]: multiplicity set at pre-compile, origin=RB:0.1.0:2022-09-07, set at pre-compile  # Compatibility Configuration | User can configure this parameter by entering the multiline string manually, if needed. This configuration is added for compatibility.
      boolean rba_BswSrv_Config_Compiler_Lib_Support [0..1]: multiplicity set at pre-compile, origin=RB:0.1.0:2022-08-23, set at pre-compile, default-value=false  # rba_BswSrv_Config_Compiler_Library_Support | Defines if Compiler Library Optimisation is enabled or not.
      multiline string rba_BswSrv_Config_Disable_Interrupt [0..1]: multiplicity set at pre-compile, origin=RB:0.1.0:2022-12-12, set at pre-compile  # Disable Interrupt | configurable macro which can be mapped to Os functions to disable interrupt
      boolean rba_BswSrv_Config_Disable_Lock_support [0..1]: multiplicity set at pre-compile, origin=RB:0.1.0:2022-08-23, set at pre-compile, default-value=true  # Disable Lock support | Macro to check Lock support enabled or disabled. If it is set to true, Lock support disabled.Configure ONLY for BootCtrl, or possibly CB projects. Removes all interrupt suspend and spinlock interfaces. If it is set to false then lock support enabled
      multiline string rba_BswSrv_Config_Enable_Interrupt [0..1]: multiplicity set at pre-compile, origin=RB:0.1.0:2022-12-12, set at pre-compile  # Enable Interrupt | configurable macro which can be mapped to Os functions to enable interrupt
      multiline string rba_BswSrv_Config_GetReturnAddress [0..1]: multiplicity set at pre-compile, origin=RB:0.1.0:2022-12-19, set at pre-compile  # Get return address function | This is function definition of rba_BswSrv_GetReturnAddress(). User needs to enter the proper function definition otherwise it may cause build error and functional issue.
      multiline string rba_BswSrv_Config_Get_Core_Id [0..1]: multiplicity set at pre-compile, origin=RB:0.1.0:2022-12-12, set at pre-compile  # Core Id | This can be configured to project specifc function to return core id
      multiline string rba_BswSrv_Config_Get_Sys_Tick [0..1]: multiplicity set at pre-compile, origin=RB:0.1.0:2022-12-12, set at pre-compile  # System Tick | This can be configured to project specifc function to get system ticks. This is mandatory configuration if rba_BswSrv_Config_Log_Level is greater than 0.
      multiline string rba_BswSrv_Config_Include_Header [0..*]: multiplicity set at pre-compile, origin=RB:0.1.0:2023-02-01, set at pre-compile  # Header File Inclusion | This is used to include the header file in the rba_BswSrv_Cfg.h file. User needs to enter the filename with file extension. E.g. stdio.h
      integer rba_BswSrv_Config_Log_Level [0..1]: multiplicity set at pre-compile, origin=RB:0.1.0:2022-12-12, set at pre-compile, default-value=0  # Log Level | Defines Logging Level. If it is set as 0, no logging. If it is set as 1,logging of locks and interrupts for each core and interrupt suspend time log can be activated at runtime. If it is set as 2,logging of locks and interrupts for each core and top 10 log of interrupt suspend time can be activated at runtime. If it is set as 3,logging for each lock type and it is For debugging only, because it needs a lot of runtime.
      boolean rba_BswSrv_Config_Machine_Support_64bit [0..1]: multiplicity set at pre-compile, origin=RB:0.1.0:2022-08-23, set at pre-compile, default-value=false  # rba_BswSrv_Config_Machine_64bit_Support | Defines if the Machine support 64BIT Operations like memset_64, memcpy_64 and memcompare_64 is enabled or not.
      multiline string rba_BswSrv_Config_Mcu_Perform_Reset [0..1]: multiplicity set at pre-compile, origin=RB:0.1.0:2023-02-22, set at pre-compile  # MCU Perform Reset | This can be configured to project specifc function to call the mcu reset function.
      multiline string rba_BswSrv_Config_PrvTryToGetLock [0..1]: multiplicity set at pre-compile, origin=RB:0.1.0:2022-12-19, set at pre-compile  # Atomic test and set | This is function definition of rba_BswSrv_PrvTryToGetLock(). User needs to enter the proper function definition otherwise it may cause build error and functional issue.
      multiline string rba_BswSrv_Config_PrvWriteLock [0..1]: multiplicity set at pre-compile, origin=RB:0.1.0:2022-12-19, set at pre-compile  # Store to allow atomic test and Set | This is function definition of rba_BswSrv_PrvWriteLock(). User needs to enter the proper function definition otherwise it may cause build error and functional issue.
    container rba_BswSrv_FifoConfig [0..1]  # Settings related to "Lock-free" fifo's | Configuration settings of all "lock-free" fifo's
      container rba_BswSrv_Fifo [0..4096]  # Configuration of specific "lock-free" fifo | Configuration of a specific lock-free fifo.
        string rba_BswSrv_FifoId: origin=RB:0.1.0:2011-11-17, set at pre-compile, min-length=1, regular-expression=^[a-zA-Z0-9_]+$  # Fifo identifier | Identifier is used to select specific FIFO. This identifer must be unique (case insensitive). Identifiers are used as: - suffix in FIFO functions and variables - upper-case'd-infix in macro names For the 2 FIFO IDs 'foo' and 'Foo' there would be for example a macro name conflict because of the same 'FOO' suffix.
        integer rba_BswSrv_FifoSize [1..*]: 1.., origin=RB:0.1.0:2011-11-17, set at pre-compile  # Fifo Size | Set a minimum size for the FIFO in Bytes. Please configure only 1 size per FIFO. The multiplicity '*' is used here to be able to detect FIFO duplicates.
