AUTOSAR XML (schema 4-2-2)
package /AUTOSAR_Det/SwComponentTypes
  service sw component type Det
    behavior IntBeh_Det
      runnable Det_ReportError: arguments=[symbol=ModuleId, symbol=InstanceId, symbol=ApiId, symbol=ErrorId], can-be-invoked-concurrently=true
      runnable Det_ReportRuntimeError: arguments=[symbol=ModuleId, symbol=InstanceId, symbol=ApiId, symbol=ErrorId], can-be-invoked-concurrently=true
      runnable Det_ReportTransientFault: arguments=[symbol=ModuleId, symbol=InstanceId, symbol=ApiId, symbol=FaultId], can-be-invoked-concurrently=true
package /AUTOSAR_Det/SwcImplementations
  swc implementation Impl_Det: programming-language=C, sw-version=5.0.0, vendor-id=6, behavior=IntBeh_Det
    code-descriptors:
      code CodeDescr_Det: artifact-descriptors=autosar-engineering-object={short-label=Code_0, category=SWSRC}
    resource consumption Det_ResourceConsumption
      memory section Det_CODE: prefix=Det, sw-addrmethod=CODE, symbol=CODE
      section name prefix Det
package /AUTOSAR_Det/PortInterfaces
  client server interface DETService: is-service=true
    operation ReportError: possible-error=E_OK
      arg ApiId: type=uint8, direction=IN
      arg ErrorId: type=uint8, direction=IN
    operation ReportRuntimeError: possible-error=E_OK
      arg ApiId: type=uint8, direction=IN
      arg ErrorId: type=uint8, direction=IN
    operation ReportTransientFault: possible-error=E_OK
      arg ApiId: type=uint8, direction=IN
      arg FaultId: type=uint8, direction=IN
    error E_OK: error-code=0
