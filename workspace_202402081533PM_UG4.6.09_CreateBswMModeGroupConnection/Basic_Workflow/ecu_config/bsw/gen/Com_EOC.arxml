AUTOSAR XML (schema 4-2-2)
package /AUTOSAR_Com/TimingExtensions
  bsw module timing Com_BswModuleTiming: behavior=BswInternalBehavior
    timing-requirements:
      execution order constraint EOC_EcuM_Init: execution-order-constraint-type=ORDINARY-EOC, is-event=false, permit-multiple-references-to-ee=false
        ordered-elements:
          eoc executable entity ref EOCEERef_CE_Com_Init: bsw-module-instance=Com, executable=CE_Init
      execution order constraint EOC_T_xxms: execution-order-constraint-type=ORDINARY-EOC, is-event=true
        ordered-elements:
          eoc event ref EOCEventRef_Com_0: bsw-module-instance=Com, event=EV_SE_MainFunctionRx_ComMainFunctionRx, successor=EOCEventRef_Com_1
          eoc event ref EOCEventRef_Com_1: bsw-module-instance=Com, event=EV_SE_MainFunctionTx_ComMainFunctionTx
