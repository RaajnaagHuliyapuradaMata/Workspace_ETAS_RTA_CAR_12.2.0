AUTOSAR XML (schema 00048)
package /AUTOSAR_Icu/EcucModuleDefs
  module definition Icu [0..1]: category=VENDOR_SPECIFIC_MODULE_DEFINITION, post-build-variant-support=true, refined-module-def=Icu, variants pre-compile  # MCAL IcuDriver | Configuration of the MCAL module "Input Capture Unit" for pwm input signals.
    container IcuConfigSet  # Channel configuration data set | Defines one data set of post-build configuration. Which of these data sets is actually active is controlled by EcuM. Data sets can only be switched at initialization time.
      container IcuChannel [1..1000]: multiplicity set at pre-compile, post-build-variant-multiplicity=true  # Channel | Configuration of a single digital input/output port, consisting of channels and possible channel groups.
        string Icu0RbCustSpecName [0..1]: multiplicity set at pre-compile, origin=RB:0.6.0:2013-02-20, post-build-variant-multiplicity=true, post-build-variant-value=true, set at pre-compile, max-length=32, min-length=1  # Customer-specific name (opt.) | Customer-specific name of this signal. If present, this name is given in the report file additionally
        enumeration IcuDefaultStartEdge: post-build-variant-value=true, set at pre-compile  # Default start edge | Configures the default-activation-edge which shall be used for this channel. It can be overwritten later by the call of service Icu_SetActivationCondition(). In case the Measurement Mode is "IcuSignalMeasurement" and the properties "DutyCycle" or "Period" are set, the edge configured here is used as equidistant Default Period Start Edge.
          ICU_BOTH_EDGES  # Both Edges
          ICU_FALLING_EDGE  # Falling Edge
          ICU_RISING_EDGE  # Rising Edge
        enumeration IcuMeasurementMode: post-build-variant-value=true, set at pre-compile  # Measurement mode | Configures the measurement mode of this channel. Supported so far: - ICU_MODE_TIMESTAMP (oil MOK, OPS-T) - ICU_MODE_SIGNAL_MEASUREMENT (PWM in) - ICU_RB_MODE_GENLOAD (alternator load)
          ICU_MODE_EDGE_COUNTER  # Edge Counter Mode
          ICU_MODE_SIGNAL_EDGE_DETECT  # Edge Detect Mode
          ICU_MODE_SIGNAL_MEASUREMENT  # Measurement Mode
          ICU_MODE_TIMESTAMP  # Timestamp Mode
          ICU_RB_MODE_GENLOAD  # GenLoad Mode
        integer IcuRbFilterTime: 0..4294967295, origin=RB:0.1.0:2012-01-18, post-build-variant-value=true, set at pre-compile  # Filter time [us] | HW filter time for both edges ([us] integer). Use small filter times for fast signals (1-2us for period of 200us), otherwise you are not able to measure the whole duty cycle range 0-100% as small pulses of 1% or 2% duty will be filtered out, also. Will be ignored for mode GenLoad, because FLT will be disabled internally.
        float IcuRbMaxPeriod: 0.., origin=RB:0.1.0:2012-01-18, post-build-variant-value=true, set at pre-compile  # Max period [s] | Maximum period (lowest frequency) the signal input shall be capable of, used for Clockbase selection. (seconds in float format like 1 or 0.1234 or 2.5E-6). TIM (24bit) Period < 0.3355s Clock0 [20ns] 2.98Hz - 4000Hz Period > 0.3355s Clock2 [400ns] 0.15Hz - 4000Hz Period > 6.71s not possible
        float IcuRbMinPeriod [0..1]: 0.., multiplicity set at pre-compile, origin=RB:0.1.0:2012-01-18, post-build-variant-multiplicity=true, post-build-variant-value=true, set at pre-compile  # Min period [s] (opt.) | Minimum period of this signal (seconds, float). Parameter NOT USED at all.
        enumeration IcuRbTimerUnit: {GTM_TIM, GTM_TIM_UNUSED}, origin=RB:0.1.0:2012-01-18, post-build-variant-value=true, set at pre-compile, default-value=GTM_TIM  # Timer Unit | Defines the timer unit for Icu channel: GTM_TIM (internal 24bit calculations) GTM_TIM_UNUSED for dummy signals without Gtm ressources
        function name IcuRbVirtFunc [0..1]: multiplicity set at pre-compile, origin=RB, post-build-variant-multiplicity=true, post-build-variant-value=true, set at pre-compile  # Virtualization function
        boolean IcuWakeupCapability [0..1]: multiplicity set at pre-compile, post-build-variant-multiplicity=true, post-build-variant-value=true, set at pre-compile, default-value=false  # Wakeup capability (opt.) | NOT SUPPORTED YET. Information about the wakeup-capability of this channel.
        container IcuSignalEdgeDetection [0..0]: multiplicity set at pre-compile, post-build-variant-multiplicity=true  # Mode edge detection parameters | NOT SUPPORTED YET. This container contains the configuration (parameters) in case the measurement mode is "IcuSignalEdgeDetection"
          function name IcuSignalNotification [0..0]: multiplicity set at pre-compile, post-build-variant-multiplicity=true, post-build-variant-value=true, set at pre-compile, max-length=127, min-length=3, regular-expression=[A-Za-z_][A-Za-z0-9_]*  # Notification function | NOT SUPPORTED YET. Notification function for signal notification. {Icu_SignalNotification_<Channel>}
        container IcuSignalMeasurement [0..1]: multiplicity set at pre-compile, post-build-variant-multiplicity=true  # Mode measurement parameters | This container contains the configuration (parameters) in case the measurement mode is "IcuSignalMeasurement"
          enumeration IcuSignalMeasurementProperty [0..1]: multiplicity set at pre-compile, post-build-variant-multiplicity=true, post-build-variant-value=true, set at pre-compile  # Measurement property | Configures the property that could be measured in case the mode is "IcuSignalMeasurement". This property can not be changed during runtime. "xxx_TIME" is required for Icu_GetTimeElapsed() "DutyCycle Values" is required for Icu_GetDutyCycleValues(). Parameter is IGNORED so far as PWMin measurement is done by RB interface that provides all information (period, pulse, duty, status)
            ICU_ACTIVE_TIME  # Active Time
            ICU_HIGH_TIME  # High Time
            ICU_LOW_TIME  # Low Time
            ICU_PERIOD_TIME  # Period Time
            ICU_DUTY_CYCLE  # DutyCycle Values
        container IcuTimestampMeasurement [0..1]: multiplicity set at pre-compile, post-build-variant-multiplicity=true  # Mode timestamp parameters | This container contains the configuration (parameters) in case the measurement mode is "IcuTimestamp"
          enumeration IcuTimestampMeasurementProperty [0..1]: multiplicity set at pre-compile, post-build-variant-multiplicity=true, post-build-variant-value=true, set at pre-compile  # Timestamp property | Configures the handling of the buffer in case the mode is "Timestamp"
            ICU_CIRCULAR_BUFFER  # Circular_Buffer
            ICU_LINEAR_BUFFER  # Linear Buffer
          function name IcuTimestampNotification [0..1]: multiplicity set at pre-compile, post-build-variant-multiplicity=true, post-build-variant-value=true, set at pre-compile, max-length=127, min-length=3, regular-expression=[A-Za-z_][A-Za-z0-9_]*  # Notification function | Notification function if the number of requested timestamps (Notification interval > 0) are acquired.
        container IcuWakeup [0..0]: multiplicity set at pre-compile, post-build-variant-multiplicity=true  # Wakeup parameters | NOT SUPPORTED YET. Information about the wakeup-capability of this channel.
          integer IcuChannelWakeupInfo [0..0]: 0..4294967295, multiplicity set at pre-compile, post-build-variant-multiplicity=true, post-build-variant-value=true, set at pre-compile  # Wakeup information | NOT SUPPORTED YET. If the wakeup-capability is true the wakeup source referenced is transmitted to the ECU State Manager (EcuM) . Implementation Type: reference to EcuM_WakeupSourceType
    container IcuGeneral  # General settings | Configuration of general aspects of the Icu module.
      boolean IcuDevErrorDetect: set at pre-compile  # Development error detection | Enables/disables the detection and notification of development errors. If this parameter is enabled, then extended error checking is performed during runtime; any errors detected by these checks are reported to the Dem module. This feature should be switched off in series software.
      integer IcuIndex [0..0]: 0..255, multiplicity set at pre-compile, set at pre-compile, default-value=0  # Module instance (opt.) | NOT SUPPORTED YET. Specifies the InstanceId of this module instance. If only one instance is present it shall have the Id 0.
      boolean IcuReportWakeupSource [0..0]: set at pre-compile  # Wakeup source reporting | NOT SUPPORTED YET. Switch for enabling Wakeup source reporting.
    container IcuOptionalApis  # Optional API services | Configuration of general aspects of the Icu module.
      boolean IcuDeInitApi [0..0]: set at pre-compile, default-value=false  # De-Initialisation API | NOT SUPPORTED. Global Mcal decision. Adds / removes the service Icu_DeInit() from the code.
      boolean IcuDisableWakeupApi [0..0]: set at pre-compile, default-value=false  # Disable wakeup API | NOT SUPPORTED YET. Adds / removes the service Icu_DisableWakeup() from the code.
      boolean IcuEdgeCountApi: set at pre-compile  # Edge count API | Adds / removes all services related to the edge counting functionality as listed below, from the code: Icu_ResetEdgeCount(), Icu_EnableEdgeCount(), Icu_DisableEdgeCount(), Icu_GetEdgeNumbers().
      boolean IcuEdgeDetectApi [0..0]: set at pre-compile, default-value=false  # Edge detect API | NOT SUPPORTED YET. Adds / removes the services related to the edge detection functionality, from the code: Icu_EnableEdgeDetection() and Icu_DisableEdgeDetection().
      boolean IcuEnableWakeupApi [0..0]: set at pre-compile, default-value=false  # Enable wakeup API | NOT SUPPORTED YET. Adds / removes the service Icu_EnableWakeup() from the code.
      boolean IcuGetDutyCycleValuesApi: set at pre-compile  # Get duty cycle API | Adds / removes the service Icu_GetDutyCycleValues() from the code.
      boolean IcuGetInputStateApi: set at pre-compile  # Get input state API | Adds / removes the service Icu_GetInputState() from the code.
      boolean IcuGetTimeElapsedApi: set at pre-compile  # Get time elapsed API | Adds / removes the service Icu_GetTimeElapsed() from the code.
      boolean IcuSetModeApi [0..0]: set at pre-compile, default-value=false  # Set Icu mode API | NOT SUPPORTED YET. Adds / removes the service Icu_SetMode() from the code.
      boolean IcuSignalMeasurementApi: set at pre-compile  # Signal measurement API | Adds / removes the services Icu_StartSignalMeasurement() and Icu_StopSignalMeasurement() from the code.
      boolean IcuTimestampApi: set at pre-compile  # Timestamp API | Adds / removes all services related to the timestamping functionality as listed below from the code: Icu_StartTimestamp(), Icu_StopTimestamp(), Icu_GetTimestampIndex().
      boolean IcuWakeupFunctionalityApi [0..0]: set at pre-compile, default-value=false  # Check wakeup API | NOT SUPPORTED YET. Adds / removes the service Icu_CheckWakeup() from the code.
