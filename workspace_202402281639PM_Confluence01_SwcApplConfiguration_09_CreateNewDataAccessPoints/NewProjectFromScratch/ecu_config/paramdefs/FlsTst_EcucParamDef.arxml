AUTOSAR XML (schema 4-2-2)
package /AUTOSAR_FlsTst/EcucModuleDefs
  module definition FlsTst: category=VENDOR_SPECIFIC_MODULE_DEFINITION, post-build-variant-support=true, refined-module-def=FlsTst, variants pre-compile  # MCAL Flash Test driver | This Flash test module provides algorithm to test invariable memory.
    container FlsTstConfigSet  # Flash Test Configuration Set | Multiple Configuration Set Container
      integer FlsTstBlockNumberBgnd: 0..4294967295, post-build-variant-value=true, set at pre-compile, with-auto=true  # Configure number of blocks background | Configures the number of FlsTst blocks tested in background test. This mandatory integer value represents how many FlsTst_Blocks are configured in the FlsTstBlockBgndConfigSet container and is automatically filled in by the script according to the count of defined FlsTst_Blocks.
      integer FlsTstBlockNumberFgnd: 0..4294967295, post-build-variant-value=true, set at pre-compile, with-auto=true  # Configure number of blocks foreground | Configures the number of FlsTst blocks tested in foreground test. This mandatory integer value represents how many FlsTst_Blocks are configured in the FlsTstBlockFgndConfigSet container and is automatically filled in by the script according to the count of defined FlsTst_Blocks.
      function name FlsTstRbBlockCompletedNotification [0..1]: multiplicity set at pre-compile, origin=RB:7.0.0:2014-12-01, post-build-variant-multiplicity=true, post-build-variant-value=true, set at pre-compile  # Configure which block completed notification callback is accessed | FlsTstBlockCompletedNotification (Configures which notification callback is accessed) This function will be called after each successful complete background test if it is enabled by FLSTST_RB_BLOCK_COMPLETED_NOTIFICATION_SUPPORTED. This parameter has to be given like: "test_block_done" when you want to call the function test_block_done(). This has NOT to be declared in the FlsTstRbDeclaration since callback functions are void void functions with external linkage. Due to this the suitable "extern void ... void" declaration is generated automatically.
      string FlsTstRbConfigSectionDirective [0..1]: multiplicity set at pre-compile, origin=RB:42.2.1.0:2018-08-14, post-build-variant-value=true, set at pre-compile  # Configure the section for Flash test configuration | Section Directive for locating this configuration block in a specific memory section. For Arm clang, enter as '__attribute__((section (".YOUR_SECTION_NAME"))) '
      integer FlsTstRbCoreLayoutVersion: 1..2, origin=RB:42.2.1.0:2018-08-14, post-build-variant-value=true, set at pre-compile  # Configure the core layout version | FlsTstRbCoreLayoutVersion is used to differentiate between 32 and 64 bit core. For 32 bit core, configure layout version as "1". For 64 bit core, configure layout version as "2".
      string FlsTstRbDeclaration [0..*]: multiplicity set at pre-compile, origin=RB:7.0.0:2014-12-01, post-build-variant-multiplicity=true, post-build-variant-value=true, set at pre-compile  # Configure which Declarations are needed | FlsTstRbDeclaration is used for declaring symbols used as areas for the backgroung or foreground test. The parameter is implemented as string and has to contain C code like "extern void *rba_SysPreInit_Start" no semicolon is allowed since this is generated. This parameter is optinal and can be defined infinite times. Enter only one declaration in one instance of the parameter.
      function name FlsTstTestCompletedNotification [0..1]: multiplicity set at pre-compile, post-build-variant-multiplicity=true, post-build-variant-value=true, set at pre-compile  # Configure which test completed notification callback is accessed | FlsTstTestCompletedNotification (Configures which notification callback is accessed) This function will be called after each successful, complete background test, if it is enabled by FLSTST_TEST_COMPLETED_NOTIFICATION_SUPPORTED. This parameter has to be given like: "test_done" when you want to call the function test_done(). This has NOT to be declared in the FlsTstRbDeclaration since callback functions are void void functions with external linkage. Due to this the suitable "extern void ... void" declaration is generated automatically.
      container FlsTstBlockBgndConfigSet  # Define background Blocks | This container defines the blocks in background mode.
        string FlsTstRbBlockBgndArraySection [0..1]: multiplicity set at pre-compile, origin=RB:42.2.1.0:2018-08-14, post-build-variant-value=true, set at pre-compile  # Configure the section for Flash background block array | Section Directive for locating this background block array in a specific memory section. Enter for Arm clang '__attribute__((section (".YOUR_SECTION_NAME"))) '
        container FlsTstBlock [0..*]: multiplicity set at pre-compile, post-build-variant-multiplicity=true  # Specify one block | This container specifies configuration parameters for an individual test block. This container is optional and can be instanciated infinite times.
          string FlsTstBlockBaseAddress: post-build-variant-value=true, set at pre-compile  # Block base address | Start Address of the Flash block. The Parameter is implemented as a String since symbols are also possible. Notice: Symbols have to be given like: "&SymbolName". Additionally symbols have to be declared before using the parameter FlsTstRbDeclaration. If entering an absolute address this has to be given like: "(void*)0x40001234".
          integer FlsTstBlockIndex: 0..4294967295, post-build-variant-value=true, set at pre-compile  # Block index | The scheduling for background test shall follow an order defined by this index. '0' means highest priority.
          string FlsTstRbBlockEndAddress: origin=RB:7.0.0:2014-12-01, post-build-variant-value=true, set at pre-compile  # Block end address | End Address of the Flash block.The Parameter is implemented as a String since symbols are also possible. Notice: Symbols have to be given like: "&SymbolName". Additionally symbols have to be declared before using the parameter FlsTstRbDeclaration. If entering an absolute address this has to be given like: "(void*)0x40001234".
          string FlsTstRbSectionBeginDirective [0..1]: multiplicity set at pre-compile, origin=RB:42.2.1.0:2018-08-14, set at pre-compile  # Section Begin | Pragma Begin Directive for locating this block in a specific memory section. Enter for DIAB: ' #pragma section CONST ".YOUR_SECTION_NAME" ".YOUR_SECTION_NAME" ' or Enter for GHS: ' #pragma ghs section rodata=".YOUR_SECTION_NAME" '. Enter for ARMCLANG: '__attribute__((section (".YOUR_SECTION_NAME"))) '
          string FlsTstRbSectionEndDirective [0..1]: multiplicity set at pre-compile, origin=RB:7.1.0:2015-01-20, set at pre-compile  # Section End | Pragma End Directive for locating this block in a specific memory section. Enter for DIAB: ' #pragma section ' or for GHS ' #pragma ghs section rodata=default ' Note: For ARMCLANG it is not needed.
      container FlsTstBlockFgndConfigSet  # Define foreground Blocks | This container defines the blocks in foreground mode.
        string FlsTstRbBlockFgndArraySection [0..1]: multiplicity set at pre-compile, origin=RB:42.2.1.0:2018-08-14, post-build-variant-value=true, set at pre-compile  # Configure the section for Flash foreground block array | Section Directive for locating this foreground block array in a specific memory section. Enter for Arm clang '__attribute__((section (".YOUR_SECTION_NAME""))) '
        container FlsTstBlock [0..*]: multiplicity set at pre-compile, post-build-variant-multiplicity=true  # Specify one block | This container specifies configuration parameters for an individual test block. This container is optional and can be instanciated infinite times.
          string FlsTstBlockBaseAddress: post-build-variant-value=true, set at pre-compile  # Block base address | Start Address of the Flash block. The Parameter is implemented as a String since symbols are also possible. Notice: Symbols have to be given like: "&SymbolName". Additionally symbols have to be declared before using the parameter FlsTstRbDeclaration. If entering an absolute address this has to be given like: "(void*)0x40001234".
          integer FlsTstBlockIndex: 0..4294967295, post-build-variant-value=true, set at pre-compile  # Block index | Index identifies block to be tested by FlsTst_StartFgnd()
          string FlsTstRbBlockEndAddress: origin=RB:7.0.0:2014-12-01, post-build-variant-value=true, set at pre-compile  # Block end address | End Address of the Flash block. The Parameter is implemented as a String since symbols are also possible. Notice: Symbols have to be given like: "&SymbolName". Additionally symbols have to be declared before using the parameter FlsTstRbDeclaration. If entering an absolute address this has to be given like: "(void*)0x40001234".
          string FlsTstRbSectionBeginDirective [0..1]: multiplicity set at pre-compile, origin=RB:7.1.0:2015-01-20, set at pre-compile  # Section Begin | Pragma Begin Directive for locating this block in a specific memory section. Enter for DIAB: ' #pragma section CONST ".YOUR_SECTION_NAME" ".YOUR_SECTION_NAME" ' Enter for GHS: ' #pragma ghs section rodata=".YOUR_SECTION_NAME" ' Enter for Arm clang: '__attribute__((section (".YOUR_SECTION_NAME""))) '
          string FlsTstRbSectionEndDirective [0..1]: multiplicity set at pre-compile, origin=RB:7.1.0:2015-01-20, set at pre-compile  # Section End | Pragma End Directive for locating this block in a specific memory section. Enter for DIAB: ' #pragma section ' or for GHS ' #pragma ghs section rodata=default ' Note: For ARMCLANG it is not needed.
    container FlsTstConfigurationOfOptApiServices  # General parameters of Flash Test driver | Configure what APIs are available
      boolean FlsTstGetCurrentStateApi: set at pre-compile  # Configure if the FlsTst_GetCurrentState() API is available | Configure if the FlsTst_GetCurrentState() API is available. This switch can be enabled or disabled depending on project needs. If Disabled the function FlsTst_GetCurrentState() is not available. This Switch also disables the FlsTst_RbGetCurrentState() function.
      boolean FlsTstGetErrorDetailsApi: set at pre-compile  # Configure if the FlsTst_GetErrorDetails() API is available | Configure if the FlsTst_GetErrorDetails() API is available. This switch can be enabled or disabled depending on project needs. If Disabled the function FlsTst_GetErrorDetails() is not available. This Switch also disables the FlsTst_RbGetErrorDetails() function.
      boolean FlsTstGetTestResultBgndApi: set at pre-compile  # Configure if the FlsTst_GetTestResultBgnd() API is available | Configure if the FlsTst_GetTestResultBgnd() API is available. This switch can be enabled or disabled depending on project needs. If Disabled the function FlsTst_GetTestResultBgnd() is not available. This Switch also disables the FlsTst_RbGetTestResultBgnd() function.
      boolean FlsTstGetTestResultFgndApi: set at pre-compile  # Configure if the FlsTst_GetTestResultFgnd() API is available | Configure if the FlsTst_GetTestResultFgnd() API is available. This switch can be enabled or disabled depending on project needs. If Disabled the function FlsTst_GetTestResultFgnd() is not available.
      boolean FlsTstGetTestSignatureBgndApi: set at pre-compile  # Configure if the FlsTst_GetTestSignatureBgnd() API is available | Configure if the FlsTst_GetTestSignatureBgnd() API is available. This switch can be enabled or disabled depending on project needs. If Disabled the function FlsTst_GetTestSignatureBgnd() is not available. This Switch also disables the FlsTst_RbGetTestSignatureBgnd() function.
      boolean FlsTstGetTestSignatureFgndApi: set at pre-compile  # Configure if the FlsTst_GetTestSignatureFgnd() API is available | Configure if the FlsTst_GetTestSignatureFgnd() API is available. This switch can be enabled or disabled depending on project needs. If Disabled the function FlsTst_GetTestSignatureFgnd() is not available.
      boolean FlsTstStartFgndApi: set at pre-compile  # Configure if the FlsTst_StartFgnd() API is available | Configure if the FlsTst_StartFgnd() API is available. This switch can be enabled or disabled depending on project needs. If Disabled the function FlsTst_StartFgnd() is not available.
      boolean FlsTstSuspendResumeApi: set at pre-compile  # Configure Suspend and Resume are supported. | Configure Suspend and Resume are supported. This switch can be enabled or disabled depending on project needs. If Disabled the functions FlsTst_Suspend() and FlsTst_Resume() are not available.
      boolean FlsTstTestEccApi: set at pre-compile  # Configures if a test via the ECC is supported | Configures if a test via the ECC mechanism of the HW is available. ATTENTION: This is not supported at the moment. This switch can be enabled or disabled depending on project needs. If Disabled the function FlsTst_TestEcc() is not available.
      boolean FlsTstVersionInfoApi: set at pre-compile  # Configures if the AUTOSAR Version Info API is available. | Configures if the AUTOSAR Version Info API is available. This switch can be enabled or disabled depending on project needs. If Disabled the function FlsTst_GetVersionInfo() is not available.
    container FlsTstGeneral  # General parameters of Flash Test driver | All general parameters of the Postcompile Configuration of MCAL Flash Test Driver are collected here.
      boolean FlsTstDevErrorDetect: set at pre-compile  # Configures additional checks during development. | Configures additional checks during development. If this Switch is on development errors are reported to the DET (Development Error Tracer). This should be disabled in series.
      integer FlsTstNumberOfTestedCells: 1..4294967295, set at pre-compile, default-value=300  # Configures how many bytes are checked | Configures how many bytes are checked in a call to FlsTst_MainFunction() for background tests.
      boolean FlsTstRbBlockCompletedNotificationSupported: origin=RB:7.0.0:2014-12-01, set at pre-compile  # Configures if a block completion notification callback is supported | FlsTstRbBlockCompletedNotificationSupported (Configures if a notification callback is supported) If this is set to on, a post build configurable function is called after each successful complete block of a background test.
      boolean FlsTstRbCrcCheck: origin=RB:7.0.0:2014-12-01, set at pre-compile  # Configure if CRC check is done | Configure if CRC check is done for background test intermediate values. When enabled then additional APIs are defined which return the results with CRC check to prove that the returned data is consistent.
      boolean FlsTstRbMixPtrSize: origin=RB:42.2.1.0:2018-08-14, set at pre-compile  # Configures if 32bit flash needs to tested with 64bit and 64bit flash needs to tested with 32bit. | Enable this when FlsTst needs to test 32bit flash block with 64bit core and/or 64bit flash with 32bit core.
      boolean FlsTstTestCompletedNotificationSupported: set at pre-compile  # Configures if a test completion notification callback is supported | FlsTstTestCompletedNotificationSupported (Configures if a notification callback is supported) If this is set to on, a post build configurable function is called after each successful complete background test.
