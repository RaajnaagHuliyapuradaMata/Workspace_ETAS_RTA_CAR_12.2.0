AUTOSAR XML (schema 00051)
package /ETAS_Project/EcucModuleConfigurationValuess
  module config Det_0: definition=Det
    DetGeneral_0 (DetGeneral): DetVersionInfoApi=0
