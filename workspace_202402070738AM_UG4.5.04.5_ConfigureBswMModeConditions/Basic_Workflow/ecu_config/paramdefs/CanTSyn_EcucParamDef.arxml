AUTOSAR XML (schema 00048)
package /AUTOSAR_CanTSyn/EcucModuleDefs
  module definition CanTSyn [0..1]: category=VENDOR_SPECIFIC_MODULE_DEFINITION, post-build-variant-support=true, refined-module-def=CanTSyn, variants pre-compile  # Configuration of the Synchronized Time-base Manager (StbM) module with respect to global time handling on CAN.
    container CanTSynGeneral  # This container holds the general parameters of the CAN-specific Synchronized Time-base Manager
      boolean CanTSynDevErrorDetect: set at pre-compile, default-value=false  # Switches the development error detection and notification on or off. | * true: detection and notification is enabled. * false: detection and notification is disabled.
      boolean CanTSynHardwareTimestampSupport: set at pre-compile  # Activate/Deactivate the hardware time stamping functionality of the CAN hardware. Note: HW time stamping feature is supported only as a prototype. | * true: Timestamp is retrieved from the CAN hardware. * false: Timestamp is retrieved from the StbM.
      float CanTSynMainFunctionPeriod: 0..INF, set at pre-compile  # Schedule period of the main function CanTSyn_MainFunction. Unit: [s].
      boolean CanTSynTimeValidationSupport [0..0]: set at pre-compile, default-value=false  # (Not Supported) Switches support for Time Validation on or off. | - true: Time Validation is enabled. - false: Time Validation is disabled
      boolean CanTSynVersionInfoApi: set at pre-compile, default-value=false  # Activate/Deactivate the version information API (CanTSyn_GetVersionInfo). True: version information API activated False: version information API deactivated.
    container CanTSynGlobalTimeDomain [1..*]: multiplicity set at pre-compile  # This represents the existence of a global time domain on CAN. The CanTSyn module can administrate several global time domains at the same time that in itself form a hierarchy of domains and sub-domains. | If the CanTSyn exists it is assumed that at least one global time domain exists.
      boolean CanTSynEnableTimeValidation [0..0]: set at pre-compile  # (Not Supported) Enables/disables time recording for Time Validation for a specific Time Domain.
      integer CanTSynGlobalTimeDomainId: 0..31, set at pre-compile  # The global time domain ID.
      integer CanTSynGlobalTimeSecureTmacLength [0..0]: 0..16, set at pre-compile, default-value=0  # (Not Supported) Represents the number of bytes for the used Truncated Message Authentication Code (TMAC). If 0, no message authentication will be used. Tags: atp.Status=draft
      boolean CanTSynUseExtendedMsgFormat: set at pre-compile, default-value=false  # Switches support for 16 Byte Timesync messages on or off (for CAN FD only) | * true: CAN FD support is active: use at least 16 byte for Timesync messages (depending on configuration) * false: Classic CAN support is active: use always 8 byte for Timesync messages
      reference CanTSynSynchronizedTimeBaseRef: set at pre-compile, requires-symbolic-name-value=true, destination=StbMSynchronizedTimeBase  # Mandatory reference to the required synchronized time-base.
      container CanTSynGlobalTimeFupDataIDList [0..1]: multiplicity set at pre-compile, post-build-variant-multiplicity=true  # The DataIDList for FUP messages ensures the identification of data elements due to CRC calculation and message authentication process.(Message authentication process is not supported yet)
        container CanTSynGlobalTimeFupDataIDListElement [16..16]  # Element of the DataIDList for FUP messages ensures the identification of data elements due to CRC calculation and message authentication process.(Message authentication process is not supported yet)
          integer CanTSynGlobalTimeFupDataIDListIndex: 0..15, post-build-variant-value=true, set at pre-compile  # Index of the DataIDList for FUP messages ensures the identification of data elements due to CRC calculation and message authentication process.(Message authentication process is not supported yet)
          integer CanTSynGlobalTimeFupDataIDListValue: 0..255, post-build-variant-value=true, set at pre-compile  # Value of the DataIDList for FUP messages ensures the identification of data elements due to CRC calculation and message authentication process.(Message authentication process is not supported yet)
      container CanTSynGlobalTimeMaster [0..1]: multiplicity set at pre-compile, post-build-variant-multiplicity=true  # Configuration of a Time Master for a Time Domain (refer to parent container). If CanTSynGlobalTimeMasters container exists, the local ECU acts as a Time Master for the Time Domain.
        float CanTSynCyclicMsgResumeTime: 0..INF, post-build-variant-value=true, set at pre-compile  # Defines the time where the 1st regular cycle time based message transmission takes place, after an immediate transmission before. Unit: seconds
        float CanTSynGlobalTimeDebounceTime: 0..INF, post-build-variant-value=true, set at pre-compile  # This represents the configuration of a TX debounce time for SYNC, FUP, OFS and OFNS messages compared to a message before with the same PDU. Unit: seconds
        enumeration CanTSynGlobalTimeTxCrcSecured: {CRC_NOT_SUPPORTED, CRC_SUPPORTED}, post-build-variant-value=true, set at pre-compile  # This represents the configuration of whether or not CRC is supported.
        float CanTSynGlobalTimeTxPeriod: 0..INF, post-build-variant-value=true, set at pre-compile  # This represents configuration of the TX period. Unit: seconds
        boolean CanTSynImmediateTimeSync: post-build-variant-value=true, set at pre-compile  # Enables/Disables the cyclic polling of StbM_GetTimeBaseUpdateCounter() within CanTSyn_MainFunction().
        float CanTSynMasterConfirmationTimeout: 0..INF, post-build-variant-value=true, set at pre-compile  # This represents the confirmation timeout after transmission of each Timesync message. | Unit: seconds.
        enumeration CanTSynTxTmacCalculated [0..0]: {TMAC_CALCULATED, TMAC_NOT_CALCULATED}, post-build-variant-value=true, set at pre-compile  # (Not Supported) This parameter controls whether or not TMAC calculation shall be supported. Tags: atp.Status=draft
        container CanTSynGlobalTimeMasterPdu  # This container encloses the configuration of the PDU that is supposed to contain the global time information.
          integer CanTSynGlobalTimeMasterConfirmationHandleId: 0..65535, set at pre-compile, symbolic-name-value=true, with-auto=true  # This represents the handle ID of the PDU that contains the global time information.
          reference CanTSynGlobalTimePduRef: post-build-variant-value=true, set at pre-compile, destination=Pdu  # This represents the reference to the Pdu taken to transmit the global time information. The global time master of a global time domain acts as the sender of the Pdu while all the time slaves are supposed to receive the Pdu.
      container CanTSynGlobalTimeOfnsDataIDList [0..1]: multiplicity set at pre-compile, post-build-variant-multiplicity=true  # The DataIDList for OFNS messages ensures the identification of data elements due to CRC calculation and message authentication process.
        container CanTSynGlobalTimeOfnsDataIDListElement [16..16]  # Element of the DataIDList for OFNS messages ensures the identification of data elements due to CRC calculation and message authentication process.
          integer CanTSynGlobalTimeOfnsDataIDListIndex: 0..15, post-build-variant-value=true, set at pre-compile  # Index of the DataIDList for OFNS messages ensures the identification of data elements due to CRC calculation and message authentication process.
          integer CanTSynGlobalTimeOfnsDataIDListValue: 0..255, post-build-variant-value=true, set at pre-compile  # Value of the DataIDList for OFNS messages ensures the identification of data elements due to CRC calculation and message authentication process.
      container CanTSynGlobalTimeOfsDataIDList [0..1]: multiplicity set at pre-compile, post-build-variant-multiplicity=true  # The DataIDList for OFS messages ensures the identification of data elements due to CRC calculation and message authentication process.
        container CanTSynGlobalTimeOfsDataIDListElement [16..16]  # Element of the DataIDList for OFS messages ensures the identification of data elements due to CRC calculation and message authentication process.
          integer CanTSynGlobalTimeOfsDataIDListIndex: 0..15, post-build-variant-value=true, set at pre-compile  # Index of the DataIDList for OFS messages ensures the identification of data elements due to CRC calculation and message authentication process.
          integer CanTSynGlobalTimeOfsDataIDListValue: 0..255, post-build-variant-value=true, set at pre-compile  # Value of the DataIDList for OFS messages ensures the identification of data elements due to CRC calculation and message authentication process.
      container CanTSynGlobalTimeSlave [0..1]: multiplicity set at pre-compile, post-build-variant-multiplicity=true  # Configuration of a Time Slave for a Time Domain (refer to parent container). If CanTSynGlobalTimeSlave container exists, the local ECU acts as a Time Slave for the Time Domain.
        float CanTSynGlobalTimeFollowUpTimeout: 0..INF, post-build-variant-value=true, set at pre-compile  # Rx timeout for the follow-up message. This is only relevant for selected bus systems Unit:seconds
        float CanTSynGlobalTimeMinMsgGap [0..0]: 0..INF, post-build-variant-value=true, set at pre-compile, default-value=0  # (Not Supported) This parameter represents the configuration of a minimum message gap time for received Timesync messages compared to a message before with the same PDU. If PDUs are received more often in between than this parameter allows, they shall be ignored. Tags: atp.Status=draft | Unit: seconds
        integer CanTSynGlobalTimeSequenceCounterHysteresis: 0..15, post-build-variant-value=true, set at pre-compile, default-value=0  # CanTSynGlobalTimeSequenceCounterHysteresis specifies the number of consecutive valid message pairs that are required by the Time Slave while being in Timeout state until a Time Tuple is forwarded to the StbM.
        integer CanTSynGlobalTimeSequenceCounterJumpWidth: 0..15, post-build-variant-value=true, set at pre-compile, default-value=0  # The SequenceCounterJumpWidth specifies the maximum allowed gap of the Sequence Counter between two SYNC resp. two OFS messages.
        enumeration CanTSynRxCrcValidated: {CRC_IGNORED, CRC_NOT_VALIDATED, CRC_OPTIONAL, CRC_VALIDATED}, post-build-variant-value=true, set at pre-compile  # Definition of whether or not validation of the CRC is supported.
        enumeration CanTSynRxTmacValidated [0..0]: {TMAC_NOT_VALIDATED, TMAC_VALIDATED}, post-build-variant-value=true, set at pre-compile  # (Not Supported) This parameter controls whether or not TMAC validation shall be supported. Tags: atp.Status=draft
        container CanTSynGlobalTimeSlavePdu  # This container encloses the configuration of the PDU that is supposed to contain the global time information.
          integer CanTSynGlobalTimeSlaveHandleId: 0..65535, set at pre-compile, symbolic-name-value=true, with-auto=true  # This represents the handle ID of the PDU that contains the global time information.
          reference CanTSynGlobalTimePduRef: post-build-variant-value=true, set at pre-compile, destination=Pdu  # This represents the reference to the Pdu taken to transmit the global time information. The global time master of a global time domain acts as the sender of the Pdu while all the time slaves are supposed to receive the Pdu.
      container CanTSynGlobalTimeSyncDataIDList [0..1]: multiplicity set at pre-compile, post-build-variant-multiplicity=true  # The DataIDList for SYNC messages ensures the identification of data elements due to CRC calculation and message authentication process.(Message authentication process is not supported yet)
        container CanTSynGlobalTimeSyncDataIDListElement [16..16]  # Element of the DataIDList for SYNC messages ensures the identification of data elements due to CRC calculation and message authentication process.(Message authentication process is not supported yet)
          integer CanTSynGlobalTimeSyncDataIDListIndex: 0..15, post-build-variant-value=true, set at pre-compile  # Index for the DataIDList for SYNC messages ensures the identification of data elements due to CRC calculation and message authentication process.(Message authentication process is not supported yet)
          integer CanTSynGlobalTimeSyncDataIDListValue: 0..255, post-build-variant-value=true, set at pre-compile  # Value of the DataIDList for SYNC messages ensures the identification of data elements due to CRC calculation and message authentication process.(Message authentication process is not supported yet)
