AUTOSAR XML (schema 00048)
package /RB/RBA/rba_Mpu/EcucModuleDefs
  module definition rba_Mpu [0..1]: category=VENDOR_SPECIFIC_MODULE_DEFINITION, variants pre-compile  # MCAL Memory Protection Unit | Memory Protection Unit (MPU) configuration
    container rba_Mpu_CoreMpuCfgDataSet [0..1]: multiplicity set at pre-compile, requires-index=true  # Core MPU Configuration | Core MPU configuration container
      boolean rba_Mpu_VirtualizationEnable [0..1]: multiplicity set at pre-compile, origin=RB, set at pre-compile, default-value=true  # Enable virtualization (transaction at EL1/EL0 are checked by EL2 and EL1 MPU) | If at least one region for EL2 MPU is configured for a core and if this virtualization tag is enabled (as it is per default), rba_Mpu sets the virtualization bit within hardware (HCR.VM=1) in order to perform for all EL1/EL0 transaction a lookup in both MPUs (EL1 MPU and EL2 MPU). Transactions are then only permitted if in both MPUs access is granted. This behaviour is needed as within EL2 MPU normally all regions are set up to define the existent memory and exclude all reserved memory areas within hardware layout, in order to prevent unwanted speculative access within these reserved memory areas. If you disable this tag (which is not recommended at all) you have to ensure, that all configured EL1 MPU regions do exclude all reserved memory areas within hardware layout.
      container rba_Mpu_CoreMpu [0..*]: multiplicity set at pre-compile, requires-index=true  # Core MPU | It is possible to define core MPU regions for up to 6 different cores for ST devices and IFX Dev 5 40nm For IFX Dev 4 40nm it is possible to configure core MPU regions for up to 4 different cores For IFX Dev 3 40nm it is possible to configure core MPU regions for up to 3 different cores
        integer rba_Mpu_CoreMpuLogicalCoreNumber: 0..5, origin=RB, set at pre-compile  # Logical core number | Logical core number of the core where the following regions are corresponding to
        reference rba_Mpu_StackRegionShortName [0..1]: multiplicity set at pre-compile, origin=RB, set at pre-compile, destination=rba_Mpu_CoreMpuRegion  # Short name of dynamic stack protection region | Configured region for dynamic stack protection
        container rba_Mpu_Application [0..*]: multiplicity set at pre-compile, requires-index=true  # Application | Application for which application specific core MPU regions are adapted or added
          reference rba_Mpu_Application: origin=RB, set at pre-compile, destination=OsApplication  # Application ID from OS | Reference to an application configured within RTA-OS for which application specific core MPU regions are adapted or added
          container rba_Mpu_CoreMpuApplicationRegion [0..*]: multiplicity set at pre-compile, requires-index=true  # Core MPU Application Region | Additional core MPU region with write access or execute access can be configured application specific within this container. It is possible to define a maximum of 18 data regions and 10 code regions per core
            enumeration rba_Mpu_Cache_Setting [0..1]: multiplicity set at pre-compile, origin=RB, set at pre-compile, default-value=NonCacheable  # Cache Setting (only for ST devices) | Currently 4 type of memories are supported 1.) GRE (Gathering, Reordering, Early write acknowledgement) 2.) nGnRnE (non-Gathering, non-Reordering, no Early write acknowledgement) 3.) outer non-cacheable, inner non-cacheable 4.) outer write through, read allocate, write no allocate, inner write through, read allocate, write no allocate
              GRE  # gathering reordering early-acknowledgement (GRE)
              nGnRnE  # non-gathering non-reordering non-early-acknowledgement (nGnRnE)
              NonCacheable  # non-cacheable
              WriteThrough  # write-through cacheable
            boolean rba_Mpu_ExecuteAccessEnable [0..1]: multiplicity set at pre-compile, origin=RB, set at pre-compile, default-value=false  # Execute Access Enable | This enables execute access for this region
            boolean rba_Mpu_ReadAccessEnable [0..1]: multiplicity set at pre-compile, origin=RB, set at pre-compile, default-value=false  # Read Access Enable (only for ST) | This enables read access for this region
            string rba_Mpu_RegionEndAddress: origin=RB, set at pre-compile  # End Address | End address for the region
            string rba_Mpu_RegionStartAddress: origin=RB, set at pre-compile  # Start Address | Start address for the region
            boolean rba_Mpu_WriteAccessEnable [0..1]: multiplicity set at pre-compile, origin=RB, set at pre-compile, default-value=false  # Write Access Enable | This enables write access for this region
          container rba_Mpu_CoreMpuStaticRegion [0..*]: multiplicity set at pre-compile, requires-index=true  # Core MPU Static Region | Write access and execute access of already static configured core MPU region can be changed application specific within this container. It is possible to define a maximum of 18 data regions and 10 code regions per core
            boolean rba_Mpu_ExecuteAccessEnable [0..1]: multiplicity set at pre-compile, origin=RB, set at pre-compile  # Execute Access Enable | This enables execute access for this region
            boolean rba_Mpu_WriteAccessEnable [0..1]: multiplicity set at pre-compile, origin=RB, set at pre-compile  # Write Access Enable | This enables write access for this region
            reference rba_Mpu_StaticRegionShortName: origin=RB, set at pre-compile, destination=rba_Mpu_CoreMpuRegion  # Short name of static region | Reference to short name of static configured region which will be adapted
        container rba_Mpu_CoreMpuRegion [0..*]: multiplicity set at pre-compile, requires-index=true  # Core MPU Region | For ST devices up to 24 different regions per core can be configured For IFX 40nm up to 28 regions per core can be configured (up to 10 code regions and up to 18 data regions)
          string rba_Mpu_00_RegionStartAddress: origin=RB, set at pre-compile  # Start Address | Start address for the region
          string rba_Mpu_01_RegionEndAddress: origin=RB, set at pre-compile  # End Address | End address for the region
          boolean rba_Mpu_02_SupervisorReadAccessEnable [0..1]: multiplicity set at pre-compile, origin=RB, set at pre-compile, default-value=false  # Supervisor Read Access Enable (for IFX: corresponds to PRS0) | This enables read access for this region in supervisor mode
          boolean rba_Mpu_02_SupervisorWriteAccessEnable [0..1]: multiplicity set at pre-compile, origin=RB, set at pre-compile, default-value=false  # Supervisor Write Access Enable (for IFX: corresponds to PRS0) | This enables write access for this region in supervisor mode
          boolean rba_Mpu_02_UserReadAccessEnable [0..1]: multiplicity set at pre-compile, origin=RB, set at pre-compile, default-value=false  # User Read Access Enable (for IFX: corresponds to PRS1) | This enables read access for this region in user mode
          boolean rba_Mpu_02_UserWriteAccessEnable [0..1]: multiplicity set at pre-compile, origin=RB, set at pre-compile, default-value=false  # User Write Access Enable (for IFX: corresponds to PRS1) | This enables write access for this region in user mode
          boolean rba_Mpu_03_SupervisorExecuteAccessEnable [0..1]: multiplicity set at pre-compile, origin=RB, set at pre-compile, default-value=false  # Supervisor Execute Access Enable (for IFX: corresponds to PRS0) | This enables execute access for this region in supervisor mode
          boolean rba_Mpu_03_UserExecuteAccessEnable [0..1]: multiplicity set at pre-compile, origin=RB, set at pre-compile, default-value=false  # User Execute Access Enable (for IFX: corresponds to PRS1) | This enables execute access for this region in user mode
          enumeration rba_Mpu_04_Cache_Setting [0..1]: multiplicity set at pre-compile, origin=RB, set at pre-compile, default-value=NonCacheable  # Cache Setting (only for ST devices) | Currently 4 type of memories are supported 1.) GRE (Gathering, Reordering, Early write acknowledgement) 2.) nGnRnE (non-Gathering, non-Reordering, no Early write acknowledgement) 3.) outer non-cacheable, inner non-cacheable 4.) outer write through, read allocate, write no allocate, inner write through, read allocate, write no allocate
            GRE  # gathering reordering early-acknowledgement (GRE)
            nGnRnE  # non-gathering non-reordering non-early-acknowledgement (nGnRnE)
            NonCacheable  # non-cacheable
            WriteThrough  # write-through cacheable
          boolean rba_Mpu_PRS2ExecuteAccessEnable [0..1]: multiplicity set at pre-compile, origin=RB, set at pre-compile, default-value=false  # PRS2 Execute Access Enable (only for IFX) | This enables execute access for this region in Protection Register Set 2 (PRS2) - only for IFX
          boolean rba_Mpu_PRS2ReadAccessEnable [0..1]: multiplicity set at pre-compile, origin=RB, set at pre-compile, default-value=false  # PRS2 Read Access Enable (only for IFX) | This enables read access for this region in Protection Register Set 2 (PRS2) - only for IFX
          boolean rba_Mpu_PRS2WriteAccessEnable [0..1]: multiplicity set at pre-compile, origin=RB, set at pre-compile, default-value=false  # PRS2 Write Access Enable (only for IFX) | This enables write access for this region in Protection Register Set 2 (PRS2) - only for IFX
          boolean rba_Mpu_PRS3ExecuteAccessEnable [0..1]: multiplicity set at pre-compile, origin=RB, set at pre-compile, default-value=false  # PRS3 Execute Access Enable (only for IFX) | This enables execute access for this region in Protection Register Set 3 (PRS3) - only for IFX
          boolean rba_Mpu_PRS3ReadAccessEnable [0..1]: multiplicity set at pre-compile, origin=RB, set at pre-compile, default-value=false  # PRS3 Read Access Enable (only for IFX) | This enables read access for this region in Protection Register Set 3 (PRS3) - only for IFX
          boolean rba_Mpu_PRS3WriteAccessEnable [0..1]: multiplicity set at pre-compile, origin=RB, set at pre-compile, default-value=false  # PRS3 Write Access Enable (only for IFX) | This enables write access for this region in Protection Register Set 3 (PRS3) - only for IFX
          boolean rba_Mpu_PRS4ExecuteAccessEnable [0..1]: multiplicity set at pre-compile, origin=RB, set at pre-compile, default-value=false  # PRS4 Execute Access Enable (only for IFX) | This enables execute access for this region in Protection Register Set 4 (PRS4) - only for IFX
          boolean rba_Mpu_PRS4ReadAccessEnable [0..1]: multiplicity set at pre-compile, origin=RB, set at pre-compile, default-value=false  # PRS4 Read Access Enable (only for IFX) | This enables read access for this region in Protection Register Set 4 (PRS4) - only for IFX
          boolean rba_Mpu_PRS4WriteAccessEnable [0..1]: multiplicity set at pre-compile, origin=RB, set at pre-compile, default-value=false  # PRS4 Write Access Enable (only for IFX) | This enables write access for this region in Protection Register Set 4 (PRS4) - only for IFX
          boolean rba_Mpu_PRS5ExecuteAccessEnable [0..1]: multiplicity set at pre-compile, origin=RB, set at pre-compile, default-value=false  # PRS5 Execute Access Enable (only for IFX) | This enables execute access for this region in Protection Register Set 5 (PRS5) - only for IFX
          boolean rba_Mpu_PRS5ReadAccessEnable [0..1]: multiplicity set at pre-compile, origin=RB, set at pre-compile, default-value=false  # PRS5 Read Access Enable (only for IFX) | This enables read access for this region in Protection Register Set 5 (PRS5) - only for IFX
          boolean rba_Mpu_PRS5WriteAccessEnable [0..1]: multiplicity set at pre-compile, origin=RB, set at pre-compile, default-value=false  # PRS5 Write Access Enable (only for IFX) | This enables write access for this region in Protection Register Set 5 (PRS5) - only for IFX
        container rba_Mpu_HypCoreMpuRegion [0..*]: multiplicity set at pre-compile, requires-index=true  # Hypervisor Core MPU Region | For ST devices up to 24 different regions per core can be configured for hypervisor MPU For IFX 40nm devices no hypervisor core MPU support is provided by hardware
          enumeration rba_Mpu_Cache_Setting [0..1]: multiplicity set at pre-compile, origin=RB, set at pre-compile, default-value=NonCacheable  # Cache Setting (only for ST) | Currently 4 types of memories are supported 1.) GRE (Gathering, Reordering, Early write acknowledgement) 2.) nGnRnE (non-Gathering, non-Reordering, no Early write acknowledgement) 3.) outer non-cacheable, inner non-cacheable 4.) outer write through, read allocate, write no allocate, inner write through, read allocate, write no allocate
            GRE  # gathering reordering early-acknowledgement (GRE)
            nGnRnE  # non-gathering non-reordering non-early-acknowledgement (nGnRnE)
            NonCacheable  # non-cacheable
            WriteThrough  # write-through cacheable
          boolean rba_Mpu_HypExecuteAccessEnable [0..1]: multiplicity set at pre-compile, origin=RB, set at pre-compile, default-value=false  # Hypervisor Execute Access Enable (ony for ST) | This enables execute access for this region in hypervisor mode
          boolean rba_Mpu_HypReadAccessEnable [0..1]: multiplicity set at pre-compile, origin=RB, set at pre-compile, default-value=false  # Hypervisor Read Access Enable (only for ST) | This enables read access for this region in hypervisor mode
          boolean rba_Mpu_HypWriteAccessEnable [0..1]: multiplicity set at pre-compile, origin=RB, set at pre-compile, default-value=false  # Hypervisor Write Access Enable (only for ST) | This enables write access for this region in hypervisor mode
          boolean rba_Mpu_NonHypExecuteAccessEnable [0..1]: multiplicity set at pre-compile, origin=RB, set at pre-compile, default-value=false  # Non Hypervisor Execute Access Enable (only for ST) | This enables execute access for this region in non-hypervisor mode
          boolean rba_Mpu_NonHypReadAccessEnable [0..1]: multiplicity set at pre-compile, origin=RB, set at pre-compile, default-value=false  # Non Hypervisor Read Access Enable (only for ST) | This enables read access for this region in non-hypervisor mode
          boolean rba_Mpu_NonHypWriteAccessEnable [0..1]: multiplicity set at pre-compile, origin=RB, set at pre-compile, default-value=false  # Non Hypervisor Write Access Enable (only for ST) | This enables write access for this region in non-hypervisor mode
          string rba_Mpu_RegionEndAddress: origin=RB, set at pre-compile  # End Address | End address for the region
          string rba_Mpu_RegionStartAddress: origin=RB, set at pre-compile  # Start Address | Start address for the region
          boolean rba_Mpu_ValidOnlyHypInitMode [0..1]: multiplicity set at pre-compile, origin=RB, set at pre-compile, default-value=false  # Region only valid in hypervisor initialization (EL2) | Current region is only valid in hypervisor initialization mode (EL2) and will be deactivated if API rba_Mpu_HypCoreMpuDisableHypOnlyRegions is called (normally before entering EL1 mode).
          boolean rba_Mpu_ValidOnlyHypNormalMode [0..1]: multiplicity set at pre-compile, origin=RB, set at pre-compile, default-value=false  # Region only valid in hypervisor normal mode (EL2) | Current region is only valid in hypervisor normal mode (EL2) and will be deactivated if API rba_Mpu_HypCoreMpuDisableHypOnlyRegions is called (normally before entering EL1 mode). Current region will be activated again if API rba_Mpu_HypCoreMpuEnableHypNormalOnlyRegions is called (normally directly after entering hypervisor mode)
    container rba_Mpu_CrossbarMpuCfgDataSet [0..1]: multiplicity set at pre-compile, requires-index=true  # Crossbar MPU / NOC Firewall Configuration | Crossbar MPU configuration container
      string rba_Mpu_Enable_Bypass_Security_C2c [0..1]: multiplicity set at pre-compile, origin=RB, set at pre-compile  # Enable bypass for security check for C2C communication | Enables bypassing security check for C2C communication. Per default, it is not possible to configure C2C access for any region. C2C can read or write from the outside world to memory areas, which should be normally protected (HSM, Immobilizer, PRAM...) Therefore by default, the bus master C2C is disabled. If project specific for at least one region the C2C bus master access is granted (C2C access is enabled), code generation will abort with a message that for C2C communication, no common security concept exists. The project has the responsibility to assure that C2C is not able to access memory areas which should be protected (HSM, Immobilizer, PRAM...). If this is assured and a valid security concept for the C2C communication is available, the tag rba_Mpu_Enable_Bypas_Security_C2c can be configured with SECURITY_CONCEPT - then code generation does no longer abort within rba_Mpu when enabling C2C bus master for at least one crossbar MPU region
      boolean rba_Mpu_Enable_Debugger_Access [0..1]: multiplicity set at pre-compile, origin=RB, set at pre-compile, default-value=false  # Enable debugger access for all regions | Enables access for all memory regions for the debugger interface
      container rba_Mpu_CrossbarMpu [0..*]: multiplicity set at pre-compile, requires-index=true  # Crossbar MPU (for IFX) | Configured crossbar MPU regions can be partitioned project specific as needed to different container All regions of one container do not have to be within a similar memory area It is not mandatory to use certain partitioning of crossbar MPU regions. It is also possible to configure all regions within one container
        enumeration rba_Mpu_CrossbarMpuMemory [0..1]: {RAM0, RAM1, RAM2, RAM3, RAM4, RAM5, DLMU0, DLMU1, DLMU2, DLMU3, DLMU4, DLMU5, LMU0, LMU1, LMU2, DAM0, DAM1, HSSL_PROTECTION}, multiplicity set at pre-compile, origin=RB, set at pre-compile  # Memory ID | Memory ID for current crossbar MPU container. Determines to which memory the configured MPU regions within this container are belonging. This tag can be used for configuration checks from project side and is only relevant within configuration scope. This tag is not considered within c-code-generation within rba_Mpu.
        container rba_Mpu_CrossbarMpuRegion [0..*]: multiplicity set at pre-compile, requires-index=true  # Crossbar MPU Region | For IFX 40nm controller: Crossbar MPU will deny access to all memory areas, which are not configured in this container. So please make sure, that all accessible memory areas are configured here. For core RAM 8 regions are available for each core. For system RAM additional regions are available: For IFX device 3 40nm 8 regions for each DLMU (DLMU0, DLMU1, DLMU2) and 8 regions for DAM0. For IFX device 4 40nm 16 regions for LMU0 and 8 regions for each DLMU area (DLMU0, DLMU1, DLMU2, DLMU3) and 8 region for DAM0. For IFX device 5 40nm 16 regions for each LMU area (LMU0, LMU1, LMU2) and 8 regions for each DLMU area (DLMU0, DLMU1, DLMU2, DLMU3, DLMU4, DLMU5) and 8 regions for each DAM (DAM0, DAM1)
          boolean rba_Mpu_C2cReadAccessEnable [0..1]: multiplicity set at pre-compile, origin=RB, set at pre-compile, default-value=false  # C2C Read Access Enable | This enables read access for chip to chip communication
          boolean rba_Mpu_C2cWriteAccessEnable [0..1]: multiplicity set at pre-compile, origin=RB, set at pre-compile, default-value=false  # C2C Write Access Enable | This enables write access for chip to chip communication
          boolean rba_Mpu_Core0ReadAccessEnable [0..1]: multiplicity set at pre-compile, origin=RB, set at pre-compile, default-value=true  # Core0 Read Access Enable | This enables read access for core 0
          boolean rba_Mpu_Core0WriteAccessEnable [0..1]: multiplicity set at pre-compile, origin=RB, set at pre-compile, default-value=false  # Core0 Write Access Enable | This enables write access for core 0
          boolean rba_Mpu_Core1ReadAccessEnable [0..1]: multiplicity set at pre-compile, origin=RB, set at pre-compile, default-value=true  # Core1 Read Access Enable | This enables read access for core 1
          boolean rba_Mpu_Core1WriteAccessEnable [0..1]: multiplicity set at pre-compile, origin=RB, set at pre-compile, default-value=false  # Core1 Write Access Enable | This enables write access for core 1
          boolean rba_Mpu_Core2ReadAccessEnable [0..1]: multiplicity set at pre-compile, origin=RB, set at pre-compile, default-value=true  # Core2 Read Access Enable | This enables read access for core 2
          boolean rba_Mpu_Core2WriteAccessEnable [0..1]: multiplicity set at pre-compile, origin=RB, set at pre-compile, default-value=false  # Core2 Write Access Enable | This enables write access for core 2
          boolean rba_Mpu_Core3ReadAccessEnable [0..1]: multiplicity set at pre-compile, origin=RB, set at pre-compile, default-value=true  # Core3 Read Access Enable | This enables read access for core 3
          boolean rba_Mpu_Core3WriteAccessEnable [0..1]: multiplicity set at pre-compile, origin=RB, set at pre-compile, default-value=false  # Core3 Write Access Enable | This enables write access for core 3
          boolean rba_Mpu_Core4ReadAccessEnable [0..1]: multiplicity set at pre-compile, origin=RB, set at pre-compile, default-value=true  # Core4 Read Access Enable | This enables read access for core 4
          boolean rba_Mpu_Core4WriteAccessEnable [0..1]: multiplicity set at pre-compile, origin=RB, set at pre-compile, default-value=false  # Core4 Write Access Enable | This enables write access for core 4
          boolean rba_Mpu_Core5ReadAccessEnable [0..1]: multiplicity set at pre-compile, origin=RB, set at pre-compile, default-value=true  # Core5 Read Access Enable | This enables read access for core 5
          boolean rba_Mpu_Core5WriteAccessEnable [0..1]: multiplicity set at pre-compile, origin=RB, set at pre-compile, default-value=false  # Core5 Write Access Enable | This enables write access for core 5
          boolean rba_Mpu_DebuggerReadAccessEnable [0..1]: multiplicity set at pre-compile, origin=RB, set at pre-compile, default-value=true  # Debugger Read Access Enable | This enables read access for debugger interface
          boolean rba_Mpu_DebuggerWriteAccessEnable [0..1]: multiplicity set at pre-compile, origin=RB, set at pre-compile, default-value=false  # Debugger Write Access Enable | This enables write access for debugger interface
          boolean rba_Mpu_DmaReadAccessEnable [0..1]: multiplicity set at pre-compile, origin=RB, set at pre-compile, default-value=true  # DMA Read Access Enable | This enables read access for DMA
          boolean rba_Mpu_DmaWriteAccessEnable [0..1]: multiplicity set at pre-compile, origin=RB, set at pre-compile, default-value=false  # DMA Write Access Enable | This enables write access for DMA
          boolean rba_Mpu_EthernetReadAccessEnable [0..1]: multiplicity set at pre-compile, origin=RB, set at pre-compile, default-value=true  # Ethernet Read Access Enable | This enables read access for Ethernet
          boolean rba_Mpu_EthernetWriteAccessEnable [0..1]: multiplicity set at pre-compile, origin=RB, set at pre-compile, default-value=false  # Ethernet Write Access Enable | This enables write access for Ethernet
          boolean rba_Mpu_HsmReadAccessEnable [0..1]: multiplicity set at pre-compile, origin=RB, set at pre-compile, default-value=true  # HSM Read Access Enable | This enables read access for HSM
          boolean rba_Mpu_HsmWriteAccessEnable [0..1]: multiplicity set at pre-compile, origin=RB, set at pre-compile, default-value=false  # HSM Write Access Enable | This enables write access for HSM
          boolean rba_Mpu_HsslUnit0 [0..1]: multiplicity set at pre-compile, origin=RB, set at pre-compile, default-value=false  # Valid for HSSL0 Unit | Current region is valid for HSSL0 Unit (only needed for C2C communication)
          boolean rba_Mpu_HsslUnit1 [0..1]: multiplicity set at pre-compile, origin=RB, set at pre-compile, default-value=false  # Valid for HSSL1 Unit | Current region is valid for HSSL1 Unit (only needed for C2C communication)
          string rba_Mpu_RegionEndAddress: origin=RB, set at pre-compile  # End Address | End address for the region to protect
          string rba_Mpu_RegionStartAddress: origin=RB, set at pre-compile  # Start Address | Start address for the region to protect
      container rba_Mpu_HypNocFirewall [0..*]: multiplicity set at pre-compile, requires-index=true  # EL2 NOC Firewall (for ST) | EL2 NOC Firewall
        enumeration rba_Mpu_FirewallInstance: {AES0, AES1, AES2, AES3, AIPS0, AIPS1, AIPS2, AIPS3, AIPS4, DAP, DFA, DME, DSPH, GTM, HSM, CLUSTER0, CLUSTER1, CLUSTER2, NVM, OCTOSPI, SYSRAM0, SYSRAM1, TMC0, TMC1, TMC2}, origin=RB, set at pre-compile  # Firewall Instance | Firewall instance of configured regions in current container
        container rba_Mpu_HypNocFirewallRegion [0..*]: multiplicity set at pre-compile, requires-index=true  # EL2 NOC Firewall Region | EL2 NOC Firewall region
          enumeration rba_Mpu_MemoryType: origin=RB, set at pre-compile  # Memory type | Region memory type for SR6X7: Device non-bufferable (nGnRnE) Device bufferable (nGnRE, nGRE or GRE) Normal non-cacheable bufferable Write-through read-allocate (Normal outer write-through) Write-back read-allocate (Normal outer write-back) Region memory type for SR6P6: NormalCacheable Normal non-cacheable or Device
            DeviceNonBufferable  # For X7 - Device non-bufferable (nGnRnE)
            DeviceBufferable  # For X7 - Device bufferable (nGnRE, nGRE or GRE)
            NormalNonCacheable  # For X7 - Normal non-cacheable bufferable
            WriteThrough  # For X7 - Write-through read-allocate (Normal outer write-through)
            WriteBack  # For X7 - Write-back read-allocate (Normal outer write-back)
            NormalCacheable  # For P6 - Normal cacheable
            NormalNonCacheableOrDevice  # For P6 - Normal non-cacheable or Device
          string rba_Mpu_RegionEndAddress: origin=RB, set at pre-compile  # End Address | End address for the region to protect
          string rba_Mpu_RegionStartAddress: origin=RB, set at pre-compile  # Start Address | Start address for the region to protect
          boolean rba_Mpu_SafeMasterAccess: origin=RB, set at pre-compile  # Safe master access only | If this tag is set, only safe master can access this region. If this tag is not set (as per default, also unsafe master can access this region)
          enumeration rba_Mpu_Shareability: origin=RB, set at pre-compile  # Read shareability | Region read shareability: Read unshareable (read access only for VMID which is configured for write access) Read shareable to all VMIDs Restricted read shareable (read access for VMIDs which are configured for read or write access)
            ReadUnshareable  # Read unshareable (read access only for configured write VMID)
            ReadShareable  # Read shareable to all VMIDs
            RestrictedReadShareble  # Restricted read shareable (read access for configured read and write VMIDs)
          integer rba_Mpu_VmidRead{0..5} [0..1]: 0..255, multiplicity set at pre-compile, origin=RB, set at pre-compile  # VMID read access {0..5} | VMID which has read access to current region
          integer rba_Mpu_VmidWrite: 0..255, origin=RB, set at pre-compile  # VMID write access | VMID which has write access to current region
      container rba_Mpu_NocFirewall [0..*]: multiplicity set at pre-compile, requires-index=true  # EL1 NOC Firewall (for ST) | EL1 NOC Firewall
        enumeration rba_Mpu_FirewallInstance: {AES0, AES1, AES2, AES3, AIPS0, AIPS1, AIPS2, AIPS3, AIPS4, DAP, DFA, DME, DSPH, GTM, HSM, CLUSTER0, CLUSTER1, CLUSTER2, NVM, OCTOSPI, SYSRAM0, SYSRAM1, TMC0, TMC1, TMC2}, origin=RB, set at pre-compile  # Firewall Instance | Firewall instance of configured regions in current container
        container rba_Mpu_NocFirewallRegion [0..*]: multiplicity set at pre-compile, requires-index=true  # EL1 NOC Firewall Region | EL1 NOC Firewall region
          boolean rba_Mpu_C2c0ExecuteAccessEnable [0..1]: multiplicity set at pre-compile, origin=RB, set at pre-compile, default-value=false  # C2c0 Execute Access Enable | This enables execute access for C2c0
          boolean rba_Mpu_C2c0ReadAccessEnable [0..1]: multiplicity set at pre-compile, origin=RB, set at pre-compile, default-value=false  # C2c0 Read Access Enable | This enables read access for C2c0
          boolean rba_Mpu_C2c0WriteAccessEnable [0..1]: multiplicity set at pre-compile, origin=RB, set at pre-compile, default-value=false  # C2c0 Write Access Enable | This enables write access for C2c0
          boolean rba_Mpu_C2c1ExecuteAccessEnable [0..1]: multiplicity set at pre-compile, origin=RB, set at pre-compile, default-value=false  # C2c1 Execute Access Enable | This enables execute access for C2c1
          boolean rba_Mpu_C2c1ReadAccessEnable [0..1]: multiplicity set at pre-compile, origin=RB, set at pre-compile, default-value=false  # C2c1 Read Access Enable | This enables read access for C2c1
          boolean rba_Mpu_C2c1WriteAccessEnable [0..1]: multiplicity set at pre-compile, origin=RB, set at pre-compile, default-value=false  # C2c1 Write Access Enable | This enables write access for C2c1
          boolean rba_Mpu_Core0ExecuteAccessEnable [0..1]: multiplicity set at pre-compile, origin=RB, set at pre-compile, default-value=false  # Core0 Execute Access Enable | This enables execute access for core 0
          boolean rba_Mpu_Core0ReadAccessEnable [0..1]: multiplicity set at pre-compile, origin=RB, set at pre-compile, default-value=true  # Core0 Read Access Enable | This enables read access for core 0
          boolean rba_Mpu_Core0WriteAccessEnable [0..1]: multiplicity set at pre-compile, origin=RB, set at pre-compile, default-value=false  # Core0 Write Access Enable | This enables write access for core 0
          boolean rba_Mpu_Core1ExecuteAccessEnable [0..1]: multiplicity set at pre-compile, origin=RB, set at pre-compile, default-value=false  # Core1 Execute Access Enable | This enables execute access for core 1
          boolean rba_Mpu_Core1ReadAccessEnable [0..1]: multiplicity set at pre-compile, origin=RB, set at pre-compile, default-value=true  # Core1 Read Access Enable | This enables read access for core 1
          boolean rba_Mpu_Core1WriteAccessEnable [0..1]: multiplicity set at pre-compile, origin=RB, set at pre-compile, default-value=false  # Core1 Write Access Enable | This enables write access for core 1
          boolean rba_Mpu_Core2ExecuteAccessEnable [0..1]: multiplicity set at pre-compile, origin=RB, set at pre-compile, default-value=false  # Core2 Execute Access Enable | This enables execute access for core 2
          boolean rba_Mpu_Core2ReadAccessEnable [0..1]: multiplicity set at pre-compile, origin=RB, set at pre-compile, default-value=true  # Core2 Read Access Enable | This enables read access for core 2
          boolean rba_Mpu_Core2WriteAccessEnable [0..1]: multiplicity set at pre-compile, origin=RB, set at pre-compile, default-value=false  # Core2 Write Access Enable | This enables write access for core 2
          boolean rba_Mpu_Core3ExecuteAccessEnable [0..1]: multiplicity set at pre-compile, origin=RB, set at pre-compile, default-value=false  # Core3 Execute Access Enable | This enables execute access for core 3
          boolean rba_Mpu_Core3ReadAccessEnable [0..1]: multiplicity set at pre-compile, origin=RB, set at pre-compile, default-value=true  # Core3 Read Access Enable | This enables read access for core 3
          boolean rba_Mpu_Core3WriteAccessEnable [0..1]: multiplicity set at pre-compile, origin=RB, set at pre-compile, default-value=false  # Core3 Write Access Enable | This enables write access for core 3
          boolean rba_Mpu_Core4ExecuteAccessEnable [0..1]: multiplicity set at pre-compile, origin=RB, set at pre-compile, default-value=false  # Core4 Execute Access Enable | This enables execute access for core 4
          boolean rba_Mpu_Core4ReadAccessEnable [0..1]: multiplicity set at pre-compile, origin=RB, set at pre-compile, default-value=true  # Core4 Read Access Enable | This enables read access for core 4
          boolean rba_Mpu_Core4WriteAccessEnable [0..1]: multiplicity set at pre-compile, origin=RB, set at pre-compile, default-value=false  # Core4 Write Access Enable | This enables write access for core 4
          boolean rba_Mpu_Core5ExecuteAccessEnable [0..1]: multiplicity set at pre-compile, origin=RB, set at pre-compile, default-value=false  # Core5 Execute Access Enable | This enables execute access for core 5
          boolean rba_Mpu_Core5ReadAccessEnable [0..1]: multiplicity set at pre-compile, origin=RB, set at pre-compile, default-value=true  # Core5 Read Access Enable | This enables read access for core 5
          boolean rba_Mpu_Core5WriteAccessEnable [0..1]: multiplicity set at pre-compile, origin=RB, set at pre-compile, default-value=false  # Core5 Write Access Enable | This enables write access for core 5
          boolean rba_Mpu_DebuggerExecuteAccessEnable [0..1]: multiplicity set at pre-compile, origin=RB, set at pre-compile, default-value=false  # Debugger Execute Access Enable | This enables execute access for debugger interface
          boolean rba_Mpu_DebuggerReadAccessEnable [0..1]: multiplicity set at pre-compile, origin=RB, set at pre-compile, default-value=true  # Debugger Read Access Enable | This enables read access for debugger interface
          boolean rba_Mpu_DebuggerWriteAccessEnable [0..1]: multiplicity set at pre-compile, origin=RB, set at pre-compile, default-value=false  # Debugger Write Access Enable | This enables write access for debugger interface
          boolean rba_Mpu_DfaExecuteAccessEnable [0..1]: multiplicity set at pre-compile, origin=RB, set at pre-compile, default-value=false  # DFA Execute Access Enable | This enables execute access for DFA
          boolean rba_Mpu_DfaReadAccessEnable [0..1]: multiplicity set at pre-compile, origin=RB, set at pre-compile, default-value=true  # DFA Read Access Enable | This enables read access for DFA
          boolean rba_Mpu_DfaWriteAccessEnable [0..1]: multiplicity set at pre-compile, origin=RB, set at pre-compile, default-value=false  # DFA Write Access Enable | This enables write access for DFA
          boolean rba_Mpu_Dma0ExecuteAccessEnable [0..1]: multiplicity set at pre-compile, origin=RB, set at pre-compile, default-value=false  # DMA0 Execute Access Enable | This enables execute access for DMA0
          boolean rba_Mpu_Dma0ReadAccessEnable [0..1]: multiplicity set at pre-compile, origin=RB, set at pre-compile, default-value=true  # DMA0 Read Access Enable | This enables read access for DMA0
          boolean rba_Mpu_Dma0WriteAccessEnable [0..1]: multiplicity set at pre-compile, origin=RB, set at pre-compile, default-value=false  # DMA0 Write Access Enable | This enables write access for DMA0
          boolean rba_Mpu_Dma1ExecuteAccessEnable [0..1]: multiplicity set at pre-compile, origin=RB, set at pre-compile, default-value=false  # DMA1 Execute Access Enable | This enables execute access for DMA1
          boolean rba_Mpu_Dma1ReadAccessEnable [0..1]: multiplicity set at pre-compile, origin=RB, set at pre-compile, default-value=true  # DMA1 Read Access Enable | This enables read access for DMA1
          boolean rba_Mpu_Dma1WriteAccessEnable [0..1]: multiplicity set at pre-compile, origin=RB, set at pre-compile, default-value=false  # DMA1 Write Access Enable | This enables write access for DMA1
          boolean rba_Mpu_Dma2ExecuteAccessEnable [0..1]: multiplicity set at pre-compile, origin=RB, set at pre-compile, default-value=false  # DMA2 Execute Access Enable | This enables execute access for DMA2
          boolean rba_Mpu_Dma2ReadAccessEnable [0..1]: multiplicity set at pre-compile, origin=RB, set at pre-compile, default-value=true  # DMA2 Read Access Enable | This enables read access for DMA2
          boolean rba_Mpu_Dma2WriteAccessEnable [0..1]: multiplicity set at pre-compile, origin=RB, set at pre-compile, default-value=false  # DMA2 Write Access Enable | This enables write access for DMA2
          boolean rba_Mpu_Dma3ExecuteAccessEnable [0..1]: multiplicity set at pre-compile, origin=RB, set at pre-compile, default-value=false  # DMA3 Execute Access Enable | This enables execute access for DMA3
          boolean rba_Mpu_Dma3ReadAccessEnable [0..1]: multiplicity set at pre-compile, origin=RB, set at pre-compile, default-value=true  # DMA3 Read Access Enable | This enables read access for DMA3
          boolean rba_Mpu_Dma3WriteAccessEnable [0..1]: multiplicity set at pre-compile, origin=RB, set at pre-compile, default-value=false  # DMA3 Write Access Enable | This enables write access for DMA3
          boolean rba_Mpu_DmeExecuteAccessEnable [0..1]: multiplicity set at pre-compile, origin=RB, set at pre-compile, default-value=false  # DME Execute Access Enable | This enables execute access for DME
          boolean rba_Mpu_DmeReadAccessEnable [0..1]: multiplicity set at pre-compile, origin=RB, set at pre-compile, default-value=true  # DME Read Access Enable | This enables read access for DME
          boolean rba_Mpu_DmeWriteAccessEnable [0..1]: multiplicity set at pre-compile, origin=RB, set at pre-compile, default-value=false  # DME Write Access Enable | This enables write access for DME
          boolean rba_Mpu_DsphExecuteAccessEnable [0..1]: multiplicity set at pre-compile, origin=RB, set at pre-compile, default-value=false  # DSPH Execute Access Enable | This enables execute access for DSPH
          boolean rba_Mpu_DsphReadAccessEnable [0..1]: multiplicity set at pre-compile, origin=RB, set at pre-compile, default-value=true  # DSPH Read Access Enable | This enables read access for DSPH
          boolean rba_Mpu_DsphWriteAccessEnable [0..1]: multiplicity set at pre-compile, origin=RB, set at pre-compile, default-value=false  # DSPH Write Access Enable | This enables write access for DSPH
          boolean rba_Mpu_Ethernet0ExecuteAccessEnable [0..1]: multiplicity set at pre-compile, origin=RB, set at pre-compile, default-value=false  # Ethernet0 Execute Access Enable | This enables execute access for Ethernet0
          boolean rba_Mpu_Ethernet0ReadAccessEnable [0..1]: multiplicity set at pre-compile, origin=RB, set at pre-compile, default-value=true  # Ethernet0 Read Access Enable | This enables read access for Ethernet0
          boolean rba_Mpu_Ethernet0WriteAccessEnable [0..1]: multiplicity set at pre-compile, origin=RB, set at pre-compile, default-value=false  # Ethernet0 Write Access Enable | This enables write access for Ethernet0
          boolean rba_Mpu_Ethernet1ExecuteAccessEnable [0..1]: multiplicity set at pre-compile, origin=RB, set at pre-compile, default-value=false  # Ethernet1 Execute Access Enable | This enables execute access for Ethernet1
          boolean rba_Mpu_Ethernet1ReadAccessEnable [0..1]: multiplicity set at pre-compile, origin=RB, set at pre-compile, default-value=true  # Ethernet1 Read Access Enable | This enables read access for Ethernet1
          boolean rba_Mpu_Ethernet1WriteAccessEnable [0..1]: multiplicity set at pre-compile, origin=RB, set at pre-compile, default-value=false  # Ethernet1 Write Access Enable | This enables write access for Ethernet1
          boolean rba_Mpu_Flexray0ExecuteAccessEnable [0..1]: multiplicity set at pre-compile, origin=RB, set at pre-compile, default-value=false  # Flexray0 Execute Access Enable | This enables execute access for Flexray0
          boolean rba_Mpu_Flexray0ReadAccessEnable [0..1]: multiplicity set at pre-compile, origin=RB, set at pre-compile, default-value=true  # Flexray0 Read Access Enable | This enables read access for Flexray0
          boolean rba_Mpu_Flexray0WriteAccessEnable [0..1]: multiplicity set at pre-compile, origin=RB, set at pre-compile, default-value=false  # Flexray0 Write Access Enable | This enables write access for Flexray0
          boolean rba_Mpu_Flexray1ExecuteAccessEnable [0..1]: multiplicity set at pre-compile, origin=RB, set at pre-compile, default-value=false  # Flexray1 Execute Access Enable | This enables execute access for Flexray1
          boolean rba_Mpu_Flexray1ReadAccessEnable [0..1]: multiplicity set at pre-compile, origin=RB, set at pre-compile, default-value=true  # Flexray1 Read Access Enable | This enables read access for Flexray1
          boolean rba_Mpu_Flexray1WriteAccessEnable [0..1]: multiplicity set at pre-compile, origin=RB, set at pre-compile, default-value=false  # Flexray1 Write Access Enable | This enables write access for Flexray1
          boolean rba_Mpu_GtmExecuteAccessEnable [0..1]: multiplicity set at pre-compile, origin=RB, set at pre-compile, default-value=false  # GTM Execute Access Enable | This enables execute access for GTM
          boolean rba_Mpu_GtmReadAccessEnable [0..1]: multiplicity set at pre-compile, origin=RB, set at pre-compile, default-value=true  # GTM Read Access Enable | This enables read access for GTM
          boolean rba_Mpu_GtmWriteAccessEnable [0..1]: multiplicity set at pre-compile, origin=RB, set at pre-compile, default-value=false  # GTM Write Access Enable | This enables write access for GTM
          boolean rba_Mpu_HsmExecuteAccessEnable [0..1]: multiplicity set at pre-compile, origin=RB, set at pre-compile, default-value=false  # HSM Execute Access Enable | This enables execute access for HSM
          boolean rba_Mpu_HsmReadAccessEnable [0..1]: multiplicity set at pre-compile, origin=RB, set at pre-compile, default-value=true  # HSM Read Access Enable | This enables read access for HSM
          boolean rba_Mpu_HsmWriteAccessEnable [0..1]: multiplicity set at pre-compile, origin=RB, set at pre-compile, default-value=false  # HSM Write Access Enable | This enables write access for HSM
          integer rba_Mpu_PartitionId [0..1]: multiplicity set at pre-compile, origin=RB, set at pre-compile  # Partition ID to which this region belongs
          boolean rba_Mpu_PartitionRegion [0..1]: multiplicity set at pre-compile, origin=RB, set at pre-compile, default-value=false  # Current region is partition region | Current region is partition region and used for partition specific set up
          integer rba_Mpu_PartitionWithSubRegions [0..1]: 1.., multiplicity set at pre-compile, origin=RB, set at pre-compile, default-value=1  # Number of regions including subregions for this partition
          string rba_Mpu_RegionEndAddress: origin=RB, set at pre-compile  # End Address | End address for the region to protect
          string rba_Mpu_RegionStartAddress: origin=RB, set at pre-compile  # Start Address | Start address for the region to protect
          boolean rba_Mpu_TmcExecuteAccessEnable [0..1]: multiplicity set at pre-compile, origin=RB, set at pre-compile, default-value=false  # TMC Execute Access Enable | This enables execute access for TMC
          boolean rba_Mpu_TmcReadAccessEnable [0..1]: multiplicity set at pre-compile, origin=RB, set at pre-compile, default-value=true  # TMC Read Access Enable | This enables read access for TMC
          boolean rba_Mpu_TmcWriteAccessEnable [0..1]: multiplicity set at pre-compile, origin=RB, set at pre-compile, default-value=false  # TMC Write Access Enable | This enables write access for TMC
    container rba_Mpu_GeneralCfgDataSet [0..1]: multiplicity set at pre-compile  # General Configuration | General configuration container
      boolean rba_Mpu_DevErrorDetect [0..1]: multiplicity set at pre-compile, origin=RB, set at pre-compile, default-value=true  # Development error detection | Enables/disables the detection and notification of development errors. If this parameter is enabled, then error checking is performed during runtime; any errors detected by these checks are reported to the Det module
      boolean rba_Mpu_EnableRbaResetUsage [0..1]: multiplicity set at pre-compile, origin=RB, set at pre-compile, default-value=true  # Usage of rba_Reset | Enables/disables the usage of rba_Reset. Per default, if nothing is configured here, rba_Reset is used. If rba_Reset is not used, all resets are mapped within rba_Mpu_Cfg_SchM.h to Mcu_PerformReset() per default, but can be remapped to any project specific reset, if needed
      boolean rba_Mpu_EnableRtaOsSafeguard [0..1]: multiplicity set at pre-compile, origin=RB, set at pre-compile, default-value=false  # Usage of RTA-OS for safeguard | Enables/disables the usage of RTA-OS in addition to safeguard configuration (Application specific reprogramming of core MPU regions and dynamic stack protection within Os_Cbk_SetMemoryAccess. If this is not configured as true, safeguard feature is not supported. Safeguard feature is only supported with RTA-OS
    container rba_Mpu_PeripheralMpu [0..1]: multiplicity set at pre-compile  # Peripheral MPU (only for ST 28nm devices) | Container for peripheral MPU configuration
      container rba_Mpu_PeripheralBridge [0..*]: multiplicity set at pre-compile, requires-index=true  # Peripheral Bridge | Container for peripheral bridge
        boolean rba_Mpu_C2c0NotForcedToUser [0..1]: multiplicity set at pre-compile, origin=RB, set at pre-compile, default-value=true  # C2c0 access is not forced to user mode
        boolean rba_Mpu_C2c0TrustedForRead [0..1]: multiplicity set at pre-compile, origin=RB, set at pre-compile, default-value=false  # C2c0 trusted for read | C2c0 access is trusted for read access
        boolean rba_Mpu_C2c0TrustedForWrite [0..1]: multiplicity set at pre-compile, origin=RB, set at pre-compile, default-value=false  # C2c0 trusted for write | C2c0 access is trusted for write access
        boolean rba_Mpu_C2c1NotForcedToUser [0..1]: multiplicity set at pre-compile, origin=RB, set at pre-compile, default-value=true  # C2c1 access is not forced to user mode
        boolean rba_Mpu_C2c1TrustedForRead [0..1]: multiplicity set at pre-compile, origin=RB, set at pre-compile, default-value=false  # C2c1 trusted for read | C2c1 access is trusted for read access
        boolean rba_Mpu_C2c1TrustedForWrite [0..1]: multiplicity set at pre-compile, origin=RB, set at pre-compile, default-value=false  # C2c1 trusted for write | C2c1 access is trusted for write access
        boolean rba_Mpu_Core0NotForcedToUser [0..1]: multiplicity set at pre-compile, origin=RB, set at pre-compile, default-value=true  # Core0 access is not forced to user mode | Core 0 access is not forced to user mode
        boolean rba_Mpu_Core0TrustedForRead [0..1]: multiplicity set at pre-compile, origin=RB, set at pre-compile, default-value=true  # Core0 trusted for read | Core 0 access is trusted for read access
        boolean rba_Mpu_Core0TrustedForWrite [0..1]: multiplicity set at pre-compile, origin=RB, set at pre-compile, default-value=false  # Core0 trusted for write | Core 0 access is trusted for write access
        boolean rba_Mpu_Core1NotForcedToUser [0..1]: multiplicity set at pre-compile, origin=RB, set at pre-compile, default-value=true  # Core1 access is not forced to user mode | Core 1 access is not forced to user mode
        boolean rba_Mpu_Core1TrustedForRead [0..1]: multiplicity set at pre-compile, origin=RB, set at pre-compile, default-value=true  # Core1 trusted for read | Core 1 access is trusted for read access
        boolean rba_Mpu_Core1TrustedForWrite [0..1]: multiplicity set at pre-compile, origin=RB, set at pre-compile, default-value=false  # Core1 trusted for write | Core 1 access is trusted for write access
        boolean rba_Mpu_Core2NotForcedToUser [0..1]: multiplicity set at pre-compile, origin=RB, set at pre-compile, default-value=true  # Core2 access is not forced to user mode | Core 2 access is not forced to user mode
        boolean rba_Mpu_Core2TrustedForRead [0..1]: multiplicity set at pre-compile, origin=RB, set at pre-compile, default-value=true  # Core2 trusted for read | Core 2 access is trusted for read access
        boolean rba_Mpu_Core2TrustedForWrite [0..1]: multiplicity set at pre-compile, origin=RB, set at pre-compile, default-value=false  # Core2 trusted for write | Core 2 access is trusted for write access
        boolean rba_Mpu_Core3NotForcedToUser [0..1]: multiplicity set at pre-compile, origin=RB, set at pre-compile, default-value=true  # Core3 access is not forced to user mode | Core 3 access is not forced to user mode
        boolean rba_Mpu_Core3TrustedForRead [0..1]: multiplicity set at pre-compile, origin=RB, set at pre-compile, default-value=true  # Core3 trusted for read | Core 3 access is trusted for read access
        boolean rba_Mpu_Core3TrustedForWrite [0..1]: multiplicity set at pre-compile, origin=RB, set at pre-compile, default-value=false  # Core3 trusted for write | Core 3 access is trusted for write access
        boolean rba_Mpu_Core4NotForcedToUser [0..1]: multiplicity set at pre-compile, origin=RB, set at pre-compile, default-value=true  # Core4 access is not forced to user mode | Core 4 access is not forced to user mode
        boolean rba_Mpu_Core4TrustedForRead [0..1]: multiplicity set at pre-compile, origin=RB, set at pre-compile, default-value=true  # Core4 trusted for read | Core 4 access is trusted for read access
        boolean rba_Mpu_Core4TrustedForWrite [0..1]: multiplicity set at pre-compile, origin=RB, set at pre-compile, default-value=false  # Core4 trusted for write | Core 4 access is trusted for write access
        boolean rba_Mpu_Core5NotForcedToUser [0..1]: multiplicity set at pre-compile, origin=RB, set at pre-compile, default-value=true  # Core5 access is not forced to user mode | Core 5 access is not forced to user mode
        boolean rba_Mpu_Core5TrustedForRead [0..1]: multiplicity set at pre-compile, origin=RB, set at pre-compile, default-value=true  # Core5 trusted for read | Core 5 access is trusted for read access
        boolean rba_Mpu_Core5TrustedForWrite [0..1]: multiplicity set at pre-compile, origin=RB, set at pre-compile, default-value=false  # Core5 trusted for write | Core 5 access is trusted for write access
        boolean rba_Mpu_DebuggerNotForcedToUser [0..1]: multiplicity set at pre-compile, origin=RB, set at pre-compile, default-value=true  # Debugger access is not forced to user mode
        boolean rba_Mpu_DebuggerTrustedForRead [0..1]: multiplicity set at pre-compile, origin=RB, set at pre-compile, default-value=true  # Debugger trusted for read | Debugger access is trusted for read access
        boolean rba_Mpu_DebuggerTrustedForWrite [0..1]: multiplicity set at pre-compile, origin=RB, set at pre-compile, default-value=false  # Debugger trusted for write | Debugger access is trusted for write access
        boolean rba_Mpu_DfaNotForcedToUser [0..1]: multiplicity set at pre-compile, origin=RB, set at pre-compile, default-value=true  # DFA access is not forced to user mode
        boolean rba_Mpu_DfaTrustedForRead [0..1]: multiplicity set at pre-compile, origin=RB, set at pre-compile, default-value=true  # DFA trusted for read | DFA access is trusted for read access
        boolean rba_Mpu_DfaTrustedForWrite [0..1]: multiplicity set at pre-compile, origin=RB, set at pre-compile, default-value=false  # DFA trusted for write | DFA access is trusted for write access
        boolean rba_Mpu_Dma0NotForcedToUser [0..1]: multiplicity set at pre-compile, origin=RB, set at pre-compile, default-value=true  # DMA0 access is not forced to user mode
        boolean rba_Mpu_Dma0TrustedForRead [0..1]: multiplicity set at pre-compile, origin=RB, set at pre-compile, default-value=true  # DMA0 trusted for read | DMA0 access is trusted for read access
        boolean rba_Mpu_Dma0TrustedForWrite [0..1]: multiplicity set at pre-compile, origin=RB, set at pre-compile, default-value=false  # DMA0 trusted for write | DMA0 access is trusted for write access
        boolean rba_Mpu_Dma1NotForcedToUser [0..1]: multiplicity set at pre-compile, origin=RB, set at pre-compile, default-value=true  # DMA1 access is not forced to user mode
        boolean rba_Mpu_Dma1TrustedForRead [0..1]: multiplicity set at pre-compile, origin=RB, set at pre-compile, default-value=true  # DMA1 trusted for read | DMA1 access is trusted for read access
        boolean rba_Mpu_Dma1TrustedForWrite [0..1]: multiplicity set at pre-compile, origin=RB, set at pre-compile, default-value=false  # DMA1 trusted for write | DMA1 access is trusted for write access
        boolean rba_Mpu_Dma2NotForcedToUser [0..1]: multiplicity set at pre-compile, origin=RB, set at pre-compile, default-value=true  # DMA2 access is not forced to user mode
        boolean rba_Mpu_Dma2TrustedForRead [0..1]: multiplicity set at pre-compile, origin=RB, set at pre-compile, default-value=true  # DMA2 trusted for read | DMA2 access is trusted for read access
        boolean rba_Mpu_Dma2TrustedForWrite [0..1]: multiplicity set at pre-compile, origin=RB, set at pre-compile, default-value=false  # DMA2 trusted for write | DMA2 access is trusted for write access
        boolean rba_Mpu_Dma3NotForcedToUser [0..1]: multiplicity set at pre-compile, origin=RB, set at pre-compile, default-value=true  # DMA3 access is not forced to user mode
        boolean rba_Mpu_Dma3TrustedForRead [0..1]: multiplicity set at pre-compile, origin=RB, set at pre-compile, default-value=true  # DMA3 trusted for read | DMA3 access is trusted for read access
        boolean rba_Mpu_Dma3TrustedForWrite [0..1]: multiplicity set at pre-compile, origin=RB, set at pre-compile, default-value=false  # DMA3 trusted for write | DMA3 access is trusted for write access
        boolean rba_Mpu_DmeNotForcedToUser [0..1]: multiplicity set at pre-compile, origin=RB, set at pre-compile, default-value=true  # DME access is not forced to user mode
        boolean rba_Mpu_DmeTrustedForRead [0..1]: multiplicity set at pre-compile, origin=RB, set at pre-compile, default-value=true  # DME trusted for read | DME access is trusted for read access
        boolean rba_Mpu_DmeTrustedForWrite [0..1]: multiplicity set at pre-compile, origin=RB, set at pre-compile, default-value=false  # DME trusted for write | DME access is trusted for write access
        boolean rba_Mpu_DsphNotForcedToUser [0..1]: multiplicity set at pre-compile, origin=RB, set at pre-compile, default-value=true  # DSPH access is not forced to user mode
        boolean rba_Mpu_DsphTrustedForRead [0..1]: multiplicity set at pre-compile, origin=RB, set at pre-compile, default-value=true  # DSPH trusted for read | DSPH access is trusted for read access
        boolean rba_Mpu_DsphTrustedForWrite [0..1]: multiplicity set at pre-compile, origin=RB, set at pre-compile, default-value=false  # DSPH trusted for write | DSPH access is trusted for write access
        boolean rba_Mpu_Ethernet0NotForcedToUser [0..1]: multiplicity set at pre-compile, origin=RB, set at pre-compile, default-value=true  # Ethernet0 access is not forced to user mode
        boolean rba_Mpu_Ethernet0TrustedForRead [0..1]: multiplicity set at pre-compile, origin=RB, set at pre-compile, default-value=true  # Ethernet0 trusted for read | Ethernet0 access is trusted for read access
        boolean rba_Mpu_Ethernet0TrustedForWrite [0..1]: multiplicity set at pre-compile, origin=RB, set at pre-compile, default-value=false  # Ethernet0 trusted for write | Ethernet0 access is trusted for write access
        boolean rba_Mpu_Ethernet1NotForcedToUser [0..1]: multiplicity set at pre-compile, origin=RB, set at pre-compile, default-value=true  # Ethernet1 access is not forced to user mode
        boolean rba_Mpu_Ethernet1TrustedForRead [0..1]: multiplicity set at pre-compile, origin=RB, set at pre-compile, default-value=true  # Ethernet1 trusted for read | Ethernet1 access is trusted for read access
        boolean rba_Mpu_Ethernet1TrustedForWrite [0..1]: multiplicity set at pre-compile, origin=RB, set at pre-compile, default-value=false  # Ethernet1 trusted for write | Ethernet1 access is trusted for write access
        boolean rba_Mpu_Flexray0NotForcedToUser [0..1]: multiplicity set at pre-compile, origin=RB, set at pre-compile, default-value=true  # Fleyray0 access is not forced to user mode | Flexray0 access is not forced to user mode
        boolean rba_Mpu_Flexray0TrustedForRead [0..1]: multiplicity set at pre-compile, origin=RB, set at pre-compile, default-value=true  # Flexray0 trusted for read | FlexRay0 access is trusted for read access
        boolean rba_Mpu_Flexray0TrustedForWrite [0..1]: multiplicity set at pre-compile, origin=RB, set at pre-compile, default-value=false  # Flexray0 trusted for write | FlexRay0 access is trusted for write access
        boolean rba_Mpu_Flexray1NotForcedToUser [0..1]: multiplicity set at pre-compile, origin=RB, set at pre-compile, default-value=true  # Fleyray1 access is not forced to user mode | Flexray1 access is not forced to user mode
        boolean rba_Mpu_Flexray1TrustedForRead [0..1]: multiplicity set at pre-compile, origin=RB, set at pre-compile, default-value=true  # Flexray1 trusted for read | FlexRay1 access is trusted for read access
        boolean rba_Mpu_Flexray1TrustedForWrite [0..1]: multiplicity set at pre-compile, origin=RB, set at pre-compile, default-value=false  # Flexray1 trusted for write | FlexRay1 access is trusted for write access
        boolean rba_Mpu_GtmNotForcedToUser [0..1]: multiplicity set at pre-compile, origin=RB, set at pre-compile, default-value=true  # GTM access is not forced to user mode
        boolean rba_Mpu_GtmTrustedForRead [0..1]: multiplicity set at pre-compile, origin=RB, set at pre-compile, default-value=true  # GTM trusted for read | GTM access is trusted for read access
        boolean rba_Mpu_GtmTrustedForWrite [0..1]: multiplicity set at pre-compile, origin=RB, set at pre-compile, default-value=false  # GTM trusted for write | GTM access is trusted for write access
        boolean rba_Mpu_HsmNotForcedToUser [0..1]: multiplicity set at pre-compile, origin=RB, set at pre-compile, default-value=true  # HSM access is not forced to user mode
        boolean rba_Mpu_HsmTrustedForRead [0..1]: multiplicity set at pre-compile, origin=RB, set at pre-compile, default-value=true  # HSM trusted for read | HSM access is trusted for read access
        boolean rba_Mpu_HsmTrustedForWrite [0..1]: multiplicity set at pre-compile, origin=RB, set at pre-compile, default-value=false  # HSM trusted for write | HSM access is trusted for write access
        integer rba_Mpu_PeripheralBridgeId: origin=RB, set at pre-compile  # Peripheral bridge ID | Selection of peripheral bridge: 0: refers to PBRIDGE_0 (AIPS_0) 1: refers to PBRIDGE_1 (AIPS_1) 2: refers to PBRIDGE_2 (AIPS_2) 3: refers to PBRIDGE_3 (AIPS_3) 4: refers to PBRIDGE_4 (AIPS_4) 5: refers to PBRIDGE_5 (AIPS_5)
        boolean rba_Mpu_TmcNotForcedToUser [0..1]: multiplicity set at pre-compile, origin=RB, set at pre-compile, default-value=true  # TMC access is not forced to user mode
        boolean rba_Mpu_TmcTrustedForRead [0..1]: multiplicity set at pre-compile, origin=RB, set at pre-compile, default-value=true  # TMC trusted for read | TMC access is trusted for read access
        boolean rba_Mpu_TmcTrustedForWrite [0..1]: multiplicity set at pre-compile, origin=RB, set at pre-compile, default-value=false  # TMC trusted for write | TMC access is trusted for write access
      container rba_Mpu_PeripheralInstance [0..*]: multiplicity set at pre-compile, requires-index=true  # Peripheral Instance | Name of peripheral instance - if a wrong or not supported name is inserted, an error message will show all supported instances. For all supported peripheral instances, see also hardware dependent json file.
        boolean rba_Mpu_SupervisorLevelRequired: origin=RB, set at pre-compile  # Peripheral requires supervisor privilege level for access | This peripheral requires supervisor privilige level for access
        boolean rba_Mpu_UntrustedMasterProtect: origin=RB, set at pre-compile  # Peripheral is protected against access from untrusted master | This peripheral is protected against access from an untrusted master
        integer rba_Mpu_Vmid [0..1]: 0..255, multiplicity set at pre-compile, origin=RB, set at pre-compile, default-value=0  # Peripheral Instance VMID | VMID associated with current peripheral instance
        boolean rba_Mpu_WriteProtect: origin=RB, set at pre-compile  # Peripheral is protected against write access | This peripheral is protected against write access
    container rba_Mpu_QoS [0..1]: multiplicity set at pre-compile  # QoS - Quality of Service (only for ST 28nm devices) | Container for QoS (Quality of Service) configuration
      container rba_Mpu_QoS_Fixed [0..*]: multiplicity set at pre-compile  # QoS Generator Fixed | Container Fixed QoS generator type
        enumeration rba_Mpu_QoS_Instance: {Flex0, Flex1, Kite0, Kite1, Kite2, DME, DSPH, HSM, EDMA0, EDMA1, EDMA2, EDMA3, DAP0, DAP1, ZipW0, ZipW1, Dfa, Ether0, Ether1, Gtm}, origin=RB, set at pre-compile  # QoS Instance | QoS instance of configured NIC (bus master) for fixed generator type
        integer rba_Mpu_QoS_UrgencyRead: 0..7, origin=RB, set at pre-compile  # Urgency level for read transactions | Urgency level for read transactions - corresponds to P1 within priority register
        integer rba_Mpu_QoS_UrgencyWrite: 0..7, origin=RB, set at pre-compile  # Urgency level for write transactions | Urgency level for write transactions - corresponds to P0 within priority register
      container rba_Mpu_QoS_Limiter [0..*]: multiplicity set at pre-compile  # QoS Generator Limiter | Container Limiter QoS generator type
        integer rba_Mpu_QoS_Bandwidth: 0..4095, origin=RB, set at pre-compile  # Bandwidth | Defines the bandwidth threshold in 1/256th-byte-per-cycle units. In other words, the desired rate in Mbytes/s is divided by frequency in MHz of the NIU, and then multiplied by 256
        enumeration rba_Mpu_QoS_Instance: {DAP0, DAP1, ZipW0, ZipW1, Dfa, Ether0, Ether1, Gtm}, origin=RB, set at pre-compile  # QoS Instance | QoS instance of configured NIC (bus master) for limiter generator type
        integer rba_Mpu_QoS_Saturation: 0..1023, origin=RB, set at pre-compile  # Saturation | Defines tolerance of the generator for blocking short-term violation of bandwidth threshold in 16-byte units. Given value defines, how many 16-byte units can be transferred until Limiter blocks access
        integer rba_Mpu_QoS_UrgencyRead: 0..7, origin=RB, set at pre-compile  # Urgency level for read transactions | Urgency level for read transactions - corresponds to P1 within priority register
        integer rba_Mpu_QoS_UrgencyWrite: 0..7, origin=RB, set at pre-compile  # Urgency level for write transactions | Urgency level for write transactions - corresponds to P0 within priority register
      container rba_Mpu_QoS_Regulator [0..*]: multiplicity set at pre-compile  # QoS Generator Regulator | Container Regulator QoS generator type
        integer rba_Mpu_QoS_Bandwidth: 0..4095, origin=RB, set at pre-compile  # Bandwidth | Defines the bandwidth threshold in 1/256th-byte-per-cycle units. In other words, the desired rate in Mbytes/s is divided by frequency in MHz of the NIU, and then multiplied by 256
        integer rba_Mpu_QoS_HighHurryLevel: 0..7, origin=RB, set at pre-compile  # High hurry level | High hurry level for regulator QoS - corresponds to P1 within priority register
        enumeration rba_Mpu_QoS_Instance: {Dfa, Ether0, Ether1, Gtm}, origin=RB, set at pre-compile  # QoS Instance | QoS instance of configured NIC (bus master) for regulator generator type
        integer rba_Mpu_QoS_LowHurryLevel: 0..7, origin=RB, set at pre-compile  # Low hurry level | Low hurry level for regulator QoS - corresponds to P0 within priority register
        integer rba_Mpu_QoS_Saturation: 0..1023, origin=RB, set at pre-compile  # Saturation | Defines tolerance of the generator for blocking short-term violation of bandwidth threshold in 16-byte units. Given value defines, how many 16-byte units can be transferred until Regulator limits access
    container rba_Mpu_Vmid [0..1]: multiplicity set at pre-compile  # VMID Module (Generation of VMIDs for distinct bus master (only for ST 28nm devices) | Container for VMID Module
      integer rba_Mpu_Vmid_C2c0 [0..1]: 0..255, multiplicity set at pre-compile, origin=RB, set at pre-compile  # C2c0 VMID | VMID of bus master C2c0
      integer rba_Mpu_Vmid_C2c1 [0..1]: 0..255, multiplicity set at pre-compile, origin=RB, set at pre-compile  # C2c1 VMID | VMID of bus master C2c1
      integer rba_Mpu_Vmid_Dfa [0..1]: 0..255, multiplicity set at pre-compile, origin=RB, set at pre-compile  # DFA VMID | VMID of bus master DFA
      integer rba_Mpu_Vmid_Dme [0..1]: 0..255, multiplicity set at pre-compile, origin=RB, set at pre-compile  # DME VMID | VMID of bus master DME
      integer rba_Mpu_Vmid_Dsph [0..1]: 0..255, multiplicity set at pre-compile, origin=RB, set at pre-compile  # DSPH VMID | VMID of bus master DSPH
      integer rba_Mpu_Vmid_Ethernet0 [0..1]: 0..255, multiplicity set at pre-compile, origin=RB, set at pre-compile  # Ethernet0 VMID | VMID of bus master Ethernet0
      integer rba_Mpu_Vmid_Ethernet1 [0..1]: 0..255, multiplicity set at pre-compile, origin=RB, set at pre-compile  # Ethernet1 VMID | VMID of bus master Ethernet1
      integer rba_Mpu_Vmid_Flexray0 [0..1]: 0..255, multiplicity set at pre-compile, origin=RB, set at pre-compile  # Flexray0 VMID | VMID of bus master Flexray0
      integer rba_Mpu_Vmid_Flexray1 [0..1]: 0..255, multiplicity set at pre-compile, origin=RB, set at pre-compile  # Flexray1 VMID | VMID of bus master Flexray1
      integer rba_Mpu_Vmid_Gtm [0..1]: 0..255, multiplicity set at pre-compile, origin=RB, set at pre-compile  # GTM VMID | VMID of bus master GTM
      integer rba_Mpu_Vmid_Hsm [0..1]: 0..255, multiplicity set at pre-compile, origin=RB, set at pre-compile  # HSM VMID | VMID of bus master HSM
      integer rba_Mpu_Vmid_Tmc [0..1]: 0..255, multiplicity set at pre-compile, origin=RB, set at pre-compile  # TMC VMID | VMID of bus master TMC
