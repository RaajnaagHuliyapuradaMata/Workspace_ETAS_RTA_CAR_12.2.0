AUTOSAR XML (schema 4-2-2)
package /RB/RBA/rba_Wdta/EcucModuleDefs
  module definition rba_Wdta [0..1]: category=VENDOR_SPECIFIC_MODULE_DEFINITION, variants pre-compile  # MCAL window watchdog timer A driver | Configuration of the rba_Wdta module for controlling the WDTA driver(s) on the Rensas XY850 CPU.
    container rba_WdtaGeneral  # General parameters of rba_Wdta | All general parameters of the WDTA driver are collected here.
      boolean rba_WdtaCheckAutosarVersion: origin=RB:1.0.0:2013-07-10, set at pre-compile  # AUTOSAR version check enable | Compile switch to enable / disable AUTOSAR version checking for this module. True: AUTOSAR version checking enabled False: AUTOSAR version checking disabled
      integer rba_WdtaModuleId: 0..255, origin=RB:1.0.0:2013-07-10, set at pre-compile, default-value=255  # Module ID of rba_Wdta | Represents the module ID of the WDTA driver (since it's not an AUTOSAR component, this can be configured)
