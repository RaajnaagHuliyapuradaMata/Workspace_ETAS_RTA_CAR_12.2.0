AUTOSAR XML (schema 00051)
package /ApplicationDataTypes
  app type MyApplicationDataType: category=VALUE
