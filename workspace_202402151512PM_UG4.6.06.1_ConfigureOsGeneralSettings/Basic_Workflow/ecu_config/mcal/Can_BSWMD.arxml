AUTOSAR XML (schema 4-2-2)
package /AUTOSAR_Can/BswModuleEntrys
  4 x bsw module entry, all with is-reentrant=false, is-synchronous=true, call-type=SCHEDULED, execution-context=TASK, sw-service-impl-policy=STANDARD:
    Can_MainFunction_Write
    Can_MainFunction_Read
    Can_MainFunction_BusOff
    Can_MainFunction_Mode
package /AUTOSAR_Can/BswModuleDescriptions
  bsw module description Can: category=MCAL_MODULE, module-id=80
    bsw internal behavior Can_BswInternalBehaviour
      exclusive area CAN_EXCLUSIVE_AREA_{00..02}
      4 x bsw schedulable entity, all with can-enter-exclusive-area=[CAN_EXCLUSIVE_AREA_00, CAN_EXCLUSIVE_AREA_01, CAN_EXCLUSIVE_AREA_02]:
        BSWSE_MainFunction_Write: implemented-entry=Can_MainFunction_Write
        BSWSE_MainFunction_Read: implemented-entry=Can_MainFunction_Read
        BSWSE_MainFunction_BusOff: implemented-entry=Can_MainFunction_BusOff
        BSWSE_MainFunction_Mode: implemented-entry=Can_MainFunction_Mode
      4 x bsw timing event, all with period=0.001:
        BSWTE_MainFunction_Write: starts-on-event=BSWSE_MainFunction_Write
        BSWTE_MainFunction_Read: starts-on-event=BSWSE_MainFunction_Read
        BSWTE_MainFunction_BusOff: starts-on-event=BSWSE_MainFunction_BusOff
        BSWTE_MainFunction_Mode: starts-on-event=BSWSE_MainFunction_Mode
package /AUTOSAR_Can/BswImplementations
  bsw implementation BSWIMPL_Can: programming-language=C, ar-release-version=4.0.2, behavior=Can_BswInternalBehaviour
    code-descriptors:
      code CodeDescriptor: artifact-descriptors=autosar-engineering-object={short-label=EngObject, category=SWSRC}
package /AUTOSAR_Can/ImplementationDataTypes
  impl type Can_IdType: category=VALUE, base-type=uint32, compu {0..0x400007FF=Standard32Bit, 0..0xDFFFFFFF=Extended32Bit}, type-emitter=HEADER_FILE  # Represents the Identifier of an L-PDU. The two most significant bits specify the frame type: 00 CAN message with Standard CAN ID 01 CAN FD frame with Standard CAN ID 10 CAN message with Extended CAN ID 11 CAN FD frame with Extended CAN ID
  impl type Can_HwType: category=STRUCTURE, type-emitter=HEADER_FILE  # This type defines a data structure which clearly provides an Hardware Object Handle including its corresponding CAN Controller and therefore CanDrv as well as the specific CanId.
    element CanId: implementation-data-type=Can_IdType
    element Hoh: implementation-data-type=Can_HwHandleType
    element ControllerId: implementation-data-type=uint8
  impl type Can_HwHandleType: category=VALUE, base-type=uint32, compu {0..0x0FF=Standard, 0..0xFFFF=Extended}, type-emitter=HEADER_FILE  # Represents the hardware object handles of a CAN hardware unit. For CAN hardware units with more than 255 HW objects use extended range.Represents the hardware object handles of a CAN hardware unit. For CAN hardware units with more than 255 HW objects use extended range.
