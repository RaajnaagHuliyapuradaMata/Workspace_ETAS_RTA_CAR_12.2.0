AUTOSAR XML (schema 00048)
package /AUTOSAR_Crypto/EcucModuleDefs
  module definition Crypto [0..*]: category=VENDOR_SPECIFIC_MODULE_DEFINITION, refined-module-def=Crypto, variants pre-compile  # Configuration of the Crypto (CryptoDriver) module
    container CryptoDriverObjects  # Container for CRYPTO Objects
      container CryptoDriverObject [0..*]: multiplicity set at pre-compile  # Configuration of a CryptoDriverObject
        integer CryptoDriverObjectId [0..1]: 0..4294967295, multiplicity set at pre-compile, set at pre-compile, symbolic-name-value=true  # Identifier of the Crypto Driver Object. The Crypto Driver Object offers different crypto primitives.
        integer CryptoQueueSize: 0..4294967295, set at pre-compile  # Size of the queue in the Crypto Driver. Defines the maximum number of jobs in the Crypto Driver Object queue. If it is set to 0, queueing is disabled in the Crypto Driver Object.
        integer CryptoRbBulkProcessingSize [0..1]: 1..4294967295, origin=RB:1.0.0:2021-06-01, set at pre-compile, default-value=1  # Number of jobs can be processed in a bulk.
        reference CryptoDefaultRandomKeyRef [0..1]: multiplicity set at pre-compile, set at pre-compile, destination=CryptoKey  # This is a reference to the CryptoKey that is used by the CryptoDefaultRandomPrimitiveRef. The key contains key elements that are necessary to seed the random number generator. | This element shall only be set if the primitive referenced by CryptoDefaultRandomPrimitiveRef requires a seed value.
        reference CryptoDefaultRandomPrimitiveRef [0..1]: multiplicity set at pre-compile, set at pre-compile, destination=CryptoPrimitive  # This is a reference to a primitive that configures a default random number generator. If a crypto driver object needs to perform a crypto primitive that requires a random number generator, but the configuration of this primitive does not provide parameter for a random number generator, then this default random number generator shall be used (i.e. the elements of algorithm family, secondary algorithm family and algorithm mode do not provide this information). | Example: The crypto driver shall generate a signature based on elliptic curve but the primitive for signature generation lacks information about a random number generator.
        reference CryptoDriverObjectEcucPartitionRef [0..1]: multiplicity set at pre-compile, set at pre-compile, destination=EcucPartition  # Maps a crypto driver object to zero or multiple ECUC partitions. The ECUC partition referenced is a subset of the ECUC partitions where the Crypto driver is mapped to. | Note: CryptoDriverObjects such as a HSM shall be mapped to one partition only.
        reference CryptoDriverObjectMainFunctionRef [0..1]: multiplicity set at pre-compile, set at pre-compile, destination=CryptoMainFunction  # This parameter refers to the used CryptoMainFunction. | Reference to CryptoMainFunction, where the according CryptoDriverObject is assigned to.
        reference CryptoPrimitiveRef [1..*]: set at pre-compile, destination=CryptoPrimitive  # Refers to primitive in the CRYPTO. | The CryptoPrimitive is a pre-configured container of the crypto service that shall be used.
    container CryptoGeneral  # Container for common configuration options
      boolean CryptoDevErrorDetect: set at pre-compile, default-value=false  # Switches the development error detection and notification on or off. | true: detection and notification is enabled. false: detection and notification is disabled
      integer CryptoInstanceId [0..1]: 0..255, multiplicity set at pre-compile, set at pre-compile, with-auto=true  # Instance ID of the crypto driver. This ID is used to discern several crypto drivers in case more than one driver is used in the same ECU.
      float CryptoMainFunctionPeriod [0..1]: 0..INF, multiplicity set at pre-compile, set at pre-compile  # Specifies the period of main function Crypto_MainFunction in seconds.
      integer CryptoRbCclCipherAsymLoopCounter [0..1]: 1..4294967295, multiplicity set at pre-compile, origin=RB:1.0.0:2021-06-01, set at pre-compile, default-value=4294967295  # Holds the number of iterations to be performed internally by the cipher asymmetric primitive. This parameter can be used to increase or reduce the runtime of a single cipher (finish) call.
      integer CryptoRbCclKeyExchangeLoopCounter [0..1]: 1..4294967295, multiplicity set at pre-compile, origin=RB:1.0.0:2021-06-01, set at pre-compile, default-value=4294967295  # Holds the number of iterations to be performed internally by the key exchange primitive. This parameter can be used to increase or reduce the runtime of a single key exchange call.
      integer CryptoRbCclKeyGenerateLoopCounter [0..1]: 1..4294967295, multiplicity set at pre-compile, origin=RB:1.0.0:2021-06-01, set at pre-compile, default-value=4294967295  # Holds the number of iterations to be performed internally by the key Generate primitive. This parameter can be used to increase or reduce the runtime of a single key Generate call.
      boolean CryptoRbCclPreCalculateK1_K2 [0..1]: multiplicity set at pre-compile, origin=RB:1.0.0:2021-06-01, set at pre-compile, default-value=false  # True: Enable the precalculation of K1 and K2 for CMAC generation. This option results in a faster generation but safety is threatened because the keys are stored within global variables and will not be cleared. False: Disable the precalculation of K1 and K2 for CMAC generation. The keys are calculated for each CMAC generation and are cleared when CMAC generation was completed (safety is enhanced = default).
      integer CryptoRbCclSignatureLoopCounter [0..1]: 1..4294967295, multiplicity set at pre-compile, origin=RB:1.0.0:2021-06-01, set at pre-compile, default-value=4294967295  # Holds the number of iterations to be performed internally by the signature primitive (update). This parameter can be used to increase or reduce the runtime of a single signature (update) call.
      enumeration CryptoRbHsmAEADSessionPriority [0..1]: {PRIO_BACKGROUND, PRIO_HIGH, PRIO_LOW, PRIO_MEDIUM}, multiplicity set at pre-compile, origin=RB:1.0.0:2021-06-01, set at pre-compile, default-value=PRIO_MEDIUM  # Determines the session priority for all jobs with this primitive type
      enumeration CryptoRbHsmBulkMacGenerateSessionPriority [0..1]: {PRIO_BACKGROUND, PRIO_HIGH, PRIO_LOW, PRIO_MEDIUM}, multiplicity set at pre-compile, origin=RB:1.0.0:2021-06-01, set at pre-compile, default-value=PRIO_HIGH  # Determines the session priority for all jobs with this primitive type
      enumeration CryptoRbHsmBulkMacVerifySessionPriority [0..1]: {PRIO_BACKGROUND, PRIO_HIGH, PRIO_LOW, PRIO_MEDIUM}, multiplicity set at pre-compile, origin=RB:1.0.0:2021-06-01, set at pre-compile, default-value=PRIO_HIGH  # Determines the session priority for all jobs with this primitive type
      integer CryptoRbHsmCancelTimeout [0..1]: 1..4294967295, multiplicity set at pre-compile, origin=RB:1.0.0:2021-06-01, set at pre-compile  # Maximum timeout duration to wait for a HSM timeout monitoring cancel operation to complete in ticks. This parameter is only used when CryptoRbHsmTimeoutMonitoringEnabled is enabled. The tick duration is set by the integrators timer configuration for timeout monitoring.
      enumeration CryptoRbHsmCipherSessionPriority [0..1]: {PRIO_BACKGROUND, PRIO_HIGH, PRIO_LOW, PRIO_MEDIUM}, multiplicity set at pre-compile, origin=RB:1.0.0:2021-06-01, set at pre-compile, default-value=PRIO_MEDIUM  # Determines the session priority for all jobs with this primitive type
      integer CryptoRbHsmCipherTimeout [0..1]: 1..4294967295, multiplicity set at pre-compile, origin=RB:1.0.0:2021-06-01, set at pre-compile  # Maximum timeout for the synchronous HSM Cipher primitive operations in ms. This parameter is only used when CryptoRbHsmTimeoutMonitoringEnabled is set to FALSE
      boolean CryptoRbHsmCsaiErrorPropagationEnabled [0..1]: multiplicity set at pre-compile, origin=RB:1.0.0:2021-06-01, set at pre-compile, default-value=false  # TRUE: Enables the propagation of CSAI error codes to an external module for specific cryptographic primitives executed on HSM. The propagation is performed only for specific primitives (MAC Generate/Verify, Encrypt/Decrypt with ECB/CBC, Random Generate/Seed, SHE Load Key/Load Plain Key, SHE Export RAM key). FALSE: The error propagation is disabled and the CSAI error propagation call is not performed.
      enumeration CryptoRbHsmHashSessionPriority [0..1]: {PRIO_BACKGROUND, PRIO_HIGH, PRIO_LOW, PRIO_MEDIUM}, multiplicity set at pre-compile, origin=RB:1.0.0:2021-06-01, set at pre-compile, default-value=PRIO_MEDIUM  # Determines the session priority for all jobs with this primitive type
      boolean CryptoRbHsmInitializeKeyElements [0..1]: multiplicity set at pre-compile, origin=RB:1.0.0:2021-06-01, set at pre-compile, default-value=true  # True: Enable the initialization of HSM key elements with configured initialization data on startup and if the persistent storage was never used before by the HSM. False: Disable the initialization of HSM key elements on startup (True = default).
      integer CryptoRbHsmInputBufferDefaultSize [0..1]: 0..4294967295, origin=RB:1.0.0:2021-06-01, set at pre-compile, default-value=1024  # Default size used for input buffers if optimal buffer size cannot be calculated from related Csm job configuration.
      boolean CryptoRbHsmInputBuffering [0..1]: multiplicity set at pre-compile, origin=RB:1.0.0:2021-06-01, set at pre-compile, default-value=false  # True: Cryptodriver creates extra input buffers (for the data read by the HSM module) as a safety separation in case of HSM driver library cannot access the input memory area provided by Cryptostack. False: HSM input buffers will not be created (in case of HSM can access the input memory areas provided by the Cryptostack).
      integer CryptoRbHsmKeyExchangeCalcPubValResultMaxLength [0..1]: 1..4294967295, multiplicity set at pre-compile, origin=RB:1.0.0:2021-06-01, set at pre-compile  # Maximum size of the calculated public value in bytes, only needed when HSM output buffering is enabled.
      integer CryptoRbHsmKeyExchangeCalcSecretDataMaxLength [0..1]: 1..4294967295, multiplicity set at pre-compile, origin=RB:1.0.0:2021-06-01, set at pre-compile  # Maximum input size of the key exchange calculate secret primitive in bytes, only needed when HSM input buffering is enabled.
      integer CryptoRbHsmKeyExchangeTimeout [0..1]: 1..4294967295, multiplicity set at pre-compile, origin=RB:1.0.0:2021-06-01, set at pre-compile  # Maximum timeout for the synchronous KEYEXCHANGE operations in ms. This parameter is only used when CryptoRbHsmTimeoutMonitoringEnabled is set to FALSE
      integer CryptoRbHsmKeyExchangeWaitForCalcSecretTimeout [0..1]: 1..4294967295, multiplicity set at pre-compile, origin=RB:1.0.0:2021-06-01, set at pre-compile, default-value=30000  # Maximum timeout duration to wait for the corresponding Job KeyExchange CalcSecret request after a successfull Job KeyExchange CalcPubVal call in ticks. The tick duration is set by the integrators timer configuration for timeout monitoring.
      boolean CryptoRbHsmKeyExchangeWithHandle [0..1]: multiplicity set at pre-compile, origin=RB:1.0.0:2021-06-01, set at pre-compile, default-value=false  # True: Enable the key exchange mode to use the key handle of an existing Priv key element for calculating the shared secret. False: The Priv key element for calculating the shared secret is a generated random number (FALSE = default).
      enumeration CryptoRbHsmKeyManagementSessionPriority [0..1]: {PRIO_BACKGROUND, PRIO_HIGH, PRIO_LOW, PRIO_MEDIUM}, multiplicity set at pre-compile, origin=RB:1.0.0:2021-06-01, set at pre-compile, default-value=PRIO_LOW  # Determines the session priority for all jobs with this primitive type
      integer CryptoRbHsmKeyManagementTimeout [0..1]: 1..4294967295, multiplicity set at pre-compile, origin=RB:1.0.0:2021-06-01, set at pre-compile  # Maximum timeout for the synchronous KEYGENERATE and key management operations in ms. This parameter is only used when CryptoRbHsmTimeoutMonitoringEnabled is set to FALSE
      integer CryptoRbHsmMacBulkGenerateMaxInput [0..1]: 1..4294967295, multiplicity set at pre-compile, origin=RB:1.0.0:2021-06-01, set at pre-compile, default-value=4294967295  # Holds the maximum number of input bytes summed up from all MAC Generate jobs to be performed by one HSM bulk job. If this value is not configured, then no restriction will be applied to the total byte count in the HSM bulk job.
      integer CryptoRbHsmMacBulkMaxGenerateJobs [0..1]: 2..4294967295, multiplicity set at pre-compile, origin=RB:1.0.0:2021-06-01, set at pre-compile  # Holds the maximum number of mac generate jobs to be performed my one HSM bulk job. The total number of all configured mac generate jobs will be used automatically if this configuration value is unset.
      integer CryptoRbHsmMacBulkMaxVerifyJobs [0..1]: 2..4294967295, multiplicity set at pre-compile, origin=RB:1.0.0:2021-06-01, set at pre-compile  # Holds the maximum number of mac verify jobs to be performed my one HSM bulk job. The total number of all configured mac verify jobs will be used automatically if this configuration value is unset.
      integer CryptoRbHsmMacBulkVerifyMaxInput [0..1]: 1..4294967295, multiplicity set at pre-compile, origin=RB:1.0.0:2021-06-01, set at pre-compile, default-value=4294967295  # Holds the maximum number of input bytes summed up from all MAC Verify jobs to be performed by one HSM bulk job. If this value is not configured, then no restriction will be applied to the total byte count in the HSM bulk job.
      enumeration CryptoRbHsmMacSingleShotSessionPriority [0..1]: {PRIO_BACKGROUND, PRIO_HIGH, PRIO_LOW, PRIO_MEDIUM}, multiplicity set at pre-compile, origin=RB:1.0.0:2021-06-01, set at pre-compile, default-value=PRIO_HIGH  # Determines the session priority for all jobs with this primitive type
      integer CryptoRbHsmMacTimeout [0..1]: 1..4294967295, multiplicity set at pre-compile, origin=RB:1.0.0:2021-06-01, set at pre-compile  # Maximum timeout for the synchronous HSM MAC primitive operations in ms. This parameter is only used when CryptoRbHsmTimeoutMonitoringEnabled is set to FALSE
      integer CryptoRbHsmOutputBufferDefaultSize [0..1]: 0..4294967295, origin=RB:1.0.0:2021-06-01, set at pre-compile, default-value=1024  # Default size used for output buffers if optimal buffer size cannot be calculated from related Csm job configuration.
      boolean CryptoRbHsmOutputBuffering [0..1]: multiplicity set at pre-compile, origin=RB:1.0.0:2021-06-01, set at pre-compile, default-value=true  # True: Cryptodriver creates extra output buffers (for the results written by the HSM module) as a safety separation in case of HSM driver library cannot access the ouput memory area provided by Cryptostack. False: HSM Output extra buffers will not be created (in case of HSM can access the output memory areas provided by the Cryptostack).
      integer CryptoRbHsmRandomGenerateResultMaxLength [0..1]: 1..4294967295, multiplicity set at pre-compile, origin=RB:1.0.0:2021-06-01, set at pre-compile  # Max size of the random generate in bytes, only needed when HSM output buffering is enabled.
      integer CryptoRbHsmRandomSeedDataMaxLength [0..1]: 1..4294967295, multiplicity set at pre-compile, origin=RB:1.0.0:2021-06-01, set at pre-compile  # Maximum input size of random seed primitive in bytes, only needed when HSM input buffering is enabled.
      enumeration CryptoRbHsmRandomSessionPriority [0..1]: {PRIO_BACKGROUND, PRIO_HIGH, PRIO_LOW, PRIO_MEDIUM}, multiplicity set at pre-compile, origin=RB:1.0.0:2021-06-01, set at pre-compile, default-value=PRIO_MEDIUM  # Determines the session priority for all jobs with this primitive type
      integer CryptoRbHsmRandomTimeout [0..1]: 1..4294967295, multiplicity set at pre-compile, origin=RB:1.0.0:2021-06-01, set at pre-compile  # Maximum timeout for synchronous HSM random primitive operations in ms. This parameter is only used when CryptoRbHsmTimeoutMonitoringEnabled is set to FALSE
      enumeration CryptoRbHsmSHESessionPriority [0..1]: {PRIO_BACKGROUND, PRIO_HIGH, PRIO_LOW, PRIO_MEDIUM}, multiplicity set at pre-compile, origin=RB:1.0.0:2021-06-01, set at pre-compile, default-value=PRIO_MEDIUM  # Determines the session priority for all jobs with this primitive type
      boolean CryptoRbHsmSafeMac [0..1]: multiplicity set at pre-compile, origin=RB:1.0.0:2021-06-01, set at pre-compile, default-value=false  # True: Enable the safe CMac mode of the HSM for any mac generation/verification (only available if bulk mode is activated also). False: Disable the safe CMac mode of the HSM for any mac generation/verification (FALSE = default).
      integer CryptoRbHsmSheTimeout [0..1]: 1..4294967295, multiplicity set at pre-compile, origin=RB:1.0.0:2021-06-01, set at pre-compile  # Maximum timeout for synchronous HSM SHE primitive operations in ms. This parameter is only used when CryptoRbHsmTimeoutMonitoringEnabled is set to FALSE
      enumeration CryptoRbHsmSignatureSessionPriority [0..1]: {PRIO_BACKGROUND, PRIO_HIGH, PRIO_LOW, PRIO_MEDIUM}, multiplicity set at pre-compile, origin=RB:1.0.0:2021-06-01, set at pre-compile, default-value=PRIO_LOW  # Determines the session priority for all jobs with this primitive type
      integer CryptoRbHsmSignatureTimeout [0..1]: 1..4294967295, multiplicity set at pre-compile, origin=RB:1.0.0:2021-06-01, set at pre-compile  # Maximum timeout for the synchronous HSM signature primitive operations in ms. This parameter is only used when CryptoRbHsmTimeoutMonitoringEnabled is set to FALSE
      integer CryptoRbHsmTimeout [0..1]: 1..4294967295, multiplicity set at pre-compile, origin=RB:1.0.0:2021-06-01, set at pre-compile  # Maximum timeout for the synchronous HSM primitive operations in ms. This value is used for all primitives which do not have a dedicated timeout parameter defined. This parameter is only used when CryptoRbHsmTimeoutMonitoringEnabled is set to FALSE .
      boolean CryptoRbHsmTimeoutMonitoringEnabled [0..1]: multiplicity set at pre-compile, origin=RB:1.0.0:2021-06-01, set at pre-compile, default-value=false  # TRUE: Enables timeout monitoring for HSM operations, whereby jobs are cancelled if the timeout duration for a given primitive is exceeded.
      enumeration CryptoRbHsmVKMSSessionPriority [0..1]: {PRIO_BACKGROUND, PRIO_HIGH, PRIO_LOW, PRIO_MEDIUM}, multiplicity set at pre-compile, origin=RB:1.0.0:2021-06-01, set at pre-compile, default-value=PRIO_MEDIUM  # Determines the session priority for all jobs with this primitive type
      integer CryptoRbHsmVkmsTimeout [0..1]: 1..4294967295, multiplicity set at pre-compile, origin=RB:1.0.0:2021-06-01, set at pre-compile  # Maximum timeout for the synchronous HSM Vkms primitive operations in ms. This parameter is only used when CryptoRbHsmTimeoutMonitoringEnabled is set to FALSE
      boolean CryptoRbKeyDynamicCfgPrefixCheck [0..1]: multiplicity set at pre-compile, origin=RB:1.0.0:2021-06-01, set at pre-compile, default-value=true  # Pre-processor switch to enable and disable the DYNAMIC_CFG_CRYPTO prefix checking for crypto keys. | True: DYNAMIC_CFG_CRYPTO prefix check is enabled. False: DYNAMIC_CFG_CRYPTO prefix check is disabled.
      integer CryptoRbMainFunctionLoopCounter [0..1]: 1..4294967295, multiplicity set at pre-compile, origin=RB:1.0.0:2021-06-01, set at pre-compile, default-value=4294967295  # Holds the number of iterations to be performed internally by the main function. This parameter can be used to increase or reduce the runtime of a single main function call.
      boolean CryptoRbWaitForNvMRead [0..1]: multiplicity set at pre-compile, origin=RB:1.0.0:2021-06-01, set at pre-compile, default-value=true  # True: In Crypto Init wait for NvM Read to be completed for required NvM block. (Calls Memstack Mainfunctions intern). False: Cyclically check NvM Read status in Crypto Mainfunction if read not already finished before Crypto Init. Note: Used only by rba_CryptoCCL init function.
      boolean CryptoVersionInfoApi: set at pre-compile, default-value=false  # Pre-processor switch to enable and disable availability of the API Crypto_GetVersionInfo(). | True: API Crypto_GetVersionInfo() is available False: API Cryptosm_GetVersionInfo() is not available.
      reference CryptoEcucPartitionRef [0..*]: multiplicity set at pre-compile, set at pre-compile, destination=EcucPartition  # Maps the Crypto driver to zero or multiple ECUC partitions to make the modules API available in this partition. The module will operate as an independent instance in each of the partitions.
    container CryptoKeyElements [0..1]: multiplicity set at pre-compile  # Container for Crypto key elements
      container CryptoKeyElement [1..*]: multiplicity set at pre-compile  # Configuration of a CryptoKeyElement
        boolean CryptoKeyElementAllowPartialAccess: set at pre-compile, default-value=false  # Enable or disable writing and reading the key element with data smaller than the size of the element. | True: enable partial access of the key element False: disable partial access of the key element
        enumeration CryptoKeyElementFormat [0..1]: {CRYPTO_KE_FORMAT_BIN_CERT_CVC, CRYPTO_KE_FORMAT_BIN_CERT_X509_V3, CRYPTO_KE_FORMAT_BIN_IDENT_PRIVATEKEY_PKCS8, CRYPTO_KE_FORMAT_BIN_IDENT_PUBLICKEY, CRYPTO_KE_FORMAT_BIN_OCTET, CRYPTO_KE_FORMAT_BIN_RSA_PRIVATEKEY, CRYPTO_KE_FORMAT_BIN_RSA_PUBLICKEY, CRYPTO_KE_FORMAT_BIN_SHEKEYS}, multiplicity set at pre-compile, set at pre-compile, default-value=CRYPTO_KE_FORMAT_BIN_OCTET  # Defines the format for the key element. This is the format used to provide or extract the key data from the driver.
        integer CryptoKeyElementId: 0..4294967295, set at pre-compile, symbolic-name-value=true  # Identifier of the CRYPTO key element
        string CryptoKeyElementInitValue [0..1]: multiplicity set at pre-compile, set at pre-compile  # Value which will be used to fill the key element during startup | (i) for all non-persistent key elements, and (ii) for those persistent key elements that have never been written.
        boolean CryptoKeyElementPersist: set at pre-compile, default-value=false  # Enable or disable persisting of the key element in non-volatile storage. | True: enable persisting of the key element. False: disable persisting of the key element.
        enumeration CryptoKeyElementReadAccess: {CRYPTO_RA_ALLOWED, CRYPTO_RA_DENIED, CRYPTO_RA_ENCRYPTED, CRYPTO_RA_INTERNAL_COPY}, set at pre-compile  # Define the reading access rights of the key element. | CRYPTO_RA_DENIED = key element cannot be read from outside the Crypto Driver CRYPTO_RA INTERNAL_COPY = key element can be copied to another key element in the same crypto driver. CRYPTO_RA_ALLOWED = key element can be read as plaintext CRYPTO_RA_ENCRYPTED = key element can be read encrypted. E.g. SHE Ram-Key export.
        integer CryptoKeyElementSize: 1..4294967295, set at pre-compile  # Maximum size of a CRYPTO key element in bytes
        enumeration CryptoKeyElementWriteAccess: {CRYPTO_WA_ALLOWED, CRYPTO_WA_DENIED, CRYPTO_WA_ENCRYPTED, CRYPTO_WA_INTERNAL_COPY}, set at pre-compile  # Define the writing access rights of the key element | CRYPTO_WA_DENIED = key element can not be written from outside the Crypto Driver CRYPTO_WA INTERNAL_COPY = key element can be filled with another key element in the same crypto driver. CRYPTO_WA_ALLOWED = key element can be rwritten as plaintext CRYPTO_WA_ENCRYPTED = key element can be written encrypted. E.g. SHE load key.
        string CryptoRbHsmKeySlotId [0..1]: multiplicity set at pre-compile, origin=RB:1.0.0:2021-06-01, set at pre-compile  # This parameter explicitly maps the given key element into a specified key slot inside the HSM secure flash. As value, either the name of the key slot (e.g. "DYNAMIC_CFG_CRYPTO_AES_KEY_BASE_0") or its enumerator representation (e.g. "ecy_hsm_CSAI_KEYID_AES_KEY_DYNAMIC_CFG_CRYPTO_AES_KEY_BASE_0") can be provided. If left empty, an available key slot is automatically assigned.
        integer CryptoRbKeyElementRteSize [0..1]: 1..4294967295, multiplicity set at pre-compile, origin=RB:1.0.0:2021-06-01, set at pre-compile  # Maximum size of a CRYPTO key element in bytes for RTE generation. Can be used for ASN.1 encoded keys to avoid RTE generation errors.
        enumeration CryptoRbKeyElementType [0..1]: {CRYPTO_ELEMENT_TYPE_CERT_X509, CRYPTO_ELEMENT_TYPE_ECDSA_SECP256R1_KEYPAIR, CRYPTO_ELEMENT_TYPE_ECDSA_SECP256R1_PRIV_KEY, CRYPTO_ELEMENT_TYPE_ECDSA_SECP256R1_PUB_KEY, CRYPTO_ELEMENT_TYPE_ECDSA_SECP384R1_KEYPAIR, CRYPTO_ELEMENT_TYPE_ECDSA_SECP384R1_PRIV_KEY, CRYPTO_ELEMENT_TYPE_ECDSA_SECP384R1_PUB_KEY, CRYPTO_ELEMENT_TYPE_EDDSA_ED25519_KEYPAIR, CRYPTO_ELEMENT_TYPE_EDDSA_ED25519_PRIV_KEY, CRYPTO_ELEMENT_TYPE_EDDSA_ED25519_PUB_KEY, CRYPTO_ELEMENT_TYPE_RSA2048_PRIV_KEY, CRYPTO_ELEMENT_TYPE_RSA2048_PUB_KEY, CRYPTO_ELEMENT_TYPE_RSA3072_PRIV_KEY, CRYPTO_ELEMENT_TYPE_RSA3072_PUB_KEY, CRYPTO_ELEMENT_TYPE_RSA4096_PRIV_KEY, CRYPTO_ELEMENT_TYPE_RSA4096_PUB_KEY, CRYPTO_ELEMENT_TYPE_SYMMETRIC_128, CRYPTO_ELEMENT_TYPE_VKMS_GET_KEY, CRYPTO_ELEMENT_TYPE_VKMS_GET_METADATA, CRYPTO_ELEMENT_TYPE_VKMS_GET_STATUS, CRYPTO_ELEMENT_TYPE_VKMS_GET_TRAININGCOUNTER, CRYPTO_ELEMENT_TYPE_VKMS_GET_VIN}, multiplicity set at pre-compile, origin=RB:1.0.0:2021-06-01, set at pre-compile  # Define the type of a key element. This parameter is optional and can be used to overrule the process to discover the type automatically.CRYPTO_ELEMENT_TYPE_SYMMETRIC_128: default type (16 byte)CRYPTO_ELEMENT_TYPE_EDDSA_ED25519_PRIV_KEY: ED25519: element to be used for signature generation (32 byte)CRYPTO_ELEMENT_TYPE_EDDSA_ED25519_PUB_KEY: ED25519: element to be used for signature verification (32 byte)CRYPTO_ELEMENT_TYPE_EDDSA_ED25519_KEYPAIR: ED25519: element to be used for signature generation and verification (64 bytes)CRYPTO_ELEMENT_TYPE_ECDSA_SECP384R1_PRIV_KEY: SECP384R1: element to be used for signature generation (48 bytes)CRYPTO_ELEMENT_TYPE_ECDSA_SECP384R1_PUB_KEY: SECP384R1: element to be used for signature verification (96 bytes)CRYPTO_ELEMENT_TYPE_ECDSA_SECP384R1_KEYPAIR: SECP384R1: element to be used for signature generation and verification (144 bytes)CRYPTO_ELEMENT_TYPE_ECDSA_SECP256R1_PRIV_KEY: SECP256R1: element to be used for signature generation (32 bytes)CRYPTO_ELEMENT_TYPE_ECDSA_SECP256R1_PUB_KEY: SECP256R1: element to be used for signature verification (64 bytes)CRYPTO_ELEMENT_TYPE_RSASSA_PSS_RSA2048_PRIV_KEY: RSASSA PSS RSA2048: element to be used for signature generation (512 bytes)CRYPTO_ELEMENT_TYPE_RSASSA_PSS_RSA2048_PUB_KEY: RSASSA PSS RSA2048: element to be used for signature verification (260 bytes)CRYPTO_ELEMENT_TYPE_RSASSA_PSS_RSA3072_PRIV_KEY: RSASSA PSS RSA3072: element to be used for signature generation (768 bytes)CRYPTO_ELEMENT_TYPE_RSASSA_PSS_RSA3072_PUB_KEY: RSASSA PSS RSA3072: element to be used for signature verification (388 bytes)CRYPTO_ELEMENT_TYPE_CERT_X509: element to be used for certificate X509CRYPTO_ELEMENT_TYPE_HSM_VKMS_GET_KEY: element to be used for VKMS Key retrievalCRYPTO_ELEMENT_TYPE_HSM_VKMS_GET_META_DATA: element to be used for VKMS Key meta data retrieval"CRYPTO_ELEMENT_TYPE_HSM_VKMS_GET_STATUS: element to be used for VKMS Status retrieval"CRYPTO_ELEMENT_TYPE_HSM_VKMS_GET_TRAINING_COUNTER: element to be used for VKMS Training counter retrieval"CRYPTO_ELEMENT_TYPE_HSM_VKMS_GET_VKMS_VIN: element to be used for VKMS VIN retrieval
    container CryptoKeyTypes [0..1]: multiplicity set at pre-compile  # Container for CRYPTO key types
      container CryptoKeyType [1..*]: multiplicity set at pre-compile  # Configuration of a CryptoKeyType
        reference CryptoKeyElementRef [1..*]: multiplicity set at pre-compile, set at pre-compile, destination=CryptoKeyElement  # Refers to a pointer in the CRYPTOCrypto Key Element, which holds the data of the crypto key element.
    container CryptoKeys [0..1]: multiplicity set at pre-compile  # Container for CRYPTO keys
      container CryptoKey [1..*]: multiplicity set at pre-compile  # Configuration of a CryptoKey
        integer CryptoKeyId [0..1]: 0..4294967295, multiplicity set at pre-compile, set at pre-compile, symbolic-name-value=true  # Identifier of the CRYPTO Key
        integer CryptoRbHsmVkmsKeyTypeId [0..1]: 0..65534, multiplicity set at pre-compile, origin=RB:1.0.0:2021-06-01, set at pre-compile, symbolic-name-value=true  # This parameter maps the given cryptokey into a specified VKMS KeyTypeId specified inside HSM VKMS Core (to be used in VKMS GetKey and GetMetaData requests).
        reference CryptoKeyNvBlockRef [0..1]: set at pre-compile, destination=CryptoNvBlock  # Reference to the NV block where the persistent key elements of this key shall be stored to.
        reference CryptoKeyTypeRef: set at pre-compile, destination=CryptoKeyType  # Refers to a pointer in the CRYPTO to a CryptoKeyType. The CryptoKeyType provides the information which key elements are contained in a CryptoKey.
    container CryptoMainFunction [0..*]: multiplicity set at pre-compile  # Container for configuration of a Crypto mainfunction. The container name serves as a symbolic name for the mainfunction configuration.
      float CryptoMainFunctionPeriod [0..1]: 0..INF, multiplicity set at pre-compile, set at pre-compile  # Specifies the period of main function Crypto_MainFunction in seconds (applicable only for the default MainFunction instance).
      integer CryptoRbMainFunctionLoopCounter [0..1]: 1..4294967295, multiplicity set at pre-compile, origin=RB:1.0.0:2021-06-01, set at pre-compile, default-value=4294967295  # Holds the number of iterations to be performed internally by the main function. This parameter can be used to increase or reduce the runtime of a single main function call.
      reference CryptoMainFunctionPartitionRef: set at pre-compile, destination=EcucPartition  # Reference to EcucPartition, where the according CryptoMainFunction instance is assigned to.
    container CryptoNvStorage [0..1]: multiplicity set at pre-compile  # Container of NV block storage. Contains a collection of all NV storage blocks used for key storage.
      container CryptoNvBlock [1..*]: multiplicity set at pre-compile  # Container to configure key storage in NVM
        integer CryptoNvBlockFailedRetries [0..1]: 0..65535, multiplicity set at pre-compile, set at pre-compile, symbolic-name-value=true  # Number of retries to request an NVM service operation.Note: This parameter is not supported in the current implementation.
        enumeration CryptoNvBlockProcessing: {CRYPTO_NV_BLOCK_DEFERRED, CRYPTO_NV_BLOCK_IMMEDIATE}, multiplicity set at pre-compile, set at pre-compile  # Selects the operation mode when an NV block shall be updated.Note: Only CRYPTO_NV_BLOCK_DEFERRED is supported in the current implementation.
        reference CryptoNvBlockDescriptorRef: set at pre-compile, destination=NvMBlockDescriptor  # Reference to an NvM block descriptor
    container CryptoPrimitives [0..*]: multiplicity set at pre-compile  # Container for CRYPTO primitives
      container CryptoPrimitive [0..*]: multiplicity set at pre-compile  # Configuration of a CryptoPrimitive
        enumeration CryptoPrimitiveAlgorithmFamily [1..*]: {CRYPTO_ALGOFAM_3DES, CRYPTO_ALGOFAM_AES, CRYPTO_ALGOFAM_BLAKE_1_256, CRYPTO_ALGOFAM_BLAKE_1_512, CRYPTO_ALGOFAM_BLAKE_2s_256, CRYPTO_ALGOFAM_BLAKE_2s_512, CRYPTO_ALGOFAM_BRAINPOOL, CRYPTO_ALGOFAM_CHACHA, CRYPTO_ALGOFAM_CUSTOM, CRYPTO_ALGOFAM_DH, CRYPTO_ALGOFAM_DRBG, CRYPTO_ALGOFAM_ECCANSI, CRYPTO_ALGOFAM_ECCNIST, CRYPTO_ALGOFAM_ECCSEC, CRYPTO_ALGOFAM_ECDH, CRYPTO_ALGOFAM_ECDSA, CRYPTO_ALGOFAM_ED25519, CRYPTO_ALGOFAM_EEA3, CRYPTO_ALGOFAM_EIA3, CRYPTO_ALGOFAM_FIPS186, CRYPTO_ALGOFAM_HKDF, CRYPTO_ALGOFAM_KDFX963, CRYPTO_ALGOFAM_NOT_SET, CRYPTO_ALGOFAM_PADDING_ONEWITHZEROS, CRYPTO_ALGOFAM_PADDING_PKCS7, CRYPTO_ALGOFAM_PBKDF2, CRYPTO_ALGOFAM_POLY1305, CRYPTO_ALGOFAM_RIPEMD160, CRYPTO_ALGOFAM_RNG, CRYPTO_ALGOFAM_RSA, CRYPTO_ALGOFAM_SHA1, CRYPTO_ALGOFAM_SHA2_224, CRYPTO_ALGOFAM_SHA2_256, CRYPTO_ALGOFAM_SHA2_384, CRYPTO_ALGOFAM_SHA2_512, CRYPTO_ALGOFAM_SHA2_512_224, CRYPTO_ALGOFAM_SHA2_512_256, CRYPTO_ALGOFAM_SHA3_224, CRYPTO_ALGOFAM_SHA3_256, CRYPTO_ALGOFAM_SHA3_384, CRYPTO_ALGOFAM_SHA3_512, CRYPTO_ALGOFAM_SHAKE128, CRYPTO_ALGOFAM_SHAKE256, CRYPTO_ALGOFAM_SIPHASH, CRYPTO_ALGOFAM_SM2, CRYPTO_ALGOFAM_SM3, CRYPTO_ALGOFAM_VKMS_GET_IDENTITY_HASH, CRYPTO_ALGOFAM_VKMS_GET_PSS_HASH, CRYPTO_ALGOFAM_VKMS_GET_VERIFICATION_HASH, CRYPTO_ALGOFAM_VKMS_HANDLE_DLC_FINISH, CRYPTO_ALGOFAM_VKMS_HANDLE_DLC_START, CRYPTO_ALGOFAM_X25519}, multiplicity set at pre-compile, set at pre-compile  # Determines the algorithm family used for the crypto service
        enumeration CryptoPrimitiveAlgorithmMode [1..*]: {CRYPTO_ALGOMODE_12ROUNDS, CRYPTO_ALGOMODE_20ROUNDS, CRYPTO_ALGOMODE_8ROUNDS, CRYPTO_ALGOMODE_CBC, CRYPTO_ALGOMODE_CFB, CRYPTO_ALGOMODE_CMAC, CRYPTO_ALGOMODE_CTR, CRYPTO_ALGOMODE_CTRDRBG, CRYPTO_ALGOMODE_CUSTOM, CRYPTO_ALGOMODE_ECB, CRYPTO_ALGOMODE_GCM, CRYPTO_ALGOMODE_GMAC, CRYPTO_ALGOMODE_HMAC, CRYPTO_ALGOMODE_NOT_SET, CRYPTO_ALGOMODE_OFB, CRYPTO_ALGOMODE_PXXXR, CRYPTO_ALGOMODE_RSAES_OAEP, CRYPTO_ALGOMODE_RSAES_PKCS1_v1_5, CRYPTO_ALGOMODE_RSASSA_PKCS1_v1_5, CRYPTO_ALGOMODE_RSASSA_PSS, CRYPTO_ALGOMODE_SIPHASH_2_4, CRYPTO_ALGOMODE_SIPHASH_4_8, CRYPTO_ALGOMODE_XTS}, multiplicity set at pre-compile, set at pre-compile  # Determines the algorithm mode used for the crypto service
        enumeration CryptoPrimitiveAlgorithmSecondaryFamily [1..*]: {CRYPTO_ALGOFAM_3DES, CRYPTO_ALGOFAM_AES, CRYPTO_ALGOFAM_BLAKE_1_256, CRYPTO_ALGOFAM_BLAKE_1_512, CRYPTO_ALGOFAM_BLAKE_2s_256, CRYPTO_ALGOFAM_BLAKE_2s_512, CRYPTO_ALGOFAM_BRAINPOOL, CRYPTO_ALGOFAM_CHACHA, CRYPTO_ALGOFAM_CUSTOM, CRYPTO_ALGOFAM_DRBG, CRYPTO_ALGOFAM_ECCANSI, CRYPTO_ALGOFAM_ECCNIST, CRYPTO_ALGOFAM_ECCSEC, CRYPTO_ALGOFAM_ED25519, CRYPTO_ALGOFAM_FIPS186, CRYPTO_ALGOFAM_NOT_SET, CRYPTO_ALGOFAM_PADDING_ONEWITHZEROS, CRYPTO_ALGOFAM_PADDING_PKCS7, CRYPTO_ALGOFAM_POLY1305, CRYPTO_ALGOFAM_RIPEMD160, CRYPTO_ALGOFAM_RNG, CRYPTO_ALGOFAM_RSA, CRYPTO_ALGOFAM_SHA1, CRYPTO_ALGOFAM_SHA2_224, CRYPTO_ALGOFAM_SHA2_256, CRYPTO_ALGOFAM_SHA2_384, CRYPTO_ALGOFAM_SHA2_512, CRYPTO_ALGOFAM_SHA2_512_224, CRYPTO_ALGOFAM_SHA2_512_256, CRYPTO_ALGOFAM_SHA3_224, CRYPTO_ALGOFAM_SHA3_256, CRYPTO_ALGOFAM_SHA3_384, CRYPTO_ALGOFAM_SHA3_512, CRYPTO_ALGOFAM_SHAKE128, CRYPTO_ALGOFAM_SHAKE256, CRYPTO_ALGOFAM_SIPHASH, CRYPTO_ALGOFAM_X25519}, multiplicity set at pre-compile, set at pre-compile  # Determines the algorithm secondary family used for the crypto service
        enumeration CryptoPrimitiveService: {AEAD_DECRYPT, AEAD_ENCRYPT, DECRYPT, ENCRYPT, HASH, KEYDERIVE, KEYELEMENTCOPY, KEYELEMENTGET, KEYELEMENTSET, KEYEXCHANGECALCPUBVAL, KEYEXCHANGECALCSECRET, KEYGENERATE, KEYSETINVALID, KEYSETVALID, MAC_GENERATE, MAC_VERIFY, RANDOM, RANDOMSEED, SHE_EXPORTRAMKEY, SHE_GETID, SHE_LOADKEY, SHE_LOADKEYSLOT, SHE_LOADPLAINKEY, SIGNATURE_GENERATE, SIGNATURE_VERIFY}, set at pre-compile  # Determines the crypto service used for defining the capabilities
        boolean CryptoRbHsmBulkProcessingModeEnabled [0..1]: multiplicity set at pre-compile, origin=RB:1.0.0:2021-06-01, set at pre-compile, default-value=false  # This parameter can be filled out to switch between Mac processing modes. | True: Enables the bulk processing mode for any mac generation/verification. False: Disables the bulk processing mode for any mac generation/verification (FALSE = default).
        reference CryptoPrimitiveAlgorithmFamilyCustomRef [0..*]: multiplicity set at pre-compile, set at pre-compile, destination=CryptoPrimitiveAlgorithmFamilyCustom  # Reference to custom family container
        reference CryptoPrimitiveAlgorithmModeCustomRef [0..*]: multiplicity set at pre-compile, set at pre-compile, destination=CryptoPrimitiveAlgorithmModeCustom  # Reference to custom mode container
        reference CryptoPrimitiveAlgorithmSecondaryFamilyCustomRef [0..*]: multiplicity set at pre-compile, set at pre-compile, destination=CryptoPrimitiveAlgorithmFamilyCustom  # Reference to custom secondary family container
      container CryptoPrimitiveAlgorithmFamilyCustom [0..*]: multiplicity set at pre-compile  # Container for custom algorithm families
        integer CryptoPrimitiveAlgorithmFamilyCustomId: 128..254, set at pre-compile, symbolic-name-value=true  # Custom algorithm family id
      container CryptoPrimitiveAlgorithmModeCustom [0..*]: multiplicity set at pre-compile  # Container for custom algorithm modes
        integer CryptoPrimitiveAlgorithmModeCustomId: 128..254, set at pre-compile, symbolic-name-value=true  # Custom mode mode id
    container CryptoRbPersistentDataMappings [0..1]: multiplicity set at pre-compile  # Container for CryptoRbPersistentDataMapping Objects
      container CryptoRbPersistentDataMapping [0..*]: multiplicity set at pre-compile  # Container for CryptoRbPersistentDataMapping configuraton parameters
        string CryptoRbMappingTag: origin=RB:1.0.0:2021-06-01, set at pre-compile, symbolic-name-value=true  # Unique string tag of data mapping. This links key valid flags and key element data to offsets in the NvM data array they will be stored in or, in the case of secured keys stored in HSM, it links the keys to ecy_hsm Key ID's. There is a strict correlation between the CryptoRbMappingTag and the short name of a key or key element it is linked to. The CryptoRbMappingTag is constructured as follows: [Key ShortName]_[Persistent Block Id]_[Length]_[*Key Element ID*] * The Key Element ID will only be present for mappings linked to Key Elements. Example 1: There is a key with short name 'CryptoKey_AesEncrypt' and block ID 0. To link this key to this mapping, the CryptoRbMappingTag must be 'CryptoKey_AesEncrypt_0_1'. CryptoKeys by themselves contain no data except their valid flag, hence the length is always 1. Example 2: There is a key element with size 32, key element id 1 and short name 'CryptoKeyElement_AesEncrypt' and it is linked through a CryptoKeyType to CryptoKey 'CryptoKey_AesEncrypt' that is in persistent block 1. To link this key element to this mapping, the CryptoRbMappingTag must be 'CryptoKey_AesEncrypt_1_32_1'.
        string CryptoRbPersistentHsmKeySlot [0..1]: multiplicity set at pre-compile, origin=RB:1.0.0:2021-06-01, set at pre-compile, symbolic-name-value=true  # String representation of ecy_hsm key ID to use for this key element. This field is valid only for data mappings linked to rba_CryptoHSM key elements that will be stored in the HSM. The name of the key slot (DYNAMIC_CFG_CRYPTO_AES_KEY_BASE_0) can be provided, or the enumerator representation of the key slot (ecy_hsm_CSAI_KEYID_AES_KEY_DYNAMIC_CFG_CRYPTO_AES_KEY_BASE_0) can be provided.
        integer CryptoRbPersistentOffset [0..1]: 0..4294967295, multiplicity set at pre-compile, origin=RB:1.0.0:2021-06-01, set at pre-compile, symbolic-name-value=true  # Offset (in bytes) of key data or key valid flag into its corresponding NvM Block data array.
