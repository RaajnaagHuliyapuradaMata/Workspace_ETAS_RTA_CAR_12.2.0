AUTOSAR XML (schema 4-3-0)
package /AUTOSAR_NvM/BswModuleDescriptions
  bsw module description NvM
    bsw internal behavior BswInternalBehavior
      29 x bsw called entity:
        CE_CancelWriteAll: implemented-entry=NvM_CancelWriteAll
        CE_EraseNvBlock: implemented-entry=NvM_EraseNvBlock
        CE_GetDataIndex: implemented-entry=NvM_GetDataIndex
        CE_GetErrorStatus: implemented-entry=NvM_GetErrorStatus
        CE_Init: implemented-entry=NvM_Init
        CE_InvalidateNvBlock: implemented-entry=NvM_InvalidateNvBlock
        CE_Rb_ClrWriteMonCntrs: implemented-entry=NvM_Rb_ClrWriteMonCntrs
        CE_Rb_FirstInitAll: implemented-entry=NvM_Rb_FirstInitAll
        CE_Rb_GetActiveService: implemented-entry=NvM_Rb_GetActiveService
        CE_Rb_GetBlockId: implemented-entry=NvM_Rb_GetBlockId
        CE_Rb_GetErrorInfoDetail: implemented-entry=NvM_Rb_GetErrorInfoDetail
        CE_Rb_GetMigrationResult: implemented-entry=NvM_Rb_GetMigrationResult
        CE_Rb_GetNvBlockLength: implemented-entry=NvM_Rb_GetNvBlockLength
        CE_Rb_GetStatus: implemented-entry=NvM_Rb_GetStatus
        CE_Rb_GetWriteCounter: implemented-entry=NvM_Rb_GetWriteCounter
        CE_ReadAll: implemented-entry=NvM_ReadAll
        CE_ReadBlock: implemented-entry=NvM_ReadBlock
        CE_ReadPRAMBlock: implemented-entry=NvM_ReadPRAMBlock
        CE_RestoreBlockDefaults: implemented-entry=NvM_RestoreBlockDefaults
        CE_RestorePRAMBlockDefaults: implemented-entry=NvM_RestorePRAMBlockDefaults
        CE_SetBlockLockStatus: implemented-entry=NvM_SetBlockLockStatus
        CE_SetBlockProtection: implemented-entry=NvM_SetBlockProtection
        CE_SetDataIndex: implemented-entry=NvM_SetDataIndex
        CE_SetRamBlockStatus: implemented-entry=NvM_SetRamBlockStatus
        CE_SetWriteAllTrigger: implemented-entry=NvM_Rb_SetWriteAllTrigger
        CE_ValidateAll: implemented-entry=NvM_ValidateAll
        CE_WriteAll: implemented-entry=NvM_WriteAll
        CE_WriteBlock: implemented-entry=NvM_WriteBlock
        CE_WritePRAMBlock: implemented-entry=NvM_WritePRAMBlock
      bsw schedulable entity SE_MainFunction: implemented-entry=NvM_MainFunction
      bsw timing event EV_SE_MainFunction: starts-on-event=SE_MainFunction, period=0.001
package /AUTOSAR_NvM/DataConstraints
  range NvM_Constr_NoUnit_u32: phys 0..4294967295 Mem_NoUnit
  range NvM_Constr_NoUnit_u16: phys 0..65535 Mem_NoUnit
  range NvM_Constr_NoUnit_u8: phys 0..255 Mem_NoUnit
package /AUTOSAR_NvM/CompuMethods
  compu method NvM_1_BlockIdType: 0=NvMConf_NvMBlockDescriptor_NvM_MultiBlock, 1=NvMConf_NvMBlockDescriptor_NvM_ConfigId, 2=NvMConf_NvMBlockDescriptor_ECUM_CFG_NVM_BLOCK, 3=NvMConf_NvMBlockDescriptor_NvM_NativeBlock_2, 4=NvMConf_NvMBlockDescriptor_NvM_NativeBlock_3  # Computation method for NvM Block ID Type.
  compu method NvM_Rb_StatusType: 0=NVM_RB_STATUS_UNINIT, 1=NVM_RB_STATUS_IDLE, 2=NVM_RB_STATUS_BUSY  # Computation method for the type of the current overall status of the NVRAM manager.
  compu method NvM_RequestResultType: 0=NVM_REQ_OK, 1=NVM_REQ_NOT_OK, 2=NVM_REQ_PENDING, 3=NVM_REQ_INTEGRITY_FAILED, 4=NVM_REQ_BLOCK_SKIPPED, 5=NVM_REQ_NV_INVALIDATED, 6=NVM_REQ_CANCELED, 7=NVM_REQ_REDUNDANCY_FAILED, 8=NVM_REQ_RESTORED_FROM_ROM  # Computation method for the type of the block request result.
  compu method NvM_Rb_ErrorInfoDetail_ten: 0=NvM_Rb_ErrorInfoDetail_NotAvailable_e, 1=NvM_Rb_ErrorInfoDetail_BlockNotFoundOnMedium_e, 2=NvM_Rb_ErrorInfoDetail_InconsistentData_e, 3=NvM_Rb_ErrorInfoDetail_VersionMismatch_e, 4=NvM_Rb_ErrorInfoDetail_CryptoFailed_e  # Computation method for the type of the detailed error info result.
  compu method NvM_Rb_MigrationResult_ten: 0=NVM_RB_MIGRATION_RESULT_INIT_E, 1=NVM_RB_MIGRATION_RESULT_NOT_NECESSARY_E, 2=NVM_RB_MIGRATION_RESULT_TO_SMALLER_SIZE_E, 3=NVM_RB_MIGRATION_RESULT_TO_BIGGER_SIZE_E, 4=NVM_RB_MIGRATION_RESULT_NOT_DONE_E, 5=NVM_RB_MIGRATION_RESULT_DEACTIVATED_E  # Computation method for the type of the migration result.
package /AUTOSAR_NvM/Units
  unit NoUnit: display-name=noUnit, factor-si-to-unit=1.0, offset-si-to-unit=0.0, physical-dimension=NoUnit  # No Unit
package /AUTOSAR_NvM/PhysicalDimensions
  physical dimension NoUnit: length-exp=0
