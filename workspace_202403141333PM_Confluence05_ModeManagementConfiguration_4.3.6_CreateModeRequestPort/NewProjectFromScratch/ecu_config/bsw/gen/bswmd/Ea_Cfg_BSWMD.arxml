AUTOSAR XML (schema 4-2-2)
package /AUTOSAR_Ea/BswImplementations
  bsw implementation Ea: programming-language=C, sw-version=22.0.1, vendor-id=6, ar-release-version=4.2.2, behavior=BswInternalBehavior
    code-descriptors:
      code CodeDescriptor: artifact-descriptors=autosar-engineering-object={short-label=ArEngObj, category=SWSRC}
package /AUTOSAR_Ea/BswModuleDescriptions
  bsw module description Ea: category=BSW_MODULE  # EEPROM Abstraction
    bsw internal behavior BswInternalBehavior
