AUTOSAR XML (schema 4-2-2)
package /RB/RBA/rba_MemLib/ImplementationDataTypes  # AUTOSAR Platform types
  8 x impl type, all with category=TYPE_REFERENCE, type-emitter=RTE:
    Mem_bool: implementation-data-type=boolean  # boolean(8bit)
    Mem_u8: implementation-data-type=uint8  # unsigned 8bit
    Mem_u16: implementation-data-type=uint16  # unsigned 16bit
    Mem_u32: implementation-data-type=uint32  # unsigned 32bit
    Mem_u64: implementation-data-type=uint64  # unsigned 64bit
    Mem_enum8: implementation-data-type=sint32  # enum fitting into 8bit
    Mem_enum16: implementation-data-type=sint32  # enum fitting into 16bit but not in 8bit
    Mem_enum32: implementation-data-type=sint32  # enum fitting into 32bit but not in 16bit
package /RB/RBA/rba_MemLib/ApplicationDataTypes
  8 x app type, all with category=VALUE, sw-calibration-access=READ-ONLY, compu-method=Mem_Identical:
    Mem_u64: range phys 0..1.8446744073709552e+19 Mem_NoUnit, display-format=%20.0f  # 64-bit unsigned integer
    Mem_u32: range phys 0..4294967295 Mem_NoUnit, display-format=%10.0f  # 32-bit unsigned integer
    Mem_u16: range phys 0..65535 Mem_NoUnit, display-format=%6.0f  # 16-bit unsigned integer
    Mem_bool: range phys 0..1 Mem_NoUnit, display-format=%6.0f  # boolean (8bit)
    Mem_u8: range phys 0..255 Mem_NoUnit, display-format=%6.0f  # 8-bit unsigned integer
    Mem_enum8: range phys 0..255 Mem_NoUnit, display-format=%6.0f  # enum fitting into 8bit
    Mem_enum16: range phys 0..65535 Mem_NoUnit, display-format=%6.0f  # enum fitting into 16bit but not in 8bit
    Mem_enum32: range phys 0..4294967295 Mem_NoUnit, display-format=%10.0f  # enum fitting into 32bit but not in 16bit
package /RB/RBA/rba_MemLib/BswImplementations
  bsw implementation rba_MemLib: programming-language=C, sw-version=22.0.1, ar-release-version=4.5.0, behavior=BswInternalBehavior
    code-descriptors:
      code CodeDescriptor: artifact-descriptors=autosar-engineering-object={short-label=ArEngObj, category=SWSRC}
    resource consumption rba_MemLib_ResourceConsumption
      5 x memory section, all with prefix=RBA_MEMLIB:
        RBA_MEMLIB_CONST_8: alignment=8, sw-addrmethod=CONST, symbol=CONST_8
        RBA_MEMLIB_CONST_32: alignment=32, sw-addrmethod=CONST, symbol=CONST_32
        RBA_MEMLIB_VAR_CLEARED_8: alignment=8, sw-addrmethod=VAR_CLEARED, symbol=VAR_CLEARED_8
        RBA_MEMLIB_VAR_CLEARED_32: alignment=32, sw-addrmethod=VAR_CLEARED, symbol=VAR_CLEARED_32
        RBA_MEMLIB_CODE: sw-addrmethod=CODE, symbol=CODE
      section name prefix RBA_MEMLIB
package /RB/RBA/rba_MemLib/BswModuleDescriptions
  bsw module description rba_MemLib: category=BSW_MODULE, module-id=255  # Memstack internal support function
    bsw internal behavior BswInternalBehavior
package /RB/RBA/rba_MemLib/DataTypeMappingSets
  data type mapping set DataTypeMappingSet
    data-type-maps:
      application-data-type=Mem_bool, implementation-data-type=boolean
      application-data-type=Mem_u8, implementation-data-type=uint8
      application-data-type=Mem_u16, implementation-data-type=uint16
      application-data-type=Mem_u32, implementation-data-type=uint32
      application-data-type=Mem_u64, implementation-data-type=uint64
      application-data-type=Mem_enum8, implementation-data-type=Mem_enum8
      application-data-type=Mem_enum16, implementation-data-type=Mem_enum16
      application-data-type=Mem_enum32, implementation-data-type=Mem_enum32
package /RB/RBA/rba_MemLib/DataConstrs
  range Mem_u24: phys 0..16777215 Mem_NoUnit
package /RB/RBA/rba_MemLib/Units
  unit Mem_NoUnit: display-name=Mem_NoUnit, factor-si-to-unit=1.0, offset-si-to-unit=0.0, physical-dimension=Mem_NoPhysDim  # Mem No Unit / 1:1 / Identical
package /RB/RBA/rba_MemLib/PhysicalDimensions
  physical dimension Mem_NoPhysDim: length-exp=0
package /RB/RBA/rba_MemLib/CompuMethods
  compu method Mem_Identical: identical; unit Mem_NoUnit  # The internal value and the physical one are identical. No physical unit available
