AUTOSAR XML (schema 4-2-2)
package /AUTOSAR_Mfl/EcucModuleDefs
  module definition Mfl [0..1]: category=VENDOR_SPECIFIC_MODULE_DEFINITION, refined-module-def=Mfl, variants pre-compile  # Floating Point Math Library
    container MflGeneral  # General settings for Mfl | General settings for Mfl with selections for used controller and activation of GetVersionInfo interface
      enumeration MflRbOptimization [0..1]: multiplicity set at pre-compile, origin=RB:1.0.0:2010-12-15, set at pre-compile  # Select for which controller optimized implementations shall be used
        TC17xx  # Tricore TC17xx controller
        TC27xx  # Tricore TC27xx controller
        MPC57xx  # JDP MPC57xx controller
        MPCCut2  # JDP MPC Cut2 controller
        NO_OPTIMIZATION  # No optimization, standard C implementations shall be used
      boolean MflRbOptimizationMcuExtract [0..1]: multiplicity set at pre-compile, origin=RB:10.0.0:2015-06-18, set at pre-compile, default-value=false  # Select whether to fetch machine type from MCU and configure for controller optimized implementation | If MflRbOptimizationMcuExtract is chosen as "True", then the controller information will be extracted from MCU.Based on this, optimized implementations will be selected.Hence the user should not configure "MflRbOptimization".If MflRbOptimizationMcuExtract is chosen as "False", the controller information will not be extracted from MCU and so the user needs to configure "MflRbOptimization" manually.
      enumeration Mfl_AUTOSAR_Version [0..1]: origin=RB:1.0.0:2021-09-15, set at pre-compile, default-value=MFL_AR45  # Configuration parameter for activation of particular Mfl AUTOSAR version functions. | If MflAUTOSARVersion is set to "MFL_AR42", AR242 related functinality should be activated for the Mfl library. If MflAUTOSARVersion is set to "MFL_AR45", AR45 related functinality should be activated for the Mfl library
        MFL_AR42  # Activate AUTOSAR version AR42.
        MFL_AR45  # Activate AUTOSAR version AR45.
      enumeration Mfl_VersionInfoAPI: origin=RB:1.0.0:2010-12-15, set at pre-compile  # Configuration parameter for activation of Mfl_GetVersionInfo function. | If MflVersionInfoAPI is set to "ON", the function MflGetVersionInfo shall return the version information of the Mfl library. If MflVersionInfoAPI is set to "OFF", the Mfl library shall not provide the function Mfl_GetVersionInfo
        ON  # Activate MflGetVersionInfo function.
        OFF  # Deactivate MflGetVersionInfo function.
      enumeration mflHWRounding [0..1]: origin=RB:6.0.0:2019-05-20, set at pre-compile, default-value=MFL_CFG_OFF  # MFL_HW_ROUNDING | Select Hardware rounding Mode
        MFL_CFG_ON  # MFL Hardware rounding is ON
        MFL_CFG_OFF  # MFL Hardware rounding is OFF
    container MflRbMemoryLocations  # Memory locations | Choose memory location settings for each single service
      enumeration mflRbMemLocAbsf32: origin=RB:1.0.0:2010-12-17, set at pre-compile  # Mfl_Abs_f32 | Select one of following values: NORMAL for location in normal flash, FAST for location in fast flash, SLOW for location in slow flash, INLINE for inlining of the service
        NORMAL  # Location in normal flash
        FAST  # Location in fast flash
        SLOW  # Location in slow flash
        INLINE  # Service is inlined
      enumeration mflRbMemLocArcCosf32: origin=RB:5.0.0:2012-12-17, set at pre-compile  # Mfl_ArcCos_f32 | Select one of following values: NORMAL for location in normal flash, FAST for location in fast flash, SLOW for location in slow flash
        NORMAL  # Location in normal flash
        FAST  # Location in fast flash
        SLOW  # Location in slow flash
      enumeration mflRbMemLocArcSinf32: origin=RB:5.0.0:2012-12-17, set at pre-compile  # Mfl_ArcSin_f32 | Select one of following values: NORMAL for location in normal flash, FAST for location in fast flash, SLOW for location in slow flash
        NORMAL  # Location in normal flash
        FAST  # Location in fast flash
        SLOW  # Location in slow flash
      enumeration mflRbMemLocArcTan2f32: origin=RB:5.0.0:2012-12-17, set at pre-compile  # Mfl_ArcTan2_f32 | Select one of following values: NORMAL for location in normal flash, FAST for location in fast flash, SLOW for location in slow flash
        NORMAL  # Location in normal flash
        FAST  # Location in fast flash
        SLOW  # Location in slow flash
      enumeration mflRbMemLocArcTanf32: origin=RB:5.0.0:2012-12-17, set at pre-compile  # Mfl_ArcTan_f32 | Select one of following values: NORMAL for location in normal flash, FAST for location in fast flash, SLOW for location in slow flash
        NORMAL  # Location in normal flash
        FAST  # Location in fast flash
        SLOW  # Location in slow flash
      enumeration mflRbMemLocArrayAveragef32f32: origin=RB:5.0.0:2012-12-17, set at pre-compile  # Mfl_ArrayAverage_f32_f32 | Select one of following values: NORMAL for location in normal flash, FAST for location in fast flash, SLOW for location in slow flash, INLINE for inlining of the service
        NORMAL  # Location in normal flash
        FAST  # Location in fast flash
        SLOW  # Location in slow flash
        INLINE  # Service is inlined
      enumeration mflRbMemLocAveragef32f32: origin=RB:2.0.0:2011-06-30, set at pre-compile  # Mfl_Average_f32_f32 | Select one of following values: NORMAL for location in normal flash, FAST for location in fast flash, SLOW for location in slow flash, INLINE for inlining of the service
        NORMAL  # Location in normal flash
        FAST  # Location in fast flash
        SLOW  # Location in slow flash
        INLINE  # Service is inlined
      enumeration mflRbMemLocCalcTeQAppf32: origin=RB:1.0.0:2010-12-17, set at pre-compile  # Mfl_CalcTeQApp_f32 | Select one of following values: NORMAL for location in normal flash, FAST for location in fast flash, SLOW for location in slow flash, INLINE for inlining of the service
        NORMAL  # Location in normal flash
        FAST  # Location in fast flash
        SLOW  # Location in slow flash
        INLINE  # Service is inlined
      enumeration mflRbMemLocCalcTeQf32: origin=RB:5.0.0:2012-12-17, set at pre-compile  # Mfl_CalcTeQ_f32 | Select one of following values: NORMAL for location in normal flash, FAST for location in fast flash, SLOW for location in slow flash, INLINE for inlining of the service
        NORMAL  # Location in normal flash
        FAST  # Location in fast flash
        SLOW  # Location in slow flash
        INLINE  # Service is inlined
      enumeration mflRbMemLocCeilf32: origin=RB:2.0.0:2011-06-30, set at pre-compile  # Mfl_Ceil_f32 | Select one of following values: NORMAL for location in normal flash, FAST for location in fast flash, SLOW for location in slow flash
        NORMAL  # Location in normal flash
        FAST  # Location in fast flash
        SLOW  # Location in slow flash
      enumeration mflRbMemLocCosf32: origin=RB:5.0.0:2012-12-17, set at pre-compile  # Mfl_Cos_f32 | Select one of following values: NORMAL for location in normal flash, FAST for location in fast flash, SLOW for location in slow flash
        NORMAL  # Location in normal flash
        FAST  # Location in fast flash
        SLOW  # Location in slow flash
      enumeration mflRbMemLocCtrlSetLimit: origin=RB:5.0.0:2012-12-17, set at pre-compile  # Mfl_CtrlSetLimit | Select one of following values: NORMAL for location in normal flash, FAST for location in fast flash, SLOW for location in slow flash, INLINE for inlining of the service
        NORMAL  # Location in normal flash
        FAST  # Location in fast flash
        SLOW  # Location in slow flash
        INLINE  # Service is inlined
      enumeration mflRbMemLocCvrtf32s16: origin=RB:5.0.0:2012-12-17, set at pre-compile  # Mfl_Cvrt_f32_s16 | Select one of following values: NORMAL for location in normal flash, FAST for location in fast flash, SLOW for location in slow flash
        NORMAL  # Location in normal flash
        FAST  # Location in fast flash
        SLOW  # Location in slow flash
      enumeration mflRbMemLocCvrtf32s32: origin=RB:5.0.0:2012-12-17, set at pre-compile  # Mfl_Cvrt_f32_s32 | Select one of following values: NORMAL for location in normal flash, FAST for location in fast flash, SLOW for location in slow flash
        NORMAL  # Location in normal flash
        FAST  # Location in fast flash
        SLOW  # Location in slow flash
      enumeration mflRbMemLocCvrtf32u16: origin=RB:5.0.0:2012-12-17, set at pre-compile  # Mfl_Cvrt_f32_u16 | Select one of following values: NORMAL for location in normal flash, FAST for location in fast flash, SLOW for location in slow flash
        NORMAL  # Location in normal flash
        FAST  # Location in fast flash
        SLOW  # Location in slow flash
      enumeration mflRbMemLocCvrtf32u32: origin=RB:5.0.0:2012-12-17, set at pre-compile  # Mfl_Cvrt_f32_u32 | Select one of following values: NORMAL for location in normal flash, FAST for location in fast flash, SLOW for location in slow flash
        NORMAL  # Location in normal flash
        FAST  # Location in fast flash
        SLOW  # Location in slow flash
      enumeration mflRbMemLocCvrts16f32: origin=RB:5.0.0:2012-12-17, set at pre-compile  # Mfl_Cvrt_s16_f32 | Select one of following values: NORMAL for location in normal flash, FAST for location in fast flash, SLOW for location in slow flash
        NORMAL  # Location in normal flash
        FAST  # Location in fast flash
        SLOW  # Location in slow flash
      enumeration mflRbMemLocCvrts32f32: origin=RB:5.0.0:2012-12-17, set at pre-compile  # Mfl_Cvrt_s32_f32 | Select one of following values: NORMAL for location in normal flash, FAST for location in fast flash, SLOW for location in slow flash
        NORMAL  # Location in normal flash
        FAST  # Location in fast flash
        SLOW  # Location in slow flash
      enumeration mflRbMemLocCvrtu16f32: origin=RB:5.0.0:2012-12-17, set at pre-compile  # Mfl_Cvrt_u16_f32 | Select one of following values: NORMAL for location in normal flash, FAST for location in fast flash, SLOW for location in slow flash
        NORMAL  # Location in normal flash
        FAST  # Location in fast flash
        SLOW  # Location in slow flash
      enumeration mflRbMemLocCvrtu32f32: origin=RB:5.0.0:2012-12-17, set at pre-compile  # Mfl_Cvrt_u32_f32 | Select one of following values: NORMAL for location in normal flash, FAST for location in fast flash, SLOW for location in slow flash
        NORMAL  # Location in normal flash
        FAST  # Location in fast flash
        SLOW  # Location in slow flash
      enumeration mflRbMemLocDT1Typ1Calc: origin=RB:1.0.0:2010-12-17, set at pre-compile  # Mfl_DT1Typ1Calc | Select one of following values: NORMAL for location in normal flash, FAST for location in fast flash, SLOW for location in slow flash
        NORMAL  # Location in normal flash
        FAST  # Location in fast flash
        SLOW  # Location in slow flash
      enumeration mflRbMemLocDT1Typ1Outf32: origin=RB:1.0.0:2010-12-17, set at pre-compile  # Mfl_DT1Typ1Out_f32 | Select one of following values: NORMAL for location in normal flash, FAST for location in fast flash, SLOW for location in slow flash, INLINE for inlining of the service
        NORMAL  # Location in normal flash
        FAST  # Location in fast flash
        SLOW  # Location in slow flash
        INLINE  # Service is inlined
      enumeration mflRbMemLocDT1Typ1SetState: origin=RB:1.0.0:2010-12-17, set at pre-compile  # Mfl_DT1Typ1SetState | Select one of following values: NORMAL for location in normal flash, FAST for location in fast flash, SLOW for location in slow flash, INLINE for inlining of the service
        NORMAL  # Location in normal flash
        FAST  # Location in fast flash
        SLOW  # Location in slow flash
        INLINE  # Service is inlined
      enumeration mflRbMemLocDT1Typ2Calc: origin=RB:1.0.0:2010-12-17, set at pre-compile  # Mfl_DT1Typ2Calc | Select one of following values: NORMAL for location in normal flash, FAST for location in fast flash, SLOW for location in slow flash
        NORMAL  # Location in normal flash
        FAST  # Location in fast flash
        SLOW  # Location in slow flash
      enumeration mflRbMemLocDT1Typ2Outf32: origin=RB:1.0.0:2010-12-17, set at pre-compile  # Mfl_DT1Typ2Out_f32 | Select one of following values: NORMAL for location in normal flash, FAST for location in fast flash, SLOW for location in slow flash, INLINE for inlining of the service
        NORMAL  # Location in normal flash
        FAST  # Location in fast flash
        SLOW  # Location in slow flash
        INLINE  # Service is inlined
      enumeration mflRbMemLocDT1Typ2SetState: origin=RB:1.0.0:2010-12-17, set at pre-compile  # Mfl_DT1Typ2SetState | Select one of following values: NORMAL for location in normal flash, FAST for location in fast flash, SLOW for location in slow flash, INLINE for inlining of the service
        NORMAL  # Location in normal flash
        FAST  # Location in fast flash
        SLOW  # Location in slow flash
        INLINE  # Service is inlined
      enumeration mflRbMemLocDeadTimef32f32: origin=RB:5.0.0:2012-12-17, set at pre-compile  # Mfl_DeadTime_f32_f32 | Select one of following values: NORMAL for location in normal flash, FAST for location in fast flash, SLOW for location in slow flash
        NORMAL  # Location in normal flash
        FAST  # Location in fast flash
        SLOW  # Location in slow flash
      enumeration mflRbMemLocDebounceInit: origin=RB:2.0.0:2011-06-30, set at pre-compile  # Mfl_DebounceInit | Select one of following values: NORMAL for location in normal flash, FAST for location in fast flash, SLOW for location in slow flash, INLINE for inlining of the service
        NORMAL  # Location in normal flash
        FAST  # Location in fast flash
        SLOW  # Location in slow flash
        INLINE  # Service is inlined
      enumeration mflRbMemLocDebounceSetParam: origin=RB:5.0.0:2012-12-17, set at pre-compile  # Mfl_DebounceSetParam | Select one of following values: NORMAL for location in normal flash, FAST for location in fast flash, SLOW for location in slow flash, INLINE for inlining of the service
        NORMAL  # Location in normal flash
        FAST  # Location in fast flash
        SLOW  # Location in slow flash
        INLINE  # Service is inlined
      enumeration mflRbMemLocDebounceu8u8: origin=RB:2.0.0:2011-06-30, set at pre-compile  # Mfl_Debounce_u8_u8 | Select one of following values: NORMAL for location in normal flash, FAST for location in fast flash, SLOW for location in slow flash
        NORMAL  # Location in normal flash
        FAST  # Location in fast flash
        SLOW  # Location in slow flash
      enumeration mflRbMemLocDivLimf32: origin=RB:1.0.0:2022-10-10, set at pre-compile  # Mfl_DivLim_f32 | Select one of following values: NORMAL for location in normal flash, FAST for location in fast flash, SLOW for location in slow flash
        NORMAL  # Location in normal flash
        FAST  # Location in fast flash
        SLOW  # Location in slow flash
      enumeration mflRbMemLocExpf32: origin=RB:5.0.0:2012-12-17, set at pre-compile  # Mfl_Exp_f32 | Select one of following values: NORMAL for location in normal flash, FAST for location in fast flash, SLOW for location in slow flash
        NORMAL  # Location in normal flash
        FAST  # Location in fast flash
        SLOW  # Location in slow flash
      enumeration mflRbMemLocFloatToIntCvrtf32s16: origin=RB:2.0.0:2017-07-05, set at pre-compile  # Mfl_FloatToIntCvrt_f32_s16 | Select one of following values: NORMAL for location in normal flash, FAST for location in fast flash, SLOW for location in slow flash
        NORMAL  # Location in normal flash
        FAST  # Location in fast flash
        SLOW  # Location in slow flash
        INLINE  # Location in INLINE flash
      enumeration mflRbMemLocFloatToIntCvrtf32s32: origin=RB:2.0.0:2017-07-05, set at pre-compile  # Mfl_FloatToIntCvrt_f32_s32 | Select one of following values: NORMAL for location in normal flash, FAST for location in fast flash, SLOW for location in slow flash
        NORMAL  # Location in normal flash
        FAST  # Location in fast flash
        SLOW  # Location in slow flash
        INLINE  # Location in inline flash
      enumeration mflRbMemLocFloatToIntCvrtf32s8: origin=RB:2.0.0:2017-07-05, set at pre-compile  # Mfl_FloatToIntCvrt_f32_s8 | Select one of following values: NORMAL for location in normal flash, FAST for location in fast flash, SLOW for location in slow flash
        NORMAL  # Location in normal flash
        FAST  # Location in fast flash
        SLOW  # Location in slow flash
        INLINE  # Location in inline flash
      enumeration mflRbMemLocFloatToIntCvrtf32u16: origin=RB:2.0.0:2017-07-05, set at pre-compile  # Mfl_FloatToIntCvrt_f32_u16 | Select one of following values: NORMAL for location in normal flash, FAST for location in fast flash, SLOW for location in slow flash
        NORMAL  # Location in normal flash
        FAST  # Location in fast flash
        SLOW  # Location in slow flash
        INLINE  # Location in inline flash
      enumeration mflRbMemLocFloatToIntCvrtf32u32: origin=RB:2.0.0:2017-07-05, set at pre-compile  # Mfl_FloatToIntCvrt_f32_u32 | Select one of following values: NORMAL for location in normal flash, FAST for location in fast flash, SLOW for location in slow flash
        NORMAL  # Location in normal flash
        FAST  # Location in fast flash
        SLOW  # Location in slow flash
        INLINE  # Location in inline flash
      enumeration mflRbMemLocFloatToIntCvrtf32u8: origin=RB:2.0.0:2017-07-05, set at pre-compile  # Mfl_FloatToIntCvrt_f32_u8 | Select one of following values: NORMAL for location in normal flash, FAST for location in fast flash, SLOW for location in slow flash
        NORMAL  # Location in normal flash
        FAST  # Location in fast flash
        SLOW  # Location in slow flash
        INLINE  # Location in inline flash
      enumeration mflRbMemLocFloorf32: origin=RB:2.0.0:2011-06-30, set at pre-compile  # Mfl_Floor_f32 | Select one of following values: NORMAL for location in normal flash, FAST for location in fast flash, SLOW for location in slow flash
        NORMAL  # Location in normal flash
        FAST  # Location in fast flash
        SLOW  # Location in slow flash
      enumeration mflRbMemLocHypotf32f32f32: origin=RB:5.0.0:2012-12-17, set at pre-compile  # Mfl_Hypot_f32f32_f32 | Select one of following values: NORMAL for location in normal flash, FAST for location in fast flash, SLOW for location in slow flash
        NORMAL  # Location in normal flash
        FAST  # Location in fast flash
        SLOW  # Location in slow flash
      enumeration mflRbMemLocHystCenterHalfDeltaf32u8: origin=RB:1.0.0:2010-12-17, set at pre-compile  # Mfl_HystCenterHalfDelta_f32_u8 | Select one of following values: NORMAL for location in normal flash, FAST for location in fast flash, SLOW for location in slow flash, INLINE for inlining of the service
        NORMAL  # Location in normal flash
        FAST  # Location in fast flash
        SLOW  # Location in slow flash
        INLINE  # Service is inlined
      enumeration mflRbMemLocHystDeltaRightf32u8: origin=RB:1.0.0:2010-12-17, set at pre-compile  # Mfl_HystDeltaRight_f32_u8 | Select one of following values: NORMAL for location in normal flash, FAST for location in fast flash, SLOW for location in slow flash, INLINE for inlining of the service
        NORMAL  # Location in normal flash
        FAST  # Location in fast flash
        SLOW  # Location in slow flash
        INLINE  # Service is inlined
      enumeration mflRbMemLocHystLeftDeltaf32u8: origin=RB:1.0.0:2010-12-17, set at pre-compile  # Mfl_HystLeftDelta_f32_u8 | Select one of following values: NORMAL for location in normal flash, FAST for location in fast flash, SLOW for location in slow flash, INLINE for inlining of the service
        NORMAL  # Location in normal flash
        FAST  # Location in fast flash
        SLOW  # Location in slow flash
        INLINE  # Service is inlined
      enumeration mflRbMemLocHystLeftRightf32u8: origin=RB:1.0.0:2010-12-17, set at pre-compile  # Mfl_HystLeftRight_f32_u8 | Select one of following values: NORMAL for location in normal flash, FAST for location in fast flash, SLOW for location in slow flash, INLINE for inlining of the service
        NORMAL  # Location in normal flash
        FAST  # Location in fast flash
        SLOW  # Location in slow flash
        INLINE  # Service is inlined
      enumeration mflRbMemLocICalc: origin=RB:1.0.0:2010-12-17, set at pre-compile  # Mfl_ICalc | Select one of following values: NORMAL for location in normal flash, FAST for location in fast flash, SLOW for location in slow flash
        NORMAL  # Location in normal flash
        FAST  # Location in fast flash
        SLOW  # Location in slow flash
      enumeration mflRbMemLocILimCalc: origin=RB:1.0.0:2010-12-17, set at pre-compile  # Mfl_ILimCalc | Select one of following values: NORMAL for location in normal flash, FAST for location in fast flash, SLOW for location in slow flash
        NORMAL  # Location in normal flash
        FAST  # Location in fast flash
        SLOW  # Location in slow flash
      enumeration mflRbMemLocIOutf32: origin=RB:1.0.0:2010-12-17, set at pre-compile  # Mfl_IOut_f32 | Select one of following values: NORMAL for location in normal flash, FAST for location in fast flash, SLOW for location in slow flash, INLINE for inlining of the service
        NORMAL  # Location in normal flash
        FAST  # Location in fast flash
        SLOW  # Location in slow flash
        INLINE  # Service is inlined
      enumeration mflRbMemLocISetState: origin=RB:1.0.0:2010-12-17, set at pre-compile  # Mfl_ISetState | Select one of following values: NORMAL for location in normal flash, FAST for location in fast flash, SLOW for location in slow flash, INLINE for inlining of the service
        NORMAL  # Location in normal flash
        FAST  # Location in fast flash
        SLOW  # Location in slow flash
        INLINE  # Service is inlined
      enumeration mflRbMemLocIntToFloatCvrts16f32: origin=RB:2.0.0:2017-07-05, set at pre-compile  # Mfl_IntToFloatCvrt_s16_f32 | Select one of following values: NORMAL for location in normal flash, FAST for location in fast flash, SLOW for location in slow flash
        NORMAL  # Location in normal flash
        FAST  # Location in fast flash
        SLOW  # Location in slow flash
      enumeration mflRbMemLocIntToFloatCvrts32f32: origin=RB:2.0.0:2017-07-05, set at pre-compile  # Mfl_IntToFloatCvrt_s32_f32 | Select one of following values: NORMAL for location in normal flash, FAST for location in fast flash, SLOW for location in slow flash
        NORMAL  # Location in normal flash
        FAST  # Location in fast flash
        SLOW  # Location in slow flash
      enumeration mflRbMemLocIntToFloatCvrts64f32: origin=RB:2.0.0:2022-03-17, set at pre-compile  # Mfl_IntToFloatCvrt_s64_f32 | Select one of following values: NORMAL for location in normal flash, FAST for location in fast flash, SLOW for location in slow flash
        NORMAL  # Location in normal flash
        FAST  # Location in fast flash
        SLOW  # Location in slow flash
      enumeration mflRbMemLocIntToFloatCvrts8f32: origin=RB:2.0.0:2017-07-05, set at pre-compile  # Mfl_IntToFloatCvrt_s8_f32 | Select one of following values: NORMAL for location in normal flash, FAST for location in fast flash, SLOW for location in slow flash
        NORMAL  # Location in normal flash
        FAST  # Location in fast flash
        SLOW  # Location in slow flash
      enumeration mflRbMemLocIntToFloatCvrtu16f32: origin=RB:2.0.0:2017-07-05, set at pre-compile  # Mfl_IntToFloatCvrt_u16_f32 | Select one of following values: NORMAL for location in normal flash, FAST for location in fast flash, SLOW for location in slow flash
        NORMAL  # Location in normal flash
        FAST  # Location in fast flash
        SLOW  # Location in slow flash
      enumeration mflRbMemLocIntToFloatCvrtu32f32: origin=RB:2.0.0:2017-07-05, set at pre-compile  # Mfl_IntToFloatCvrt_u32_f32 | Select one of following values: NORMAL for location in normal flash, FAST for location in fast flash, SLOW for location in slow flash
        NORMAL  # Location in normal flash
        FAST  # Location in fast flash
        SLOW  # Location in slow flash
      enumeration mflRbMemLocIntToFloatCvrtu64f32: origin=RB:2.0.0:2022-03-17, set at pre-compile  # Mfl_IntToFloatCvrt_u64_f32 | Select one of following values: NORMAL for location in normal flash, FAST for location in fast flash, SLOW for location in slow flash
        NORMAL  # Location in normal flash
        FAST  # Location in fast flash
        SLOW  # Location in slow flash
      enumeration mflRbMemLocIntToFloatCvrtu8f32: origin=RB:2.0.0:2017-07-05, set at pre-compile  # Mfl_IntToFloatCvrt_u8_f32 | Select one of following values: NORMAL for location in normal flash, FAST for location in fast flash, SLOW for location in slow flash
        NORMAL  # Location in normal flash
        FAST  # Location in fast flash
        SLOW  # Location in slow flash
      enumeration mflRbMemLocLimitf32: origin=RB:1.0.0:2010-12-17, set at pre-compile  # Mfl_Limit_f32 | Select one of following values: NORMAL for location in normal flash, FAST for location in fast flash, SLOW for location in slow flash, INLINE for inlining of the service
        NORMAL  # Location in normal flash
        FAST  # Location in fast flash
        SLOW  # Location in slow flash
        INLINE  # Service is inlined
      enumeration mflRbMemLocLogf32: origin=RB:5.0.0:2012-12-17, set at pre-compile  # Mfl_Log_f32 | Select one of following values: NORMAL for location in normal flash, FAST for location in fast flash, SLOW for location in slow flash
        NORMAL  # Location in normal flash
        FAST  # Location in fast flash
        SLOW  # Location in slow flash
      enumeration mflRbMemLocMaxf32: origin=RB:1.0.0:2010-12-17, set at pre-compile  # Mfl_Max_f32 | Select one of following values: NORMAL for location in normal flash, FAST for location in fast flash, SLOW for location in slow flash, INLINE for inlining of the service
        NORMAL  # Location in normal flash
        FAST  # Location in fast flash
        SLOW  # Location in slow flash
        INLINE  # Service is inlined
      enumeration mflRbMemLocMedianSortf32f32: origin=RB:5.0.0:2012-12-17, set at pre-compile  # Mfl_MedianSort_f32_f32 | Select one of following values: NORMAL for location in normal flash, FAST for location in fast flash, SLOW for location in slow flash
        NORMAL  # Location in normal flash
        FAST  # Location in fast flash
        SLOW  # Location in slow flash
      enumeration mflRbMemLocMinf32: origin=RB:1.0.0:2010-12-17, set at pre-compile  # Mfl_Min_f32 | Select one of following values: NORMAL for location in normal flash, FAST for location in fast flash, SLOW for location in slow flash, INLINE for inlining of the service
        NORMAL  # Location in normal flash
        FAST  # Location in fast flash
        SLOW  # Location in slow flash
        INLINE  # Service is inlined
      enumeration mflRbMemLocModf32: origin=RB:1.0.0:2022-10-07, set at pre-compile  # Mfl_Mod_f32 | Select one of following values: NORMAL for location in normal flash, FAST for location in fast flash, SLOW for location in slow flash
        NORMAL  # Location in normal flash
        FAST  # Location in fast flash
        SLOW  # Location in slow flash
      enumeration mflRbMemLocPCalc: origin=RB:1.0.0:2010-12-17, set at pre-compile  # Mfl_PCalc | Select one of following values: NORMAL for location in normal flash, FAST for location in fast flash, SLOW for location in slow flash
        NORMAL  # Location in normal flash
        FAST  # Location in fast flash
        SLOW  # Location in slow flash
      enumeration mflRbMemLocPDCalc: origin=RB:1.0.0:2010-12-17, set at pre-compile  # Mfl_PDCalc | Select one of following values: NORMAL for location in normal flash, FAST for location in fast flash, SLOW for location in slow flash
        NORMAL  # Location in normal flash
        FAST  # Location in fast flash
        SLOW  # Location in slow flash
      enumeration mflRbMemLocPDOutf32: origin=RB:1.0.0:2010-12-17, set at pre-compile  # Mfl_PDOut_f32 | Select one of following values: NORMAL for location in normal flash, FAST for location in fast flash, SLOW for location in slow flash, INLINE for inlining of the service
        NORMAL  # Location in normal flash
        FAST  # Location in fast flash
        SLOW  # Location in slow flash
        INLINE  # Service is inlined
      enumeration mflRbMemLocPDSetParam: origin=RB:1.0.0:2010-12-17, set at pre-compile  # Mfl_PDSetParam | Select one of following values: NORMAL for location in normal flash, FAST for location in fast flash, SLOW for location in slow flash, INLINE for inlining of the service
        NORMAL  # Location in normal flash
        FAST  # Location in fast flash
        SLOW  # Location in slow flash
        INLINE  # Service is inlined
      enumeration mflRbMemLocPDSetState: origin=RB:1.0.0:2010-12-17, set at pre-compile  # Mfl_PDSetState | Select one of following values: NORMAL for location in normal flash, FAST for location in fast flash, SLOW for location in slow flash, INLINE for inlining of the service
        NORMAL  # Location in normal flash
        FAST  # Location in fast flash
        SLOW  # Location in slow flash
        INLINE  # Service is inlined
      enumeration mflRbMemLocPIDOutf32: origin=RB:1.0.0:2010-12-17, set at pre-compile  # Mfl_PIDOut_f32 | Select one of following values: NORMAL for location in normal flash, FAST for location in fast flash, SLOW for location in slow flash, INLINE for inlining of the service
        NORMAL  # Location in normal flash
        FAST  # Location in fast flash
        SLOW  # Location in slow flash
        INLINE  # Service is inlined
      enumeration mflRbMemLocPIDSetParam: origin=RB:1.0.0:2010-12-17, set at pre-compile  # Mfl_PIDSetParam | Select one of following values: NORMAL for location in normal flash, FAST for location in fast flash, SLOW for location in slow flash, INLINE for inlining of the service
        NORMAL  # Location in normal flash
        FAST  # Location in fast flash
        SLOW  # Location in slow flash
        INLINE  # Service is inlined
      enumeration mflRbMemLocPIDSetState: origin=RB:1.0.0:2010-12-17, set at pre-compile  # Mfl_PIDSetState | Select one of following values: NORMAL for location in normal flash, FAST for location in fast flash, SLOW for location in slow flash, INLINE for inlining of the service
        NORMAL  # Location in normal flash
        FAST  # Location in fast flash
        SLOW  # Location in slow flash
        INLINE  # Service is inlined
      enumeration mflRbMemLocPIDTyp1Calc: origin=RB:1.0.0:2010-12-17, set at pre-compile  # Mfl_PIDTyp1Calc | Select one of following values: NORMAL for location in normal flash, FAST for location in fast flash, SLOW for location in slow flash
        NORMAL  # Location in normal flash
        FAST  # Location in fast flash
        SLOW  # Location in slow flash
      enumeration mflRbMemLocPIDTyp1LimCalc: origin=RB:1.0.0:2010-12-17, set at pre-compile  # Mfl_PIDTyp1LimCalc | Select one of following values: NORMAL for location in normal flash, FAST for location in fast flash, SLOW for location in slow flash
        NORMAL  # Location in normal flash
        FAST  # Location in fast flash
        SLOW  # Location in slow flash
      enumeration mflRbMemLocPIDTyp2Calc: origin=RB:1.0.0:2010-12-17, set at pre-compile  # Mfl_PIDTyp2Calc | Select one of following values: NORMAL for location in normal flash, FAST for location in fast flash, SLOW for location in slow flash
        NORMAL  # Location in normal flash
        FAST  # Location in fast flash
        SLOW  # Location in slow flash
      enumeration mflRbMemLocPIDTyp2LimCalc: origin=RB:1.0.0:2010-12-17, set at pre-compile  # Mfl_PIDTyp2LimCalc | Select one of following values: NORMAL for location in normal flash, FAST for location in fast flash, SLOW for location in slow flash
        NORMAL  # Location in normal flash
        FAST  # Location in fast flash
        SLOW  # Location in slow flash
      enumeration mflRbMemLocPIOutf32: origin=RB:1.0.0:2010-12-17, set at pre-compile  # Mfl_PIOut_f32 | Select one of following values: NORMAL for location in normal flash, FAST for location in fast flash, SLOW for location in slow flash, INLINE for inlining of the service
        NORMAL  # Location in normal flash
        FAST  # Location in fast flash
        SLOW  # Location in slow flash
        INLINE  # Service is inlined
      enumeration mflRbMemLocPISetParam: origin=RB:1.0.0:2010-12-17, set at pre-compile  # Mfl_PISetParam | Select one of following values: NORMAL for location in normal flash, FAST for location in fast flash, SLOW for location in slow flash, INLINE for inlining of the service
        NORMAL  # Location in normal flash
        FAST  # Location in fast flash
        SLOW  # Location in slow flash
        INLINE  # Service is inlined
      enumeration mflRbMemLocPISetState: origin=RB:1.0.0:2010-12-17, set at pre-compile  # Mfl_PISetState | Select one of following values: NORMAL for location in normal flash, FAST for location in fast flash, SLOW for location in slow flash, INLINE for inlining of the service
        NORMAL  # Location in normal flash
        FAST  # Location in fast flash
        SLOW  # Location in slow flash
        INLINE  # Service is inlined
      enumeration mflRbMemLocPITyp1Calc: origin=RB:1.0.0:2010-12-17, set at pre-compile  # Mfl_PITyp1Calc | Select one of following values: NORMAL for location in normal flash, FAST for location in fast flash, SLOW for location in slow flash
        NORMAL  # Location in normal flash
        FAST  # Location in fast flash
        SLOW  # Location in slow flash
      enumeration mflRbMemLocPITyp1LimCalc: origin=RB:1.0.0:2010-12-17, set at pre-compile  # Mfl_PITyp1LimCalc | Select one of following values: NORMAL for location in normal flash, FAST for location in fast flash, SLOW for location in slow flash
        NORMAL  # Location in normal flash
        FAST  # Location in fast flash
        SLOW  # Location in slow flash
      enumeration mflRbMemLocPITyp2Calc: origin=RB:1.0.0:2010-12-17, set at pre-compile  # Mfl_PITyp2Calc | Select one of following values: NORMAL for location in normal flash, FAST for location in fast flash, SLOW for location in slow flash
        NORMAL  # Location in normal flash
        FAST  # Location in fast flash
        SLOW  # Location in slow flash
      enumeration mflRbMemLocPITyp2LimCalc: origin=RB:1.0.0:2010-12-17, set at pre-compile  # Mfl_PITyp2LimCalc | Select one of following values: NORMAL for location in normal flash, FAST for location in fast flash, SLOW for location in slow flash
        NORMAL  # Location in normal flash
        FAST  # Location in fast flash
        SLOW  # Location in slow flash
      enumeration mflRbMemLocPOutf32: origin=RB:1.0.0:2010-12-17, set at pre-compile  # Mfl_POut_f32 | Select one of following values: NORMAL for location in normal flash, FAST for location in fast flash, SLOW for location in slow flash, INLINE for inlining of the service
        NORMAL  # Location in normal flash
        FAST  # Location in fast flash
        SLOW  # Location in slow flash
        INLINE  # Service is inlined
      enumeration mflRbMemLocPT1Calc: origin=RB:1.0.0:2010-12-17, set at pre-compile  # Mfl_PT1Calc | Select one of following values: NORMAL for location in normal flash, FAST for location in fast flash, SLOW for location in slow flash
        NORMAL  # Location in normal flash
        FAST  # Location in fast flash
        SLOW  # Location in slow flash
      enumeration mflRbMemLocPT1Outf32: origin=RB:1.0.0:2010-12-17, set at pre-compile  # Mfl_PT1Out_f32 | Select one of following values: NORMAL for location in normal flash, FAST for location in fast flash, SLOW for location in slow flash, INLINE for inlining of the service
        NORMAL  # Location in normal flash
        FAST  # Location in fast flash
        SLOW  # Location in slow flash
        INLINE  # Service is inlined
      enumeration mflRbMemLocPT1SetState: origin=RB:1.0.0:2010-12-17, set at pre-compile  # Mfl_PT1SetState | Select one of following values: NORMAL for location in normal flash, FAST for location in fast flash, SLOW for location in slow flash, INLINE for inlining of the service
        NORMAL  # Location in normal flash
        FAST  # Location in fast flash
        SLOW  # Location in slow flash
        INLINE  # Service is inlined
      enumeration mflRbMemLocPowf32: origin=RB:5.0.0:2012-12-17, set at pre-compile  # Mfl_Pow_f32 | Select one of following values: NORMAL for location in normal flash, FAST for location in fast flash, SLOW for location in slow flash
        NORMAL  # Location in normal flash
        FAST  # Location in fast flash
        SLOW  # Location in slow flash
      enumeration mflRbMemLocRampCalc: origin=RB:1.0.0:2010-12-17, set at pre-compile  # Mfl_RampCalc | Select one of following values: NORMAL for location in normal flash, FAST for location in fast flash, SLOW for location in slow flash
        NORMAL  # Location in normal flash
        FAST  # Location in fast flash
        SLOW  # Location in slow flash
      enumeration mflRbMemLocRampCalcJump: origin=RB:1.0.0:2010-12-17, set at pre-compile  # Mfl_RampCalcJump | Select one of following values: NORMAL for location in normal flash, FAST for location in fast flash, SLOW for location in slow flash, INLINE for inlining of the service
        NORMAL  # Location in normal flash
        FAST  # Location in fast flash
        SLOW  # Location in slow flash
        INLINE  # Service is inlined
      enumeration mflRbMemLocRampCalcSwitch: origin=RB:5.0.0:2012-12-17, set at pre-compile  # Mfl_RampCalcSwitch | Select one of following values: NORMAL for location in normal flash, FAST for location in fast flash, SLOW for location in slow flash, INLINE for inlining of the service
        NORMAL  # Location in normal flash
        FAST  # Location in fast flash
        SLOW  # Location in slow flash
        INLINE  # Service is inlined
      enumeration mflRbMemLocRampCheckActivity: origin=RB:1.0.0:2010-12-17, set at pre-compile  # Mfl_RampCheckActivity | Select one of following values: NORMAL for location in normal flash, FAST for location in fast flash, SLOW for location in slow flash, INLINE for inlining of the service
        NORMAL  # Location in normal flash
        FAST  # Location in fast flash
        SLOW  # Location in slow flash
        INLINE  # Service is inlined
      enumeration mflRbMemLocRampGetSwitchPos: origin=RB:1.0.0:2010-12-17, set at pre-compile  # Mfl_RampGetSwitchPos | Select one of following values: NORMAL for location in normal flash, FAST for location in fast flash, SLOW for location in slow flash, INLINE for inlining of the service
        NORMAL  # Location in normal flash
        FAST  # Location in fast flash
        SLOW  # Location in slow flash
        INLINE  # Service is inlined
      enumeration mflRbMemLocRampInitState: origin=RB:1.0.0:2010-12-17, set at pre-compile  # Mfl_RampInitState | Select one of following values: NORMAL for location in normal flash, FAST for location in fast flash, SLOW for location in slow flash, INLINE for inlining of the service
        NORMAL  # Location in normal flash
        FAST  # Location in fast flash
        SLOW  # Location in slow flash
        INLINE  # Service is inlined
      enumeration mflRbMemLocRampOutf32: origin=RB:1.0.0:2010-12-17, set at pre-compile  # Mfl_RampOut_f32 | Select one of following values: NORMAL for location in normal flash, FAST for location in fast flash, SLOW for location in slow flash, INLINE for inlining of the service
        NORMAL  # Location in normal flash
        FAST  # Location in fast flash
        SLOW  # Location in slow flash
        INLINE  # Service is inlined
      enumeration mflRbMemLocRampSetParam: origin=RB:1.0.0:2010-12-17, set at pre-compile  # Mfl_RampSetParam | Select one of following values: NORMAL for location in normal flash, FAST for location in fast flash, SLOW for location in slow flash, INLINE for inlining of the service
        NORMAL  # Location in normal flash
        FAST  # Location in fast flash
        SLOW  # Location in slow flash
        INLINE  # Service is inlined
      enumeration mflRbMemLocRateLimiterf32: origin=RB:5.0.0:2012-12-17, set at pre-compile  # Mfl_RateLimiter_f32 | Select one of following values: NORMAL for location in normal flash, FAST for location in fast flash, SLOW for location in slow flash, INLINE for inlining of the service
        NORMAL  # Location in normal flash
        FAST  # Location in fast flash
        SLOW  # Location in slow flash
        INLINE  # Service is inlined
      enumeration mflRbMemLocRoundf32: origin=RB:2.0.0:2011-06-30, set at pre-compile  # Mfl_Round_f32 | Select one of following values: NORMAL for location in normal flash, FAST for location in fast flash, SLOW for location in slow flash
        NORMAL  # Location in normal flash
        FAST  # Location in fast flash
        SLOW  # Location in slow flash
      enumeration mflRbMemLocSignf32: origin=RB:2.0.0:2011-06-30, set at pre-compile  # Mfl_Sign_f32 | Select one of following values: NORMAL for location in normal flash, FAST for location in fast flash, SLOW for location in slow flash
        NORMAL  # Location in normal flash
        FAST  # Location in fast flash
        SLOW  # Location in slow flash
      enumeration mflRbMemLocSinf32: origin=RB:5.0.0:2012-12-17, set at pre-compile  # Mfl_Sin_f32 | Select one of following values: NORMAL for location in normal flash, FAST for location in fast flash, SLOW for location in slow flash
        NORMAL  # Location in normal flash
        FAST  # Location in fast flash
        SLOW  # Location in slow flash
      enumeration mflRbMemLocSortAscendf32: origin=RB:1.0.0:2010-12-17, set at pre-compile  # Mfl_SortAscend_f32 | Select one of following values: NORMAL for location in normal flash, FAST for location in fast flash, SLOW for location in slow flash
        NORMAL  # Location in normal flash
        FAST  # Location in fast flash
        SLOW  # Location in slow flash
      enumeration mflRbMemLocSortDescendf32: origin=RB:1.0.0:2010-12-17, set at pre-compile  # Mfl_SortDescend_f32 | Select one of following values: NORMAL for location in normal flash, FAST for location in fast flash, SLOW for location in slow flash
        NORMAL  # Location in normal flash
        FAST  # Location in fast flash
        SLOW  # Location in slow flash
      enumeration mflRbMemLocSqrtf32: origin=RB:2.0.0:2011-06-30, set at pre-compile  # Mfl_Sqrt_f32 | Select one of following values: NORMAL for location in normal flash, FAST for location in fast flash, SLOW for location in slow flash
        NORMAL  # Location in normal flash
        FAST  # Location in fast flash
        SLOW  # Location in slow flash
      enumeration mflRbMemLocTanf32: origin=RB:5.0.0:2012-12-17, set at pre-compile  # Mfl_Tan_f32 | Select one of following values: NORMAL for location in normal flash, FAST for location in fast flash, SLOW for location in slow flash
        NORMAL  # Location in normal flash
        FAST  # Location in fast flash
        SLOW  # Location in slow flash
      enumeration mflRbMemLocTruncf32: origin=RB:2.0.0:2011-06-30, set at pre-compile  # Mfl_Trunc_f32 | Select one of following values: NORMAL for location in normal flash, FAST for location in fast flash, SLOW for location in slow flash
        NORMAL  # Location in normal flash
        FAST  # Location in fast flash
        SLOW  # Location in slow flash
