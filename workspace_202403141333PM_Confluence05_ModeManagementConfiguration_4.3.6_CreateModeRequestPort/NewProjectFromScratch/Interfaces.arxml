AUTOSAR XML (schema 00051)
package /Interfaces
  sender receiver interface My_SR_Interface
    data DE_MyDataElement: type=MyApplicationDataType
