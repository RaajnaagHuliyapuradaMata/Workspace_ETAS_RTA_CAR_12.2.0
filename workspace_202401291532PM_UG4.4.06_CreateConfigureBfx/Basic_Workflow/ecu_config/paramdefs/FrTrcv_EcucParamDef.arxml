AUTOSAR XML (schema 00048)
package /AUTOSAR_FrTrcv/EcucModuleDefs
  module definition FrTrcv [0..*]: category=VENDOR_SPECIFIC_MODULE_DEFINITION, refined-module-def=FrTrcv, variants pre-compile  # Configuration of the FrTrcv (FlexRay Transceiver driver) module.
    container FrTrcvChannel [1..*]  # Container gives FlexRay transceiver driver information about a single FlexRay transceiver channel. | Any FlexRay transceiver driver has such FlexRay transceiver channels.
      integer FrTrcvAddWaitAfterRead [0..1]: -100..100, origin=RB, set at pre-compile, default-value=0  # Additional wait time for WaitAfterRead
      integer FrTrcvAddWaitBeforeRead [0..1]: -100..100, origin=RB, set at pre-compile, default-value=0  # Additional wait time for WaitBeforeRead
      integer FrTrcvChannelId: 0..255, set at pre-compile, symbolic-name-value=true, with-auto=true  # Unique identifier of the FlexRay Transceiver Channel.
      boolean FrTrcvChannelUsed: set at pre-compile, default-value=true  # Shall the related FlexRay transceiver channel be used?
      boolean FrTrcvControlsPowerSupply: set at pre-compile, default-value=false  # Is ECU power supply controlled by this transceiver?
      function name FrTrcvEnableInterruptCallout [0..1]: multiplicity set at pre-compile, origin=RB:v1.0.0:2020-06-30, set at pre-compile  # This parameter defines the existence and the name of a callout function that enables the interrupt pin for the wakeup. If this parameter is omitted no callout shall take place.
      enumeration FrTrcvHardwareType: {TJA1080, TJA1081, TJA1082, TJA1085, AS8221, TJA1081_NCV7381, NCV7381, NCV7383, TLE9221, CDD}, origin=RB:v1.0.0:2016-9-30, set at pre-compile  # Type of the used Hardware | FRTRCV_HARDWARE_NAME and internal information about ability of this hardware typel.
      enumeration FrTrcvInitState: {FRTRCV_TRCVMODE_SLEEP, FRTRCV_TRCVMODE_STANDBY}, set at pre-compile  # State of FlexRay transceiver after power on. | ImplementationType: FrTrcv_TrcvModeType
      enumeration FrTrcvMaxBaudrate: {FR_10M, FR_2M5, FR_5M0}, set at pre-compile  # Max baudrate for transceiver hardware type. Only used for validation purposes. Value shall be configured by configuration tool based on | FRTRCV_HARDWARE_NAME and internal information about ability of this hardware typel.
      integer FrTrcvRbCddChalId [0..1]: 0..255, origin=RB, set at pre-compile, symbolic-name-value=true  # This Parameter should be configured if Cdd API are having channel ID as one parameter.
      integer FrTrcvRbCddModeChangeDelay [0..1]: 1..255, origin=RB, set at pre-compile, default-value=1  # This parameter need to be configured only if unexpected Mode Propogation monitoring for CDD type of Transceiver is enabled. Here user need to specify the minimum delay required to set the requested mode of transcier. User have to enter the number in the multiples of main fucntion duration. For example if Main funtion is scheduled in 10ms task and minimum time required to change the transceiver mode is 20ms then configure this parameter as 2 .
      string FrTrcvRbCddName [0..1]: origin=RB, set at pre-compile  # Only used if CDD is choosen as HardwareType. A separate freetext field which is used to generate function calls out of FrTrcv into the CDD and to include the corresponding .h file. E:G. if "rba_IoExtCy321" is configured, the FrTrcv code generator generates function calls "rba_IoExtCy321_FrTrcvSetOpMode", "rba_IoExtCy321_FrTrcvGetOpMode", "rba_IoExtCy321_FrTrcvGetBusWuReason", "rba_IoExtCy321_FrTrcvSetWakeupMode" and includes the file rba_IoExtCy321.h.
      boolean FrTrcvTRXDInterfaceUsed [0..1]: origin=RB:v1.0.0:2016-9-30, set at pre-compile, default-value=false  # This Tag is applicable only for TJA1085 Transceiver.This tag indicates whether TRXD0/1 interfaces is used to route the signals from one Transceiver to another. In some configuration, If multiple TJA1085 are used where only one instance of TJA1085 is connected to Communication interface and the other one is not connect to Communication interface. The other transciver is used to increase the number of braches by connecting the TRXD/0/1 interfaces as input. User should check the interfacing of tranceiver in schematic and based on the connection this tag need to be set. If this tag is enabled then wakeup on TRXD interface is monitored
      integer FrTrcvTimeoutInner [0..1]: 0..1000, origin=RB, set at pre-compile, default-value=0  # Inner Timeout. How long does a read of one bit take until a Interrupt is detected and a new read of statusbit is started. This value is transceiver dependent. If value is 0 or empty, a default value for the specific transceiver is choosen. It is recommended to use default values.
      integer FrTrcvTimeoutOuter [0..1]: 0..10000, origin=RB, set at pre-compile, default-value=0  # Outer Timeout. How long does the SW tryto read out the complete amout of error bit.
      boolean FrTrcvWakeupByBusUsed: set at pre-compile  # Is wake up by node supported? If FlexRay transceiver hardware does not support wake up by node value is always FALSE. If FlexRay transceiver hardware supports wake up by node value is TRUE or FALSE depending whether it is used or not.
      reference FrTrcvChannelEcucPartitionRef [0..0]: scope=ECU, multiplicity set at pre-compile, set at pre-compile, destination=EcucPartition  # Maps one single Flexray transceiver channel to zero or one ECUC partitions. The ECUC partition referenced is a subset of the ECUC partitions where the Flexray transceiver driver is mapped to.
      symbolic name reference FrTrcvIcuChannelRef [0..1]: scope=ECU, multiplicity set at pre-compile, set at pre-compile, destination=IcuChannel  # Reference to the IcuChannel to enable/disable the interrupts for wakeups.
      symbolic name reference FrTrcvMasterChannelRef [0..1]: multiplicity set at pre-compile, origin=RB:v4.0.0:2017-12-29, set at pre-compile, destination=FrTrcvChannel  # Reference to Master Transceiver where CC Interface is connected.This Parameter is applicable only when TJA1085 transceiver is use. This parameter is also used to Identify wheather CC Interface is connected or Not. If this reference is empty then CC Inter face is enabled and .
      symbolic name reference FrTrcvWakeupSourceRef [0..1]: scope=ECU, multiplicity set at pre-compile, set at pre-compile, destination=EcuMWakeupSource  # Reference to a wakeup source in the EcuM configuration. If | FrTrcvWakeUpSupport is configured as FRTRCV_WAKEUP_NOT_SUPPORTED the FrTrcvWakeupSourceRef is not needed. Implementation Type: reference to EcuM_WakeupSourceType
      container FrTrcvAccess
        container FrTrcvDioAccess [0..1]  # Container gives FR transceiver driver information about accessing ports and port pins. If a FR transceiver hardware has no Dio interface, there is no instance of this container.
          container FrTrcvDioChannelAccess [1..*]  # In this Container the relation between FR transceiver hardware pin names and Dio port access information is given.
            enumeration FrTrcvDioHardwareInterfaceType: {Enable, Standby, ErrorPin, WakeupSignalisation, Inhibit}, origin=RB, set at pre-compile  # Type of functionalty of this pin. The trcv-software uses this parameter to know what functionality is located at the referenced Dio Pin conneted to the Trcv-HW. | FRTRCV_HARDWARE_NAME and internal information about ability of this hardware typel.
            string FrTrcvHardwareInterfaceName: set at pre-compile  # FR transceiver hardware interface name. It is typically the name of a pin. From a Dio point of view it is either a port, a single channel or a channel group. Depending on this fact either FRTRCV_DIO_PORT_SYMBOLIC_NAME or FRTRCV_DIO_CHANNEL_SYMBOLIC_NAME or FRTRCV_DIO_CHANNEL_GROUP_SYMBOLIC_NAME shall reference a Dio configuration. The FR transceiver driver implementation description shall list up this name for the appropriate FR transceiver hardware.
            string FrTrcvRbDioSymName [0..1]: origin=RB:v4.1.0:2018-02-28, set at pre-compile  # This parameter have to be configured only if Dio component is not available in the Project. In this case Macro to access Dio will be generated based on the name given here. Macro is generated by attaching the symbolic name pattern. If third party macro is not matching with the generated macro , then a mapping macro should by created by integrator. If project has Autosar Dio then no need to configure this parameter.
            boolean FrTrcvRbHardwarePinInvert [0..1]: multiplicity set at pre-compile, origin=RB, set at pre-compile, default-value=false  # Parameter depends on hardware: Describes, if a inverter is between transceiver pin and micro controller. If the transceiver is directly connected to the Controller, 'false' should be configured. If there is an inverter between transceiver and micro controller, 'yes' should be configured. | false: No inverter between Micro Controller and transceiver yes: Inverter between Micro Controller and transceiver
            choice reference FrTrcvDioSymNameRef: set at pre-compile, destination=[DioChannel, DioChannelGroup, DioPort]  # Choice Reference to a DIO Port, DIO Channel or DIO Channel Group. This reference replaces the FRTRCV_DIO_PORT_SYM_NAME, FRTRCV_DIO_CHANNEL_SYM_NAME and FRTRCV_DIO_GROUP_SYM_NAME references in the Fr Trcv SWS.
        container FrTrcvSpiSequence [0..1]  # Container gives FlexRay transceiver driver information about one SPI sequence. One SPI sequence used by FlexRay transceiver driver is in exclusive use for it. No other driver is allowed to access this sequence. FlexRay transceiver driver may use one sequence to access n FlexRay transceiver hardwares chips of the same type or n sequences are used to access one single FlexRay transceiver hardware chip. If a FlexRay transceiver hardware has no SPI interface, there is no instance of this container. | Note: as ChannelIDs and JobIDs are hardlinked to the SequenceID through the SPI configuration, if the SPI configuration is modified (in particular the ChannelIDs associated to the SPI sequence FrTrcvSpiSequence refers to), FrTrcv must be compiled again to reflect the latest changes.
          string FrTrcvRbSpiChnlStrgName [0..1]: origin=RB:v4.1.0:2018-02-28, set at pre-compile  # This parameter have to be configured only if SPI component is not available in the Project. In this case Macro to access SPI will be generated based on the name given here.Macro is generated by attachig the symbloic name patter. If generated macro name is not matching with third party macro then integrator should provide the mapping macro .If project has Autosar SPI then no need to configure this parameter.
          string FrTrcvRbSpiSeqStrgName [0..1]: origin=RB:v4.1.0:2018-02-28, set at pre-compile  # This parameter have to be configured only if SPI component is not available in the Project. In this case Macro to access SPI will be generated based on the name given here.Macro is generated by attachig the symbloic name patter. If generated macro name is not matching with third party macro then integrator should provide the mapping macro .If project has Autosar SPI then no need to configure this parameter.
          reference FrTrcvSpiSequenceName: set at pre-compile, destination=SpiSequence  # Reference to a Spi sequence configuration container.
      container FrTrcvBranchIdContainer [1..*]  # Only one SymbolicNameValue can be defined per container. Therefore this container is necessary.
        integer FrTrcvBranchId [0..1]: 0..255, set at pre-compile, symbolic-name-value=true, with-auto=true  # Unique branch id. It is used by CDDs and internally.
        integer FrTrcvHardwareBranchId [0..1]: 0..255, origin=RB:v1.0.0:2016-9-30, set at pre-compile, symbolic-name-value=true  # Unique Hardware branch id. Used Brach IDs can be configured here For Example TJA1085 supports upto for Branches 1 2 3 and 4 .
      container FrTrcvChannelDemEventParameterRefs [0..1]  # Container for the references to DemEventParameter elements which shall be invoked using the API Dem_SetEventStatus in case the corresponding error occurs. The EventId is taken from the referenced DemEventParameter's DemEventId symbolic value. The standardized errors are provided in this container and can be extended by vendor-specific error references.
        enumeration FrTrcvRbDynCreate_FRTRCV_E_FR_NO_CONTROL_TRCV [0..1]: {Disabled, Standard}, origin=RB, set at pre-compile, default-value=Disabled  # Dynamically create DemEvent | Selects the way how the example DemEvent is created. If not set or set to &quot;Disabled&quot;, no such DemEvent is automatically created. If the dynamic creation of this DemEvent is enabled, the reference to this DemEvent (in parameter rba_Example_DemEventRef) is also automatically created and shall therefore not be set manually.
        symbolic name reference FRTRCV_E_FR_BUSERROR_TRCV [0..1]: scope=ECU, multiplicity set at pre-compile, set at pre-compile, destination=DemEventParameter  # Reference to configured DEM event to report "Error Status of Class B (SPI) transceiver bus errors where TrcvIdx is the transceiver index"
        symbolic name reference FRTRCV_E_FR_ERRN_TRCV [0..1]: scope=ECU, multiplicity set at pre-compile, set at pre-compile, destination=DemEventParameter  # Reference to configured DEM event to report "Error Status of Class A (GPIO) transceiver"
        symbolic name reference FRTRCV_E_FR_NO_CONTROL_TRCV [0..1]: scope=ECU, multiplicity set at pre-compile, origin=RB, set at pre-compile, destination=DemEventParameter  # Reference to configured DEM event to report &quot;No/incorrect communication to transceiver&quot
        symbolic name reference FRTRCV_RB_E_UNEXPECTED_MODE_PROP [0..1]: scope=ECU, multiplicity set at pre-compile, origin=RB:v4.1.0:2018-2-28, set at pre-compile, destination=DemEventParameter  # Reference to the DemEventParameter which shall be issued when the unexpected mode propogation is detcted in Transceiver HW.
    container FrTrcvGeneral  # Container gives FlexRay transceiver driver basic information.
      enumeration FrTrcvAutosarVersion: {Legacy, AR4_0_2, AR4_0_3}, origin=RB, set at pre-compile  # Naming convention for symbolic names are generated according autosar version: Lecacy: no prefix AR4.0.2: Dio_ (ecuc_sws_2108) AR4.0.3: DioConf_DioChannel_
      boolean FrTrcvClearWupReasonInSetWakeupMode: origin=RB, set at pre-compile, default-value=false  # On true, the wakeup reason is cleared in function FrTrcv_ClearTransceiverWakeup. With 'false' at this configuration parameter, the wakeup reason is not cleared in function FrTrcv_ClearTransceiverWakeup. The wakeup reason is cleard always init-function and on transition to sleep mode. If this parameter is set to true in one Fr Trcv it will be used in all FrTrcv | * true: enabled (ON). * false: disabled (OFF). If switched on, #define FRTRCV_DEV _ERROR_DETECT ON shall be generated. If switched off, #define FRTRCV_DEV_ERROR _DETECT OFF shall be generated. Define shall be part of file FrTrcv_Cfg.h.
      function name FrTrcvDemReportErrorStatusConfiguration [0..1]: multiplicity set at pre-compile, set at pre-compile  # Name of a C function which substitutes Dem_SetEventStatus.
      boolean FrTrcvDevErrorDetect: set at pre-compile, default-value=false  # Switches the development error detection and notification on or off. | * true: detection and notification is enabled. * false: detection and notification is disabled.
      boolean FrTrcvEnableMultipleWakeupreason: origin=RB, set at pre-compile, default-value=false  # If the enum FrTrcv_TrcvWUReasonType in Fr_Generatypes.h supports multiple wakeupreasons (e.g. FRTRCV_WU_BY_BUS_AND_PIN) then the value should set to true (e.g. at RB stack). if the enum FrTrcv_TrcvWUReasonType in Fr_Generatypes.h does not support multiple wakeupreasons (e.g. FRTRCV_WU_BY_BUS_AND_PIN) then the value should set to false (e.g. at Vector stack) If value is set to false, the config parameters FrTrcvRbWakeupReasonBusAndPin, FrTrcvRbWakeupReasonPinAndPower, FrTrcvRbWakeupReasonBusAndPower, FrTrcvRbWakeupReasonBusAndPinAndPower are relevant.
      boolean FrTrcvErrorCheckDuringCommunication: set at pre-compile  # Enable a functionality to check transceiver's state during communication.
      boolean FrTrcvErrorCheckInInit: set at pre-compile  # Enable a functionality to check transceiver's state while initialization process of FrTrcv.
      boolean FrTrcvGetTrcvWuReasonDirectHwUpdate [0..1]: origin=RB, set at pre-compile  # On true, in function FrTrcv_GetTransceiverWUReason the wakeupreason is directly read out with function FrTrcv_GetTransceiverError. Depending on used transceiver, this can result in gread runtime consumption. On false, in function FrTrcv_GetTransceiverWUReason previous stored wakeupreason is returned. The wakeupreaons is read out at transition to normal mode and at function call FrTrcv_GetTransceiverError. This parameter is global for all configured FrTrcv. If this parameter is set for one transceiver it is used for all FrTrcv.
      integer FrTrcvIndex: 0..255, set at pre-compile, symbolic-name-value=true, with-auto=true  # Specifies the InstanceId of this module instance. If only one instance is present it shall have the Id 0.
      float FrTrcvMainFunctionCycleTime [0..1]: 0..INF, set at pre-compile  # Cyclic call time for function FrTrcvMainFunction in seconds. A multiplicity of 0 indicates no calls for this function. In this case function need not be present in compiled code.
      enumeration FrTrcvRbBswmdBooleanSize [0..1]: {FRTRCV_BSWMDVALUESIZE_8BIT, FRTRCV_BSWMDVALUESIZE_16BIT, FRTRCV_BSWMDVALUESIZE_32BIT}, origin=RB, set at pre-compile, default-value=FRTRCV_BSWMDVALUESIZE_8BIT  # At BSWMD generation the bit-size of boolean type has to be forwarded to rba_Arxml_Gen and can be configured here.
      enumeration FrTrcvRbBswmdEnumSize [0..1]: {FRTRCV_BSWMDVALUESIZE_8BIT, FRTRCV_BSWMDVALUESIZE_16BIT, FRTRCV_BSWMDVALUESIZE_32BIT}, origin=RB, set at pre-compile, default-value=FRTRCV_BSWMDVALUESIZE_8BIT  # At BSWMD generation the bit-size of boolean type has to be forwarded to rba_Arxml_Gen and can be configured here.
      enumeration FrTrcvRbBswmdSpiSize [0..1]: {FRTRCV_BSWMDVALUESIZE_8BIT, FRTRCV_BSWMDVALUESIZE_16BIT, FRTRCV_BSWMDVALUESIZE_32BIT}, origin=RB, set at pre-compile, default-value=FRTRCV_BSWMDVALUESIZE_16BIT  # At BSWMD generation the bit-size of boolean type has to be forwarded to rba_Arxml_Gen and can be configured here.
      boolean FrTrcvRbCheckWakeupByTrcvReturnVal [0..1]: origin=RB:v5.0.0:2018-5-22, set at pre-compile, default-value=false  # Configures the function declaration of FrTrcv_CheckWakeupByTransceiver False: The function FrTrcv_CheckWakeupByTransceiver behaves as described in Autosar and has the function declaration "void". True: The function frTrcv_CheckWakeupByTransceiver has function declaration <Std_ReturnType> and returns <true>, if wakeup was detected and <false>, if no wakeup was detected. No other functionality is changed.
      enumeration FrTrcvRbWakeupReasonBusAndPin [0..1]: {FRTRCV_WU_BY_BUS, FRTRCV_WU_BY_PIN}, origin=RB, set at pre-compile  # This parameter is only used if FrTrcvEnableMultipleWakeupreason is set to false (if no RB stack is used) If this parameter is used, if wakeupreason by Bus (remote) and by Pin (local) occure at the same time, then the configured wakeupreason is given back in function FrTrcv_GetBusWuReason This parameter is global for all configured FrTrcv. If this parameter is set for one transceiver it is used for all FrTrcv.
      enumeration FrTrcvRbWakeupReasonBusAndPinAndPower [0..1]: {FRTRCV_WU_BY_BUS, FRTRCV_WU_BY_PIN, FRTRCV_WU_POWER_ON}, origin=RB, set at pre-compile  # This parameter is only used if FrTrcvEnableMultipleWakeupreason is set to false (if no RB stack is used). If this parameter is used, if wakeupreason by Bus (remote) and by Pin (local) and by Power On occure at the same time, then the configured wakeupreason is given back in function FrTrcv_GetBusWuReason This parameter is global for all configured FrTrcv. If this parameter is set for one transceiver it is used for all FrTrcv.
      enumeration FrTrcvRbWakeupReasonBusAndPower [0..1]: {FRTRCV_WU_BY_BUS, FRTRCV_WU_POWER_ON}, origin=RB, set at pre-compile  # This parameter is only used if FrTrcvEnableMultipleWakeupreason is set to false (if no RB stack is used). If this parameter is used, if wakeupreason by Bus (remote) and by Power On occure at the same time, then the configured wakeupreason is given back in function FrTrcv_GetBusWuReason This parameter is global for all configured FrTrcv. If this parameter is set for one transceiver it is used for all FrTrcv.
      enumeration FrTrcvRbWakeupReasonPinAndPower [0..1]: {FRTRCV_WU_BY_PIN, FRTRCV_WU_POWER_ON}, origin=RB, set at pre-compile  # This parameter is only used if FrTrcvEnableMultipleWakeupreason is set to false (if no RB stack is used) If this parameter is used, if wakeupreason by Pin (local) and by Power On occure at the same time, then the configured wakeupreason is given back in function FrTrcv_GetBusWuReason This parameter is global for all configured FrTrcv. If this parameter is set for one transceiver it is used for all FrTrcv.
      integer FrTrcvRetryCountInInit: 0..255, set at pre-compile  # Specifies the number of retry count when error occurs while initialization process of FrTrcv.
      boolean FrTrcvSPISyncTrnsmitUsed [0..1]: origin=RB:v1.0.0:2016-9-30, set at pre-compile, default-value=false  # Switches indicates whether SPi Sync Transsmit can be used to Transmit SPI data synchronously.This tag is applicable for TJA1085 transceiver.If SPi does not support sync Trnasmit APi or project does not want to use sync API then set this tag as FALSE
      enumeration FrTrcvTimerType [0..1]: {None, Timer_1us16bit}, multiplicity set at pre-compile, set at pre-compile  # Type of the Time Service Predefined Timer.
      boolean FrTrcvUseAsr3Api: origin=RB, set at pre-compile, default-value=false  # If enabled, the API: FrTrcv_EnableTransceiverWakeup, FrTrcv_DisableTransceiverWakeup, FrTrcv_Cbk_WakeupByTransceiver is available but the API FrTrcv_CheckWakeupByTransceiver is not available.
      boolean FrTrcvVersionInfoApi: set at pre-compile, default-value=false  # Switches version information API on and off. If switched off, function need not be present in compiled code.
      float FrTrcvWaitTime [0..1]: 0..2.55E-4, multiplicity set at pre-compile, set at pre-compile  # Wait time for transceiver state changes in seconds.
      enumeration FrTrcvWakeUpSupport: {FRTRCV_WAKEUP_BY_POLLING, FRTRCV_WAKEUP_NOT_SUPPORTED}, set at pre-compile  # Informs whether wake up is supported by polling or whether it is not supported. | In case no wake up is supported by FlexRay transceiver hardware setting has to be always NO. Only in case wake up is supported by polling main function FlexRayTrcv_main has to be present in source code. In case of support for wake up either by polling wake up ability may be switched on or off for each channel of one FlexRay transceiver channel independently by FrTrcvWakeupByBusUsed.
      reference FrTrcvEcucPartitionRef [0..*]: scope=ECU, multiplicity set at pre-compile, set at pre-compile, destination=EcucPartition  # Maps the Flexray transceiver driver to zero or multiple ECUC partitions to make the modules API available in this partition. The Flexray transceiver driver will operate as an independent instance in each of the partitions.
