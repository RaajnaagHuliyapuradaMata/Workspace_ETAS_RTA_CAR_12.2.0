AUTOSAR XML (schema 00050)
package /AUTOSAR_IdsM/EcucModuleDefs
  module definition IdsM [0..1]: category=VENDOR_SPECIFIC_MODULE_DEFINITION, refined-module-def=IdsM, variants pre-compile  # Configuration of the IdsM (Intrusion detection system manager) module.
    container IdsMConfiguration  # Configuration parameters of the module IdsM.
      container IdsMBlockState [0..16]: multiplicity set at pre-compile  # Configuration of an IdsM blocking state used in the IdsMStateBlockFilter to suspend the collection of security events. The active state is reported by the BswM via IdsM_BswM_StateChanged().
        integer IdsMBlockStateID: 0..15, scope=ECU, set at pre-compile, symbolic-name-value=true  # This value specifies the identifier of this block state.
      container IdsMBufferConfiguration  # Configuration of the event buffers and context data buffers used by IdsM.
        container IdsMContextDataBuffer [0..65535]: multiplicity set at pre-compile  # Buffer that is reserved to store the context data of SEvs. Depending on the type of SEv that is processed, there can be significant differences in sizes of the context data. TRACE[SWS_IdsM_00704]
          integer IdsMContextDataBufferSize: 1..1500, set at pre-compile  # Size of the context data buffer in bytes. It is recommended to configure buffers with an appropriate size depending on the configured SEvs.
          integer IdsMNumberOfContextDataBuffers: 1..65535, set at pre-compile  # The number of buffers with the configured buffer size specified in IdsMContextDataBufferSize. It is recommended to configure an appropriate number of buffers depending on the configured SEvs.
        container IdsMEventBuffers  # Buffers used to store the SEvs. TRACE[SWS_IdsM_00701]
          integer IdsMNumberOfEventBuffers: 1..65535, set at pre-compile  # The number of event buffers used to store the SEvs. The suggested number of buffers can be calculated as follows: IdsMNumberOfBuffers = Number of Aggregation Filter Instances + Upper bound of parallel processed SEvs. Number of Aggregation Filter Instances = The number of configured SEvs that use a filter chain that contains an aggregation filter. Upper bound of parallel processed SEvs = 10% of the number of configured SEvs.
        container IdsMRbQSEvBuffers [0..1]: multiplicity set at pre-compile  # Buffers used to store the QSEvs.
          integer IdsMRbNumberOfQSEvBuffers: 1..65535, origin=RB:4.0.0:2023-01-20, set at pre-compile, default-value=1  # The number of buffers to store the QSEv datagram. After a SEv is qualified to be a QSEv, it is required to be transmitted or locally persisted. In some cases where transmission confirmation is expected before subsequent transmission or reduced frequency of NvM storage, a QSEv buffering would help.
      container IdsMContextDataModification [0..1]: multiplicity set at pre-compile  # Configuration of context data modifier callouts.
        string IdsMGlobalContextDataHeaderFileIncludes [0..*]: multiplicity set at pre-compile, set at pre-compile, min-length=0  # List of optional header files which contains the prototypes of the context data modifier callouts.
        function name IdsMGlobalContextDataModifierCalloutFct [0..1]: multiplicity set at pre-compile, set at pre-compile  # Global context data modifier callout function. This callout can be overruled by event-specific context data modifier callouts.
        integer IdsMGlobalContextDataSizeModifier [0..1]: 0..1500, multiplicity set at pre-compile, set at pre-compile, default-value=0  # Global context data size modifier used in combination with global context data size modifier callout function.
        container IdsMContextDataModifierCallout [0..65535]: multiplicity set at pre-compile  # Configuration of event specific context data modifier callouts.
          function name IdsMContextDataModifierCalloutFct: set at pre-compile  # Event specific context data modifier callout function. If the global context data modifier callout is configured, it can be overruled by this event-specific callout.
          integer IdsMContextDataSizeModifier: 0..1500, set at pre-compile, default-value=0  # Event specific context data size modifier used in combination with event specific context data size modifier callout function.
      container IdsMEvent [1..65535]: multiplicity set at pre-compile  # Configuration of the IdsM Event unit which is reported by a sensor and its parameters
        integer IdsMExternalEventId: 0..65534, set at pre-compile  # The external security event ID which is reported to the sink. There are two different value ranges depending on the referencing module: Standarized SEv ID is defined by the AUTOSAR specification. This ID is usually derived from the SecXT. Standard ID range: 0x0000 - 0x8000 Generic User Event ID is defined by the user. Used when a SW-C / Application references the SEv. Generic ID range: 0x8000 - 0xFFFE. 0xFFFF is considered an invalid ID. SWS_IdsM_00608 must be respected. TRACE[SWS_IdsM_00604].
        integer IdsMInternalEventId: 0..65535, scope=ECU, set at pre-compile, default-value=65535  # Consecutive number used internally as an identifier by the IdsM module. This number is calculated internally and shall not be configured manually. This parameter is only available to publish the result of this calculation. Applications using IdsM APIs shall not rely on the value of this parameter. Instead, they shall use the symbolic name value.
        enumeration IdsMReportingModeFilter: {BRIEF, BRIEF_BYPASSING_FILTERS, DETAILED, DETAILED_BYPASSING_FILTERS, OFF}, set at pre-compile  # The reporting mode filter defines the level of detail of the reporting. Whether SEv should be dropped, forwarded with context data or forwarded without context data. The parameter determines if the SEv is either: - dropped (OFF) - sent without context data (BRIEF) - sent with context data (DETAILED) - sent without context data, ignoring the rest of the filter chain (BRIEF_BYPASSING_FILTERS) - sent with context data ignoring the rest of the filter chain (DETAILED_BYPASSING_FILTERS) TRACE[SWS_IdsM_01010]
        integer IdsMSensorInstanceId: 0..65535, set at pre-compile, default-value=0  # The instance ID of the sensor which reports security events to the IdsM. If there is only one instance of a sensor, the default ID is 0. TRACE[SWS_IdsM_00605]. SWS_IdsM_00608 must be respected.
        boolean IdsMSinkDem [0..0]: set at pre-compile, default-value=false  # The QSEv will be sent to the Dem Module into a Security Event Memory (Sem) to persist it on the local ECU.
        boolean IdsMSinkIdsR: set at pre-compile, default-value=false  # The QSEv will be sent to the IDS Reporter
        reference IdsMFilterChainRef [0..1]: multiplicity set at pre-compile, set at pre-compile, destination=IdsMFilterChain  # Reference to a configured IdsM filter chain.
        container IdsMContextDataModifierOptions [0..1]: multiplicity set at pre-compile  # Adittional configuration parameters of a SEv to be able to modify incoming context data.
          reference IdsMContextDataModifierCalloutRef: set at pre-compile, destination=IdsMContextDataModifierCallout  # Reference to event specific context data modifier callout function.
        container IdsMServiceInterfaceOptions [0..1]: multiplicity set at pre-compile  # Additional configuration parameters of a SEv. Addition to AR - This container, if configured, is used for application and basic software SEvs. AUTOSAR defines it only for application SEvs. This satisfies AUTOSAR and in addition to it the parameters in IdsMServiceInterfaceOptions are used for basis software SEv as well in the following way. (1) Configured IdsMEventMaxContextDataSize is used to validate the context data size provided while reporting an SEv over the APIs that support context data (IdsM_SetSecurityEventWith**ContextData). (2) If IdsMAdditionalParameterOption is configured to CountTimestamp and the SEv was reported without a timestamp, IdsM will obtain the timestamp from StbM and add it to the SEv regardless if the SEv is a ASW or a BSW SEv. If IdsMAdditionalParameterOption is not configured to CountTimestamp and the SEv was reported with a timestamp, IdsM will drop the provided timestamp and buffer the event without a timestamp. The AUTOSAR requirement is statisfied because the parameters of this container are used to generate the service interfaces for the SEv when configured IdsMExternalId is in range 0x8000 - 0xFFFE as specified in AR IdsM SWS Ch 8.7.
          enumeration IdsMAdditionalParameterOption: {Count, CountTimestamp, None}, set at pre-compile  # In addition to the optional context data the Service Port Interface can be extended by the following parameters: - None: No extensions - Count: Additionally a count can be passed. This value is used as an initialization counter for the corresponding SEv. - Count and Timestamp: Additionally to the count a timestamp can be passed. Note: The timestamp option depends on whether IdsMTimeStampOption is configured to enable timestamps.
          integer IdsMEventMaxContextDataSize: 0..1500, set at pre-compile, default-value=0  # Maximum number of bytes of context data to be accepted by IdsM for this particular event. Additional hint for configuration - TRACE[SWS_IdsM_00501] The functions IdsM_SetSecurityEventWithContext- Data, IdsM_SetSecurityEventWithCountContextData and IdsM_SetSecurityEventWithTimestampCountContextData shall support a maximum length of 1500 bytes for the context data. To avoid overloading of the network, a maximum of 1500 bytes for the context data is recommended, especially when transmitting on CAN Bus. There might be cases in which this limit is insufficient to transmit all the sensor’s information, in that case it shall be evaluated that there are enough resources to avoid flooding of the communication channels.
      container IdsMFilterChain [0..*]: multiplicity set at pre-compile  # A filter chain is a combination of filters that affects one or more SEvs. A filter receives a SEv, checks condition(s) and, e.g. - forwards SEv immediately/later - drops SEv - stores SEv - modifies SEv Consider that the filter order is defined as follows: - Reporting Mode Level (per SEv ID) - Block State (per SEv ID) - Forward Every nth (per SEv ID) - Event Aggregation (per SEv ID) - Event Threshold (per SEv ID) - Event Rate Limitation (per IdsM Instance) - Traffic Limitation (per IdsM Instance)
        container IdsMBlockStateFilter [0..1]: multiplicity set at pre-compile  # This state filter drops SEvs if the current State reported by the BswM is in this state filter list.
          reference IdsMBlockStateReference [1..16]: multiplicity set at pre-compile, set at pre-compile, requires-symbolic-name-value=true, destination=IdsMBlockState  # The collection of SEvs during this state will be suspended
        container IdsMEventAggregationFilter [0..1]: multiplicity set at pre-compile  # All received events of a certain event ID that are received by this filter during a single aggregation time interval are not forwarded immediately. Instead, only the last or the first received SEv is stored in an aggregation buffer, depending on the configuration of "IdsMContextDataSourceSelector". The counter field of the SEv is modified so that it contains the sum of the counter fields of all incoming SEvs during the current aggregation time interval. At the end of the aggregation time interval, the buffered SEv is sent out and the aggregation buffer is cleared. If there was no incoming SEv until the end of the aggregation time interval, no message will be sent.
          enumeration IdsMContextDataSourceSelector: {IDSM_FILTERS_CTX_USE_FIRST, IDSM_FILTERS_CTX_USE_LAST}, set at pre-compile  # The resulting SEv from the aggregation filter contains the context data from one of the following two sources: IDSM_FILTERS_CTX_USE_FIRST = ContextData of first received SEv is used for resulting QSEv. IDSM_FILTERS_CTX_USE_LAST = ContextData of last received SEv is used for resulting QSEv.
          float IdsMEventAggregationTimeInterval: 0..INF, set at pre-compile  # Length of the aggregation time interval (as float in seconds). Note: Shall be configured as a multiple of the IdsM main function period.
        container IdsMEventThresholdFilter [0..1]: multiplicity set at pre-compile  # During each time interval "IdsMEventThresholdTimeInterval", the filter drops the first "IdsMEventThresholdNumber - 1" SEvs and forwards all other incoming SEvs immediately until the end of the time interval.
          integer IdsMEventThresholdNumber: 2..65535, set at pre-compile  # This parameter assigns the threshold ’p’ for each SEv ID affected by this threshold filter. All SEvs ’ p-1’ are dropped, SEvs equal or greater than ’p’ are forwarded.
          float IdsMEventThresholdTimeInterval: 0..INF, set at pre-compile  # Length of the threshold time interval (as float in seconds). Note: Shall be configured as a multiple of the IdsM main function period.
        container IdsMForwardEveryNthFilter [0..1]: multiplicity set at pre-compile  # Out of all incoming SEVs, drop all but every nth. Those will be forwarded without modification.
          integer IdsMNthParameter: 2..65535, set at pre-compile  # For each SEv ID for which this filter is configured, this parameter assigns the appropriate n. Only 1 from n SEvs will be forwarded.
        container IdsMRbCustomFilter [0..100]  # Custom filter to be used over a callout
          reference IdsMRbCustomFilterReference: multiplicity set at pre-compile, set at pre-compile, requires-symbolic-name-value=true, destination=IdsMConfiguration/IdsMRbCustomFilter  # Reference to IdsMRbCustomFilter to hook a custom filter to a filter chain
      container IdsMPdus [0..1]: multiplicity set at pre-compile  # Configuration of the PDU references used to send the events data.
        container IdsMIfTxPdu [0..1]: multiplicity set at pre-compile  # IF PDU used to transmit a QSEv via the PduR to the IdsR. If the total size of the QSEv’s data to be transmitted fits in a single frame of the underlying bus, the IF PDU is used.
          integer IdsMIfTxPduHandleId: 0..0, scope=ECU, set at pre-compile, symbolic-name-value=true, default-value=0  # IdsM does not use this parameter, content will be ignored. The existence of this parameter is needed by PduR.
          reference IdsMIfTxPduRef: scope=ECU, set at pre-compile, destination=Pdu  # Reference to the IF PDU used for transmission of the QSEvs. IdsM is not post build capable. Though the container referred to has post-build capable configurations (Pdu/PduLength), IdsM does not support. The burden lays on the configurator / integrator to maintain the consistency in the configuration.
        container IdsMTpTxPdu [0..1]: multiplicity set at pre-compile  # TP PDU used to transmit a QSEv via the PduR to the IdsR. If the total size of the QSEv’s data to be transmitted is bigger than the size of a single frame of the underlying bus, the TP PDU is used. IdsM is not post build capable. Though the container referred to has post-build capable configurations (Pdu/PduLength), IdsM does not support.The burden lays on the configurator / integrator to maintain the consistency in the configuration.
          integer IdsMTpTxPduHandleId: 0..0, scope=ECU, set at pre-compile, symbolic-name-value=true, default-value=0  # IdsM does not use this parameter, content will be ignored. The existence of this parameter is needed by PduR.
          reference IdsMTpTxPduRef: scope=ECU, set at pre-compile, destination=Pdu  # Reference to the TP PDU used for transmission of the QSEvs.
      container IdsMRbCustomFilter [0..100]: multiplicity set at pre-compile  # Custom filter to be used over a callout.
        string IdsMRbCustomFilterFunction: origin=RB:4.0.0:2023-01-20, set at pre-compile  # IdsM generates a callout to {IdsMRbCustomFilterFunction} at the position indicated by IdsMRbCustomFilterSequenceNumber. The definition of the function lays in the responsibility of the project configuring it. Rules for the function - (1) Return value shall be a boolean. TRUE if processed event is filtered out. FALSE if process event is to be passed to the next filter or to be qualified The filter shall respect SWS_IdsM_00904, SWS_IdsM_00905. (2) First argument of the function prototype is IdsM_Event_Config_tst. This shall NOT be modified by the user. It is only for reading purposes. (3) Second arguement of the function prototype is IdsM_EventBuffer_tst. Modification of elements of this structure is allowed as a part of the implemented filtering algorithm. However failures arrising in IdsM due to modification of this structure shall be in the resposiibilty of the user. Consultation with RTA-BSW IdsM responsible is advised. (4) Calling of IdsM_Prv_ClearLinkedContextDataBuffer to clear associated context data during dropping is in the responsibility of the function, e.g., IdsM_Prv_ApplyBlockStateFilter.
    container IdsMGeneral  # General configuration parameters of IdsM.
      boolean IdsMDevErrorDetect: set at pre-compile  # This parameter enables/disables the Development Error Detection and Notification. true: Development error detection is enabled. false: Development error detection is disabled.
      boolean IdsMDiagnosticSupport: set at pre-compile, default-value=false  # Enables or disables the Dcm APIs which are used to read and write certain values of the IdsM module through the diagnostic communication manager.TRACE[SWS_IdsM_01800]
      integer IdsMInstanceId: 0..1023, set at pre-compile  # The unique identifier of the sending IdsM instance. This ID helps identifying the origin of a SEv, together with the SEv configuration parameters: ExternalEventId and the IdsMSensorInstanceId..
      float IdsMMainFunctionPeriod: 0..INF, scope=ECU, set at pre-compile, default-value=0.01  # The period between successive calls to the IdsM main function (as float in seconds)..
      boolean IdsMSignatureSupport: set at pre-compile, default-value=false  # This parameter enables/disables the functionality of sending messages to the network with a signature of encryption calculated by the crypto services.
      boolean IdsMVersionInfoApi: set at pre-compile  # This parameter enables/disables the function IdsM_GetVersionInfo() to get major, minor and patch version information of the module.
      boolean IdsMRbSinkIdsRFixedIfPduLength [0..1]: origin=RB:4.0.0:2023-04-20, set at pre-compile, default-value=false  # This parameter enables/disables padding of zeros to the QSEv datagram to match the PduLength of the configured underlying If Pdu referred by IdsMIfTxPduRef. The QSEv datagram is computed by IdsM based on 5.1.1 IDS Protocol Overview from Specification of Intrusion Detection System Protocol. true: Zeros are padded to the end of the QSEv datagram to match the configured PduLength and transmission to PduR is triggered with size of data equivalent to configured PduLength. false: Transmission of QSEv datagram is requested based on IdsM computed QSEv datagram size.
      reference IdsMNvmBlockDescriptor [0..1]: scope=ECU, multiplicity set at pre-compile, set at pre-compile, requires-symbolic-name-value=true, destination=NvMBlockDescriptor  # Choose a NvM block descriptor reference, that is used to load and store the non-volatile data of IdsM module. The supported NvM block names are: RAM: IdsM_NvMRamBlockData ROM: IdsM_NvMRomBlockData.
      container IdsMGlobalRateLimitationFilters [0..1]: multiplicity set at pre-compile  # Global rate limitation filters for all SEvs.
        container IdsMFilterEventRateLimitation [0..1]: multiplicity set at pre-compile  # For configurable time intervals of length "IdsMRateLimitationTimeInterval" this filter forwards all the SEvs until reaching the limit "IdsMRateLimitationMaximumEvents". The limit is measured in number of incoming SEvs. Until the end of the time interval, all subsequent SEvs are dropped. This is helpful to cap the load that the IdsM generates unto information sinks like the IdsR. This filter is not specific to a single SEv but it applies to all SEvs handled by the current IdsM instance.
          integer IdsMRateLimitationMaximumEvents: 1..65535, set at pre-compile  # The maximum number of SEvs which are passed on by this filter in a single rate limitation time interval. TRACE[SWS_IdsM_01080]
          float IdsMRateLimitationTimeInterval: 0..INF, set at pre-compile  # Time interval length of the event rate limitation filter (as float in seconds). Note: Shall be configured as a multiple of the IdsM main function period. TRACE[SWS_IdsM_01080]
        container IdsMFilterTrafficLimitation [0..1]: multiplicity set at pre-compile  # The traffic limitation filter forwards all the incoming SEvs until reaching the limit "IdsMTrafficLimitationMaximumBytes". The limit is measured in incoming amount of bytes. This filter forwards SEvs only, if the accumulated sizes of all incoming SEvs in the current traffic limitation time interval up until the current SEv is smaller or equal than a configurable maximum number of bytes "IdsMTrafficLimitationMaximumBytes". The length of the traffic limitation time interval is configurable in "IdsMTrafficLimitationTimeInterval". This filter is not specific to a single SEv but it applies to all SEvs handled by the current IdsM instance.
          integer IdsMTrafficLimitationMaximumBytes: 1..65535, set at pre-compile  # The maximum number of bytes to be sent out by the IdsM in a single traffic limitation time interval. TRACE[SWS_IdsM_01090]
          float IdsMTrafficLimitationTimeInterval: 0..INF, set at pre-compile  # Length of the traffic limitation time interval (as float in seconds). Note: Shall be configured as a multiple of the IdsM main function period. TRACE[SWS_IdsM_01090]
      container IdsMRbFilterChainSequence: multiplicity set at pre-compile  # Sequence of the filters in the filter chain. No configuration needed if no custom filters are used and AUTOSAR filter order is required.
        integer IdsMRbBlockStateFilterSequenceNumber [0..1]: 1..104, origin=RB:4.0.0:2023-01-20, set at pre-compile, default-value=1  # Sequence number of the block state filter in the filter chain. The sequence number is allowed to be discontinuous. Default sequence number = 1, i.e., block state filter is the first filter applied in the filter chain.
        integer IdsMRbEventAggregationFilterSequenceNumber [0..1]: 1..104, origin=RB:4.0.0:2023-01-20, set at pre-compile, default-value=3  # Sequence number of the event aggregation filter in the filter chain. The sequence number is allowed to be discontinuous. Default sequence number = 3, i.e., event aggregation filter is the third filter applied in the filter chain.
        integer IdsMRbEventThresholdFilterSequenceNumber [0..1]: 1..104, origin=RB:4.0.0:2023-01-20, set at pre-compile, default-value=4  # Sequence number of the event threshold filter in the filter chain. The sequence number is allowed to be discontinuous. Default sequence number = 4, i.e., event threshold filter is the first filter applied in the filter chain.
        integer IdsMRbForwardEveryNthFilterSequenceNumber [0..1]: 1..104, origin=RB:4.0.0:2023-01-20, set at pre-compile, default-value=2  # Sequence number of the sampling filter (forward every Nth filter) in the filter chain. The sequence number is allowed to be discontinuous. Default sequence number = 2, i.e., forward every Nth filter is the first filter applied in the filter chain.
        container IdsMRbCustomFilterSequenceNumber [0..100]: multiplicity set at pre-compile  # Custom filter to be used over a callout
          integer IdsMRbCustomFilterSequenceNumber [0..1]: 1..104, origin=RB:4.0.0:2023-01-20, set at pre-compile  # Sequence number of the custom filter in the filter chain. The sequence number is allowed to be discontinuous. No default sequence number, i.e., the sequence number of custom filter have to always be explicitly configured.
          reference IdsMRbCustomFilterRef [0..1]: multiplicity set at pre-compile, origin=RB:4.0.0:2023-01-20, set at pre-compile, requires-symbolic-name-value=true, destination=IdsMConfiguration/IdsMRbCustomFilter  # This parameter serves as an association between sequence numbers and custom filters by having a reference to IdsMRbCustomFilter.
      container IdsMSignature [0..1]: multiplicity set at pre-compile  # Disabled. If this container exists all qualified security events are signed by the crypto service.
        integer IdsMSignatureLength: 1..4294967295, multiplicity set at pre-compile, set at pre-compile  # This parameter defines the length of the signature in bytes calculated by the crypto service.
        reference IdsMCsmJobReference: multiplicity set at pre-compile, set at pre-compile, destination=CsmJob  # This parameter references the Csm job that is used to generate signatures when qualified security events must be signed.
      container IdsMTimestamp [0..1]: multiplicity set at pre-compile  # If this container exists a timestamp field is added to all qualified security events.
        enumeration IdsMTimestampOption: {AUTOSAR, Custom}, set at pre-compile  # This parameter speciies if the origin of the timestamp is from the AUTOSAR stack or from the application (custom timestamp). TRACE[SWS_IdsM_01100]
        reference IdsMStbmTimeBaseReference [0..1]: multiplicity set at pre-compile, set at pre-compile, requires-symbolic-name-value=true, destination=StbMSynchronizedTimeBase  # This parameter references the time source when the origin of the timestamp is AUTOSAR.
