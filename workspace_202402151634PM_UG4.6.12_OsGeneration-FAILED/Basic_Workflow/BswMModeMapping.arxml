AUTOSAR XML (schema 00051)
package /ModeDeclarationGroups
  mode declaration group MDG_ECUM_STATE: initial-mode=ECUM_STATE_STARTUP_ONE
    6 x mode:
      ECUM_STATE_APP_POST_RUN
      ECUM_STATE_APP_RUN
      ECUM_STATE_PREP_SHUTDOWN
      ECUM_STATE_RUN
      ECUM_STATE_STARTUP_ONE
      ECUM_STATE_STARTUP_TWO
package /DataTypeMappingSets
  data type mapping set ECUM_STATE_Mapping: mode-request-type-map{implementation-data-type=uint8, mode-group=MDG_ECUM_STATE}
