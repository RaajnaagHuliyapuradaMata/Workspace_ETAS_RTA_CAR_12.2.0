AUTOSAR XML (schema 4-2-2)
package /AUTOSAR_CanIf/BswModuleDescriptions
  bsw module description CanIf: category=BSW_MODULE, module-id=60  # CAN Interface
    provided-entrys:
      CanIf_GetVersionInfo
      CanIf_Init
      CanIf_SetControllerMode
      CanIf_Transmit
      CanIf_ReadTxNotifStatus
      CanIf_ReadRxNotifStatus
      CanIf_SetPduMode
      CanIf_GetPduMode
      CanIf_SetDynamicTxId
      CanIf_SetTrcvMode
      CanIf_GetTrcvMode
      CanIf_GetTrcvWakeupReason
      CanIf_SetTrcvWakeupMode
      CanIf_CheckWakeup
      CanIf_CheckValidation
      CanIf_GetTxConfirmationState
      CanIf_ClearTrcvWufFlag
      CanIf_CheckTrcvWakeFlag
      CanIf_SetBaudrate
      CanIf_GetControllerMode
      CanIf_CancelTransmit
      CanIf_ReadRxPduData
      CanIf_ReturnTxPduId
      CanIf_XCore_PipeMainfunction_Core{0..5}
      CanIf_GetCurrentTime
      CanIf_EnableEgressTimeStamp
      CanIf_GetEgressTimeStamp
      CanIf_GetIngressTimeStamp
    outgoing-callbacks:
      CanIf_TxConfirmation
      CanIf_RxIndication
      CanIf_ControllerBusOff
      CanIf_ConfirmPnAvailability
      CanIf_ClearTrcvWufFlagIndication
      CanIf_CheckTrcvWakeFlagIndication
      CanIf_ControllerModeIndication
      CanIf_TrcvModeIndication
      CanIf_ControllerErrorPassive
      CanIf_TriggerTransmit
package /AUTOSAR_CanIf/BswModuleEntrys
  43 x bsw module entry, all with sw-service-impl-policy=STANDARD:
    CanIf_GetVersionInfo: service-id=0x0b, is-reentrant=true, is-synchronous=true, call-type=REGULAR, execution-context=UNSPECIFIED  # This service returns the version information of the called CAN Interface module.
      sw service arg VersionInfo: category=DATA_REFERENCE, direction=OUT, sw-pointer-target-props={target-category=STRUCTURE, implementation-data-type=Std_VersionInfoType}  # Pointer to where to store the version information of this module.
    CanIf_Init: service-id=0x01, is-reentrant=false, is-synchronous=true, call-type=REGULAR, execution-context=UNSPECIFIED  # CanIf service to initialize the module | This service Initializes internal and external interfaces of the CAN Interface
      sw service arg configPtr: category=DATA_REFERENCE, direction=IN, sw-pointer-target-props={target-category=STRUCTURE, implementation-data-type=CanIf_ConfigType, sw-impl-policy=CONST}  # Pointer to configuration parameter set, used e.g. for post build parameters
    CanIf_SetControllerMode: service-id=0x03, is-reentrant=true, is-synchronous=true, call-type=REGULAR, execution-context=UNSPECIFIED  # This service calls the corresponding CAN Driver service for changing of the CAN controller mode.
      return type Returnvalue: implementation-data-type=Std_ReturnType  # E_OK: Controller mode request has been accepted E_NOT_OK: Controller mode request has not been accepted
      sw service arg ControllerId: direction=IN, implementation-data-type=uint8  # Abstracted CanIf ControllerId which is assigned to a CAN controller, which is requested for mode transition.
      sw service arg ControllerMode: category=DATA_REFERENCE, direction=IN, implementation-data-type=Can_ControllerStateType  # Requested mode transition
    CanIf_Transmit: service-id=0x05, is-reentrant=true, is-synchronous=true, call-type=REGULAR, execution-context=UNSPECIFIED  # This service initiates a request for transmission of the CAN L-PDU specified by the CanTxSduId and CAN related data in the L-SDU structure.
      return type Returnvalue: implementation-data-type=Std_ReturnType  # E_OK: Transmit request has been accepted E_NOT_OK: Transmit request has not been accepted
      sw service arg CanIfTxSduId: direction=IN, implementation-data-type=PduIdType  # L-SDU handle to be transmitted. This handle specifies the corresponding CAN LSDU ID and implicitly the CAN Driver instance as well as the corresponding CAN controller device.
      sw service arg CanIfTxInfoPtr: category=DATA_REFERENCE, direction=IN, sw-pointer-target-props={target-category=STRUCTURE, implementation-data-type=PduInfoType, sw-impl-policy=CONST}  # Pointer to a structure with CAN L-SDU related data: DLC and pointer to CAN L-SDU buffer including the MetaData of dynamic L-PDUs.
    CanIf_CancelTransmit: service-id=0x18, is-reentrant=false, is-synchronous=true, call-type=REGULAR, execution-context=UNSPECIFIED  # This is a dummy method introduced for interface compatibility.
      return type Returnvalue: implementation-data-type=Std_ReturnType  # Always return E_OK
      sw service arg CanIfTxSduId: direction=IN, implementation-data-type=PduIdType  # L-SDU handle to be transmitted. This handle specifies the corresponding CAN LSDU ID and implicitly the CAN Driver instance as well as the corresponding CAN controller device.
    CanIf_GetControllerMode: service-id=0x04, is-reentrant=false, is-synchronous=true, call-type=REGULAR, execution-context=UNSPECIFIED  # This service reports about the current status of the requested CAN controller.
      return type ReturnValue: implementation-data-type=Std_ReturnType  # E_OK: Controller mode request has been accepted. E_NOT_OK: Controller mode request has not been accepted.
      sw service arg ControllerId: direction=IN, implementation-data-type=uint8  # Abstracted CanIf ControllerId which is assigned to a CAN controller, which is requested for current operation mode.
      sw service arg ControllerModePtr: category=DATA_REFERENCE, direction=OUT, sw-pointer-target-props={target-category=VALUE, implementation-data-type=Can_ControllerStateType}  # Pointer to a memory location, where the current mode of the CAN controller will be stored.
    CanIf_GetCurrentTime: service-id=0x51, is-reentrant=false, is-synchronous=true, call-type=REGULAR, execution-context=UNSPECIFIED  # This service calls the corresponding CAN Driver service to retrieve the current time value out of the HW registers.
      return type ReturnValue: implementation-data-type=Std_ReturnType  # E_OK: successful E_NOT_OK: failed
      sw service arg Controller: direction=IN, implementation-data-type=uint8  # Index of the addresses CAN controller
      sw service arg timeStampPtr: category=DATA_REFERENCE, direction=OUT, sw-pointer-target-props={target-category=VALUE, implementation-data-type=Can_TimeStampType}  # current time stamp
    CanIf_EnableEgressTimeStamp: service-id=0x52, is-reentrant=false, is-synchronous=true, call-type=REGULAR, execution-context=UNSPECIFIED  # This service calls the corresponding CAN Driver service to activate egress time stamping on a dedicated message object.
      sw service arg TxPduId: direction=IN, implementation-data-type=PduIdType  # L-PDU handle of CAN L-PDU for which the time stamping shall be enabled.
    CanIf_GetEgressTimeStamp: service-id=0x53, is-reentrant=true, is-synchronous=true, call-type=REGULAR, execution-context=UNSPECIFIED  # This service calls the corresponding CAN Driver service to read back the egress time stamp on a dedicated message object.
      return type ReturnValue: implementation-data-type=Std_ReturnType  # E_OK: successful E_NOT_OK: failed
      sw service arg TxPduId: direction=IN, implementation-data-type=PduIdType  # L-PDU handle of CAN L-PDU for which the time stamp shall be returned.
      sw service arg timeStampPtr: category=DATA_REFERENCE, direction=OUT, sw-pointer-target-props={target-category=VALUE, implementation-data-type=Can_TimeStampType}  # current time stamp
    CanIf_GetIngressTimeStamp: service-id=0x54, is-reentrant=true, is-synchronous=true, call-type=REGULAR, execution-context=UNSPECIFIED  # This service calls the corresponding CAN Driver service to reads back the ingress time stamp on a dedicated message object.
      return type ReturnValue: implementation-data-type=Std_ReturnType  # E_OK: successful E_NOT_OK: failed
      sw service arg RxPduId: direction=IN, implementation-data-type=PduIdType  # ID of the received I-PDU for which the time stamp shall be returned.
      sw service arg timeStampPtr: category=DATA_REFERENCE, direction=OUT, sw-pointer-target-props={target-category=VALUE, implementation-data-type=Can_TimeStampType}  # current time stamp
    CanIf_ReadRxPduData: service-id=0x06, is-reentrant=false, is-synchronous=true, call-type=REGULAR, execution-context=UNSPECIFIED  # This service provides the CAN DLC and the received data of the requested CanIfRxSduId to the calling upper layer.
      return type Returnvalue: implementation-data-type=Std_ReturnType  # E_OK: Request for L-SDU data has been accepted E_NOT_OK: No valid data has been received
      sw service arg CanIfRxSduId: direction=IN, implementation-data-type=PduIdType  # Receive L-SDU handle specifying the corresponding CAN L-SDU ID and implicitly the CAN Driver instance as well as the corresponding CAN controller device.
      sw service arg CanIfRxInfoPtr: category=DATA_REFERENCE, direction=OUT, sw-pointer-target-props={target-category=STRUCTURE, implementation-data-type=PduInfoType}  # Pointer to a structure with CAN L-SDU related data: DLC and pointer to CAN L-SDU buffer including the MetaData of dynamic L-PDUs.
    CanIf_ReadTxNotifStatus: service-id=0x07, is-reentrant=false, is-synchronous=true, call-type=REGULAR, execution-context=UNSPECIFIED  # This service returns the confirmation status (confirmation occurred or not) of a specific static or dynamic CAN Tx L-PDU, requested by the CanIfTxSduId.
      return type Returnvalue: implementation-data-type=CanIf_NotifStatusType  # Current confirmation status of the corresponding CAN Tx L-PDU.
      sw service arg CanIfTxSduId: direction=IN, implementation-data-type=PduIdType  # L-SDU handle to be transmitted. This handle specifies the corresponding CAN LSDU ID and implicitly the CAN Driver instance as well as the corresponding CAN controller device.
    CanIf_ReadRxNotifStatus: service-id=0x08, is-reentrant=false, is-synchronous=true, call-type=REGULAR, execution-context=UNSPECIFIED  # This service returns the indication status (indication occurred or not) of a specific CAN Rx L-PDU, requested by the CanIfRxSduId.
      return type Returnvalue: implementation-data-type=CanIf_NotifStatusType  # Current indication status of the corresponding CAN Rx L-PDU.
      sw service arg CanIfRxSduId: direction=IN, implementation-data-type=PduIdType  # Receive L-SDU handle specifying the corresponding CAN L-SDU ID and implicitly the CAN Driver instance as well as the corresponding CAN controller device.
    CanIf_SetPduMode: service-id=0x09, is-reentrant=false, is-synchronous=true, call-type=REGULAR, execution-context=UNSPECIFIED  # This service sets the requested mode at the L-PDUs of a predefined logical PDU channel.
      return type Returnvalue: implementation-data-type=Std_ReturnType  # E_OK: Request for mode transition has been accepted. E_NOT_OK: Request for mode transition has not been accepted.
      sw service arg ControllerId: direction=IN, implementation-data-type=uint8  # All PDUs of the own ECU connected to the corresponding CanIf ControllerId, which is assigned to a physical CAN controller are addressed.
      sw service arg PduModeRequest: direction=IN, implementation-data-type=CanIf_PduModeType  # Requested PDU mode change
    CanIf_GetPduMode: service-id=0x0a, is-reentrant=true, is-synchronous=true, call-type=REGULAR, execution-context=UNSPECIFIED  # This service reports the current mode of a requested PDU channel.
      return type Returnvalue: implementation-data-type=Std_ReturnType  # E_OK: PDU mode request has been accepted E_NOT_OK: PDU mode request has not been accepted
      sw service arg ControllerId: direction=IN, implementation-data-type=uint8  # All PDUs of the own ECU connected to the corresponding CanIf ControllerId, which is assigned to a physical CAN controller are addressed.
      sw service arg PduModePtr: category=TYPE_REFERENCE, direction=OUT, sw-pointer-target-props={target-category=VALUE, implementation-data-type=CanIf_PduModeType}  # Pointer to a memory location, where the current mode of the logical PDU channel will be stored.
    CanIf_SetDynamicTxId: service-id=0x0c, is-reentrant=false, is-synchronous=true, call-type=REGULAR, execution-context=UNSPECIFIED  # This service reconfigures the corresponding CAN identifier of the requested CAN L-PDU.
      sw service arg CanIfTxSduId: direction=IN, implementation-data-type=PduIdType  # L-SDU handle to be transmitted. This handle specifies the corresponding CAN LSDU ID and implicitly the CAN Driver instance as well as the corresponding CAN controller device.
      sw service arg CanId: direction=IN, implementation-data-type=Can_IdType  # Standard/Extended CAN ID of CAN L-SDU that shall be transmitted as FD or conventional CAN frame.
    CanIf_SetTrcvMode: service-id=0x0d, is-reentrant=false, is-synchronous=false, call-type=REGULAR, execution-context=UNSPECIFIED  # This service changes the operation mode of the tansceiver TransceiverId, via calling the corresponding CAN Transceiver Driver service.
      return type Returnvalue: implementation-data-type=Std_ReturnType  # E_OK: Transceiver mode request has been accepted. E_NOT_OK: Transceiver mode request has not been accepted.
      sw service arg TransceiverId: direction=IN, implementation-data-type=uint8  # Abstracted CanIf TransceiverId, which is assigned to a CAN transceiver, which is requested for mode transition
      sw service arg TransceiverMode: direction=IN, implementation-data-type=uint8  # Requested mode transition
    CanIf_GetTrcvMode: service-id=0x0e, is-reentrant=false, is-synchronous=true, call-type=REGULAR, execution-context=UNSPECIFIED  # This function invokes CanTrcv_GetOpMode and updates the parameter TransceiverModePtr with the value OpMode provided by CanTrcv.
      return type Returnvalue: implementation-data-type=Std_ReturnType  # E_OK: Transceiver mode request has been accepted. E_NOT_OK: Transceiver mode request has not been accepted.
      sw service arg TransceiverModePtr: category=TYPE_REFERENCE, direction=OUT, sw-pointer-target-props={target-category=VALUE, implementation-data-type=uint8}  # Requested mode of requested network the Transceiver is connected to.
      sw service arg TransceiverId: direction=IN, implementation-data-type=uint8  # Abstracted CanIf TransceiverId, which is assigned to a CAN transceiver, which is requested for current operation mode.
    CanIf_GetTrcvWakeupReason: service-id=0x0f, is-reentrant=false, is-synchronous=true, call-type=REGULAR, execution-context=UNSPECIFIED  # This service returns the reason for the wake up of the transceiver TransceiverId, via calling the corresponding CAN Transceiver Driver service.
      return type Returnvalue: implementation-data-type=Std_ReturnType  # E_OK: Transceiver wake up reason request has been accepted. E_NOT_OK: Transceiver wake up reason request has not been accepted.
      sw service arg TransceiverId: direction=IN, implementation-data-type=uint8  # Abstracted CanIf TransceiverId, which is assigned to a CAN transceiver, which is requested for wakeup reason.
      sw service arg TrcvWuReasonPtr: category=TYPE_REFERENCE, direction=OUT, sw-pointer-target-props={target-category=VALUE, implementation-data-type=uint8}  # provided pointer to where the requested transceiver wake up reason shall be returned
    CanIf_SetTrcvWakeupMode: service-id=0x10, is-reentrant=false, is-synchronous=true, call-type=REGULAR, execution-context=UNSPECIFIED  # This function shall call CanTrcv_SetTrcvWakeupMode.
      return type Returnvalue: implementation-data-type=Std_ReturnType  # E_OK: Will be returned, if the wake up notifications state has been changed to the requested mode. E_NOT_OK: Will be returned, if the wake up notifications state change has failed or the parameter is out of the allowed range. The previous state has not been changed.
      sw service arg TransceiverId: direction=IN, implementation-data-type=uint8  # Abstracted CanIf TransceiverId, which is assigned to a CAN transceiver, which is requested for wake up notification mode transition.
      sw service arg TrcvWakeupMode: direction=IN, implementation-data-type=uint8  # Requested transceiver wake up notification mode
    CanIf_CheckWakeup: service-id=0x11, is-reentrant=true, is-synchronous=false, call-type=REGULAR, execution-context=UNSPECIFIED  # This service checks, whether an underlying CAN driver or a CAN transceiver driver already signals a wakeup event.
      return type Returnvalue: implementation-data-type=Std_ReturnType  # E_OK: Will be returned, if the check wake up request has been accepted E_NOT_OK: Will be returned, if the check wake up request has not been accepted
      sw service arg WakeupSource: direction=IN, implementation-data-type=EcuM_WakeupSourceType  # Source device, which initiated the wake up event: CAN controller or CAN transceiver
    CanIf_CheckValidation: service-id=0x12, is-reentrant=true, is-synchronous=true, call-type=REGULAR, execution-context=UNSPECIFIED  # This service is performed to validate a previous wakeup event.
      return type Returnvalue: implementation-data-type=Std_ReturnType  # E_OK: Will be returned, if the check validation request has been accepted. E_NOT_OK: Will be returned, if the check validation request has not been accepted.
      sw service arg WakeupSource: direction=IN, implementation-data-type=EcuM_WakeupSourceType  # Source device which initiated the wake-up event and which has to be validated: CAN controller or CAN transceiver
    CanIf_GetTxConfirmationState: service-id=0x19, is-reentrant=true, is-synchronous=true, call-type=REGULAR, execution-context=UNSPECIFIED  # This service reports, if any TX confirmation has been done for the whole CAN controller since the last CAN controller start.
      return type Returnvalue: implementation-data-type=CanIf_NotifStatusType  # Combined TX confirmation status for all TX PDUs of the CAN controller
      sw service arg ControllerId: direction=IN, implementation-data-type=uint8  # Abstracted CanIf ControllerId which is assigned to a CAN controller
    CanIf_ClearTrcvWufFlag: service-id=0x1e, is-reentrant=true, is-synchronous=false, call-type=REGULAR, execution-context=UNSPECIFIED  # Requests the CanIf module to clear the WUF flag of the designated CAN transceiver.
      return type Returnvalue: implementation-data-type=Std_ReturnType  # E_OK: Request has been accepted E_NOT_OK: Request has not been accepted
      sw service arg TransceiverId: direction=IN, implementation-data-type=uint8  # Abstract CanIf TransceiverId, which is assigned to the designated CAN transceiver.
    CanIf_CheckTrcvWakeFlag: service-id=0x1f, is-reentrant=true, is-synchronous=false, call-type=REGULAR, execution-context=UNSPECIFIED  # Requests the CanIf module to check the Wake flag of the designated CAN transceiver.
      return type Returnvalue: implementation-data-type=Std_ReturnType  # E_OK: Request has been accepted E_NOT_OK: Request has not been accepted
      sw service arg TransceiverId: direction=IN, implementation-data-type=uint8  # Abstract CanIf TransceiverId, which is assigned to the designated CAN transceiver.
    CanIf_SetBaudrate: service-id=0x27, is-reentrant=true, is-synchronous=true, call-type=REGULAR, execution-context=UNSPECIFIED  # This service shall set the baud rate configuration of the CAN controller. Depending on necessary baud rate modifications the controller might have to reset.
      return type Returnvalue: implementation-data-type=Std_ReturnType  # E_OK: Service request accepted, setting of (new) baud rate started E_NOT_OK: Service request not accepted
      sw service arg ControllerId: direction=IN, implementation-data-type=uint8  # Abstract CanIf ControllerId which is assigned to a CAN controller, whose baud rate shall be set.
      sw service arg BaudRateConfigID: direction=IN, implementation-data-type=uint16  # references a baud rate configuration by ID
    CanIf_TxConfirmation: service-id=0x13, is-reentrant=true, is-synchronous=true, call-type=CALLBACK, execution-context=UNSPECIFIED  # This service confirms a previously successfully processed transmission of a CAN TxPDU.
      sw service arg CanTxPduId: direction=IN, implementation-data-type=PduIdType  # L-PDU handle of CAN L-PDU successfully transmitted. This ID specifies the corresponding CAN L-PDU ID and implicitly the CAN Driver instance as well as the corresponding CAN controller device.
    CanIf_RxIndication: service-id=0x14, is-reentrant=true, is-synchronous=true, call-type=CALLBACK, execution-context=UNSPECIFIED  # This service indicates a successful reception of a received CAN Rx LPDU to the CanIf after passing all filters and validation checks.
      sw service arg Mailbox: category=TYPE_REFERENCE, direction=IN, sw-pointer-target-props={target-category=STRUCTURE, implementation-data-type=Can_HwType, sw-impl-policy=CONST}  # Identifies the HRH and its corresponding CAN Controller
      sw service arg PduInfoPtr: category=DATA_REFERENCE, direction=IN, sw-pointer-target-props={target-category=STRUCTURE, implementation-data-type=PduInfoType, sw-impl-policy=CONST}  # Pointer to the received L-PDU
    CanIf_ControllerBusOff: service-id=0x16, is-reentrant=true, is-synchronous=true, call-type=CALLBACK, execution-context=UNSPECIFIED  # This service indicates a Controller BusOff event referring to the corresponding CAN Controller with the abstract CanIf ControllerId.
      sw service arg ControllerId: direction=IN, implementation-data-type=uint8  # Abstract CanIf ControllerId which is assigned to a CAN controller, where a BusOff occured.
    CanIf_ConfirmPnAvailability: service-id=0x1a, is-reentrant=true, is-synchronous=true, call-type=CALLBACK, execution-context=UNSPECIFIED  # This service indicates that the transceiver is running in PN communication mode referring to the corresponding CAN transceiver with the abstract CanIf TransceiverId.
      sw service arg TransceiverId: direction=IN, implementation-data-type=uint8  # Abstract CanIf TransceiverId, which is assigned to a CAN transceiver, which was checked for PN availability.
    CanIf_ClearTrcvWufFlagIndication: service-id=0x20, is-reentrant=true, is-synchronous=true, call-type=CALLBACK, execution-context=UNSPECIFIED  # This service indicates that the transceiver has cleared the WufFlag referring to the corresponding CAN transceiver with the abstract CanIf TransceiverId.
      sw service arg TransceiverId: direction=IN, implementation-data-type=uint8  # Abstract CanIf TransceiverId, which is assigned to a CAN transceiver, for which this function was called.
    CanIf_CheckTrcvWakeFlagIndication: service-id=0x21, is-reentrant=true, is-synchronous=true, call-type=CALLBACK, execution-context=UNSPECIFIED  # This service indicates that the check of the transceivers wake-up flag has been finished by the corresponding CAN transceiver with the abstract CanIf TransceiverId. This indication is used to cope with the asynchronous transceiver communication.
      sw service arg TransceiverId: direction=IN, implementation-data-type=uint8  # Abstract CanIf TransceiverId, which is assigned to a CAN transceiver, for which this function was called.
    CanIf_ControllerModeIndication: service-id=0x17, is-reentrant=true, is-synchronous=true, call-type=CALLBACK, execution-context=UNSPECIFIED  # This service indicates a controller state transition referring to the corresponding CAN controller with the abstract CanIf ControllerId.
      sw service arg ControllerId: direction=IN, implementation-data-type=uint8  # Abstract CanIf ControllerId which is assigned to a CAN controller, which state has been transitioned.
      sw service arg ControllerMode: direction=IN, implementation-data-type=Can_ControllerStateType  # Mode to which the CAN controller transitioned
    CanIf_TrcvModeIndication: service-id=0x22, is-reentrant=true, is-synchronous=true, call-type=CALLBACK, execution-context=UNSPECIFIED  # This service indicates a transceiver state transition referring to the corresponding CAN transceiver with the abstract CanIf TransceiverId.
      sw service arg TransceiverId: direction=IN, implementation-data-type=uint8  # Abstract CanIf TransceiverId, which is assigned to a CAN transceiver, which state has been transitioned.
      sw service arg TransceiverMode: direction=IN, implementation-data-type=uint8  # Mode to which the CAN transceiver transitioned
    CanIf_ReturnTxPduId: service-id=0x1c, is-reentrant=true, is-synchronous=true, call-type=REGULAR, execution-context=UNSPECIFIED  # Service that retutrns the PduId when the Target PduId is given.
      return type Returnvalue: implementation-data-type=Std_ReturnType  # E_OK: Request is accepted. E_NOT_OK: Request is rejected.
      sw service arg CanIfTxTargetPduId: direction=IN, implementation-data-type=PduIdType  # CanIf Transmit Target PduId
      sw service arg CanIfTxPduIdPtr: category=DATA_REFERENCE, direction=OUT, sw-pointer-target-props={target-category=STRUCTURE, implementation-data-type=PduInfoType, sw-impl-policy=CONST}  # Pointer to the transmitted L-PDU
    CanIf_ControllerErrorPassive: service-id=0xc0, is-reentrant=true, is-synchronous=true, call-type=CALLBACK, execution-context=UNSPECIFIED  # Service indicates a CAN controller Error Passive event referring to the corresponding CAN controller. This service is called by the CAN driver. CanIf should inturn notify the error passive state informtion to the user using the callback API whose name is provided by parameter CanIfDispatchErrorPassiveNotificationName.
      sw service arg ControllerId: direction=IN, implementation-data-type=uint8  # Controller whose state is in Error Passive state.
    CanIf_TriggerTransmit: service-id=0x41, is-reentrant=true, is-synchronous=true, call-type=CALLBACK, execution-context=UNSPECIFIED  # Within this API, the upper layer module (called module) shall check whether the available data fits into the buffer size reported by SduLength. If it fits, it shall copy its data into the buffer provided by SduDataPtr and update the length of the actual copied data in SduLength. If not, it returns E_NOT_OK without changingPduInfoPtr.
      sw service arg TxPduId: direction=IN, implementation-data-type=PduIdType  # ID of the SDU that is requested to be transmitted.
      sw service arg PduInfoPtr: category=DATA_REFERENCE, direction=INOUT, sw-pointer-target-props={target-category=STRUCTURE, implementation-data-type=PduInfoType, sw-impl-policy=CONST}  # Contains a pointer to a buffer (SduDataPtr) to where the SDU data shall be copied, and the available buffer size in SduLengh. On return, the service will indicate the length of the copied SDU data in SduLength.
    CanIf_XCore_PipeMainfunction_Core{0..5}: is-reentrant=false, is-synchronous=true, call-type=SCHEDULED, execution-context=TASK
package /AUTOSAR_CanIf/ImplementationDataTypes
  5 x impl type, all with type-emitter=HEADER_FILE:
    CanIf_ConfigType: category=STRUCTURE  # This type defines a data structure for the post build parameters of the CAN interface | This type defines a data structure for the post build parameters of the CAN interface for all underlying CAN drivers. At initialization the CanIf gets a pointer to a structure of this type to get access to its configuration data, which is necessary for initialization.
      33 x element:
        TxPduConfig: category=DATA_REFERENCE, sw-pointer-target-props={target-category=VALUE, base-type=uint8}  # Pointer to the Tx Pdu Configuration
        RxPduConfig: category=DATA_REFERENCE, sw-pointer-target-props={target-category=VALUE, base-type=uint8}
        HrhConfig: category=DATA_REFERENCE, sw-pointer-target-props={target-category=VALUE, base-type=uint8}
        NumCanTxPduId: implementation-data-type=PduIdType
        NumCanRxPduId: implementation-data-type=PduIdType
        NumDynamicCanTxPduId: implementation-data-type=PduIdType
        NumControllers: implementation-data-type=uint8
        TxBufferPtr: category=DATA_REFERENCE, sw-pointer-target-props={target-category=VALUE, base-type=uint8}
        TxBufferAllocPtr: category=DATA_REFERENCE, sw-pointer-target-props={target-category=VALUE, base-type=boolean}
        HTHStatusFlagPtr: category=DATA_REFERENCE, sw-pointer-target-props={target-category=VALUE, base-type=boolean}
        RxBufferPtr: category=DATA_REFERENCE, sw-pointer-target-props={target-category=VALUE, base-type=uint8}
        TxNotifPtr: category=DATA_REFERENCE, sw-pointer-target-props={target-category=VALUE, base-type=uint8}
        RxNotifPtr: category=DATA_REFERENCE, sw-pointer-target-props={target-category=VALUE, base-type=uint8}
        ListCfgPtr: category=DATA_REFERENCE, sw-pointer-target-props={target-category=VALUE, base-type=uint8, sw-impl-policy=CONST}
        RangeCfgPtr: category=DATA_REFERENCE, sw-pointer-target-props={target-category=VALUE, base-type=uint8, sw-impl-policy=CONST}
        RxUSERCbkPtr: category=DATA_REFERENCE, sw-pointer-target-props={target-category=VALUE, base-type=uint8, sw-impl-policy=CONST}
        RxCDDCbkPtr: category=DATA_REFERENCE, sw-pointer-target-props={target-category=VALUE, base-type=uint8, sw-impl-policy=CONST}
        RxJ1939CbkPtr: category=DATA_REFERENCE, sw-pointer-target-props={target-category=VALUE, base-type=uint8, sw-impl-policy=CONST}
        TxUSER_CDDCbkPtr: category=DATA_REFERENCE, sw-pointer-target-props={target-category=VALUE, base-type=uint8, sw-impl-policy=CONST}
        WakeupLutPtr: category=DATA_REFERENCE, sw-pointer-target-props={target-category=VALUE, base-type=uint8, sw-impl-policy=CONST}
        NewRxMsgPtr: category=DATA_REFERENCE, sw-pointer-target-props={target-category=VALUE, base-type=uint8}
        WkpEventPtr: category=DATA_REFERENCE, sw-pointer-target-props={target-category=VALUE, base-type=uint8}
        CtrlStatePtr: category=DATA_REFERENCE, sw-pointer-target-props={target-category=VALUE, base-type=uint8}
        TxConfStatusPtr: category=DATA_REFERENCE, sw-pointer-target-props={target-category=VALUE, base-type=uint8}
        DynTxIdPtr: category=DATA_REFERENCE, sw-pointer-target-props={target-category=VALUE, base-type=uint8}
        NmtxIdPtr: category=DATA_REFERENCE, sw-pointer-target-props={target-category=VALUE, base-type=uint8, sw-impl-policy=CONST}
        TxBufferSize: implementation-data-type=uint16
        RxBufferSize: implementation-data-type=uint16
        NumHrhHandles: implementation-data-type=uint16
        CfgSetIndex: implementation-data-type=uint8, sw-impl-policy=CONST
        CanIf_VersionInfo: category=DATA_REFERENCE, sw-pointer-target-props={target-category=VALUE, base-type=uint8}
        CallbackPtr: category=DATA_REFERENCE, sw-pointer-target-props={target-category=VALUE, base-type=uint8, sw-impl-policy=CONST}
        Num_custid_entries: implementation-data-type=PduIdType
    CanIf_PduModeType: compu {0=CANIF_OFFLINE (Transmit and receive path of the corresponding channel are disabled => no communication mode), 1=CANIF_TX_OFFLINE (Transmit path of the corresponding channel is disabled. The receive path is enabled.), 2=CANIF_TX_OFFLINE_ACTIVE (Transmit path of the corresponding channel is in offline active mode. The receive path is disabled. This mode requires CanIfTxOfflineActiveSupport = TRUE.), 3=CANIF_ONLINE (Transmit and receive path of the corresponding channel are enabled => full operation mode)}, implementation-data-type=uint8  # The PduMode of a channel defines its transmit or receive activity. Communication direction (transmission and/or reception) of the channel can be controlled separately or together by upper layers.
    CanIf_NotifStatusType: compu {0=CANIF_NO_NOTIFICATION (No transmit or receive event occurred for the requested L-PDU.), 1=CANIF_TX_RX_NOTIFICATION (The requested Rx/Tx CAN L-PDU was successfully transmitted or received.)}, implementation-data-type=uint8  # Return value of CAN L-PDU notification status.
    CanIf_PduSetModeType: compu {0=CANIF_SET_OFFLINE (No transmission and reception in channel), 1=CANIF_SET_RX_OFFLINE (Receive path of the channel disabled), 2=CANIF_SET_RX_ONLINE (Receive path of the corresponding channel shall be enabled), 3=CANIF_SET_TX_OFFLINE (Transmit path of channel disabled), 4=CANIF_SET_TX_ONLINE (Transmit path of channel enabled), 5=CANIF_SET_ONLINE (Set to full operation mode), 6=CANIF_SET_TX_TP_ONLINE (Set the Transmission TP Online), 7=CANIF_SET_TX_USER_TP_ONLINE (Set the Tx User TP Online), 8=CANIF_SET_TX_OFFLINE_ACTIVE (Notifications are processed but transmit requests are blocked), 9=CANIF_SET_MAXREQUEST (Max number of requests)}, implementation-data-type=uint8  # Types of Controller modes
    CanIf_PduGetModeType: compu {0=CANIF_GET_OFFLINE (No transmission and reception), 1=CANIF_GET_RX_ONLINE (Receive path of the channel is enabled and transmit path is disabled), 2=CANIF_GET_TX_ONLINE (Transmit path of the channel is enabled and receive path is disabled), 3=CANIF_GET_ONLINE (Full operation mode), 4=CANIF_GET_TX_TP_ONLINE (Set the Transmission TP Online), 5=CANIF_GET_TX_USER_TP_ONLINE (Set the Tx User TP Online), 6=CANIF_GET_OFFLINE_ACTIVE (Transmit path is simulated and Receive path is disabled), 7=CANIF_GET_OFFLINE_ACTIVE_RX_ONLINE (Transmit path is simulated and Receive path is enabled)}, implementation-data-type=uint8  # Status of the PDU channel group
