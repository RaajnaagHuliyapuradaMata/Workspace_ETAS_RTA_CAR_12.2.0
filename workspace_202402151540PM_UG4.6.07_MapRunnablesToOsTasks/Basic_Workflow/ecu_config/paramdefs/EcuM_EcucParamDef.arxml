AUTOSAR XML (schema 4-2-2)
package /AUTOSAR_EcuM/EcucModuleDefs
  module definition EcuM [0..1]: category=VENDOR_SPECIFIC_MODULE_DEFINITION, post-build-variant-support=true, refined-module-def=EcuM, variants post-build  # Ecu State Manager Module | Configuration of the EcuM (ECU State Manager) module (with vendor specific enhancements of RB).
    container EcuMConfiguration  # This container contains the configuration (parameters) of the ECU State Manager. For every post-build variant, one instance of EcuMConfiguration should be created. If the project is configured with post-build variant criterion approach a single instance only needed.
      container EcuMCommonConfiguration  # This container contains the common configuration (parameters) of the ECU State Manager.
        integer EcuMConfigConsistencyHash [0..0]: 0..18446744073709551615, set at link  # A hash value generated across all pre-compile and link-time parameters of all BSW modules. This hash value is compared against a field in the EcuM_ConfigType and hence allows checking the consistency of the entire configuration.
        boolean EcuMIgnoreWakeupEvValOffPreOS: set at pre-compile, default-value=false  # Defines the wakeup events that must be considered in OffPreOS | true: only wakeup events which do not need validation shall be considered false: wakeup events which do not need validation and pending wakeup events that need validation.
        reference EcuMDefaultAppMode: post-build-variant-value=true, set at post-build, destination=OsAppMode  # The default OS application mode loaded when the ECU comes out of reset.
        reference EcuMOSResource [0..*]: set at pre-compile, destination=OsResource  # This parameter is a reference to a OS resource which is used to bring the ECU into sleep mode. | In case of multi core each core shall have an own OsResource.
        container EcuMDefaultShutdownTarget  # This container describes the default shutdown target to be selected by EcuM. It can be OFF or RESET. The shutdown target selected by this configuration can be overridden by the EcuM_SelectShutdownTarget service.
          enumeration EcuMDefaultState: {EcuMStateOff, EcuMStateReset, EcuMStateSleep}, post-build-variant-value=true, set at post-build  # This parameter describes the state part of the default shutdown target selected when the ECU comes out of reset. That is OFF or RESET. If EcuMStateReset is selected, the parameter EcuMDefaultResetModeRef selects the specific Reset mode. | This parameter describes the state part of the default shutdown target selected when the ECU comes out of reset. That is OFF , RESET or SLEEP .If EcuMStateSleep is selected, the parameter EcuMDefaultSleepModeRef selects the specific sleep mode that is corresponding MCU mode. If EcuMStateReset is selected, the parameter EcuMDefaultResetModeRef selects the specific Reset mode.
          symbolic name reference EcuMDefaultResetModeRef [0..1]: multiplicity set at post-build, post-build-variant-multiplicity=true, post-build-variant-value=true, set at post-build, destination=EcuMResetMode  # If EcuMDefaultShutdownTarget is EcuMStateReset, this parameter selects the default reset mode. In all other cases this parameter can be ignored.
          symbolic name reference EcuMDefaultSleepModeRef [0..1]: multiplicity set at post-build, post-build-variant-multiplicity=true, post-build-variant-value=true, set at post-build, destination=EcuMSleepMode  # If EcuMDefaultShutdownTarget is EcuMStateSleep, this parameter selects the default Sleep mode. In all other cases this parameter can be ignored.
        container EcuMDriverInitListOne [0..1]  # Container for Init Block I. | This container holds a list of module IDs that will be initialised from EcuM_AL_DriverInitOne. All modules that should be initialized before StartOs and having post-build dependency for initialization should be configured here. Multi-Core initialization is supported that is modules can be initialized based on the Os Core. Note that the driver init list configured here is pre-compile. So the order and init items should be same in all configured EcuM variant. The init order will be same as that given in first EcuMConfiguration container.
          container EcuMDriverInitItem [1..*]: requires-index=true  # These containers describe the entries in a driver initialization list. Each module in the list will be called for initialisation from EcuM_Init in the same order as configured in this list.
            string EcuMModuleID [0..1]: multiplicity set at pre-compile, set at pre-compile  # Short name of the module to be initialized, e.g. Mcu, Gpt etc. If both EcuMModuleRef and EcuMModuleId parameters are configured EcuMModuleRef will be discarded by code generators.
            enumeration EcuMModuleParameter: {NULL_PTR, POSTBUILD_PTR, VOID}, set at pre-compile  # Definition of the function prototype and the parameter passed to the function. If EcuMModuleParameter -> "POSTBUILD" then EcuM will call Dem_PreInit(&Dem_Config) , If EcuMModuleParameter -> "NULL_PTR" then EcuM will call Dem_PreInit (NULL_PTR) , If EcuMModuleParameter -> "VOID" then EcuM will call Dem_PreInit ().
            string EcuMModuleService [0..1]: multiplicity set at pre-compile, set at pre-compile  # The service to be called to initialize that module, e.g. Init, PreInit, Start etc. If the parameter is left unconfigured, by default 'Init' will be considerd | If the service is Init and the parameter EcuMModuleConfigurationRef has been set for that module, the corresponding pointer to the init structure (<Module>_ConfigType) and in case of multiple instantiation an uint8 value to identify the instance of the module(<MSN>_CtrlIdx) shall be passed as arguments.
            boolean EcuMRbMonitoringCapable [0..1]: origin=RB:2.0.0:2017-05-10, set at pre-compile  # When EcuMRbMonitoringCapable parameter is set to TRUE for a PB capable driver module with valid postbuild pointer, that particular driver module will be considered for Monitoring service generation. If it is set to FALSE or not configured then that particular module will not be considered for the monitoring service generation. Also if EcuMRbMonitoringCapable parameter set to TRUE for a module which is not having valid postbuild pointer(VOID/NULL_PTR) then that module will not be considered for monitoring service.
            integer EcuMRbSequenceID [0..1]: multiplicity set at pre-compile, origin=RB:3.0.0:2018-01-31, set at pre-compile  # This ID determines the sequence in which the configured callouts appear. If all driver list items are provided with a unique ID, generation of callouts is done based on this ID. If some sequence IDs are duplicate or some sequence IDs are missing, error is thrown. If ID is not configured for any of the EcuMDriverInitItems, then the callouts are generated based on the order in which they are configured.
            reference EcuMEcucCoreDefinitionRef [0..1]: multiplicity set at pre-compile, set at pre-compile, destination=EcucCoreDefinition  # Reference denotes the core the EcuM AUTOSAR services shall be offered on.
            foreign reference EcuMModuleRef [0..1]: set at pre-compile, destination-type=ECUC-MODULE-CONFIGURATION-VALUES  # Foreign reference to the configuration of a module instance which shall be initialized by EcuM. If EcuMModuleRef and EcuMModuleId both are configured EcuMModuleRef will be discarded by code generators.
        container EcuMDriverInitListZero [0..1]  # Container for Init Block 0. | This container holds a list of module IDs that will be initialised from EcuM_AL_DriverInitZero. All modules in this list are initialised before the post-build configuration has been loaded and the OS is initialized. Therefore, these modules may not use post-build configuration. Note that the driver init list configured here is pre-compile. So the order and init items should be same in all configured EcuM variant. The init order will be same as that given in first EcuMConfiguration container.
          container EcuMDriverInitItem [1..*]: requires-index=true  # These containers describe the entries in a driver init list.
            string EcuMModuleID [0..1]: multiplicity set at pre-compile, set at pre-compile  # Short name of the module to be initialized, e.g. Mcu, Gpt etc. If both EcuMModuleRef and EcuMModuleId parameters are configured EcuMModuleRef will be discarded by code generators.
            enumeration EcuMModuleParameter [0..0]: {NULL_PTR, POSTBUILD_PTR, VOID}, set at pre-compile  # Definition of the function prototype and the parameter passed to the function. Applicable only for DriverInitListOne Items. If EcuMModuleParameter -> "POSTBUILD" then EcuM will call Dem_PreInit(&Dem_Config) , If EcuMModuleParameter -> "NULL_PTR" then EcuM will call Dem_PreInit (NULL_PTR) , If EcuMModuleParameter -> "VOID" then EcuM will call Dem_PreInit ().
            string EcuMModuleService [0..1]: multiplicity set at pre-compile, set at pre-compile  # The service to be called to initialize that module, e.g. Init, PreInit, Start etc. If the parameter is left unconfigured, by default 'Init' will be considerd | If the service is Init and the parameter EcuMModuleConfigurationRef has been set for that module, the corresponding pointer to the init structure (<Module>_ConfigType) and in case of multiple instantiation an uint8 value to identify the instance of the module(<MSN>_CtrlIdx) shall be passed as arguments.
            integer EcuMRbSequenceID [0..1]: multiplicity set at pre-compile, origin=RB:3.0.0:2018-01-31, set at pre-compile  # This ID determines the sequence in which the configured callouts appear. If all driver list items are provided with a unique ID, generation of callouts is done based on this ID. If some sequence IDs are duplicate or some sequence IDs are missing, error is thrown. If ID is not configured for any of the EcuMDriverInitItems, then the callouts are generated based on the order in which they are configured.
            reference EcuMEcucCoreDefinitionRef [0..1]: multiplicity set at pre-compile, set at pre-compile, destination=EcucCoreDefinition  # Reference denotes the core the EcuM AUTOSAR services shall be offered on.
            foreign reference EcuMModuleRef [0..1]: set at pre-compile, destination-type=ECUC-MODULE-CONFIGURATION-VALUES  # Foreign reference to the configuration of a module instance which shall be initialized by EcuM. If EcuMModuleRef and EcuMModuleId both are configured EcuMModuleRef will be discarded by code generators.
        container EcuMDriverRestartList [0..1]  # Container for Driver Restart Block. Modules configured here should be a subset of Driver init list 0 and Driver init List one. | List of Module IDs. Entries in this list must appear in the same order as in the combined list of EcuMDriverInitListOne and EcuM_DriverInitListTwo.This list may be a real subset though. In all other cases , the generation tool shall report error. Note that the driver init list configured here is pre-compile. So the order and init items should be same in all configured EcuM variant. The init order will be same as that given in first EcuMConfiguration container.
          container EcuMDriverInitItem [1..*]: requires-index=true  # These containers describe the entries in a driver init list.
            string EcuMModuleID [0..1]: multiplicity set at pre-compile, set at pre-compile  # Short name of the module to be initialized, e.g. Mcu, Gpt etc. If both EcuMModuleRef and EcuMModuleId parameters are configured EcuMModuleRef will be discarded by code generators.
            enumeration EcuMModuleParameter: {NULL_PTR, POSTBUILD_PTR, VOID}, set at pre-compile  # Definition of the function prototype and the parameter passed to the function. Applicable only for DriverInitListOne Items. If EcuMModuleParameter -> "POSTBUILD" then EcuM will call Dem_PreInit(&Dem_Config) , If EcuMModuleParameter -> "NULL_PTR" then EcuM will call Dem_PreInit (NULL_PTR) , If EcuMModuleParameter -> "VOID" then EcuM will call Dem_PreInit ().
            string EcuMModuleService [0..1]: multiplicity set at pre-compile, set at pre-compile  # The service to be called to initialize that module, e.g. Init, PreInit, Start etc. If the parameter is left unconfigured, by default 'Init' will be considerd | If the service is Init and the parameter EcuMModuleConfigurationRef has been set for that module, the corresponding pointer to the init structure (<Module>_ConfigType) and in case of multiple instantiation an uint8 value to identify the instance of the module(<MSN>_CtrlIdx) shall be passed as arguments.
            foreign reference EcuMModuleRef [0..1]: set at pre-compile, destination-type=ECUC-MODULE-CONFIGURATION-VALUES  # Foreign reference to the configuration of a module instance which shall be initialized by EcuM. If EcuMModuleRef and EcuMModuleId both are configured EcuMModuleRef will be discarded by code generators.
        container EcuMSleepMode [0..256]  # These containers describe the configured Sleep Modes. Sleep modes are actually reference to different Mcu Modes. So in-order to configure this container Mcu configuration of Modes is mandatory.
          integer EcuMSleepModeId: scope=ECU, set at pre-compile, symbolic-name-value=true, with-auto=true  # This ID identifies the Sleep mode in Services like EcuM_SelectShutdownTarget. The id is auto-generated by EcuM.
          boolean EcuMSleepModeSuspend: set at pre-compile  # This flag is set to true,the CPU will be suspended, halted or powered off in the sleep mode (Halt mode).Else, if the flag is reset the CPU will enter into Polling mode.
          symbolic name reference EcuMSleepModeMcuModeRef: set at pre-compile, destination=McuModeSettingConf  # This parameter is a reference to the corresponding MCU mode for the sleep mode configured.
          symbolic name reference EcuMWakeupSourceMask [1..*]: multiplicity set at pre-compile, set at pre-compile, destination=EcuMWakeupSource  # These parameters are references to the the wakeup sources that shall be enabled for this sleep mode. In-order to wakeup from the configured Sleep Mode, only the list of wakeup sources configured in EcuMWakeupSourceMask are valid.
        container EcuMWakeupSource [1..32]  # These containers describe the configured wakeup sources. Maximum 32 wakeup sources are valid. Among this 32 , 5 are pre-defined in EcuM that are standard wakeup sources like ECUM_WKSOURCE_POWER, ECUM_WKSOURCE_RESET, ECUM_WKSOURCE_INTERNAL_RESET, ECUM_WKSOURCE_INTERNAL_WDG, ECUM_WKSOURCE_EXTERNAL_WDG. And these 5 sources are auto-configured by EcuM.
          float EcuMCheckWakeupTimeout [0..1]: 0..10, multiplicity set at pre-compile, set at pre-compile, default-value=0  # This Parameter is the initial Value for the Time of the EcuM to delay shut down of the ECU if the check of the Wakeup Source is done asynchronously (CheckWakeupTimer). | The unit is in seconds.
          float EcuMValidationTimeout [0..1]: 0..INF, multiplicity set at pre-compile, set at pre-compile  # The validation timeout (period for which the ECU State Manager will wait for the validation of a wakeup event) can be defined for each wakeup source independently. The timeout is specified in seconds. If this timeout is not configured there wont be any validation routine for this wakeup source and EcuM will consider this source as a valid one immediately. There is no separate timer for this, instead its considered as number of main function periods. | When the timeout is not instantiated, there is no validation routine and the ECU Manager shall not validate the wakeup source.
          integer EcuMWakeupSourceId: 0..31, scope=ECU, set at pre-compile, symbolic-name-value=true, with-auto=true  # This parameter defines the identifier of this wakeup source. This is auto-configured by EcuM
          boolean EcuMWakeupSourcePolling [0..1]: multiplicity set at pre-compile, set at pre-compile  # This parameter describes if Wakeup Source needs Polling.If this parameter is set, then wakeupsource needs polling. Else, if the parameter is reset, Wakeup source does not need polling.
          symbolic name reference EcuMComMChannelRef [0..*]: multiplicity set at pre-compile, set at pre-compile, destination=ComMChannel  # This parameter could reference multiple Networks (channels) defined in the Communication Manager. No reference indicates that the wakeup source is not a communication channel. If this reference is configured, the wakeup source detection will be indicated to ComM.
          symbolic name reference EcuMComMPNCRef [0..*]: multiplicity set at pre-compile, post-build-variant-multiplicity=true, set at pre-compile, destination=ComMPnc  # This is a reference to a one or more PNC's defined in the Communication Manager. No reference indicates that the wakeup source is not assigned to a partial network.
          symbolic name reference EcuMResetReasonRef [0..1]: multiplicity set at pre-compile, set at pre-compile, destination=McuResetReasonConf  # This parameter describes the mapping of reset reasons detected by the MCU driver into wakeup sources. This mapping is needed during EcuM initialization to check the last reset reason.
      container EcuMFlexConfiguration  # This container contains the configuration (parameters) of the EcuMFlex. | Only applicable if EcuMFlex is implemented.
        symbolic name reference EcuMNormalMcuModeRef [0..1]: multiplicity set at pre-compile, set at pre-compile, destination=McuModeSettingConf  # This parameter is a reference to the normal MCU mode to be restored after waking up from sleep.
        reference EcuMPartitionRef [0..0]: set at pre-compile, destination=EcucPartition  # Reference denotes the partition a EcuM shall run inside. | Please note that in case of a multicore ECU this reference is mandatory.
        container EcuMAlarmClock [0..0]  # These containers describe the configured alarm clocks. | The name of these conatiners allows giving a symbolic name to one alarm clock.
          integer EcuMAlarmClockId [0..0]: 0..255, set at pre-compile, symbolic-name-value=true  # This ID identifies this alarmclock.
          float EcuMAlarmClockTimeOut [0..0]: 0..Inf, set at pre-compile  # This parameter allows to define a timeout for this alarm clock.
          symbolic name reference EcuMAlarmClockUser [0..0]: set at pre-compile, destination=EcuMFlexUserConfig  # This parameter allows an alarm to be assigned to a user.
        container EcuMDriverInitListBswM [0..*]  # Container for BswM Init Block. | This container holds a list of modules to be initialized by the BswM. Note that the driver init list configured here is pre-compile. So the order and init items should be same in all configured EcuM variant. The init order will be same as that given in first EcuMFlexConfiguration container.
          container EcuMDriverInitItem [1..*]: requires-index=true  # These containers describe the entries in a driver initialization list. Each module in the list will be called for initialisation from BswM in the same order as configured in this list.
            string EcuMModuleID [0..1]: multiplicity set at pre-compile, set at pre-compile  # Short name of the module to be initialized, e.g. Mcu, Gpt etc. If both EcuMModuleRef and EcuMModuleId parameters are configured EcuMModuleRef will be discarded by code generators.
            enumeration EcuMModuleParameter: {NULL_PTR, POSTBUILD_PTR, VOID}, set at pre-compile, default-value=VOID  # Definition of the function prototype and the parameter passed to the function. If EcuMModuleParameter -> "POSTBUILD" then EcuM will call Dem_PreInit(&Dem_Config) , If EcuMModuleParameter -> "NULL_PTR" then EcuM will call Dem_PreInit (NULL_PTR) , If EcuMModuleParameter -> "VOID" then EcuM will call Dem_PreInit ().
            string EcuMModuleService [0..1]: multiplicity set at pre-compile, set at pre-compile  # The service to be called to initialize that module, e.g. Init, PreInit, Start etc. If the parameter is left unconfigured, by default 'Init' will be considerd | If the service is Init and the parameter EcuMModuleConfigurationRef has been set for that module, the corresponding pointer to the init structure (<Module>_ConfigType) and in case of multiple instantiation an uint8 value to identify the instance of the module(<MSN>_CtrlIdx) shall be passed as arguments.
            integer EcuMRbSequenceID [0..1]: multiplicity set at pre-compile, origin=RB:42.6.1.0:2019-07-22, set at pre-compile  # This ID determines the sequence in which the configured callouts appear. If all driver list items are provided with a unique ID, generation of callouts is done based on this ID. If some sequence IDs are duplicate or some sequence IDs are missing, error is thrown. If ID is not configured for any of the EcuMDriverInitItems, then the callouts are generated based on the order in which they are configured.
            foreign reference EcuMModuleRef [0..1]: set at pre-compile, destination-type=ECUC-MODULE-CONFIGURATION-VALUES  # Foreign reference to the configuration of a module instance which shall be initialized by EcuM.
        container EcuMFlexUserConfig [1..*]  # These containers describe the identifiers that are needed to refer to a software component or another appropriate entity in the system which uses the EcuMFlex Interfaces.
          integer EcuMFlexUser: 0..65535, set at pre-compile, symbolic-name-value=true  # Parameter used to identify one user. Module Function Id can be used for this instead of selecting some random numbers.
          reference EcuMFlexEcucPartitionRef [0..0]: set at pre-compile, destination=EcucPartition  # Denotes in which "EcucPartition" the user of the EcuM is executed.
        container EcuMGoDownAllowedUsers [0..1]  # This container describes the collection of allowed users which are allowed to call the EcuM_GoDown API.
          symbolic name reference EcuMGoDownAllowedUserRef [1..*]: multiplicity set at pre-compile, set at pre-compile, destination=EcuMFlexUserConfig  # These parameters describe the references to the users which are allowed to call the EcuM_GoDown API. The user which is very likely allowed to shutdown the system is BswM.
        container EcuMResetMode [1..256]  # These containers describe the configured reset modes. 3 reset modes are standard and this is auto-configured by EcuM like ECUM_RESET_MCU - ECUM_RESET_WDGM - ECUM_RESET_IO. | The name of these containers allows one of the following symbolic names to be given to the different reset modes: - ECUM_RESET_MCU - ECUM_RESET_WDGM - ECUM_RESET_IO.
          integer EcuMResetModeId: 0..255, set at pre-compile, symbolic-name-value=true, with-auto=true  # This ID identifies this reset mode in services like EcuM_SelectShutdownTarget. This id is auto-configured by EcuM.
        container EcuMSetClockAllowedUsers [0..0]  # This container describes the collection of allowed users which are allowed to call the EcuM_SetClock API.
          symbolic name reference EcuMSetClockAllowedUserRef [0..0]: set at pre-compile, destination=EcuMFlexUserConfig  # These parameters describe the references to the users which are allowed to call the EcuM_SetClock API.
        container EcuMShutdownCause [1..256]  # These containers describe the configured shut down or reset causes. 4 shutdown causes are standard and are auto-configured by EcuM like ECUM_CAUSE_UNKNOWN, ECUM_CAUSE_ECU_STATE, ECUM_CAUSE_WDGM and ECUM_CAUSE_DCM | The name of these containers allows to give one of the following symbolic names to the diffenrent shut down causes: - ECUM_CAUSE_ECU_STATE - ECU state machine entered a state for shutdown, - ECUM_CAUSE_WDGM - WdgM detected failure, - ECUM_CAUSE_DCM - Dcm requests shutdown (split into UDS services?), - and values from configuration.
          integer EcuMShutdownCauseId: 0..255, set at pre-compile, symbolic-name-value=true, with-auto=true  # This ID identifies this shut down cause. This id is auto-configured by EcuM.
    container EcuMGeneral  # This container holds the general, pre-compile configuration parameters.
      boolean EcuMAlarmClockPresent [0..0]: set at pre-compile  # This flag indicates whether the optional AlarmClock feature is present.
      boolean EcuMDevErrorDetect: set at pre-compile, default-value=false  # Switches the development error detection and notification on or off. true: detection and notification is enabled. false: detection and notification is disabled.
      boolean EcuMIncludeDet: set at pre-compile  # If defined, the according BSW module will be initialized by the ECU State Manager
      float EcuMMainFunctionPeriod: 0..INF, scope=ECU, set at pre-compile  # This parameter defines the schedule period of EcuM_MainFunction. Unit is in Seconds. | Unit: [s]
      boolean EcuMRbConfigCCASInit [0..1]: multiplicity set at pre-compile, origin=RB:42.3.1:2017-04-30, set at pre-compile, default-value=false  # If this parameter is set as TRUE,then the Autosar conventional Startup and Shutdown of all cores and OS will be disabled.
      integer EcuMRbCubecCompCheckInteger [0..0]: origin=RB:40.8.0.0:2015-10-27, set at pre-compile  # Hidden Integer parameter for the validation of CUBEC Compatibility Switches
      string EcuMRbCubecCompCheckString [0..0]: origin=RB:40.8.0.0:2015-10-27, set at pre-compile  # Hidden String parameter for the validation of CUBEC Compatibility Switches
      boolean EcuMRbDisableNvM [0..1]: multiplicity set at pre-compile, origin=RB:42.9.0.0:2021-01-31, set at pre-compile, default-value=false  # Optional parameter provided to disable NvM. If NvM module is configured in a project and the parameter EcuMRbDisableNvM is either set as FALSE or is not configured then shutdown related data will be forwarded to NvM. Otherwise no shutdown related data will be forwarded to NvM and the EcuM API's EcuM_Rb_GetLastShutdownInfo() and EcuM_GetLastShutdownTarget() turns out to be irrelevant or inaccessible.
      boolean EcuMRbIncludeComm [0..1]: multiplicity set at pre-compile, origin=RB:42.6.0.0:2019-07-31, set at pre-compile, default-value=true  # If this parameter is set as TRUE, call to COMM functoins is enabled. If this parameter is set as FALSE, call to COMM functions will be disabled. If EcuMRbIncludeComm is set to FALSE ensure that the Parameters EcuMComMChannelRef and EcuMComMPNCRef are not configured in Wakeupsource. This is to ensure ComM Parameters are not defined when it is disabled.
      integer EcuMRbModeSwitchQueueLength [0..1]: 1..255, multiplicity set at pre-compile, origin=RB:42.7.0.0:2020-01-31, set at pre-compile, default-value=1  # This element specifies whether the mode switch communication is queued or not, the length of the mode switch queue ( which is generated by the RTE ) on the provider port. Unqueued communication - When a mode manager initiates a mode switch, RTE will begin processing the request. When the mode switch is currently in progress for the mode instance, any further mode switches will be discarded/overwritten by RTE. Queued communication - When a mode manager initiates a mode switch, RTE will begin processing the request. When the mode switch is currently in progress for the mode instance, any further mode switches will be queued. The size of the mode switch queue is determined by EcuMRbModeSwitchQueueLength.
      integer EcuMRbNvMBlockDeviceId [0..1]: 0..254, multiplicity set at pre-compile, origin=RB:42.8.0.0:2020-07-31, set at pre-compile  # This optional parameter defines the NVRAM device ID where the NVRAM block is located.If the EcuM parameter EcuMRbNvMBlockDeviceId is not configured and FEE module is present, then NvMNvramDeviceId forwarded with a value of 0.If FEE module not present and EA module is present, then NvMNvramDeviceId forwarded with a value of 1, along with those warning info message is passed.In case both module are not present only info message will passed.
      float EcuMRbRunMinimumDuration [0..1]: multiplicity set at pre-compile, origin=RB:42.1.0.0:2016-06-08, set at pre-compile  # Duration given in seconds. If this is configured with a non-Zero value, after the startup EcuM will continue to stay in RUN state for that much duration even in the case of no run request from any users. When configuring this value Integrator should consider the time by when Rte is getting started.
      boolean EcuMRbSlaveCoreEarlierStart [0..1]: multiplicity set at pre-compile, origin=RB:40.9.0.0:2016-03-01, set at pre-compile, default-value=false  # If this parameter is set as TRUE, Slave cores would be started earlier i.e., Slave cores would be started by master just before initializing EcuMDriverInitListOne.If this parameter is set as FALSE, then Slave cores would be started at the end phase of EcuM_Init.
      boolean EcuMRbStartupDuration [0..1]: multiplicity set at pre-compile, origin=RB:42.4.1:2018-09-20, set at pre-compile, default-value=false  # If this parameter is set to TRUE ,then the startup duration time measurement is enabled.8 bytes will be forwareded as the size of ECUM_CFG_NVM_BLOCK block.If this is set to FALSE or not configured then the startup duration time measurement is disabled .4 bytes will be forwareded as the size of ECUM_CFG_NVM_BLOCK block
      boolean EcuMRbUserTypeUpdate [0..1]: multiplicity set at pre-compile, origin=RB:42.5.1:2019-04-30, set at pre-compile, default-value=false  # This parameter can be used to configure the Implementation type of EcuM_UserType in the file EcuM_Cfg_SWCD.arxml. If this parameter is set as TRUE, then EcuM_UserType will have type uint8. If the parameter is set as FALSE OR not configured then EcuM_UserType will have type uint16.
      boolean EcuMVersionInfoApi: set at pre-compile, default-value=false  # Switches the version info API, EcuM_GetVersionInfo, ON or OFF
      symbolic name reference EcuMRbCubecCheckReference [0..0]: origin=RB:40.8.0.0:2015-10-27, set at pre-compile, destination=EcuMResetMode  # Hidden Reference parameter for the validation of CUBEC Compatibility Switches
      reference EcuMRbStartupCore [0..1]: multiplicity set at pre-compile, origin=RB:4.0.0:2023-01-20, set at pre-compile, destination=EcucCoreDefinition  # If Configured with a ecucCoreDefinition reference,then the configured core behaves like Master Core where all the startup,wakeup and shutdown sequences are carried out. If not Configured,then Core 0 is the Master Core.This parameter is added to fulfill the safety requirement of IFX-Device 4 that complete startup should run on a core with lockstep.
      container EcuMRbAlSwitchOffCallout [0..1]  # Container used for defining EcuM_AL_SwitchOff callout. If this is not configured integratopr should manually call the functions inside EcuM_Callout_Stubs.c. | This container holds a list of function call that will be called on EcuMAL_SwitchOFF Callout.
        container EcuMRbCallOutItem [1..*]  # Container used for defining EcuM callout function calls.
          string EcuMRbCalloutFunction: origin=RB, set at pre-compile  # Function to be called from the callout. Both void and non-void functions are allowed. Function calls with parameters can be passed directly as '$Function_Name($parameter)' with no restriction on the number of parameters. Function calls without parameters can be passed as '$Function_Name'.
          string EcuMRbModuleID: set at pre-compile  # Module name of the function call. This is needed for the header inclusion needed for EcuMRbCalloutFunction configured. Example : NvM
          integer EcuMRbSequenceID [0..1]: multiplicity set at pre-compile, origin=RB:3.0.0:2018-01-31, set at pre-compile  # This ID determines the sequence in which the configured callouts appear. If all driver list items are provided with a unique ID, generation of callouts is done based on this ID. If some sequence IDs are duplicate or some sequence IDs are missing, error is thrown. If ID is not configured for any of the EcuMRbCallOutItems, then the callouts are generated based on the order in which they are configured.
          boolean EcuMRbServiceIsNonAutosar [0..1]: multiplicity set at pre-compile, origin=RB, set at pre-compile  # Flag, which is set true, if the module is Non-AUTOSAR specified. By default if this parameter is not configured the value is taken as FALSE. if the parameter is FALSE, then for the header inclused by EcuMRbModuleID will be followed by a mdule version check.
          container EcuMRbCalloutCondition [0..1]  # Condition needed to be checked before function calls. Note: This condition check is only possible with Run time. Pre-Compile time check is not possible.
            string EcuMRbCondition: origin=RB, set at pre-compile  # If there is any condition needs to be checked before calling the function then condition can be added in this parameter. Note: This condition check is only possible with Run time. Pre-Compile time check is not possible.
            container EcuMRbCalloutHeaderList [1..*]  # Header needed to be included for condition check.
              string EcuMRbCalloutConditionHeader: origin=RB, set at pre-compile  # Header to be included.
              boolean EcuMRbServiceIsNonAutosar [0..1]: multiplicity set at pre-compile, origin=RB, set at pre-compile, default-value=false  # Flag, which is set true, if the module is Non-AUTOSAR specified. By default if this parameter is not configured the value is taken as FALSE. if the parameter is FALSE, then for the header inclused by EcuMRbModuleID will be followed by a mdule version check.
      container EcuMRbDeterminePb [0..1]  # Post Build configuration determination criterion. Configure this container only if post build selectable features is used. Currently, detection via only Port pins is supported
        boolean EcuMRbBootCtrlRelevant [0..1]: multiplicity set at pre-compile, origin=RB, set at pre-compile, default-value=false  # If set to true the port configuration will be forwarded to rba_BootCtrl module. If this parameter is set to false or left unconfigured, there will be no forwarding to rba_BootCtrl
        boolean EcuMRbSwcRelevant [0..1]: multiplicity set at pre-compile, origin=RB, set at pre-compile, default-value=false  # This parameter is applicable only in case of a Master/Slave configuration of ECU. If set to true the API EcuM_Rb_GetEcuType() will be generated. If this parameter is set to false or left unconfigured, this API will not be generated
        container EcuMRbPbVariant [2..65536]  # Here we configure the patterns of the pin value corresponding to the ECU logical number. Right now a maximum of 65535 ECUs are supported.
          integer EcuMRbPattern: origin=RB, set at pre-compile  # Pin Pattern corresponding to the ECU configured above
          integer EcuMRbPbVariantIndex: 0..65535, origin=RB:42.2:2017-06-20, set at pre-compile  # Logical number of the ECU
        container EcuMRbPortConfiguration  # This is port configuration which is used to determine the post build selectable configuration. Only one port is supported at the moment. Maximum of three pins can be configured inside the Port.
          integer EcuMRbPin [1..16]: 0..15, multiplicity set at pre-compile, origin=RB:42.2:2017-06-20, set at pre-compile  # Pin number within the port
          string EcuMRbPort: origin=RB, set at pre-compile  # Port number
      container EcuMRbIncludeHeaderList [0..1]  # EcuMRbIncludeHeader is a custom place holder which will be included in EcuM.h. This parameter can be used to export API's of other modules.
        string EcuMRbModuleHeader [1..*]: multiplicity set at pre-compile, origin=RB, set at pre-compile  # Shortname of the moudle to be included or header to be included. Example : Can, Gpt.
      container EcuMRbOnGoOffOneCallout [0..1]  # Container used for defining EcuM_OnGoOffOne callout. If this is not configured integratopr should manually call the functions inside EcuM_Callout_Stubs.c. | This container holds a list of function call that will be called on EcuM_OnGoOffOne Callout.
        container EcuMRbCallOutItem [1..*]  # Container used for defining EcuM callout function calls.
          string EcuMRbCalloutFunction: origin=RB, set at pre-compile  # Function to be called from the callout. Both void and non-void functions are allowed. Function calls with parameters can be passed directly as '$Function_Name($parameter)' with no restriction on the number of parameters. Function calls without parameters can be passed as '$Function_Name'.
          string EcuMRbModuleID: set at pre-compile  # Module name of the function call. This is needed for the header inclusion needed for EcuMRbCalloutFunction configured. Example : NvM
          integer EcuMRbSequenceID [0..1]: multiplicity set at pre-compile, origin=RB:3.0.0:2018-01-31, set at pre-compile  # This ID determines the sequence in which the configured callouts appear. If all driver list items are provided with a unique ID, generation of callouts is done based on this ID. If some sequence IDs are duplicate or some sequence IDs are missing, error is thrown. If ID is not configured for any of the EcuMRbCallOutItems, then the callouts are generated based on the order in which they are configured.
          boolean EcuMRbServiceIsNonAutosar [0..1]: multiplicity set at pre-compile, origin=RB, set at pre-compile  # Flag, which is set true, if the module is Non-AUTOSAR specified. By default if this parameter is not configured the value is taken as FALSE. if the parameter is FALSE, then for the header inclused by EcuMRbModuleID will be followed by a mdule version check.
          container EcuMRbCalloutCondition [0..1]  # Condition needed to be checked before function calls. Note: This condition check is only possible with Run time. Pre-Compile time check is not possible.
            string EcuMRbCondition: origin=RB, set at pre-compile  # If there is any condition needs to be checked before calling the function then condition can be added in this parameter. Note: This condition check is only possible with Run time. Pre-Compile time check is not possible.
            container EcuMRbCalloutHeaderList [1..*]  # Header needed to be included for condition check.
              string EcuMRbCalloutConditionHeader: origin=RB, set at pre-compile  # Header to be included.
              boolean EcuMRbServiceIsNonAutosar [0..1]: multiplicity set at pre-compile, origin=RB, set at pre-compile, default-value=false  # Flag, which is set true, if the module is Non-AUTOSAR specified. By default if this parameter is not configured the value is taken as FALSE. if the parameter is FALSE, then for the header inclused by EcuMRbModuleID will be followed by a mdule version check.
      container EcuMRbOnGoOffTwoCallout [0..1]  # Container used for defining EcuM_OnGoOffTwo callout. If this is not configured integratopr should manually call the functions inside EcuM_Callout_Stubs.c. | This container holds a list of function call that will be called on EcuMShutdownOnGoOffTwo callout.
        container EcuMRbCallOutItem [1..*]  # Container used for defining EcuM callout function calls.
          string EcuMRbCalloutFunction: origin=RB, set at pre-compile  # Function to be called from the callout. Both void and non-void functions are allowed. Function calls with parameters can be passed directly as '$Function_Name($parameter)' with no restriction on the number of parameters. Function calls without parameters can be passed as '$Function_Name'.
          string EcuMRbModuleID: set at pre-compile  # Module name of the function call. This is needed for the header inclusion needed for EcuMRbCalloutFunction configured. Example : NvM
          integer EcuMRbSequenceID [0..1]: multiplicity set at pre-compile, origin=RB:3.0.0:2018-01-31, set at pre-compile  # This ID determines the sequence in which the configured callouts appear. If all driver list items are provided with a unique ID, generation of callouts is done based on this ID. If some sequence IDs are duplicate or some sequence IDs are missing, error is thrown. If ID is not configured for any of the EcuMRbCallOutItems, then the callouts are generated based on the order in which they are configured.
          boolean EcuMRbServiceIsNonAutosar [0..1]: multiplicity set at pre-compile, origin=RB, set at pre-compile  # Flag, which is set true, if the module is Non-AUTOSAR specified. By default if this parameter is not configured the value is taken as FALSE. if the parameter is FALSE, then for the header inclused by EcuMRbModuleID will be followed by a mdule version check.
          container EcuMRbCalloutCondition [0..1]  # Condition needed to be checked before function calls. Note: This condition check is only possible with Run time. Pre-Compile time check is not possible.
            string EcuMRbCondition: origin=RB, set at pre-compile  # If there is any condition needs to be checked before calling the function then condition can be added in this parameter. Note: This condition check is only possible with Run time. Pre-Compile time check is not possible.
            container EcuMRbCalloutHeaderList [1..*]  # Header needed to be included for condition check.
              string EcuMRbCalloutConditionHeader: origin=RB, set at pre-compile  # Header to be included.
              boolean EcuMRbServiceIsNonAutosar [0..1]: multiplicity set at pre-compile, origin=RB, set at pre-compile, default-value=false  # Flag, which is set true, if the module is Non-AUTOSAR specified. By default if this parameter is not configured the value is taken as FALSE. if the parameter is FALSE, then for the header inclused by EcuMRbModuleID will be followed by a mdule version check.
    container EcuMFlexGeneral [0..1]  # This container holds the general, pre-compile configuration parameters for the EcuMFlex.
      boolean EcuMModeHandling [0..1]: multiplicity set at pre-compile, set at pre-compile  # If this parameter is enabled, EcuM Mode Management feature will be enabled. The ECU Mode Handling introduces a common interface for SW-Cs as known from ECU State Manger with fixed state machine (EcuMFixed). The ECU State Manager with flexible state machine (EcuMFlex) provides interfaces for SW-Cs to request and release the modes RUN and POST_RUN optionally.
      boolean EcuMResetLoopDetection [0..0]: set at pre-compile  # If false, no reset loop detection is performed. If this configuration parameter exists and is set to true, the callout "EcuM_LoopDetection" is called during startup of EcuM (during StartPreOS).
      boolean EcuMSetProgrammableInterrupts [0..1]: set at pre-compile  # If this configuration parameter exists and is to true, the callout "EcuM_AL_SetProgrammableInterrupts" is called during startup of EcuM (during StartPreOS).
