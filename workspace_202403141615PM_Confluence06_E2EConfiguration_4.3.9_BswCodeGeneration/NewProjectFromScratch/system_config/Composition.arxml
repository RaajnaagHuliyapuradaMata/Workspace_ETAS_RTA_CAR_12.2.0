AUTOSAR XML (schema 00051)
package /Composition
  composition sw component type TopLevelComposition
    7 x component:
      CPT_MyTransmittingSWC_ApplicationEcu: type=MyTransmittingSWC
      CPT_MyReceivingSWC_ApplicationEcu: type=MyReceivingSWC
      CPT_MyTransmittingSWC_TestEcu: type=MyTransmittingSWC
      CPT_MyReceivingSWC_TestEcu: type=MyReceivingSWC
      CPT_ComM: type=ComM
      CPT_NvM: type=NvM
      CPT_E2ESWC: type=E2ESWC
    connect CPT_MyTransmittingSWC_ApplicationEcu.PPortPrototype_0 -> CPT_MyReceivingSWC_TestEcu.RPortPrototype_0
    connect CPT_MyTransmittingSWC_TestEcu.PPortPrototype_0 -> CPT_MyReceivingSWC_ApplicationEcu.RPortPrototype_0
    connect CPT_NvM.PS_NvM_NativeBlock_2 -> CPT_MyReceivingSWC_ApplicationEcu.R_NvMService_0
    connect CPT_NvM.PS_NvM_NativeBlock_3 -> CPT_MyReceivingSWC_ApplicationEcu.R_NvMService_0
    connect CPT_NvM.PS_NvM_NativeBlock_2 -> CPT_MyReceivingSWC_TestEcu.R_NvMService_0
    connect CPT_MyTransmittingSWC_TestEcu.PPortPrototype_0 -> CPT_MyReceivingSWC_TestEcu.RPortPrototype_0
    connect CPT_MyTransmittingSWC_ApplicationEcu.PPortPrototype_0 -> CPT_MyReceivingSWC_ApplicationEcu.RPortPrototype_0
    connect CPT_NvM.PS_NvM_NativeBlock_3 -> CPT_MyReceivingSWC_TestEcu.R_NvMService_0
    connect CPT_E2ESWC.PPort_E2E_Tx -> CPT_MyReceivingSWC_ApplicationEcu.RPortPrototype_0, mapping=PIM_My_SR_Interface_E2E_DataInterface
    connect CPT_MyTransmittingSWC_ApplicationEcu.PPortPrototype_0 -> CPT_E2ESWC.RPort_E2E_Rx, mapping=PIM_My_SR_Interface_E2E_DataInterface
package /Composition/PortInterfaceMappingSets
  port interface mapping set PIMSet_TopLevelComposition
    port-interface-mappings:
      variable and parameter interface mapping PIM_My_SR_Interface_E2E_DataInterface: data-prototype-mapping{first-data-prototype=DE_MyDataElement, second-data-prototype=CKS}
