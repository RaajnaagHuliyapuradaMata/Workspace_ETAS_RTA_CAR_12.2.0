AUTOSAR XML (schema 4-2-2)
package /RB/UBK/Project/EcucModuleConfigurationValuess
  module config rba_ArxmlGen: implementation-config-variant=VARIANT-PRE-COMPILE
    Fls (rba_ArxmlGen_Comp):
      rba_ArxmlGen_CompCategory = BswModule
      rba_ArxmlGen_CompId = 92
      rba_ArxmlGen_CompIsConfigurable = 0
      rba_ArxmlGen_CompIsStandalone = 1
      rba_ArxmlGen_CompIsStandardized = 1
      rba_ArxmlGen_CompLongName = FlashDriver
      rba_ArxmlGen_CompVersionAr = 4.2.2
      rba_ArxmlGen_CompVersionSw = 8.0.0
      Fls_MainFunction (rba_ArxmlGen_ExecEntity): rba_ArxmlGen_ExecEntityCategory=Schedulable, rba_ArxmlGen_ExecEntityPeriod=0.01, rba_ArxmlGen_ExecEntityImplEntryRef=Fls_MainFunction
