AUTOSAR XML (schema 00051)
package /ETAS_Project/EcucModuleConfigurationValuess
  module config E2E
    E2ERbGeneral_0 (E2ERbGeneral):
      E2ERbCallout = 0
      E2ERbCheckParameterType = E2E_NONE
      E2ERbCheckStatusTypeCompatibilityMode = 1
      E2ERbDataIDBitOrderProfile5 = ORDER_UNCHANGED
      E2ERbDataIDBitOrderProfile6 = ORDER_UNCHANGED
      E2ERbDevTest = 0
      E2ERbHeaderBitOrderProfile11 = ORDER_UNCHANGED
      E2ERbHeaderBitOrderProfile22 = ORDER_UNCHANGED
      E2ERbHeaderBitOrderProfile4 = ORDER_UNCHANGED
      E2ERbHeaderBitOrderProfile44 = ORDER_UNCHANGED
      E2ERbHeaderBitOrderProfile{5..7} = ORDER_UNCHANGED
      E2ERbProfile1 = 1
      E2ERbProfile11 = 1
      E2ERbProfile2 = 1
      E2ERbProfile22 = 1
      E2ERbProfile4 = 1
      E2ERbProfile44 = 1
      E2ERbProfile{5..7} = 1
      E2ERbSMVersion = AR42
      E2ERbStateMachine = 1
      E2ERbVersionInfoApi = 1
