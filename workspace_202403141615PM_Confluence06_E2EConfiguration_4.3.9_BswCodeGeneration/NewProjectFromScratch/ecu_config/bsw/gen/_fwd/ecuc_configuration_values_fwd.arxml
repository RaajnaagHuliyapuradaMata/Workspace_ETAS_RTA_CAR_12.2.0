AUTOSAR XML (schema 00051)
package /ETAS_Project/EcucModuleConfigurationValuess
  module config CanIf
    CanIfInitCfg
      ApplicationECU_TestResult_Tx_Can_Network_CANNODE_0_OUT (CanIfTxPduCfg): CanIfTxPduId=0
      TestECU_TestCode_Tx_Can_Network_CANNODE_0_IN (CanIfRxPduCfg): CanIfRxPduId=0
    CanIfCtrlDrvCfg
      Can_Network_CANNODE_0 (CanIfCtrlCfg): CanIfCtrlId=0
  module config ComM
    ComMConfigSet
      ComMUser_Can_Network_Channel_Can_Network (ComMUser): ComMUserIdentifier=0
      Can_Network_Channel_Can_Network (ComMChannel): ComMChannelId=0
  module config NvM
    ECUM_CFG_NVM_BLOCK (NvMBlockDescriptor):
      NvMBlockJobPriority = 1
      NvMBlockManagementType = NVM_BLOCK_NATIVE
      NvMBlockUseCrc = true
      NvMBlockUseSyncMechanism = false
      NvMBlockUseCRCCompMechanism = false
      NvMBlockWriteProt = false
      NvMCalcRamBlockCrc = false
      NvMMaxNumOfReadRetries = 0
      NvMMaxNumOfWriteRetries = 0
      NvMNvBlockLength = 4
      NvMBlockHeaderInclude = EcuM
      NvMNvBlockNum = 1
      NvMNvramDeviceId = 0
      NvMRamBlockDataAddress = EcuM_Rb_dataShutdownInfo_st
      NvMBlockUsePort = false
      NvMResistantToChangedSw = false
      NvMRomBlockDataAddress = NULL_PTR
      NvMRomBlockNum = 0
      NvMSelectBlockForReadAll = true
      NvMSelectBlockForWriteAll = true
      NvMStaticBlockIDCheck = false
      NvMWriteBlockOnce = false
      NvMWriteVerification = false
      NvMWriteVerificationDataSize = 0
      NvMSingleBlockCallback: NvMSingleBlockCallbackFnc=EcuM_Rb_NvMSingleBlockCallbackFunction
  module config EcuM
    EcuMConfiguration_0 (EcuMConfiguration)
      EcuMCommonConfiguration
        10 x EcuMWakeupSource:
          ECUM_WKSOURCE_POWER
          ECUM_WKSOURCE_RESET
          ECUM_WKSOURCE_INTERNAL_RESET
          ECUM_WKSOURCE_INTERNAL_WDG
          ECUM_WKSOURCE_EXTERNAL_WDG
          ECUM_WKSOURCE_POWER: EcuMWakeupSourceId=0, EcuMValidationTimeout=0.0
          ECUM_WKSOURCE_RESET: EcuMWakeupSourceId=1, EcuMValidationTimeout=0.0
          ECUM_WKSOURCE_INTERNAL_RESET: EcuMWakeupSourceId=2, EcuMValidationTimeout=0.0
          ECUM_WKSOURCE_INTERNAL_WDG: EcuMWakeupSourceId=3, EcuMValidationTimeout=0.0
          ECUM_WKSOURCE_EXTERNAL_WDG: EcuMWakeupSourceId=4, EcuMValidationTimeout=0.0
      EcuMFlexConfiguration
        6 x EcuMResetMode:
          ECUM_RESET_MCU
          ECUM_RESET_WDGM
          ECUM_RESET_IO
          ECUM_RESET_MCU: EcuMResetModeId=0
          ECUM_RESET_WDGM: EcuMResetModeId=1
          ECUM_RESET_IO: EcuMResetModeId=2
        8 x EcuMShutdownCause:
          ECUM_CAUSE_UNKNOWN
          ECUM_CAUSE_ECU_STATE
          ECUM_CAUSE_WDGM
          ECUM_CAUSE_DCM
          ECUM_CAUSE_UNKNOWN: EcuMShutdownCauseId=0
          ECUM_CAUSE_ECU_STATE: EcuMShutdownCauseId=1
          ECUM_CAUSE_WDGM: EcuMShutdownCauseId=2
          ECUM_CAUSE_DCM: EcuMShutdownCauseId=3
  module config rba_MemLib
    rba_MemLibPublished:
      rba_MemLibPublishedEnableMeas = false
      rba_MemLibPublishedEnableMemAccBuild = false
      rba_MemLibPublishedEnableMemAccUsage = false
      rba_MemLibPublishedEnableMemMapGeneration = true
      rba_MemLibPublishedEnablePrototype = true
      rba_MemLibPublishedEnableRte = true
      rba_MemLibPublishedEnableRteFound = true
      rba_MemLibPublishedEnableTimer = false
      rba_MemLibPublishedEnableVecu = false
      rba_MemLibPublishedSizeEnum8 = 4
      rba_MemLibPublishedSizeEnum16 = 4
      rba_MemLibPublishedSwMajorVersion = 22
      rba_MemLibPublishedSwMinorVersion = 0
      rba_MemLibPublishedSwPatchVersion = 1
      rba_MemLibPublishedARMajorVersion = 4
      rba_MemLibPublishedARMinorVersion = 5
      rba_MemLibPublishedARRevisionVersion = 0
      rba_MemLibPublishedArxmlVersion = 00048
  module config CanSM
    CanSMConfiguration
      Can_Network_CANNODE_0 (CanSMManagerNetwork): CanSMNetworkIndex=0
  module config Com
    ComConfig
      IP_TestECU_TestCode_Tx_Can_Network_Channel_CAN_Rx (ComIPdu): ComIPduHandleId=0
      IP_ApplicationECU_TestResult_Tx_Can_Network_Channel_CAN_Tx (ComIPdu): ComIPduHandleId=0
      S_TestECU_SG_TestCode_Tx_Can_Network_Channel_CAN_Rx (ComSignal): ComHandleId=0
      S_ApplicationECU_SG_TestResult_Tx_Can_Network_Channel_CAN_Tx (ComSignal): ComHandleId=0
      ComIPduGroup_Rx (ComIPduGroup): ComIPduGroupHandleId=0
      ComIPduGroup_Tx (ComIPduGroup): ComIPduGroupHandleId=1
  module config MemIf
    MemIfGeneral:
      MemIfNumberOfDevices = 1
      MemIfRbFeeUsed = true
      MemIfRbNumberOfEADevices = 0
      MemIfMainFunctionCycleTime = 0.001
      MemIfRbMainFunctionScheduling = MEMIF_RB_MAINFUNC_SCHEDULING_RTE_TIMED
  module config Fee
    FeeGeneral: FeePollingMode=true, FeeMainFunctionPeriod=0.0, FeeRbMainFunctionScheduling=FEE_RB_MAINFUNC_SCHEDULING_MANUAL
    3 x FeeBlockConfiguration, all with FeeImmediateData=false, FeeNumberOfWriteCycles=1, FeeRbFirstReadDataMigration=false, FeeRbDeviceIndex=0, FeeRbNoFallback=false, FeeRbOrigin=NVM, FeeRbSecLevel=1, FeeRbSurvival=false, FeeRbVarBlockLength=false:
      ECUM_CFG_NVM_BLOCK: FeeBlockSize=4, FeeRbBlockPersistentId=62199
      NvM_NativeBlock_2: FeeBlockSize=2, FeeRbBlockPersistentId=42697
      NvM_NativeBlock_3: FeeBlockSize=2, FeeRbBlockPersistentId=46912
  module config rba_MemLibVal
    3 x rba_MemLibValComp:
      NvM
      MemIf
      Fee
  module config Fls_Fee: definition=Fls
    FlsGeneral:
      FlsMainFunctionPeriod = 0.0
      FlsRbMainFunctionScheduling = FLS_RB_MAINFUNC_SCHEDULING_MANUAL
      FlsRbMachineType = MCU_RB_EVE_AUTOSAR
      FlsDriverIndex = 0
      FlsCancelApi = false
      FlsRbCancelApi = false
      FlsGetStatusApi = true
      FlsCompareApi = true
      FlsGetJobResultApi = true
      FlsRbWriteWithoutTransientErrorApi = true
      FlsBlankCheckApi = true
      FlsSetModeApi = false
    FlsConfigSet: FlsRbDeviceType=RBA_FLSPC_DFLASH, FlsDefaultMode=MEMIF_MODE_SLOW
      FlsSectorList
        Fls_Fee (FlsSector): FlsPageSize=8, FlsSectorSize=1024, FlsSectorStartaddress=0, FlsNumberOfSectors=2
  module config PduR
    PduRRoutingPaths
      TestECU_TestCode_Tx_CanIf2PduR_Can_Network_Channel_CAN (PduRSrcPdu): PduRSourcePduHandleId=0
      ApplicationECU_TestResult_Tx_PduR2CanIf_Can_Network_Channel_CAN (PduRDestPdu): PduRDestPduHandleId=0
      ApplicationECU_TestResult_Tx_Com2PduR_Can_Network_Channel_CAN (PduRSrcPdu): PduRSourcePduHandleId=0
      TestECU_TestCode_Tx_PduR2Com_Can_Network_Channel_CAN (PduRDestPdu): PduRDestPduHandleId=0
package /RB/UBK/Project/EcucModuleConfigurationValuess
  module config rba_ArxmlGen
    6 x rba_ArxmlGen_Comp:
      PduR
        PduR_Init (rba_ArxmlGen_BswModuleEntry):
          rba_ArxmlGen_IsReentrant = false
          rba_ArxmlGen_IsSynchronus = true
          rba_ArxmlGen_BswCallType = REGULAR
          rba_ArxmlGen_BswExecutionContext = UNSPECIFIED
          rba_ArxmlGen_swServiceImplPolicy = STANDARD
        PduR_GetVersionInfo (rba_ArxmlGen_BswModuleEntry):
          rba_ArxmlGen_IsReentrant = false
          rba_ArxmlGen_IsSynchronus = true
          rba_ArxmlGen_BswCallType = CALLBACK
          rba_ArxmlGen_BswExecutionContext = UNSPECIFIED
          rba_ArxmlGen_swServiceImplPolicy = STANDARD
        CE_Init (rba_ArxmlGen_ExecEntity): rba_ArxmlGen_ExecEntityCategory=Called, rba_ArxmlGen_ExecEntityImplEntryRef=PduR_Init
      ComM: rba_ArxmlGen_CompVersionSw=5.0.0
        SE_MainFunction_Can_Network_Channel_Can_Network (rba_ArxmlGen_ExecEntity):
          rba_ArxmlGen_ExecEntityCategory = Schedulable
          rba_ArxmlGen_ExecEntityPeriod = 0.01
          rba_ArxmlGen_ExecEntityImplEntryRef = ComM_MainFunction_Can_Network_Channel_Can_Network
        ComM_Init (rba_ArxmlGen_BswModuleEntry):
          rba_ArxmlGen_IsReentrant = false
          rba_ArxmlGen_IsSynchronus = true
          rba_ArxmlGen_BswCallType = REGULAR
          rba_ArxmlGen_BswExecutionContext = UNSPECIFIED
          rba_ArxmlGen_swServiceImplPolicy = STANDARD
        ComM_MainFunction_Can_Network_Channel_Can_Network (rba_ArxmlGen_BswModuleEntry):
          rba_ArxmlGen_IsReentrant = false
          rba_ArxmlGen_IsSynchronus = true
          rba_ArxmlGen_BswCallType = SCHEDULED
          rba_ArxmlGen_BswExecutionContext = TASK
          rba_ArxmlGen_swServiceImplPolicy = STANDARD
        ComM_UserStruct_Array_App (rba_ArxmlGen_ApplDataType): rba_ArxmlGen_ApplDataTypeNumElements=1
        ComM_ChannelStruct_Array_App (rba_ArxmlGen_ApplDataType): rba_ArxmlGen_ApplDataTypeNumElements=1
        ComM_UserStruct_Array_Impl (rba_ArxmlGen_ImplDataType): rba_ArxmlGen_ImplDataTypeNumElements=1
        ComM_ChannelStruct_Array_Impl (rba_ArxmlGen_ImplDataType): rba_ArxmlGen_ImplDataTypeNumElements=1
      CanSM
        CanSM_Au8_app (rba_ArxmlGen_ApplDataType): rba_ArxmlGen_ApplDataTypeNumElements=1, rba_ArxmlGen_ApplDataTypeImplOwnRef=CanSM_Au8_impl
        CanSM_Au8_impl (rba_ArxmlGen_ImplDataType): rba_ArxmlGen_ImplDataTypeNumElements=1
        CanSM_Aboolean_app (rba_ArxmlGen_ApplDataType): rba_ArxmlGen_ApplDataTypeNumElements=1, rba_ArxmlGen_ApplDataTypeImplOwnRef=CanSM_Aboolean_impl
        CanSM_Aboolean_impl (rba_ArxmlGen_ImplDataType): rba_ArxmlGen_ImplDataTypeNumElements=1
        CanSM_currBOR_State_a_Aenum_app (rba_ArxmlGen_ApplDataType): rba_ArxmlGen_ApplDataTypeNumElements=1, rba_ArxmlGen_ApplDataTypeImplOwnRef=CanSM_currBOR_State_a_Aenum_impl
        CanSM_currComM_Mode_a_Aenum_app (rba_ArxmlGen_ApplDataType): rba_ArxmlGen_ApplDataTypeNumElements=1, rba_ArxmlGen_ApplDataTypeImplOwnRef=CanSM_currComM_Mode_a_Aenum_impl
        CanSM_currBOR_State_a_Aenum_impl (rba_ArxmlGen_ImplDataType): rba_ArxmlGen_ImplDataTypeNumElements=1
        CanSM_currComM_Mode_a_Aenum_impl (rba_ArxmlGen_ImplDataType): rba_ArxmlGen_ImplDataTypeNumElements=1
        CanSM_TimerConfig_ast_Astruct_app (rba_ArxmlGen_ApplDataType): rba_ArxmlGen_ApplDataTypeNumElements=1, rba_ArxmlGen_ApplDataTypeImplOwnRef=CanSM_TimerConfig_ast_Astruct_impl
        CanSM_TimerConfig_ast_Astruct_impl (rba_ArxmlGen_ImplDataType): rba_ArxmlGen_ImplDataTypeNumElements=1
        SE_MainFunction (rba_ArxmlGen_ExecEntity): rba_ArxmlGen_ExecEntityPeriod=0.01
      NvM: rba_ArxmlGen_CompCategory=BswModule, rba_ArxmlGen_CompId=20, rba_ArxmlGen_CompIsConfigurable=true, rba_ArxmlGen_CompIsStandalone=false, rba_ArxmlGen_CompIsStandardized=true, rba_ArxmlGen_CompLongName=NVRAM Manager, rba_ArxmlGen_CompVersionAr=4.5.0, rba_ArxmlGen_CompVersionSw=22.0.1, rba_ArxmlGen_EnableBswImplementations=false, rba_ArxmlGen_CompSwcBswMappingRef=NvM
        4 x rba_ArxmlGen_CompuMethod, all with rba_ArxmlGen_CompuMethodCategory=TextTable:
          NvM_Rb_StatusType: rba_ArxmlGen_CompuMethodLongName=Computation method for the type of the current overall status of the NVRAM manager.
            3 x rba_ArxmlGen_CompuMethodTextEntry, all with rba_ArxmlGen_CompuMethodTENumVals=1:
              NVM_RB_STATUS_UNINIT: rba_ArxmlGen_CompuMethodTEIntVal=0, rba_ArxmlGen_CompuMethodTEText=NVM_RB_STATUS_UNINIT
              NVM_RB_STATUS_IDLE: rba_ArxmlGen_CompuMethodTEIntVal=1, rba_ArxmlGen_CompuMethodTEText=NVM_RB_STATUS_IDLE
              NVM_RB_STATUS_BUSY: rba_ArxmlGen_CompuMethodTEIntVal=2, rba_ArxmlGen_CompuMethodTEText=NVM_RB_STATUS_BUSY
          NvM_RequestResultType: rba_ArxmlGen_CompuMethodLongName=Computation method for the type of the block request result.
            9 x rba_ArxmlGen_CompuMethodTextEntry, all with rba_ArxmlGen_CompuMethodTENumVals=1:
              NVM_REQ_OK: rba_ArxmlGen_CompuMethodTEIntVal=0, rba_ArxmlGen_CompuMethodTEText=NVM_REQ_OK
              NVM_REQ_NOT_OK: rba_ArxmlGen_CompuMethodTEIntVal=1, rba_ArxmlGen_CompuMethodTEText=NVM_REQ_NOT_OK
              NVM_REQ_PENDING: rba_ArxmlGen_CompuMethodTEIntVal=2, rba_ArxmlGen_CompuMethodTEText=NVM_REQ_PENDING
              NVM_REQ_INTEGRITY_FAILED: rba_ArxmlGen_CompuMethodTEIntVal=3, rba_ArxmlGen_CompuMethodTEText=NVM_REQ_INTEGRITY_FAILED
              NVM_REQ_BLOCK_SKIPPED: rba_ArxmlGen_CompuMethodTEIntVal=4, rba_ArxmlGen_CompuMethodTEText=NVM_REQ_BLOCK_SKIPPED
              NVM_REQ_NV_INVALIDATED: rba_ArxmlGen_CompuMethodTEIntVal=5, rba_ArxmlGen_CompuMethodTEText=NVM_REQ_NV_INVALIDATED
              NVM_REQ_CANCELED: rba_ArxmlGen_CompuMethodTEIntVal=6, rba_ArxmlGen_CompuMethodTEText=NVM_REQ_CANCELED
              NVM_REQ_REDUNDANCY_FAILED: rba_ArxmlGen_CompuMethodTEIntVal=7, rba_ArxmlGen_CompuMethodTEText=NVM_REQ_REDUNDANCY_FAILED
              NVM_REQ_RESTORED_FROM_ROM: rba_ArxmlGen_CompuMethodTEIntVal=8, rba_ArxmlGen_CompuMethodTEText=NVM_REQ_RESTORED_FROM_ROM
          NvM_Rb_ErrorInfoDetail_ten: rba_ArxmlGen_CompuMethodLongName=Computation method for the type of the detailed error info result.
            5 x rba_ArxmlGen_CompuMethodTextEntry, all with rba_ArxmlGen_CompuMethodTENumVals=1:
              NvM_Rb_ErrorInfoDetail_NotAvailable_e: rba_ArxmlGen_CompuMethodTEIntVal=0, rba_ArxmlGen_CompuMethodTEText=NvM_Rb_ErrorInfoDetail_NotAvailable_e
              NvM_Rb_ErrorInfoDetail_BlockNotFoundOnMedium_e: rba_ArxmlGen_CompuMethodTEIntVal=1, rba_ArxmlGen_CompuMethodTEText=NvM_Rb_ErrorInfoDetail_BlockNotFoundOnMedium_e
              NvM_Rb_ErrorInfoDetail_InconsistentData_e: rba_ArxmlGen_CompuMethodTEIntVal=2, rba_ArxmlGen_CompuMethodTEText=NvM_Rb_ErrorInfoDetail_InconsistentData_e
              NvM_Rb_ErrorInfoDetail_VersionMismatch_e: rba_ArxmlGen_CompuMethodTEIntVal=3, rba_ArxmlGen_CompuMethodTEText=NvM_Rb_ErrorInfoDetail_VersionMismatch_e
              NvM_Rb_ErrorInfoDetail_CryptoFailed_e: rba_ArxmlGen_CompuMethodTEIntVal=4, rba_ArxmlGen_CompuMethodTEText=NvM_Rb_ErrorInfoDetail_CryptoFailed_e
          NvM_Rb_MigrationResult_ten: rba_ArxmlGen_CompuMethodLongName=Computation method for the type of the migration result.
            6 x rba_ArxmlGen_CompuMethodTextEntry, all with rba_ArxmlGen_CompuMethodTENumVals=1:
              NVM_RB_MIGRATION_RESULT_INIT_E: rba_ArxmlGen_CompuMethodTEIntVal=0, rba_ArxmlGen_CompuMethodTEText=NVM_RB_MIGRATION_RESULT_INIT_E
              NVM_RB_MIGRATION_RESULT_NOT_NECESSARY_E: rba_ArxmlGen_CompuMethodTEIntVal=1, rba_ArxmlGen_CompuMethodTEText=NVM_RB_MIGRATION_RESULT_NOT_NECESSARY_E
              NVM_RB_MIGRATION_RESULT_TO_SMALLER_SIZE_E: rba_ArxmlGen_CompuMethodTEIntVal=2, rba_ArxmlGen_CompuMethodTEText=NVM_RB_MIGRATION_RESULT_TO_SMALLER_SIZE_E
              NVM_RB_MIGRATION_RESULT_TO_BIGGER_SIZE_E: rba_ArxmlGen_CompuMethodTEIntVal=3, rba_ArxmlGen_CompuMethodTEText=NVM_RB_MIGRATION_RESULT_TO_BIGGER_SIZE_E
              NVM_RB_MIGRATION_RESULT_NOT_DONE_E: rba_ArxmlGen_CompuMethodTEIntVal=4, rba_ArxmlGen_CompuMethodTEText=NVM_RB_MIGRATION_RESULT_NOT_DONE_E
              NVM_RB_MIGRATION_RESULT_DEACTIVATED_E: rba_ArxmlGen_CompuMethodTEIntVal=5, rba_ArxmlGen_CompuMethodTEText=NVM_RB_MIGRATION_RESULT_DEACTIVATED_E
        3 x rba_ArxmlGen_DataConstraint, all with rba_ArxmlGen_DataConstraintCategory=Physical, rba_ArxmlGen_DataConstraintLower=0, rba_ArxmlGen_DataConstraintUnitRef=Mem_NoUnit:
          NvM_Constr_NoUnit_u32: rba_ArxmlGen_DataConstraintUpper=4294967295
          NvM_Constr_NoUnit_u16: rba_ArxmlGen_DataConstraintUpper=65535
          NvM_Constr_NoUnit_u8: rba_ArxmlGen_DataConstraintUpper=255
        30 x rba_ArxmlGen_ExecEntity:
          CE_CancelWriteAll: rba_ArxmlGen_ExecEntityCategory=Called, rba_ArxmlGen_ExecEntityImplEntryRef=NvM_CancelWriteAll
          CE_EraseNvBlock: rba_ArxmlGen_ExecEntityCategory=Called, rba_ArxmlGen_ExecEntityImplEntryRef=NvM_EraseNvBlock
          CE_GetDataIndex: rba_ArxmlGen_ExecEntityCategory=Called, rba_ArxmlGen_ExecEntityImplEntryRef=NvM_GetDataIndex
          CE_GetErrorStatus: rba_ArxmlGen_ExecEntityCategory=Called, rba_ArxmlGen_ExecEntityImplEntryRef=NvM_GetErrorStatus
          CE_Init: rba_ArxmlGen_ExecEntityCategory=Called, rba_ArxmlGen_ExecEntityImplEntryRef=NvM_Init
          CE_InvalidateNvBlock: rba_ArxmlGen_ExecEntityCategory=Called, rba_ArxmlGen_ExecEntityImplEntryRef=NvM_InvalidateNvBlock
          SE_MainFunction: rba_ArxmlGen_ExecEntityPeriod=0.001, rba_ArxmlGen_ExecEntityCategory=Schedulable, rba_ArxmlGen_ExecEntityImplEntryRef=NvM_MainFunction
          CE_Rb_ClrWriteMonCntrs: rba_ArxmlGen_ExecEntityCategory=Called, rba_ArxmlGen_ExecEntityImplEntryRef=NvM_Rb_ClrWriteMonCntrs
          CE_Rb_FirstInitAll: rba_ArxmlGen_ExecEntityCategory=Called, rba_ArxmlGen_ExecEntityImplEntryRef=NvM_Rb_FirstInitAll
          CE_Rb_GetActiveService: rba_ArxmlGen_ExecEntityCategory=Called, rba_ArxmlGen_ExecEntityImplEntryRef=NvM_Rb_GetActiveService
          CE_Rb_GetBlockId: rba_ArxmlGen_ExecEntityCategory=Called, rba_ArxmlGen_ExecEntityImplEntryRef=NvM_Rb_GetBlockId
          CE_Rb_GetErrorInfoDetail: rba_ArxmlGen_ExecEntityCategory=Called, rba_ArxmlGen_ExecEntityImplEntryRef=NvM_Rb_GetErrorInfoDetail
          CE_Rb_GetMigrationResult: rba_ArxmlGen_ExecEntityCategory=Called, rba_ArxmlGen_ExecEntityImplEntryRef=NvM_Rb_GetMigrationResult
          CE_Rb_GetNvBlockLength: rba_ArxmlGen_ExecEntityCategory=Called, rba_ArxmlGen_ExecEntityImplEntryRef=NvM_Rb_GetNvBlockLength
          CE_Rb_GetStatus: rba_ArxmlGen_ExecEntityCategory=Called, rba_ArxmlGen_ExecEntityImplEntryRef=NvM_Rb_GetStatus
          CE_Rb_GetWriteCounter: rba_ArxmlGen_ExecEntityCategory=Called, rba_ArxmlGen_ExecEntityImplEntryRef=NvM_Rb_GetWriteCounter
          CE_ReadAll: rba_ArxmlGen_ExecEntityCategory=Called, rba_ArxmlGen_ExecEntityImplEntryRef=NvM_ReadAll
          CE_ReadBlock: rba_ArxmlGen_ExecEntityCategory=Called, rba_ArxmlGen_ExecEntityImplEntryRef=NvM_ReadBlock
          CE_ReadPRAMBlock: rba_ArxmlGen_ExecEntityCategory=Called, rba_ArxmlGen_ExecEntityImplEntryRef=NvM_ReadPRAMBlock
          CE_RestoreBlockDefaults: rba_ArxmlGen_ExecEntityCategory=Called, rba_ArxmlGen_ExecEntityImplEntryRef=NvM_RestoreBlockDefaults
          CE_RestorePRAMBlockDefaults: rba_ArxmlGen_ExecEntityCategory=Called, rba_ArxmlGen_ExecEntityImplEntryRef=NvM_RestorePRAMBlockDefaults
          CE_SetBlockLockStatus: rba_ArxmlGen_ExecEntityCategory=Called, rba_ArxmlGen_ExecEntityImplEntryRef=NvM_SetBlockLockStatus
          CE_SetBlockProtection: rba_ArxmlGen_ExecEntityCategory=Called, rba_ArxmlGen_ExecEntityImplEntryRef=NvM_SetBlockProtection
          CE_SetDataIndex: rba_ArxmlGen_ExecEntityCategory=Called, rba_ArxmlGen_ExecEntityImplEntryRef=NvM_SetDataIndex
          CE_SetRamBlockStatus: rba_ArxmlGen_ExecEntityCategory=Called, rba_ArxmlGen_ExecEntityImplEntryRef=NvM_SetRamBlockStatus
          CE_SetWriteAllTrigger: rba_ArxmlGen_ExecEntityCategory=Called, rba_ArxmlGen_ExecEntityImplEntryRef=NvM_Rb_SetWriteAllTrigger
          CE_ValidateAll: rba_ArxmlGen_ExecEntityCategory=Called, rba_ArxmlGen_ExecEntityImplEntryRef=NvM_ValidateAll
          CE_WriteAll: rba_ArxmlGen_ExecEntityCategory=Called, rba_ArxmlGen_ExecEntityImplEntryRef=NvM_WriteAll
          CE_WriteBlock: rba_ArxmlGen_ExecEntityCategory=Called, rba_ArxmlGen_ExecEntityImplEntryRef=NvM_WriteBlock
          CE_WritePRAMBlock: rba_ArxmlGen_ExecEntityCategory=Called, rba_ArxmlGen_ExecEntityImplEntryRef=NvM_WritePRAMBlock
      CanIf
        CanIf_ControllerState_Astruct_impl (rba_ArxmlGen_ImplDataType):
          rba_ArxmlGen_ImplDataTypeCategory = Array
          rba_ArxmlGen_ImplDataTypeLongName = Implementation datatype for array of struct
          rba_ArxmlGen_ImplDataTypeNumElements = 1
          CanIf_struct_impl (rba_ArxmlGen_ImplDataTypeSub): rba_ArxmlGen_ImplDataTypeSubOwnRef=CanIf_ControllerStateType_struct_impl
        CanIf_ControllerState_Astruct_app (rba_ArxmlGen_ApplDataType):
          rba_ArxmlGen_ApplDataTypeCategory = Array
          rba_ArxmlGen_ApplDataTypeLongName = Structure datatype in CanIf
          rba_ArxmlGen_ApplDataTypeNumElements = 1
          rba_ArxmlGen_ApplDataTypeImplOwnRef = CanIf_ControllerState_Astruct_impl
          CanIf_ControllerStateType (rba_ArxmlGen_ApplDataTypeSub): rba_ArxmlGen_ApplDataTypeSubOwnRef=CanIf_ControllerStateType_struct_app
        CanIf_Prv_ControllerState_ast (rba_ArxmlGen_Measurement):
          rba_ArxmlGen_MeasCategory = Array
          rba_ArxmlGen_MeasDispFormat = %5.0f
          rba_ArxmlGen_MeasLongName = Can Interface controller State
          rba_ArxmlGen_MeasAddrMethodRef = INTERNAL_VAR_CLEARED
          rba_ArxmlGen_MeasApplDataTypeOwnRef = CanIf_ControllerState_Astruct_app
        CanIf_NotifStatusType_Aenum_impl (rba_ArxmlGen_ImplDataType):
          rba_ArxmlGen_ImplDataTypeCategory = Array
          rba_ArxmlGen_ImplDataTypeLongName = implementation data type for array of enum
          rba_ArxmlGen_ImplDataTypeNumElements = 1
          CanIf_Enum_impl (rba_ArxmlGen_ImplDataTypeSub): rba_ArxmlGen_ImplDataTypeSubOwnRef=CanIf_NotifStatusType_Enum_impl
        CanIf_NotifStatusType_Aenum_app (rba_ArxmlGen_ApplDataType):
          rba_ArxmlGen_ApplDataTypeCategory = Array
          rba_ArxmlGen_ApplDataTypeLongName = application data type for array of enum
          rba_ArxmlGen_ApplDataTypeNumElements = 1
          rba_ArxmlGen_ApplDataTypeImplOwnRef = CanIf_NotifStatusType_Aenum_impl
          CanIf_NotifStatusType (rba_ArxmlGen_ApplDataTypeSub): rba_ArxmlGen_ApplDataTypeSubOwnRef=CanIf_NotifStatusType_Enum_app
        CanIf_Prv_TxNotification_aen (rba_ArxmlGen_Measurement):
          rba_ArxmlGen_MeasCategory = Array
          rba_ArxmlGen_MeasDispFormat = %5.0f
          rba_ArxmlGen_MeasLongName = Can Interface Transmit Notification
          rba_ArxmlGen_MeasAddrMethodRef = INTERNAL_VAR_CLEARED
          rba_ArxmlGen_MeasApplDataTypeOwnRef = CanIf_NotifStatusType_Aenum_app
      Com: rba_ArxmlGen_CompVersionSw=5.0.0
        Com_SigBufComMainFunctionRx_au8_impl (rba_ArxmlGen_ImplDataType):
          rba_ArxmlGen_ImplDataTypeCategory = Array
          rba_ArxmlGen_ImplDataTypeNumElements = 1
          rba_ArxmlGen_ImplDataTypeLongName = Implementation data type for Signals of type - uint8,sint8,boolean,uint8_n
          Com_SubimplComMainFunctionRx_u8 (rba_ArxmlGen_ImplDataTypeSub): rba_ArxmlGen_ImplDataTypeSubOwnRef=Com_impl_u8
        Com_SigBufComMainFunctionRx_au8 (rba_ArxmlGen_ApplDataType):
          rba_ArxmlGen_ApplDataTypeCategory = Array
          rba_ArxmlGen_ApplDataTypeNumElements = 1
          rba_ArxmlGen_ApplDataTypeLongName = Application data type for Signals of type - uint8,sint8,boolean,uint8_n
          rba_ArxmlGen_ApplDataTypeImplOwnRef = Com_SigBufComMainFunctionRx_au8_impl
          Com_SubappComMainFunctionRx_u8 (rba_ArxmlGen_ApplDataTypeSub): rba_ArxmlGen_ApplDataTypeSubOwnRef=Com_uint8
        Com_RxSigBuf_ComMainFunctionRx_au8 (rba_ArxmlGen_Measurement):
          rba_ArxmlGen_MeasCategory = Array
          rba_ArxmlGen_MeasDispFormat = %5.0f
          rba_ArxmlGen_MeasLongName = Measurement variable for Signals of type - uint8,sint8,boolean,uint8_n. To refer Individual element in the Buffer array, Fetch Buffer Index from Com_PBcfg.c for each signal.
          rba_ArxmlGen_MeasAddrMethodRef = INTERNAL_VAR_CLEARED
          rba_ArxmlGen_MeasApplDataTypeOwnRef = Com_SigBufComMainFunctionRx_au8
        Com_implDataType_au8_Size8 (rba_ArxmlGen_ImplDataType):
          rba_ArxmlGen_ImplDataTypeCategory = Array
          rba_ArxmlGen_ImplDataTypeLongName = Implementation data type for Ipdu buffer of Size8
          rba_ArxmlGen_ImplDataTypeNumElements = 8
          Com_Subimpl8 (rba_ArxmlGen_ImplDataTypeSub): rba_ArxmlGen_ImplDataTypeSubOwnRef=Com_impl_u8
        Com_applDataType_au8_Size8 (rba_ArxmlGen_ApplDataType):
          rba_ArxmlGen_ApplDataTypeCategory = Array
          rba_ArxmlGen_ApplDataTypeLongName = Application data type for Ipdu buffer of Size8
          rba_ArxmlGen_ApplDataTypeNumElements = 8
          rba_ArxmlGen_ApplDataTypeImplOwnRef = Com_implDataType_au8_Size8
          Com_Subapp8 (rba_ArxmlGen_ApplDataTypeSub): rba_ArxmlGen_ApplDataTypeSubOwnRef=Com_uint8
        Com_dIP_ApplicationECU_TestResult_Tx_Can_Network_Channel_CAN_TxByte (rba_ArxmlGen_Measurement):
          rba_ArxmlGen_MeasCategory = Array
          rba_ArxmlGen_MeasDispFormat = %5.0f
          rba_ArxmlGen_MeasLongName = Tx Ipdu buffer of IPdu -IP_ApplicationECU_TestResult_Tx_Can_Network_Channel_CAN_Tx- as a Measurement parameter
          rba_ArxmlGen_MeasAddrMethodRef = INTERNAL_VAR_CLEARED
          rba_ArxmlGen_MeasApplDataTypeOwnRef = Com_applDataType_au8_Size8
        Com_dIP_TestECU_TestCode_Tx_Can_Network_Channel_CAN_RxByte (rba_ArxmlGen_Measurement):
          rba_ArxmlGen_MeasCategory = Array
          rba_ArxmlGen_MeasDispFormat = %5.0f
          rba_ArxmlGen_MeasLongName = Rx Local Ipdu buffer of IPdu -IP_TestECU_TestCode_Tx_Can_Network_Channel_CAN_Rx- as a Measurement parameter
          rba_ArxmlGen_MeasAddrMethodRef = INTERNAL_VAR_CLEARED
          rba_ArxmlGen_MeasApplDataTypeOwnRef = Com_applDataType_au8_Size8
        Com_MainFunctionRx_ComMainFunctionRx (rba_ArxmlGen_BswModuleEntry):
          rba_ArxmlGen_IsReentrant = false
          rba_ArxmlGen_IsSynchronus = true
          rba_ArxmlGen_BswCallType = SCHEDULED
          rba_ArxmlGen_BswExecutionContext = TASK
          rba_ArxmlGen_swServiceImplPolicy = STANDARD
        Com_MainFunctionTx_ComMainFunctionTx (rba_ArxmlGen_BswModuleEntry):
          rba_ArxmlGen_IsReentrant = false
          rba_ArxmlGen_IsSynchronus = true
          rba_ArxmlGen_BswCallType = SCHEDULED
          rba_ArxmlGen_BswExecutionContext = TASK
          rba_ArxmlGen_swServiceImplPolicy = STANDARD
        SE_MainFunctionRx_ComMainFunctionRx (rba_ArxmlGen_ExecEntity):
          rba_ArxmlGen_ExecEntityCategory = Schedulable
          rba_ArxmlGen_ExecEntityPeriod = 0.01
          rba_ArxmlGen_ExecEntityImplEntryRef = Com_MainFunctionRx_ComMainFunctionRx
        SE_MainFunctionTx_ComMainFunctionTx (rba_ArxmlGen_ExecEntity):
          rba_ArxmlGen_ExecEntityCategory = Schedulable
          rba_ArxmlGen_ExecEntityPeriod = 0.01
          rba_ArxmlGen_ExecEntityImplEntryRef = Com_MainFunctionTx_ComMainFunctionTx
        4 x rba_ArxmlGen_Memsection:
          CODE: rba_ArxmlGen_MemsectionAddrMethodRef=CODE
          CONST: rba_ArxmlGen_MemsectionDatatype_UNSPECIFIED=true, rba_ArxmlGen_MemsectionAddrMethodRef=CONST
          CONFIG_DATA: rba_ArxmlGen_MemsectionDatatype_64=true, rba_ArxmlGen_MemsectionDatatype_32=true, rba_ArxmlGen_MemsectionDatatype_16=true, rba_ArxmlGen_MemsectionDatatype_08=true, rba_ArxmlGen_MemsectionDatatype_UNSPECIFIED=true, rba_ArxmlGen_MemsectionAddrMethodRef=CONFIG_DATA
          VAR_CLEARED: rba_ArxmlGen_MemsectionDatatype_08=true, rba_ArxmlGen_MemsectionDatatype_16=true, rba_ArxmlGen_MemsectionDatatype_32=true, rba_ArxmlGen_MemsectionDatatype_64=true, rba_ArxmlGen_MemsectionDatatype_UNSPECIFIED=true, rba_ArxmlGen_MemsectionAddrMethodRef=VAR_CLEARED
