AUTOSAR XML (schema 00048)
package /AUTOSAR_Fee/BswModuleDescriptions
  bsw module description Fee: category=BSW_MODULE  # Flash Eeprom Emulation
    bsw internal behavior BswInternalBehavior
package /AUTOSAR_Fee/BswImplementations
  bsw implementation Fee: programming-language=C, sw-version=22.0.1, vendor-id=6, ar-release-version=4.5.0, behavior=Fee/BswInternalBehavior
    code-descriptors:
      code CodeDescriptor: artifact-descriptors=autosar-engineering-object={short-label=ArEngObj, category=SWSRC}
    resource consumption Fee_ResourceConsumption
      21 x memory section, all with prefix=FEE:
        FEE_VAR_CLEARED_8: alignment=8, sw-addrmethod=VAR_CLEARED, symbol=VAR_CLEARED_8
        FEE_VAR_CLEARED_16: alignment=16, sw-addrmethod=VAR_CLEARED, symbol=VAR_CLEARED_16
        FEE_VAR_CLEARED_32: alignment=32, sw-addrmethod=VAR_CLEARED, symbol=VAR_CLEARED_32
        FEE_VAR_CLEARED_UNSPECIFIED: alignment=UNSPECIFIED, sw-addrmethod=VAR_CLEARED, symbol=VAR_CLEARED_UNSPECIFIED
        FEE_VAR_INIT_8: alignment=8, sw-addrmethod=VAR_INIT, symbol=VAR_INIT_8
        FEE_VAR_INIT_16: alignment=16, sw-addrmethod=VAR_INIT, symbol=VAR_INIT_16
        FEE_VAR_INIT_32: alignment=32, sw-addrmethod=VAR_INIT, symbol=VAR_INIT_32
        FEE_VAR_INIT_UNSPECIFIED: alignment=UNSPECIFIED, sw-addrmethod=VAR_INIT, symbol=VAR_INIT_UNSPECIFIED
        FEE_VAR_SAVED_ZONE_8: alignment=8, sw-addrmethod=VAR_SAVED_ZONE, symbol=VAR_SAVED_ZONE_8
        FEE_VAR_SAVED_ZONE_16: alignment=16, sw-addrmethod=VAR_SAVED_ZONE, symbol=VAR_SAVED_ZONE_16
        FEE_VAR_SAVED_ZONE_32: alignment=32, sw-addrmethod=VAR_SAVED_ZONE, symbol=VAR_SAVED_ZONE_32
        FEE_VAR_SAVED_ZONE_UNSPECIFIED: alignment=UNSPECIFIED, sw-addrmethod=VAR_SAVED_ZONE, symbol=VAR_SAVED_ZONE_UNSPECIFIED
        FEE_CONST_8: alignment=8, sw-addrmethod=CONST, symbol=CONST_8
        FEE_CONST_16: alignment=16, sw-addrmethod=CONST, symbol=CONST_16
        FEE_CONST_32: alignment=32, sw-addrmethod=CONST, symbol=CONST_32
        FEE_CONST_UNSPECIFIED: alignment=UNSPECIFIED, sw-addrmethod=CONST, symbol=CONST_UNSPECIFIED
        FEE_VAR_SECURED_CLEARED_32: alignment=32, sw-addrmethod=VAR_SECURED_CLEARED, symbol=VAR_SECURED_CLEARED_32
        FEE_VAR_SECURED_CLEARED_8: alignment=8, sw-addrmethod=VAR_SECURED_CLEARED, symbol=VAR_SECURED_CLEARED_8
        FEE_VAR_SECURED_CLEARED_UNSPECIFIED: alignment=UNSPECIFIED, sw-addrmethod=VAR_SECURED_CLEARED, symbol=VAR_SECURED_CLEARED_UNSPECIFIED
        FEE_VAR_SECURED_CACHED_RAM_ALIGNED_CLEARED_UNSPECIFIED: alignment=UNSPECIFIED, sw-addrmethod=VAR_SECURED_CACHED_RAM_ALIGNED_CLEARED, symbol=VAR_SECURED_CACHED_RAM_ALIGNED_CLEARED_UNSPECIFIED
        FEE_CODE: sw-addrmethod=CODE, symbol=CODE
      section name prefix FEE
package /AUTOSAR_Fee/BswModuleEntrys
  bsw module entry Fee_MainFunction: is-reentrant=true, is-synchronous=true, call-type=SCHEDULED, execution-context=TASK, sw-service-impl-policy=STANDARD  # Performs the cyclic processing of jobs. | Service to handle the requested read / write / erase jobs and the internal management operations.
package /AUTOSAR_Fee/BswModuleDescriptions
  bsw module description Fee: category=BSW_MODULE, provided-entrys=Fee_MainFunction  # Flash EEPROM Emulation
    bsw internal behavior BswInternalBehavior
