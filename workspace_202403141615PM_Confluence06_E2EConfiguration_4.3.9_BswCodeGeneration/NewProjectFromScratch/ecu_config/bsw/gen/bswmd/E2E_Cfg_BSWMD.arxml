AUTOSAR XML (schema 4-2-2)
package /AUTOSAR_E2E/BswImplementations
  bsw implementation E2E: programming-language=C, sw-version=2.0.0, ar-release-version=4.2.2, behavior=BswInternalBehavior, vendor-specific-module-def=E2E
    code-descriptors:
      code CodeDescriptor: artifact-descriptors=autosar-engineering-object={short-label=ArEngObj, category=SWSRC}
    resource consumption E2E_ResourceConsumption
      memory section E2E_CODE: prefix=E2E, sw-addrmethod=CODE, symbol=CODE
      memory section E2E_CONST_8: prefix=E2E, sw-addrmethod=CONST, symbol=CONST_8
      section name prefix E2E
package /AUTOSAR_E2E/BswModuleDescriptions
  bsw module description E2E: category=BSW_MODULE, module-id=207
    provided-entrys:
      E2E_P01ProtectInit
      E2E_P01Protect
      E2E_P01CheckInit
      E2E_P01Check
      E2E_P01MapStatusToSM
      E2E_P02ProtectInit
      E2E_P02Protect
      E2E_P02CheckInit
      E2E_P02Check
      E2E_P02MapStatusToSM
      E2E_P04ProtectInit
      E2E_P04Protect
      E2E_P04CheckInit
      E2E_P04Check
      E2E_P04MapStatusToSM
      E2E_P05ProtectInit
      E2E_P05Protect
      E2E_P05CheckInit
      E2E_P05Check
      E2E_P05MapStatusToSM
      E2E_P06ProtectInit
      E2E_P06Protect
      E2E_P06CheckInit
      E2E_P06Check
      E2E_P06MapStatusToSM
      E2E_P07ProtectInit
      E2E_P07Protect
      E2E_P07CheckInit
      E2E_P07Check
      E2E_P07MapStatusToSM
      E2E_P11ProtectInit
      E2E_P11Protect
      E2E_P11CheckInit
      E2E_P11Check
      E2E_P11MapStatusToSM
      E2E_P22ProtectInit
      E2E_P22Protect
      E2E_P22CheckInit
      E2E_P22Check
      E2E_P22MapStatusToSM
      E2E_P44ProtectInit
      E2E_P44Protect
      E2E_P44CheckInit
      E2E_P44Check
      E2E_P44MapStatusToSM
      E2E_SMCheckInit
      E2E_SMCheck
      E2E_GetVersionInfo
    bsw module dependency Crc: target-module-id=201
    bsw internal behavior BswInternalBehavior
      48 x bsw called entity:
        CE_E2E_P01ProtectInit: implemented-entry=E2E_P01ProtectInit
        CE_E2E_P01Protect: implemented-entry=E2E_P01Protect
        CE_E2E_P01CheckInit: implemented-entry=E2E_P01CheckInit
        CE_E2E_P01Check: implemented-entry=E2E_P01Check
        CE_E2E_P01MapStatusToSM: implemented-entry=E2E_P01MapStatusToSM
        CE_E2E_P02ProtectInit: implemented-entry=E2E_P02ProtectInit
        CE_E2E_P02Protect: implemented-entry=E2E_P02Protect
        CE_E2E_P02CheckInit: implemented-entry=E2E_P02CheckInit
        CE_E2E_P02Check: implemented-entry=E2E_P02Check
        CE_E2E_P02MapStatusToSM: implemented-entry=E2E_P02MapStatusToSM
        CE_E2E_P04ProtectInit: implemented-entry=E2E_P04ProtectInit
        CE_E2E_P04Protect: implemented-entry=E2E_P04Protect
        CE_E2E_P04CheckInit: implemented-entry=E2E_P04CheckInit
        CE_E2E_P04Check: implemented-entry=E2E_P04Check
        CE_E2E_P04MapStatusToSM: implemented-entry=E2E_P04MapStatusToSM
        CE_E2E_P05ProtectInit: implemented-entry=E2E_P05ProtectInit
        CE_E2E_P05Protect: implemented-entry=E2E_P05Protect
        CE_E2E_P05CheckInit: implemented-entry=E2E_P05CheckInit
        CE_E2E_P05Check: implemented-entry=E2E_P05Check
        CE_E2E_P05MapStatusToSM: implemented-entry=E2E_P05MapStatusToSM
        CE_E2E_P06ProtectInit: implemented-entry=E2E_P06ProtectInit
        CE_E2E_P06Protect: implemented-entry=E2E_P06Protect
        CE_E2E_P06CheckInit: implemented-entry=E2E_P06CheckInit
        CE_E2E_P06Check: implemented-entry=E2E_P06Check
        CE_E2E_P06MapStatusToSM: implemented-entry=E2E_P06MapStatusToSM
        CE_E2E_P07ProtectInit: implemented-entry=E2E_P07ProtectInit
        CE_E2E_P07Protect: implemented-entry=E2E_P07Protect
        CE_E2E_P07CheckInit: implemented-entry=E2E_P07CheckInit
        CE_E2E_P07Check: implemented-entry=E2E_P07Check
        CE_E2E_P07MapStatusToSM: implemented-entry=E2E_P07MapStatusToSM
        CE_E2E_P11ProtectInit: implemented-entry=E2E_P11ProtectInit
        CE_E2E_P11Protect: implemented-entry=E2E_P11Protect
        CE_E2E_P11CheckInit: implemented-entry=E2E_P11CheckInit
        CE_E2E_P11Check: implemented-entry=E2E_P11Check
        CE_E2E_P11MapStatusToSM: implemented-entry=E2E_P11MapStatusToSM
        CE_E2E_P22ProtectInit: implemented-entry=E2E_P22ProtectInit
        CE_E2E_P22Protect: implemented-entry=E2E_P22Protect
        CE_E2E_P22CheckInit: implemented-entry=E2E_P22CheckInit
        CE_E2E_P22Check: implemented-entry=E2E_P22Check
        CE_E2E_P22MapStatusToSM: implemented-entry=E2E_P22MapStatusToSM
        CE_E2E_P44ProtectInit: implemented-entry=E2E_P44ProtectInit
        CE_E2E_P44Protect: implemented-entry=E2E_P44Protect
        CE_E2E_P44CheckInit: implemented-entry=E2E_P44CheckInit
        CE_E2E_P44Check: implemented-entry=E2E_P44Check
        CE_E2E_P44MapStatusToSM: implemented-entry=E2E_P44MapStatusToSM
        CE_E2E_SMCheckInit: implemented-entry=E2E_SMCheckInit
        CE_E2E_SMCheck: implemented-entry=E2E_SMCheck
        CE_E2E_GetVersionInfo: implemented-entry=E2E_GetVersionInfo
package /AUTOSAR_E2E/BswModuleEntrys
  48 x bsw module entry, all with is-reentrant=true, is-synchronous=true, call-type=REGULAR, execution-context=UNSPECIFIED, sw-service-impl-policy=STANDARD:
    E2E_P01ProtectInit: service-id=27  # Initializes the Profile 01 sender state.
      return type Std_ReturnType: implementation-data-type=Std_ReturnType  # E_OK is returned if the operation was successfull. E2E_E_INPUTERR_NULL is returned if a null pointer was applied as parameter.
      sw service arg StatePtr: category=DATA_REFERENCE, direction=OUT, sw-pointer-target-props={target-category=VALUE, implementation-data-type=E2E_P01ProtectStateType}  # Pointer to port/data communication sender state.
    E2E_P01Protect: service-id=1  # Protects the array/buffer to be transmitted using the E2E profile 1. | Protects the array/buffer to be transmitted using the E2E profile 1. A message counter is added to the data stream and a crc checksum is calculated over the data, counter and data ID and added to the data stream as well. It depends on the configuration of the profile if parts of the data ID are written into the data stream or not. | Example: The following example shows the usage of the P01-Protect function: /*-------------------------------- P01 - Protect Example ------------------------------*/ /*-------------------------------- P01 - Declaration of variables ---------------------*/ E2E_P01ConfigType s_Config_P01; /* This structure holds the P01-sender-configuration */ E2E_P01ProtectStateType s_State_P01; /* This structure holds the P01-sender-state */ /* ************************************************************************************* * 8 as size is just chosen to have enough space for the protection result. * * Another number proper size is valid as well. * ***************************************************************************************/ uint8 s_Data_P01[8]; /*-------------------------------- P01 - Setup ----------------------------------------*/ s_Config_P01.DataLength = 64; /* Setting the DataLength */ s_Config_P01.MaxDeltaCounterInit = 1; /* Setting how much delta is still accepted in case of a sequence error */ s_Config_P01.CRCOffset = 0; /* The offset for the crc in the the data. Must be a int-multiple of 4 */ s_Config_P01.DataIDMode = E2E_P01_DATAID_LOW; /* Setting the DataIDMode to DATAID_LOW */ /* ************************************************************************************* * The offset for the counter in the the data. Must be a int-multiple of 8 * * and greater than the crc-offset. * ***************************************************************************************/ s_Config_P01.CounterOffset = 8; /* ************************************************************************************* * The data-id. This is for the authentication. It must be the same * * like the receiver uses (in check function). * ***************************************************************************************/ s_Config_P01.DataID = 0xABCDu; /* ************************************************************************************* * Setting the SyncCounterInit to 0 and MaxNoNewOrRepeatedData to 5 for no * * synchronisation is aimed. * ***************************************************************************************/ s_Config_P01.SyncCounterInit = 0; s_Config_P01.MaxNoNewOrRepeatedData = 5; /*---------------------------- P01 - Call of the ProtectInit Function -----------------*/ E2E_P01ProtectInit(&s_State_P01); /* Initialize the sender state structure before first usage */ /*-------------------------------- P01 - Filling with Input-Data ----------------------*/ /* first 2 bytes are reserved for CRC and counter */ s_Data_P01[2] = 0xCA; /* Data to protect. Here random value. */ s_Data_P01[3] = 0xFE; /* Data to protect. Here random value. */ s_Data_P01[4] = 0xAF; /* Data to protect. Here random value. */ s_Data_P01[5] = 0xFE; /* Data to protect. Here random value. */ s_Data_P01[6] = 0xBE; /* Data to protect. Here random value. */ s_Data_P01[7] = 0xEF; /* Data to protect. Here random value. */ /*-------------------------------- P01 - Call of the Protect Function -----------------*/ E2E_P01Protect(&s_Config_P01, &s_State_P01, s_Data_P01); /* Performing the protection of s_Data_P01 */
      return type Std_ReturnType: implementation-data-type=Std_ReturnType  # For definitions of the return values, see the preprocessor constants chapter. | E2E_E_INPUTERR_NULL E2E_E_INPUTERR_WRONG E2E_E_INTERR E2E_E_OK
      sw service arg ConfigPtr: category=DATA_REFERENCE, direction=IN, sw-pointer-target-props={target-category=VALUE, implementation-data-type=E2E_P01ConfigType}  # Pointer to static configuration.
      sw service arg StatePtr: category=DATA_REFERENCE, direction=INOUT, sw-pointer-target-props={target-category=VALUE, implementation-data-type=E2E_P01ProtectStateType}  # Pointer to port/data communication sender state. This includes the counter (see example below for more details).
      sw service arg DataPtr: category=DATA_REFERENCE, direction=INOUT, sw-pointer-target-props={target-category=VALUE, implementation-data-type=uint8}  # Pointer to the data to protect. The values like CRC and counter are saved directly into the data stream.
    E2E_P01CheckInit: service-id=28  # Initializes the Profile 01 receiver state.
      return type Std_ReturnType: implementation-data-type=Std_ReturnType  # E_OK is returned if the operation was successfull. E2E_E_INPUTERR_NULL is returned if a null pointer was applied as parameter.
      sw service arg StatePtr: category=DATA_REFERENCE, direction=OUT, sw-pointer-target-props={target-category=VALUE, implementation-data-type=E2E_P01CheckStateType}  # Pointer to port/data communication receiver state.
    E2E_P01Check: service-id=2  # Checks the data received using the E2E profile 1. | Checks the received data by using the E2E profile 1. The function calculates a CRC for the received data, counter and data ID and compares it with the CRC stored within the data stream (written by the protect function). | Example: The following example shows the usage of the P01-Check function: /*-------------------------------- P01 - Check Example --------------------------------*/ /*-------------------------------- P01 - Declaration of variables ---------------------*/ E2E_P01ConfigType r_Config_P01; /* This structure holds the P01-receiver-configuration */ E2E_P01CheckStateType r_State_P01; /* This structure holds the P01-receiver-state */ Std_ReturnType r_returnValue_P01; /* This variable holds the Check function call return value */ E2E_PCheckStatusType r_PcheckValue_P01; /* This variable holds the generic check status value used by state machine*/ uint8 i_u8; /* ************************************************************************************* * 8 as size is just chosen to have enough space for the protection result. * * Another number proper size is valid as well. * ***************************************************************************************/ uint8 r_Data_P01[8]; /*-------------------------------- P01 - Setup ----------------------------------------*/ /* ************************************************************************************* * For the config setting, the same data has to be used like for the protection. * * This is why following r_Config_P01 takes the data from s_Config_P01. * * For more details of the configuration see the example above (protect function). * ***************************************************************************************/ r_Config_P01.DataLength = s_Config_P01.DataLength; r_Config_P01.MaxDeltaCounterInit = s_Config_P01.MaxDeltaCounterInit; r_Config_P01.CRCOffset = s_Config_P01.CRCOffset; r_Config_P01.CounterOffset = s_Config_P01.CounterOffset; r_Config_P01.DataID = s_Config_P01.DataID; r_Config_P01.DataIDMode = s_Config_P01.DataIDMode; /* ************************************************************************************* * Setting the SyncCounterInit to 0 and MaxNoNewOrRepeatedData to 5 for no * * synchronisation is aimed. * ***************************************************************************************/ r_Config_P01.SyncCounterInit = s_Config_P01.SyncCounterInit; r_Config_P01.MaxNoNewOrRepeatedData = s_Config_P01.MaxNoNewOrRepeatedData /*---------------------------- P01 - Call of the CheckInit Function -------------------*/ E2E_P01CheckInit(&r_State_P01); /* Initialize the receiver state structure before first usage */ /*-------------------------------- P01 - Filling with Input-Data ----------------------*/ /* ************************************************************************************* * The input data is the data that is protected by the protect function. * * Here this is s_Data_P01. This data must be used to check it. * ***************************************************************************************/ for(i_u8 = 0; i_u8 < sizeof(r_Data_P01); i_u8++) { r_Data_P01[i_u8] = s_Data_P01[i_u8]; } /*-------------------------------- P01 - Call of the Check Function -------------------*/ r_returnValue_P01 = E2E_P01Check(&r_Config_P01, &r_State_P01, r_Data_P01); /* Performing the check of r_Data_P01 */ /*----------------------- Perform generic receive status conversion -------------------*/ r_PcheckValue_P01 = E2E_P01MapStatusToSM(r_returnValue_P01, r_State_P01.Status, TRUE);
      return type Std_ReturnType: implementation-data-type=Std_ReturnType  # For definitions of the return values, see the preprocessor constants chapter. | E2E_E_INPUTERR_NULL E2E_E_INPUTERR_WRONG E2E_E_INTERR E2E_E_OK
      sw service arg ConfigPtr: category=DATA_REFERENCE, direction=IN, sw-pointer-target-props={target-category=VALUE, implementation-data-type=E2E_P01ConfigType}  # Pointer to static configuration.
      sw service arg StatePtr: category=DATA_REFERENCE, direction=INOUT, sw-pointer-target-props={target-category=VALUE, implementation-data-type=E2E_P01CheckStateType}  # Pointer to port/data communication state. After executing the check function, the result is stored in the state. The result shows if the received data is valid or corrupt.
      sw service arg DataPtr: category=DATA_REFERENCE, direction=IN, sw-pointer-target-props={target-category=VALUE, implementation-data-type=uint8}  # Pointer to the data to check
    E2E_P01MapStatusToSM: category=TYPE_REFERENCE, service-id=29  # Converts profile P01 check status to generic state machine status. | The function maps the check status of Profile 1 to a generic check status, which can be used by E2E state machine check function. The E2E Profile 1 delivers a more fine-granular status, but this is not relevant for the E2E state machine.
      return type Std_ReturnType: implementation-data-type=E2E_PCheckStatusType  # Profile-independent status of the reception of a single message in one cycle.
      sw service arg CheckReturn: direction=IN, implementation-data-type=Std_ReturnType  # Return value of the E2E_P01Check function
      sw service arg Status: direction=IN, implementation-data-type=E2E_P01CheckStatusType  # Status determined by E2E_P01Check function
      sw service arg profileBehavior: category=VALUE, direction=IN, implementation-data-type=boolean  # Declare the behavior of the profile. FALSE: check has the legacy behaviour, before AR4.2. TRUE: check has the legacy behaviour, like P4/P5/P6/P7/P44 profiles introduced in AR4.2.
    E2E_P02ProtectInit: service-id=30  # Initializes the Profile 02 sender state.
      return type Std_ReturnType: implementation-data-type=Std_ReturnType  # E_OK is returned if the operation was successfull. E2E_E_INPUTERR_NULL is returned if a null pointer was applied as parameter.
      sw service arg StatePtr: category=DATA_REFERENCE, direction=OUT, sw-pointer-target-props={target-category=VALUE, implementation-data-type=E2E_P02ProtectStateType}  # Pointer to port/data communication sender state.
    E2E_P02Protect: service-id=3  # Protects the array/buffer to be transmitted using the E2E profile 2. | Protects the array/buffer to be transmitted using the E2E profile 2. A message counter is added to the data stream and a crc checksum is calculated over the data, counter and data ID and added to the data stream as well. | Example: The following example shows the usage of the P02-Protect function: /*-------------------------------- P02 - Protect Example ------------------------------*/ /*-------------------------------- P02 - Declaration of variables ---------------------*/ E2E_P02ConfigType s_Config_P02; /* This structure holds the P02-sender-configuration */ E2E_P02ProtectStateType s_State_P02; /* This structure holds the P02-sender-state */ /* ************************************************************************************* * 8 as size is just chosen to have enough space for the protection result. * * Another number proper size is valid as well. * ***************************************************************************************/ uint8 s_Data_P02[8]; /*-------------------------------- P02 - Setup ----------------------------------------*/ s_Config_P02.DataLength = 64; /* Setting the DataLength */ /* ************************************************************************************* * Setting how much delta is still accepted in case of a sequence error. * * Here it is set to maximal. * ***************************************************************************************/ s_Config_P02.MaxDeltaCounterInit = E2E_P02_MAXCOUNTER; /* ************************************************************************************* * The DataID, required for the authentication, is not static like for P01. * * For P02 its different, depending on the current value of the counter. * * This is why, 16 DataIDs must be set. * ***************************************************************************************/ s_Config_P02.DataIDList[0] = 0x25; s_Config_P02.DataIDList[1] = 0x2E; s_Config_P02.DataIDList[2] = 0xEC; s_Config_P02.DataIDList[3] = 0xC5; s_Config_P02.DataIDList[4] = 0x01; s_Config_P02.DataIDList[5] = 0x0F; s_Config_P02.DataIDList[6] = 0x11; s_Config_P02.DataIDList[7] = 0x60; s_Config_P02.DataIDList[8] = 0x00; s_Config_P02.DataIDList[9] = 0x7A; s_Config_P02.DataIDList[10] = 0xA9; s_Config_P02.DataIDList[11] = 0xB2; s_Config_P02.DataIDList[12] = 0x44; s_Config_P02.DataIDList[13] = 0x38; s_Config_P02.DataIDList[14] = 0xCC; s_Config_P02.DataIDList[15] = 0x0D; /* ************************************************************************************* * Setting the SyncCounterInit to 0 and MaxNoNewOrRepeatedData to 5 for no * * synchronisation is aimed. * ***************************************************************************************/ s_Config_P02.SyncCounterInit = 0; s_Config_P02.MaxNoNewOrRepeatedData = 5; /*---------------------------- P02 - Call of the ProtectInit Function -----------------*/ E2E_P02ProtectInit(&s_State_P02); /* Initialize the sender state structure before first usage */ /*-------------------------------- P02 - Filling with Input-Data ----------------------*/ /* first 2 bytes are reserved for CRC and counter */ s_Data_P02[2] = 0xCA; /* Data to protect. Here random value. */ s_Data_P02[3] = 0xFE; /* Data to protect. Here random value. */ s_Data_P02[4] = 0xAF; /* Data to protect. Here random value. */ s_Data_P02[5] = 0xFE; /* Data to protect. Here random value. */ s_Data_P02[6] = 0xBE; /* Data to protect. Here random value. */ s_Data_P02[7] = 0xEF; /* Data to protect. Here random value. */ /*-------------------------------- P02 - Call of the Protect Function ----------------*/ E2E_P02Protect(&s_Config_P02, &s_State_P02, s_Data_P02); /* Performing the protection of s_Data_P02 */
      return type Std_ReturnType: implementation-data-type=Std_ReturnType  # For definitions of the return values, see the preprocessor constants chapter. | E2E_E_INPUTERR_NULL E2E_E_INPUTERR_WRONG E2E_E_INTERR E2E_E_OK
      sw service arg ConfigPtr: category=DATA_REFERENCE, direction=IN, sw-pointer-target-props={target-category=VALUE, implementation-data-type=E2E_P02ConfigType}  # Pointer to static configuration.
      sw service arg StatePtr: category=DATA_REFERENCE, direction=INOUT, sw-pointer-target-props={target-category=VALUE, implementation-data-type=E2E_P02ProtectStateType}  # Pointer to port/data communication sender state. This includes the counter (see example below for more details).
      sw service arg DataPtr: category=DATA_REFERENCE, direction=INOUT, sw-pointer-target-props={target-category=VALUE, implementation-data-type=uint8}  # Pointer to the data to protect. The values like CRC and counter are saved directly into the data stream.
    E2E_P02CheckInit: service-id=31  # Initializes the Profile 02 receiver state.
      return type Std_ReturnType: implementation-data-type=Std_ReturnType  # E_OK is returned if the operation was successfull. E2E_E_INPUTERR_NULL is returned if a null pointer was applied as parameter.
      sw service arg StatePtr: category=DATA_REFERENCE, direction=OUT, sw-pointer-target-props={target-category=VALUE, implementation-data-type=E2E_P02CheckStateType}  # Pointer to port/data communication receiver state.
    E2E_P02Check: service-id=4  # Checks the Data received using the E2E profile 2. | Checks the received data by using the E2E profile 2. The function calculates a CRC for the received data, counter and data ID and compares it with the CRC stored within the data stream (written by the protect function). | Example: The following example shows the usage of the P02-Check function: /*-------------------------------- P02 - Check Example --------------------------------*/ /*-------------------------------- P02 - Declaration of variables ---------------------*/ E2E_P02ConfigType r_Config_P02; /* This structure holds the P02-receiver-configuration */ E2E_P02CheckStateType r_State_P02; /* This structure holds the P02-receiver-state */ Std_ReturnType r_returnValue_P02; /* This variable holds the Check function call return value */ E2E_PCheckStatusType r_PcheckValue_P02; /* This variable holds the generic check status value used by state machine*/ uint8 i_u8; /* ************************************************************************************* * 8 as size is just chosen to have enough space for the protection result. * * Another number proper size is valid as well. * ***************************************************************************************/ uint8 r_Data_P02[8]; /*-------------------------------- P02 - Setup ----------------------------------------*/ r_Config_P02.DataLength = s_Config_P02.DataLength; r_Config_P02.MaxDeltaCounterInit = s_Config_P02.MaxDeltaCounterInit; /* ************************************************************************************* * Setting the SyncCounterInit to 0 and MaxNoNewOrRepeatedData to 5 for no * * synchronisation is aimed. * ***************************************************************************************/ r_Config__P02.SyncCounterInit = s_Config__P02.SyncCounterInit; r_Config_P02.MaxNoNewOrRepeatedData = s_Config_P02.MaxNoNewOrRepeatedData; /* ************************************************************************************* * Setup data id list from previous id list used to protect the message * ***************************************************************************************/ for (i_u8 = 0; i_u8 < sizeof(r_Config_P02.DataIDList); i_u8++) { r_Config_P02.DataIDList[i_u8] = s_Config_P02.DataIDList[i_u8]; } /*---------------------------- P02 - Call of the CheckInit Function -------------------*/ E2E_P02CheckInit(&r_State_P02); /* Initialize the receiver state structure before first usage */ /*-------------------------------- P02 - Filling with Input-Data ----------------------*/ /* ************************************************************************************* * The input data is the data that is protected by the protect function. * * Here this is s_Data_P02. This data must be used to check it. * ***************************************************************************************/ for(i_u8 = 0; i_u8 < sizeof(r_Data_P02); i_u8++) { r_Data_P02[i_u8] = s_Data_P02[i_u8]; } /*-------------------------------- P02 - Call of the Check Function -------------------*/ r_returnValue_P02 = E2E_P02Check(&r_Config_P02, &r_State_P02, r_Data_P02); /* Performing the check of r_Data_P02 */ /*----------------------- Perform generic receive status conversion -------------------*/ r_PcheckValue_P02 = E2E_P02MapStatusToSM(r_returnValue_P02, r_State_P02.Status, TRUE);
      return type Std_ReturnType: implementation-data-type=Std_ReturnType  # For definitions of the return values, see the preprocessor constants chapter. | E2E_E_INPUTERR_NULL E2E_E_INPUTERR_WRONG E2E_E_INTERR E2E_E_OK
      sw service arg ConfigPtr: category=DATA_REFERENCE, direction=IN, sw-pointer-target-props={target-category=VALUE, implementation-data-type=E2E_P02ConfigType}  # Pointer to static configuration.
      sw service arg StatePtr: category=DATA_REFERENCE, direction=INOUT, sw-pointer-target-props={target-category=VALUE, implementation-data-type=E2E_P02CheckStateType}  # Pointer to port/data communication state. After executing the check function, the result is stored in the state. The result shows if the received data is valid or corrupt.
      sw service arg DataPtr: category=DATA_REFERENCE, direction=IN, sw-pointer-target-props={target-category=VALUE, implementation-data-type=uint8}  # Pointer to the data to check.
    E2E_P02MapStatusToSM: service-id=32  # Converts profile P02 check status to generic state machine status. | The function maps the check status of Profile 2 to a generic check status, which can be used by E2E state machine check function. The E2E Profile 2 delivers a more fine-granular status, but this is not relevant for the E2E state machine.
      return type Std_ReturnType: implementation-data-type=E2E_PCheckStatusType  # Profile-independent status of the reception of a single message in one cycle.
      sw service arg CheckReturn: direction=IN, implementation-data-type=Std_ReturnType  # Return value of the E2E_P02Check function
      sw service arg Status: direction=IN, implementation-data-type=E2E_P02CheckStatusType  # Status determined by E2E_P02Check function
      sw service arg profileBehavior: category=VALUE, direction=IN, implementation-data-type=boolean  # Declare the behavior of the profile. FALSE: check has the legacy behaviour, before AR4.2. TRUE: check has the legacy behaviour, like P4/P5/P6/P7/P44 profiles introduced in AR4.2.
    E2E_P04ProtectInit: service-id=34  # Initializes the Profile 04 sender state.
      return type Std_ReturnType: implementation-data-type=Std_ReturnType  # E_OK is returned if the operation was successfull. E2E_E_INPUTERR_NULL is returned if a null pointer was applied as parameter.
      sw service arg StatePtr: category=DATA_REFERENCE, direction=OUT, sw-pointer-target-props={target-category=VALUE, implementation-data-type=E2E_P04ProtectStateType}  # Pointer to port/data communication sender state.
    E2E_P04Protect: service-id=33  # Protects the array/buffer to be transmitted using the E2E profile 4. | Protects the array/buffer to be transmitted using the E2E profile 4. A message counter, the length of the data stream and the data ID are added to the data stream and a crc checksum is calculated over the data. The checksum is written to the data stream as well. | Example: The following example shows the usage of the P04-Protect function: /*-------------------------------- P04 - Protect Example ------------------------------*/ /*-------------------------------- P04 - Declaration of variables ---------------------*/ E2E_P04ConfigType s_Config_P04; /* This structure holds the P04-sender-configuration */ E2E_P04ProtectStateType s_State_P04; /* This structure holds the P04-sender-state */ /* ************************************************************************************* * 16 as size is just chosen to have enough space for the protection result (12 + 4). * * Another number with proper size is valid as well. * ***************************************************************************************/ uint8 s_Data_P04[16]; /*-------------------------------- P04 - Setup ----------------------------------------*/ s_Config_P04.Offset = 0; /* Setting the Offset */ s_Config_P04.MinDataLength = (uint16)(12 * 8); /* Setting the MinDataLength */ s_Config_P04.MaxDataLength = (uint16)(1024 * 8); /* Setting the MaxDataLength */ s_Config_P04.DataID = 0xCAFEAFFE; /* Setting the DataID */ /* ************************************************************************************* * Setting how much delta is still accepted in case of a sequence error. * * Here it is set to 5. * ***************************************************************************************/ s_Config_P04.MaxDeltaCounter = 5; /*---------------------------- P04 - Call of the ProtectInit Function -----------------*/ E2E_P04ProtectInit(&s_State_P04); /* Initialize the sender state structure before first usage */ /*-------------------------------- P04 - Filling with Input-Data ----------------------*/ /* first 12 bytes are reserved for length, counter, data ID and CRC (32 bit) */ s_Data_P04[12] = 0xDE; /* Data to protect. Here random value. */ s_Data_P04[13] = 0xAD; /* Data to protect. Here random value. */ s_Data_P04[14] = 0xBE; /* Data to protect. Here random value. */ s_Data_P04[15] = 0xEF; /* Data to protect. Here random value. */ /*-------------------------------- P04 - Call of the Protect Function ----------------*/ E2E_P04Protect(&s_Config_P04, &s_State_P04, s_Data_P04, sizeof(s_Data_P04)); /* Performing the protection of s_Data_P04 */
      return type Std_ReturnType: implementation-data-type=Std_ReturnType  # For definitions of the return values, see the preprocessor constants chapter. | E2E_E_INPUTERR_NULL E2E_E_INPUTERR_WRONG E2E_E_INTERR E2E_E_OK
      4 x sw service arg, all with category=DATA_REFERENCE:
        ConfigPtr: direction=IN, sw-pointer-target-props={target-category=VALUE, implementation-data-type=E2E_P04ConfigType}  # Pointer to static configuration.
        StatePtr: direction=INOUT, sw-pointer-target-props={target-category=VALUE, implementation-data-type=E2E_P04ProtectStateType}  # Pointer to port/data communication sender state. This includes the counter (see example below for more details).
        DataPtr: direction=INOUT, sw-pointer-target-props={target-category=VALUE, implementation-data-type=uint8}  # Pointer to the data to protect. The values like CRC, counter, length and Data ID are saved directly into the data stream.
        Length: direction=IN, sw-pointer-target-props={target-category=VALUE, implementation-data-type=uint16}  # Length of data to protect.
    E2E_P04CheckInit: service-id=36  # Initializes the Profile 04 receiver state.
      return type Std_ReturnType: implementation-data-type=Std_ReturnType  # E_OK is returned if the operation was successfull. E2E_E_INPUTERR_NULL is returned if a null pointer was applied as parameter.
      sw service arg StatePtr: category=DATA_REFERENCE, direction=OUT, sw-pointer-target-props={target-category=VALUE, implementation-data-type=E2E_P04CheckStateType}  # Pointer to port/data communication receiver state.
    E2E_P04Check: service-id=35  # Checks the Data received using the E2E profile 4. | Checks the received data by using the E2E profile 4. The function calculates a CRC for the received data, counter, length and data ID and compares it with the CRC stored within the data stream (written by the protect function). The length of the datastream is checked as well (length information is part of the data stream). | Example: The following example shows the usage of the P04-Check function: /*-------------------------------- P04 - Check Example --------------------------------*/ /*-------------------------------- P04 - Declaration of variables ---------------------*/ E2E_P04ConfigType r_Config_P04; /* This structure holds the P04-receiver-configuration */ E2E_P04CheckStateType r_State_P04; /* This structure holds the P04-receiver-state */ Std_ReturnType r_returnValue_P04; /* This variable holds the Check function call return value */ E2E_PCheckStatusType r_PcheckValue_P04; /* This variable holds the generic check status value used by the state machine */ uint16 i_u16; /* ************************************************************************************* * 16 as size is just chosen to have enough space for the protection result (12 + 4). * * Another number with proper size is valid as well. * ***************************************************************************************/ uint8 r_Data_P04[16]; /*-------------------------------- P04 - Setup ----------------------------------------*/ r_Config_P04.Offset = s_Config_P04.Offset; r_Config_P04.MinDataLength = s_Config_P04.MinDataLength; r_Config_P04.MaxDataLength = s_Config_P04.MaxDataLength; r_Config_P04.DataID = s_Config_P04.DataID; r_Config_P04.MaxDeltaCounter = s_Config_P04.MaxDeltaCounter /*---------------------------- P04 - Call of the CheckInit Function -------------------*/ E2E_P04CheckInit(&r_State_P04); /* Initialize the receiver state structure before first usage */ /*-------------------------------- P04 - Filling with Input-Data ----------------------*/ /* ************************************************************************************* * The input data is the data that is protected by the protect function. * * Here this is s_Data_P04. This data must be used to check it. * ***************************************************************************************/ for (i_u16 = 0; i_u16 < sizeof(r_Data_P04); i_u16++) { r_Data_P04[i_u16] = s_Data_P04[i_u16]; } /*-------------------------------- P04 - Call of the Check Function -------------------*/ r_returnValue_P04 = E2E_P04Check(&r_Config_P04, &r_State_P04, r_Data_P04, sizeof(r_Data_P04)); /* Performing the check of r_Data_P04 */ /*----------------------- Perform generic receive status conversion -------------------*/ r_PcheckValue_P04 = E2E_P04MapStatusToSM(r_returnValue_P04, r_State_P04.Status);
      return type Std_ReturnType: implementation-data-type=Std_ReturnType  # For definitions of the return values, see the preprocessor constants chapter. | E2E_E_INPUTERR_NULL E2E_E_INPUTERR_WRONG E2E_E_INTERR E2E_E_OK
      4 x sw service arg, all with category=DATA_REFERENCE:
        ConfigPtr: direction=IN, sw-pointer-target-props={target-category=VALUE, implementation-data-type=E2E_P04ConfigType}  # Pointer to static configuration.
        StatePtr: direction=INOUT, sw-pointer-target-props={target-category=VALUE, implementation-data-type=E2E_P04CheckStateType}  # Pointer to port/data communication state. After executing the check function, the result is stored in the state. The result shows if the received data is valid or corrupt.
        DataPtr: direction=IN, sw-pointer-target-props={target-category=VALUE, implementation-data-type=uint8}  # Pointer to the data to check
        Length: direction=IN, sw-pointer-target-props={target-category=VALUE, implementation-data-type=uint16}  # Length of data to check
    E2E_P04MapStatusToSM: service-id=37  # Converts profile P04 check status to generic state machine status. | The function maps the check status of Profile 4 to a generic check status, which can be used by E2E state machine check function. The E2E Profile 4 delivers a more fine-granular status, but this is not relevant for the E2E state machine.
      return type Std_ReturnType: implementation-data-type=E2E_PCheckStatusType  # Profile-independent status of the reception of a single message in one cycle.
      sw service arg CheckReturn: direction=IN, implementation-data-type=Std_ReturnType  # Return value of the E2E_P04Check function
      sw service arg Status: direction=IN, implementation-data-type=E2E_P04CheckStatusType  # Status determined by E2E_P04Check function
    E2E_P05ProtectInit: service-id=39  # Initializes the Profile 05 sender state.
      return type Std_ReturnType: implementation-data-type=Std_ReturnType  # E_OK is returned if the operation was successfull. E2E_E_INPUTERR_NULL is returned if a null pointer was applied as parameter.
      sw service arg StatePtr: category=DATA_REFERENCE, direction=OUT, sw-pointer-target-props={target-category=VALUE, implementation-data-type=E2E_P05ProtectStateType}  # Pointer to port/data communication sender state.
    E2E_P05Protect: service-id=38  # Protects the array/buffer to be transmitted using the E2E profile 5. | Protects the array/buffer to be transmitted using the E2E profile 5. A message counter is added to the data stream and a crc checksum is calculated over the data. The checksum is written to the data stream as well. | Example: The following example shows the usage of the P05-Protect function: /*-------------------------------- P05 - Protect Example ------------------------------*/ /*-------------------------------- P05 - Declaration of variables ---------------------*/ E2E_P05ConfigType s_Config_P05; /* This structure holds the P05-sender-configuration */ E2E_P05ProtectStateType s_State_P05; /* This structure holds the P05-sender-state */ /* ************************************************************************************* * 8 as size is just chosen to have enough space for the protection result. * * Another number proper size is valid as well. * ***************************************************************************************/ uint8 s_Data_P05[8]; /*-------------------------------- P05 - Setup ----------------------------------------*/ s_Config_P05.Offset = 0; /* Setting the Offset */ s_Config_P05.DataLength = (uint8)(sizeof(s_Data_P05) * 8); /* Setting the DataLength */ s_Config_P05.DataID = 0xCAFE; /* Setting the DataID */ /* ************************************************************************************* * Setting how much delta is still accepted in case of a sequence error. * * Here it is set to 5. * ***************************************************************************************/ s_Config_P05.MaxDeltaCounter = 5; /*---------------------------- P05 - Call of the ProtectInit Function -----------------*/ E2E_P05ProtectInit(&s_State_P05); /* Initialize the sender state structure before first usage */ /*-------------------------------- P05 - Filling with Input-Data ----------------------*/ /* first 3 bytes are reserved for CRC (16 bit) and counter */ s_Data_P05[3] = 0xFE; /* Data to protect. Here random value. */ s_Data_P05[4] = 0xAF; /* Data to protect. Here random value. */ s_Data_P05[5] = 0xFE; /* Data to protect. Here random value. */ s_Data_P05[6] = 0xBE; /* Data to protect. Here random value. */ s_Data_P05[7] = 0xEF; /* Data to protect. Here random value. */ /*-------------------------------- P02 - Call of the Protect Function ----------------*/ E2E_P05Protect(&s_Config_P05, &s_State_P05, s_Data_P05, sizeof(s_Data_P05)); /* Performing the protection of s_Data_P05 */
      return type Std_ReturnType: implementation-data-type=Std_ReturnType  # For definitions of the return values, see the preprocessor constants chapter. | E2E_E_INPUTERR_NULL E2E_E_INPUTERR_WRONG E2E_E_INTERR E2E_E_OK
      4 x sw service arg, all with category=DATA_REFERENCE:
        ConfigPtr: direction=IN, sw-pointer-target-props={target-category=VALUE, implementation-data-type=E2E_P05ConfigType}  # Pointer to static configuration.
        StatePtr: direction=INOUT, sw-pointer-target-props={target-category=VALUE, implementation-data-type=E2E_P05ProtectStateType}  # Pointer to port/data communication sender state. This includes the counter (see example below for more details).
        DataPtr: direction=INOUT, sw-pointer-target-props={target-category=VALUE, implementation-data-type=uint8}  # Pointer to the data to protect. The values like CRC and counter are saved directly into the data stream.
        Length: direction=IN, sw-pointer-target-props={target-category=VALUE, implementation-data-type=uint16}  # Length of data to protect.
    E2E_P05CheckInit: service-id=41  # Initializes the Profile 05 receiver state.
      return type Std_ReturnType: implementation-data-type=Std_ReturnType  # E_OK is returned if the operation was successfull. E2E_E_INPUTERR_NULL is returned if a null pointer was applied as parameter.
      sw service arg StatePtr: category=DATA_REFERENCE, direction=OUT, sw-pointer-target-props={target-category=VALUE, implementation-data-type=E2E_P05CheckStateType}  # Pointer to port/data communication receiver state.
    E2E_P05Check: service-id=40  # Checks the Data received using the E2E profile 5. | Checks the received data by using the E2E profile 5. The function calculates a CRC for the received data, counter and data ID and compares it with the CRC stored within the data stream (written by the protect function). | Example: The following example shows the usage of the P05-Check function: /*-------------------------------- P05 - Check Example --------------------------------*/ /*-------------------------------- P05 - Declaration of variables ---------------------*/ E2E_P05ConfigType r_Config_P05; /* This structure holds the P05-receiver-configuration */ E2E_P05CheckStateType r_State_P05; /* This structure holds the P05-receiver-state */ Std_ReturnType r_returnValue_P05; /* This variable holds the Check function call return value */ E2E_PCheckStatusType r_PcheckValue_P05; /* This variable holds the generic check status value used by state machine*/ uint8 i_u8; /* ************************************************************************************* * 8 as size is just chosen to have enough space for the protection result. * * Another number proper size is valid as well. * ***************************************************************************************/ uint8 r_Data_P05[8]; /*-------------------------------- P05 - Setup ----------------------------------------*/ r_Config_P05.Offset = s_Config_P05.Offset; r_Config_P05.DataLength = s_Config_P05.DataLength; r_Config_P05.DataID = s_Config_P05.DataID; r_Config_P05.MaxDeltaCounter = s_Config_P05.MaxDeltaCounter /*---------------------------- P05 - Call of the CheckInit Function -------------------*/ E2E_P05CheckInit(&r_State_P05); /* Initialize the receiver state structure before first usage */ /*-------------------------------- P05 - Filling with Input-Data ----------------------*/ /* ************************************************************************************* * The input data is the data that is protected by the protect function. * * Here this is s_Data_P05. This data must be used to check it. * ***************************************************************************************/ for (i_u8 = 0; i_u8 < sizeof(r_Data_P05); i_u8++) { r_Data_P05[i_u8] = s_Data_P05[i_u8]; } /*-------------------------------- P05 - Call of the Check Function -------------------*/ r_returnValue_P05 = E2E_P05Check(&r_Config_P05, &r_State_P05, r_Data_P05, sizeof(r_Data_P05)); /* Performing the check of r_Data_P05 */ /*----------------------- Perform generic receive status conversion -------------------*/ r_PcheckValue_P05 = E2E_P05MapStatusToSM(r_returnValue_P05, r_State_P05.Status);
      return type Std_ReturnType: implementation-data-type=Std_ReturnType  # For definitions of the return values, see the preprocessor constants chapter. | E2E_E_INPUTERR_NULL E2E_E_INPUTERR_WRONG E2E_E_INTERR E2E_E_OK
      4 x sw service arg, all with category=DATA_REFERENCE:
        ConfigPtr: direction=IN, sw-pointer-target-props={target-category=VALUE, implementation-data-type=E2E_P05ConfigType}  # Pointer to static configuration.
        StatePtr: direction=INOUT, sw-pointer-target-props={target-category=VALUE, implementation-data-type=E2E_P05CheckStateType}  # Pointer to port/data communication state. After executing the check function, the result is stored in the state. The result shows if the received data is valid or corrupt.
        DataPtr: direction=IN, sw-pointer-target-props={target-category=VALUE, implementation-data-type=uint8}  # Pointer to the data to check
        Length: direction=IN, sw-pointer-target-props={target-category=VALUE, implementation-data-type=uint16}  # Length of data to check
    E2E_P05MapStatusToSM: service-id=42  # Converts profile P05 check status to generic state machine status. | The function maps the check status of Profile 5 to a generic check status, which can be used by E2E state machine check function. The E2E Profile 5 delivers a more fine-granular status, but this is not relevant for the E2E state machine.
      return type Std_ReturnType: implementation-data-type=E2E_PCheckStatusType  # Profile-independent status of the reception of a single message in one cycle.
      sw service arg CheckReturn: direction=IN, implementation-data-type=Std_ReturnType  # Return value of the E2E_P05Check function
      sw service arg Status: direction=IN, implementation-data-type=E2E_P05CheckStatusType  # Status determined by E2E_P05Check function
    E2E_P06ProtectInit: service-id=44  # Initializes the Profile 06 sender state.
      return type Std_ReturnType: implementation-data-type=Std_ReturnType  # E_OK is returned if the operation was successfull. E2E_E_INPUTERR_NULL is returned if a null pointer was applied as parameter.
      sw service arg StatePtr: category=DATA_REFERENCE, direction=OUT, sw-pointer-target-props={target-category=VALUE, implementation-data-type=E2E_P06ProtectStateType}  # Pointer to port/data communication sender state.
    E2E_P06Protect: service-id=43  # Protects the array/buffer to be transmitted using the E2E profile 6. | Protects the array/buffer to be transmitted using the E2E profile 6. A message counter and the length of the data stream are added to the data stream and a crc checksum is calculated over the data. The checksum is written to the data stream as well. | Example: The following example shows the usage of the P06-Protect function: /*-------------------------------- P06 - Protect Example ------------------------------*/ /*-------------------------------- P06 - Declaration of variables ---------------------*/ E2E_P06ConfigType s_Config_P06; /* This structure holds the P06-sender-configuration */ E2E_P06ProtectStateType s_State_P06; /* This structure holds the P06-sender-state */ /* ************************************************************************************* * 8 as size is just chosen to have enough space for the protection result. * * Another number proper size is valid as well. * ***************************************************************************************/ uint8 s_Data_P06[8]; /*-------------------------------- P06 - Setup ----------------------------------------*/ s_Config_P06.Offset = 0; /* Setting the Offset */ s_Config_P06.MinDataLength = (uint8)(5 * 8); /* Setting the MinDataLength */ s_Config_P06.MaxDataLength = (uint8)(16 * 8); /* Setting the MaxDataLength */ s_Config_P06.DataID = 0xCAFE; /* Setting the DataID */ /* ************************************************************************************* * Setting how much delta is still accepted in case of a sequence error. * * Here it is set to 5. * ***************************************************************************************/ s_Config_P06.MaxDeltaCounter = 5; /*---------------------------- P06 - Call of the ProtectInit Function -----------------*/ E2E_P06ProtectInit(&s_State_P06); /* Initialize the sender state structure before first usage */ /*-------------------------------- P06 - Filling with Input-Data ----------------------*/ /* first 5 bytes are reserved for CRC (16 bit), counter and length */ s_Data_P06[5] = 0xFE; /* Data to protect. Here random value. */ s_Data_P06[6] = 0xBE; /* Data to protect. Here random value. */ s_Data_P06[7] = 0xEF; /* Data to protect. Here random value. */ /*-------------------------------- P06 - Call of the Protect Function ----------------*/ E2E_P06Protect(&s_Config_P06, &s_State_P06, s_Data_P06, sizeof(s_Data_P06)); /* Performing the protection of s_Data_P06 */
      return type Std_ReturnType: implementation-data-type=Std_ReturnType  # For definitions of the return values, see the preprocessor constants chapter. | E2E_E_INPUTERR_NULL E2E_E_INPUTERR_WRONG E2E_E_INTERR E2E_E_OK
      4 x sw service arg, all with category=DATA_REFERENCE:
        ConfigPtr: direction=IN, sw-pointer-target-props={target-category=VALUE, implementation-data-type=E2E_P06ConfigType}  # Pointer to static configuration.
        StatePtr: direction=INOUT, sw-pointer-target-props={target-category=VALUE, implementation-data-type=E2E_P06ProtectStateType}  # Pointer to port/data communication sender state. This includes the counter (see example below for more details).
        DataPtr: direction=INOUT, sw-pointer-target-props={target-category=VALUE, implementation-data-type=uint8}  # Pointer to the data to protect. The values like CRC, counter and length are saved directly into the data stream.
        Length: direction=IN, sw-pointer-target-props={target-category=VALUE, implementation-data-type=uint16}  # Length of data to protect.
    E2E_P06CheckInit: service-id=46  # Initializes the Profile 06 receiver state.
      return type Std_ReturnType: implementation-data-type=Std_ReturnType  # E_OK is returned if the operation was successfull. E2E_E_INPUTERR_NULL is returned if a null pointer was applied as parameter.
      sw service arg StatePtr: category=DATA_REFERENCE, direction=OUT, sw-pointer-target-props={target-category=VALUE, implementation-data-type=E2E_P06CheckStateType}  # Pointer to port/data communication receiver state.
    E2E_P06Check: service-id=45  # Checks the Data received using the E2E profile 6. | Checks the received data by using the E2E profile 6. The function calculates a CRC for the received data, counter, length and data ID and compares it with the CRC stored within the data stream (written by the protect function). In addition to profile 5 the length of the datastream is checked as well (length information is part of the data stream). | Example: The following example shows the usage of the P06-Check function: /*-------------------------------- P06 - Check Example --------------------------------*/ /*-------------------------------- P06 - Declaration of variables ---------------------*/ E2E_P06ConfigType r_Config_P06; /* This structure holds the P06-receiver-configuration */ E2E_P06CheckStateType r_State_P06; /* This structure holds the P06-receiver-state */ Std_ReturnType r_returnValue_P06; /* This variable holds the Check function call return value */ E2E_PCheckStatusType r_PcheckValue_P06; /* This variable holds the generic check status value used by state machine*/ uint8 i_u8; /* ************************************************************************************* * 8 as size is just chosen to have enough space for the protection result. * * Another number proper size is valid as well. * ***************************************************************************************/ uint8 r_Data_P06[8]; /*-------------------------------- P06 - Setup ----------------------------------------*/ r_Config_P06.Offset = s_Config_P06.Offset; r_Config_P06.MinDataLength = s_Config_P06.MinDataLength; r_Config_P06.MaxDataLength = s_Config_P06.MaxDataLength; r_Config_P06.DataID = s_Config_P06.DataID; r_Config_P06.MaxDeltaCounter = s_Config_P06.MaxDeltaCounter /*---------------------------- P06 - Call of the CheckInit Function -------------------*/ E2E_P06CheckInit(&r_State_P06); /* Initialize the receiver state structure before first usage */ /*-------------------------------- P06 - Filling with Input-Data ----------------------*/ /* ************************************************************************************* * The input data is the data that is protected by the protect function. * * Here this is s_Data_P06. This data must be used to check it. * ***************************************************************************************/ for (i_u8 = 0; i_u8 < sizeof(r_Data_P06); i_u8++) { r_Data_P06[i_u8] = s_Data_P06[i_u8]; } /*-------------------------------- P06 - Call of the Check Function -------------------*/ r_returnValue_P06 = E2E_P06Check(&r_Config_P06, &r_State_P06, r_Data_P06, sizeof(r_Data_P06)); /* Performing the check of r_Data_P06 */ /*----------------------- Perform generic receive status conversion -------------------*/ r_PcheckValue_P06 = E2E_P06MapStatusToSM(r_returnValue_P06, r_State_P06.Status);
      return type Std_ReturnType: implementation-data-type=Std_ReturnType  # For definitions of the return values, see the preprocessor constants chapter. | E2E_E_INPUTERR_NULL E2E_E_INPUTERR_WRONG E2E_E_INTERR E2E_E_OK
      4 x sw service arg, all with category=DATA_REFERENCE:
        ConfigPtr: direction=IN, sw-pointer-target-props={target-category=VALUE, implementation-data-type=E2E_P06ConfigType}  # Pointer to static configuration.
        StatePtr: direction=INOUT, sw-pointer-target-props={target-category=VALUE, implementation-data-type=E2E_P06CheckStateType}  # Pointer to port/data communication state. After executing the check function, the result is stored in the state. The result shows if the received data is valid or corrupt.
        DataPtr: direction=IN, sw-pointer-target-props={target-category=VALUE, implementation-data-type=uint8}  # Pointer to the data to check
        Length: direction=IN, sw-pointer-target-props={target-category=VALUE, implementation-data-type=uint16}  # Length of data to check
    E2E_P06MapStatusToSM: service-id=47  # Converts profile P06 check status to generic state machine status. | The function maps the check status of Profile 6 to a generic check status, which can be used by E2E state machine check function. The E2E Profile 6 delivers a more fine-granular status, but this is not relevant for the E2E state machine.
      return type Std_ReturnType: implementation-data-type=E2E_PCheckStatusType  # Profile-independent status of the reception of a single message in one cycle.
      sw service arg CheckReturn: direction=IN, implementation-data-type=Std_ReturnType  # Return value of the E2E_P06Check function
      sw service arg Status: direction=IN, implementation-data-type=E2E_P06CheckStatusType  # Status determined by E2E_P06Check function
    E2E_P07ProtectInit: service-id=34  # Initializes the Profile 07 sender state.
      return type Std_ReturnType: implementation-data-type=Std_ReturnType  # E_OK is returned if the operation was successfull. E2E_E_INPUTERR_NULL is returned if a null pointer was applied as parameter.
      sw service arg StatePtr: category=DATA_REFERENCE, direction=OUT, sw-pointer-target-props={target-category=VALUE, implementation-data-type=E2E_P07ProtectStateType}  # Pointer to port/data communication sender state.
    E2E_P07Protect: service-id=33  # Protects the array/buffer to be transmitted using the E2E profile 7. | Protects the array/buffer to be transmitted using the E2E profile 7. A message counter, the length of the data stream and the data ID are added to the data stream and a crc checksum is calculated over the data. The checksum is written to the data stream as well. | Example: The following example shows the usage of the P07-Protect function: /*-------------------------------- P07 - Protect Example ------------------------------*/ /*-------------------------------- P07 - Declaration of variables ---------------------*/ E2E_P07ConfigType s_Config_P07; /* This structure holds the P07-sender-configuration */ E2E_P07ProtectStateType s_State_P07; /* This structure holds the P07-sender-state */ /* ************************************************************************************* * 24 as size is just chosen to have enough space for the protection result (20 + 4). * * Another number with proper size is valid as well. * ***************************************************************************************/ uint8 s_Data_P07[24]; /*-------------------------------- P07 - Setup ----------------------------------------*/ s_Config_P07.Offset = 0; /* Setting the Offset */ s_Config_P07.MinDataLength = (uint32)(20 * 8); /* Setting the MinDataLength */ s_Config_P07.MaxDataLength = (uint32)(1024 * 8); /* Setting the MaxDataLength */ s_Config_P07.DataID = 0xCAFEAFFE; /* Setting the DataID */ /* ************************************************************************************* * Setting how much delta is still accepted in case of a sequence error. * * Here it is set to 5. * ***************************************************************************************/ s_Config_P07.MaxDeltaCounter = 5; /*---------------------------- P07 - Call of the ProtectInit Function -----------------*/ E2E_P07ProtectInit(&s_State_P07); /* Initialize the sender state structure before first usage */ /*-------------------------------- P07 - Filling with Input-Data ----------------------*/ /* first 20 bytes are reserved for CRC (64 bit), counter, length and data ID */ s_Data_P07[20] = 0xDE; /* Data to protect. Here random value. */ s_Data_P07[21] = 0xAD; /* Data to protect. Here random value. */ s_Data_P07[22] = 0xBE; /* Data to protect. Here random value. */ s_Data_P07[23] = 0xEF; /* Data to protect. Here random value. */ /*-------------------------------- P07 - Call of the Protect Function ----------------*/ E2E_P07Protect(&s_Config_P07, &s_State_P07, s_Data_P07, sizeof(s_Data_P07)); /* Performing the protection of s_Data_P07 */
      return type Std_ReturnType: implementation-data-type=Std_ReturnType  # For definitions of the return values, see the preprocessor constants chapter. | E2E_E_INPUTERR_NULL E2E_E_INPUTERR_WRONG E2E_E_INTERR E2E_E_OK
      4 x sw service arg, all with category=DATA_REFERENCE:
        ConfigPtr: direction=IN, sw-pointer-target-props={target-category=VALUE, implementation-data-type=E2E_P07ConfigType}  # Pointer to static configuration.
        StatePtr: direction=INOUT, sw-pointer-target-props={target-category=VALUE, implementation-data-type=E2E_P07ProtectStateType}  # Pointer to port/data communication sender state. This includes the counter (see example below for more details).
        DataPtr: direction=INOUT, sw-pointer-target-props={target-category=VALUE, implementation-data-type=uint8}  # Pointer to the data to protect. The values like CRC, counter, length and Data ID are saved directly into the data stream.
        Length: direction=IN, sw-pointer-target-props={target-category=VALUE, implementation-data-type=uint32}  # Length of data to protect.
    E2E_P07CheckInit: service-id=36  # Initializes the Profile 07 receiver state.
      return type Std_ReturnType: implementation-data-type=Std_ReturnType  # E_OK is returned if the operation was successfull. E2E_E_INPUTERR_NULL is returned if a null pointer was applied as parameter.
      sw service arg StatePtr: category=DATA_REFERENCE, direction=OUT, sw-pointer-target-props={target-category=VALUE, implementation-data-type=E2E_P07CheckStateType}  # Pointer to port/data communication receiver state.
    E2E_P07Check: service-id=35  # Checks the Data received using the E2E profile 7. | Checks the received data by using the E2E profile 7. The function calculates a CRC for the received data, counter, length and data ID and compares it with the CRC stored within the data stream (written by the protect function). The length of the datastream is checked as well (length information is part of the data stream). | Example: The following example shows the usage of the P07-Check function: /*-------------------------------- P07 - Check Example --------------------------------*/ /*-------------------------------- P07 - Declaration of variables ---------------------*/ E2E_P07ConfigType r_Config_P07; /* This structure holds the P07-receiver-configuration */ E2E_P07CheckStateType r_State_P07; /* This structure holds the P07-receiver-state */ Std_ReturnType r_returnValue_P07; /* This variable holds the Check function call return value */ E2E_PCheckStatusType r_PcheckValue_P07; /* This variable holds the generic check status value used by the state machine */ uint32 i_u32; /* ************************************************************************************* * 24 as size is just chosen to have enough space for the protection result (20 + 4). * * Another number with proper size is valid as well. * ***************************************************************************************/ uint8 r_Data_P07[24]; /*-------------------------------- P07 - Setup ----------------------------------------*/ r_Config_P07.Offset = s_Config_P07.Offset; r_Config_P07.MinDataLength = s_Config_P07.MinDataLength; r_Config_P07.MaxDataLength = s_Config_P07.MaxDataLength; r_Config_P07.DataID = s_Config_P07.DataID; r_Config_P07.MaxDeltaCounter = s_Config_P07.MaxDeltaCounter /*---------------------------- P07 - Call of the CheckInit Function -------------------*/ E2E_P07CheckInit(&r_State_P07); /* Initialize the receiver state structure before first usage */ /*-------------------------------- P07 - Filling with Input-Data ----------------------*/ /* ************************************************************************************* * The input data is the data that is protected by the protect function. * * Here this is s_Data_P07. This data must be used to check it. * ***************************************************************************************/ for (i_u32 = 0; i_u32 < sizeof(r_Data_P07); i_u32++) { r_Data_P07[i_u32] = s_Data_P07[i_u32]; } /*-------------------------------- P07 - Call of the Check Function -------------------*/ r_returnValue_P07 = E2E_P07Check(&r_Config_P07, &r_State_P07, r_Data_P07, sizeof(r_Data_P07)); /* Performing the check of r_Data_P07 */ /*----------------------- Perform generic receive status conversion -------------------*/ r_PcheckValue_P07 = E2E_P07MapStatusToSM(r_returnValue_P07, r_State_P07.Status);
      return type Std_ReturnType: implementation-data-type=Std_ReturnType  # For definitions of the return values, see the preprocessor constants chapter. | E2E_E_INPUTERR_NULL E2E_E_INPUTERR_WRONG E2E_E_INTERR E2E_E_OK
      4 x sw service arg, all with category=DATA_REFERENCE:
        ConfigPtr: direction=IN, sw-pointer-target-props={target-category=VALUE, implementation-data-type=E2E_P07ConfigType}  # Pointer to static configuration.
        StatePtr: direction=INOUT, sw-pointer-target-props={target-category=VALUE, implementation-data-type=E2E_P07CheckStateType}  # Pointer to port/data communication state. After executing the check function, the result is stored in the state. The result shows if the received data is valid or corrupt.
        DataPtr: direction=IN, sw-pointer-target-props={target-category=VALUE, implementation-data-type=uint8}  # Pointer to the data to check
        Length: direction=IN, sw-pointer-target-props={target-category=VALUE, implementation-data-type=uint32}  # Length of data to check
    E2E_P07MapStatusToSM: service-id=37  # Converts profile P07 check status to generic state machine status. | The function maps the check status of Profile 7 to a generic check status, which can be used by E2E state machine check function. The E2E Profile 7 delivers a more fine-granular status, but this is not relevant for the E2E state machine.
      return type Std_ReturnType: implementation-data-type=E2E_PCheckStatusType  # Profile-independent status of the reception of a single message in one cycle.
      sw service arg CheckReturn: direction=IN, implementation-data-type=Std_ReturnType  # Return value of the E2E_P07Check function
      sw service arg Status: direction=IN, implementation-data-type=E2E_P07CheckStatusType  # Status determined by E2E_P07Check function
    E2E_P11ProtectInit: service-id=60  # Initializes the Profile 11 sender state.
      return type Std_ReturnType: implementation-data-type=Std_ReturnType  # E_OK is returned if the operation was successfull. E2E_E_INPUTERR_NULL is returned if a null pointer was applied as parameter.
      sw service arg StatePtr: category=DATA_REFERENCE, direction=OUT, sw-pointer-target-props={target-category=VALUE, implementation-data-type=E2E_P11ProtectStateType}  # Pointer to port/data communication sender state.
    E2E_P11Protect: service-id=59  # Protects the array/buffer to be transmitted using the E2E profile 11. | Protects the array/buffer to be transmitted using the E2E profile 11. A message counter is added to the data stream and a crc checksum is calculated over the data, counter and data ID and added to the data stream as well. It depends on the configuration of the profile if parts of the data ID are written into the data stream or not.
      return type Std_ReturnType: implementation-data-type=Std_ReturnType  # For definitions of the return values, see the preprocessor constants chapter. | E2E_E_INPUTERR_NULL E2E_E_INPUTERR_WRONG E2E_E_INTERR E2E_E_OK
      sw service arg ConfigPtr: category=DATA_REFERENCE, direction=IN, sw-pointer-target-props={target-category=VALUE, implementation-data-type=E2E_P11ConfigType}  # Pointer to static configuration.
      sw service arg StatePtr: category=DATA_REFERENCE, direction=INOUT, sw-pointer-target-props={target-category=VALUE, implementation-data-type=E2E_P11ProtectStateType}  # Pointer to port/data communication sender state. This includes the counter.
      sw service arg DataPtr: category=DATA_REFERENCE, direction=INOUT, sw-pointer-target-props={target-category=VALUE, implementation-data-type=uint8}  # Pointer to the data to protect. The values like CRC and counter are saved directly into the data stream.
    E2E_P11CheckInit: service-id=57  # Initializes the Profile 11 receiver state.
      return type Std_ReturnType: implementation-data-type=Std_ReturnType  # E_OK is returned if the operation was successfull. E2E_E_INPUTERR_NULL is returned if a null pointer was applied as parameter.
      sw service arg StatePtr: category=DATA_REFERENCE, direction=OUT, sw-pointer-target-props={target-category=VALUE, implementation-data-type=E2E_P11CheckStateType}  # Pointer to port/data communication receiver state.
    E2E_P11Check: service-id=56  # Checks the data received using the E2E profile 11. | Checks the received data by using the E2E profile 11. The function calculates a CRC for the received data, counter and data ID and compares it with the CRC stored within the data stream (written by the protect function).
      return type Std_ReturnType: implementation-data-type=Std_ReturnType  # For definitions of the return values, see the preprocessor constants chapter. | E2E_E_INPUTERR_NULL E2E_E_INPUTERR_WRONG E2E_E_INTERR E2E_E_OK
      sw service arg ConfigPtr: category=DATA_REFERENCE, direction=IN, sw-pointer-target-props={target-category=VALUE, implementation-data-type=E2E_P11ConfigType}  # Pointer to static configuration.
      sw service arg StatePtr: category=DATA_REFERENCE, direction=INOUT, sw-pointer-target-props={target-category=VALUE, implementation-data-type=E2E_P11CheckStateType}  # Pointer to port/data communication state. After executing the check function, the result is stored in the state. The result shows if the received data is valid or corrupt.
      sw service arg DataPtr: category=DATA_REFERENCE, direction=IN, sw-pointer-target-props={target-category=VALUE, implementation-data-type=uint8}  # Pointer to the data to check
    E2E_P11MapStatusToSM: service-id=58  # Converts profile P11 check status to generic state machine status. | The function maps the check status of Profile 11 to a generic check status, which can be used by E2E state machine check function. The E2E Profile 11 delivers a more fine-granular status, but this is not relevant for the E2E state machine.
      return type Std_ReturnType: implementation-data-type=E2E_PCheckStatusType  # Profile-independent status of the reception of a single message in one cycle.
      sw service arg CheckReturn: direction=IN, implementation-data-type=Std_ReturnType  # Return value of the E2E_P11Check function
      sw service arg Status: direction=IN, implementation-data-type=E2E_P11CheckStatusType  # Status determined by E2E_P11Check function
    E2E_P22ProtectInit: service-id=65  # Initializes the Profile 22 sender state.
      return type Std_ReturnType: implementation-data-type=Std_ReturnType  # E_OK is returned if the operation was successfull. E2E_E_INPUTERR_NULL is returned if a null pointer was applied as parameter.
      sw service arg StatePtr: category=DATA_REFERENCE, direction=OUT, sw-pointer-target-props={target-category=VALUE, implementation-data-type=E2E_P22ProtectStateType}  # Pointer to port/data communication sender state.
    E2E_P22Protect: service-id=64  # Protects the array/buffer to be transmitted using the E2E profile 22. | Protects the array/buffer to be transmitted using the E2E profile 22. A message counter is added to the data stream and a crc checksum is calculated over the data, counter and data ID and added to the data stream as well. It depends on the configuration of the profile if parts of the data ID are written into the data stream or not.
      return type Std_ReturnType: implementation-data-type=Std_ReturnType  # For definitions of the return values, see the preprocessor constants chapter. | E2E_E_INPUTERR_NULL E2E_E_INPUTERR_WRONG E2E_E_INTERR E2E_E_OK
      sw service arg ConfigPtr: category=DATA_REFERENCE, direction=IN, sw-pointer-target-props={target-category=VALUE, implementation-data-type=E2E_P22ConfigType}  # Pointer to static configuration.
      sw service arg StatePtr: category=DATA_REFERENCE, direction=INOUT, sw-pointer-target-props={target-category=VALUE, implementation-data-type=E2E_P22ProtectStateType}  # Pointer to port/data communication sender state. This includes the counter.
      sw service arg DataPtr: category=DATA_REFERENCE, direction=INOUT, sw-pointer-target-props={target-category=VALUE, implementation-data-type=uint8}  # Pointer to the data to protect. The values like CRC and counter are saved directly into the data stream.
    E2E_P22CheckInit: service-id=62  # Initializes the Profile 22 receiver state.
      return type Std_ReturnType: implementation-data-type=Std_ReturnType  # E_OK is returned if the operation was successfull. E2E_E_INPUTERR_NULL is returned if a null pointer was applied as parameter.
      sw service arg StatePtr: category=DATA_REFERENCE, direction=OUT, sw-pointer-target-props={target-category=VALUE, implementation-data-type=E2E_P22CheckStateType}  # Pointer to port/data communication receiver state.
    E2E_P22Check: service-id=61  # Checks the data received using the E2E profile 22. | Checks the received data by using the E2E profile 22. The function calculates a CRC for the received data, counter and data ID and compares it with the CRC stored within the data stream (written by the protect function).
      return type Std_ReturnType: implementation-data-type=Std_ReturnType  # For definitions of the return values, see the preprocessor constants chapter. | E2E_E_INPUTERR_NULL E2E_E_INPUTERR_WRONG E2E_E_INTERR E2E_E_OK
      sw service arg ConfigPtr: category=DATA_REFERENCE, direction=IN, sw-pointer-target-props={target-category=VALUE, implementation-data-type=E2E_P22ConfigType}  # Pointer to static configuration.
      sw service arg StatePtr: category=DATA_REFERENCE, direction=INOUT, sw-pointer-target-props={target-category=VALUE, implementation-data-type=E2E_P22CheckStateType}  # Pointer to port/data communication state. After executing the check function, the result is stored in the state. The result shows if the received data is valid or corrupt.
      sw service arg DataPtr: category=DATA_REFERENCE, direction=IN, sw-pointer-target-props={target-category=VALUE, implementation-data-type=uint8}  # Pointer to the data to check
    E2E_P22MapStatusToSM: service-id=63  # Converts profile P22 check status to generic state machine status. | The function maps the check status of Profile 22 to a generic check status, which can be used by E2E state machine check function. The E2E Profile 22 delivers a more fine-granular status, but this is not relevant for the E2E state machine.
      return type Std_ReturnType: implementation-data-type=E2E_PCheckStatusType  # Profile-independent status of the reception of a single message in one cycle.
      sw service arg CheckReturn: direction=IN, implementation-data-type=Std_ReturnType  # Return value of the E2E_P22Check function
      sw service arg Status: direction=IN, implementation-data-type=E2E_P22CheckStatusType  # Status determined by E2E_P22Check function
    E2E_P44ProtectInit: service-id=34  # Initializes the Profile 44 sender state.
      return type Std_ReturnType: implementation-data-type=Std_ReturnType  # E_OK is returned if the operation was successfull. E2E_E_INPUTERR_NULL is returned if a null pointer was applied as parameter.
      sw service arg StatePtr: category=DATA_REFERENCE, direction=OUT, sw-pointer-target-props={target-category=VALUE, implementation-data-type=E2E_P44ProtectStateType}  # Pointer to port/data communication sender state.
    E2E_P44Protect: service-id=33  # Protects the array/buffer to be transmitted using the E2E profile 44. | Protects the array/buffer to be transmitted using the E2E profile 44. A message counter, the length of the data stream and the data ID are added to the data stream and a crc checksum is calculated over the data. The checksum is written to the data stream as well. | Example: The following example shows the usage of the P44-Protect function: /*-------------------------------- P44 - Protect Example ------------------------------*/ /*-------------------------------- P44 - Declaration of variables ---------------------*/ E2E_P44ConfigType s_Config_P44; /* This structure holds the P44-sender-configuration */ E2E_P44ProtectStateType s_State_P44; /* This structure holds the P44-sender-state */ /* ************************************************************************************* * 16 as size is just chosen to have enough space for the protection result (12 + 4). * * Another number with proper size is valid as well. * ***************************************************************************************/ uint8 s_Data_P44[16]; /*-------------------------------- P44 - Setup ----------------------------------------*/ s_Config_P44.Offset = 0; /* Setting the Offset */ s_Config_P44.MinDataLength = (uint32)(12 * 8); /* Setting the MinDataLength */ s_Config_P44.MaxDataLength = (uint32)(1024 * 8); /* Setting the MaxDataLength */ s_Config_P44.DataID = 0xCAFEAFFE; /* Setting the DataID */ /* ************************************************************************************* * Setting how much delta is still accepted in case of a sequence error. * * Here it is set to 5. * ***************************************************************************************/ s_Config_P44.MaxDeltaCounter = 5; /*---------------------------- P44 - Call of the ProtectInit Function -----------------*/ E2E_P44ProtectInit(&s_State_P44); /* Initialize the sender state structure before first usage */ /*-------------------------------- P44 - Filling with Input-Data ----------------------*/ /* first 12 bytes are reserved for length, counter, data ID and CRC (32 bit) */ s_Data_P44[12] = 0xDE; /* Data to protect. Here random value. */ s_Data_P44[13] = 0xAD; /* Data to protect. Here random value. */ s_Data_P44[14] = 0xBE; /* Data to protect. Here random value. */ s_Data_P44[15] = 0xEF; /* Data to protect. Here random value. */ /*-------------------------------- P44 - Call of the Protect Function ----------------*/ E2E_P44Protect(&s_Config_P44, &s_State_P44, s_Data_P44, sizeof(s_Data_P44)); /* Performing the protection of s_Data_P44 */
      return type Std_ReturnType: implementation-data-type=Std_ReturnType  # For definitions of the return values, see the preprocessor constants chapter. | E2E_E_INPUTERR_NULL E2E_E_INPUTERR_WRONG E2E_E_INTERR E2E_E_OK
      4 x sw service arg, all with category=DATA_REFERENCE:
        ConfigPtr: direction=IN, sw-pointer-target-props={target-category=VALUE, implementation-data-type=E2E_P44ConfigType}  # Pointer to static configuration.
        StatePtr: direction=INOUT, sw-pointer-target-props={target-category=VALUE, implementation-data-type=E2E_P44ProtectStateType}  # Pointer to port/data communication sender state. This includes the counter (see example below for more details).
        DataPtr: direction=INOUT, sw-pointer-target-props={target-category=VALUE, implementation-data-type=uint8}  # Pointer to the data to protect. The values like CRC, counter, length and Data ID are saved directly into the data stream.
        Length: direction=IN, sw-pointer-target-props={target-category=VALUE, implementation-data-type=uint16}  # Length of data to protect.
    E2E_P44CheckInit: service-id=36  # Initializes the Profile 44 receiver state.
      return type Std_ReturnType: implementation-data-type=Std_ReturnType  # E_OK is returned if the operation was successfull. E2E_E_INPUTERR_NULL is returned if a null pointer was applied as parameter.
      sw service arg StatePtr: category=DATA_REFERENCE, direction=OUT, sw-pointer-target-props={target-category=VALUE, implementation-data-type=E2E_P44CheckStateType}  # Pointer to port/data communication receiver state.
    E2E_P44Check: service-id=35  # Checks the Data received using the E2E profile 44. | Checks the received data by using the E2E profile 44. The function calculates a CRC for the received data, counter, length and data ID and compares it with the CRC stored within the data stream (written by the protect function). The length of the datastream is checked as well (length information is part of the data stream). | Example: The following example shows the usage of the P44-Check function: /*-------------------------------- P44 - Check Example --------------------------------*/ /*-------------------------------- P44 - Declaration of variables ---------------------*/ E2E_P44ConfigType r_Config_P44; /* This structure holds the P44-receiver-configuration */ E2E_P44CheckStateType r_State_P44; /* This structure holds the P44-receiver-state */ Std_ReturnType r_returnValue_P44; /* This variable holds the Check function call return value */ E2E_PCheckStatusType r_PcheckValue_P44; /* This variable holds the generic check status value used by the state machine */ uint16 i_u16; /* ************************************************************************************* * 16 as size is just chosen to have enough space for the protection result (12 + 4). * * Another number with proper size is valid as well. * ***************************************************************************************/ uint8 r_Data_P44[16]; /*-------------------------------- P44 - Setup ----------------------------------------*/ r_Config_P44.Offset = s_Config_P04.Offset; r_Config_P44.MinDataLength = s_Config_P44.MinDataLength; r_Config_P44.MaxDataLength = s_Config_P44.MaxDataLength; r_Config_P44.DataID = s_Config_P44.DataID; r_Config_P44.MaxDeltaCounter = s_Config_P44.MaxDeltaCounter /*---------------------------- P44 - Call of the CheckInit Function -------------------*/ E2E_P44CheckInit(&r_State_P44); /* Initialize the receiver state structure before first usage */ /*-------------------------------- P44 - Filling with Input-Data ----------------------*/ /* ************************************************************************************* * The input data is the data that is protected by the protect function. * * Here this is s_Data_P44. This data must be used to check it. * ***************************************************************************************/ for (i_u16 = 0; i_u16 < sizeof(r_Data_P44); i_u16++) { r_Data_P44[i_u16] = s_Data_P44[i_u16]; } /*-------------------------------- P44 - Call of the Check Function -------------------*/ r_returnValue_P44 = E2E_P44Check(&r_Config_P44, &r_State_P44, r_Data_P44, sizeof(r_Data_P44)); /* Performing the check of r_Data_P44 */ /*----------------------- Perform generic receive status conversion -------------------*/ r_PcheckValue_P44 = E2E_P44MapStatusToSM(r_returnValue_P44, r_State_P44.Status);
      return type Std_ReturnType: implementation-data-type=Std_ReturnType  # For definitions of the return values, see the preprocessor constants chapter. | E2E_E_INPUTERR_NULL E2E_E_INPUTERR_WRONG E2E_E_INTERR E2E_E_OK
      4 x sw service arg, all with category=DATA_REFERENCE:
        ConfigPtr: direction=IN, sw-pointer-target-props={target-category=VALUE, implementation-data-type=E2E_P44ConfigType}  # Pointer to static configuration.
        StatePtr: direction=INOUT, sw-pointer-target-props={target-category=VALUE, implementation-data-type=E2E_P44CheckStateType}  # Pointer to port/data communication state. After executing the check function, the result is stored in the state. The result shows if the received data is valid or corrupt.
        DataPtr: direction=IN, sw-pointer-target-props={target-category=VALUE, implementation-data-type=uint8}  # Pointer to the data to check
        Length: direction=IN, sw-pointer-target-props={target-category=VALUE, implementation-data-type=uint16}  # Length of data to check
    E2E_P44MapStatusToSM: service-id=37  # Converts profile P44 check status to generic state machine status. | The function maps the check status of Profile 44 to a generic check status, which can be used by E2E state machine check function. The E2E Profile 44 delivers a more fine-granular status, but this is not relevant for the E2E state machine.
      return type Std_ReturnType: implementation-data-type=E2E_PCheckStatusType  # Profile-independent status of the reception of a single message in one cycle.
      sw service arg CheckReturn: direction=IN, implementation-data-type=Std_ReturnType  # Return value of the E2E_P44Check function
      sw service arg Status: direction=IN, implementation-data-type=E2E_P44CheckStatusType  # Status determined by E2E_P44Check function
    E2E_SMCheckInit: service-id=49  # Initializes the state machine. | E2E communication check state initialization
      return type Std_ReturnType: implementation-data-type=Std_ReturnType  # E_OK is returned if the operation was successfull. E2E_E_INPUTERR_NULL is returned if a null pointer was applied as parameter.
      sw service arg StatePtr: category=DATA_REFERENCE, direction=INOUT, sw-pointer-target-props={target-category=VALUE, implementation-data-type=E2E_SMCheckStateType}  # Pointer to port/data communication receiver state.
      sw service arg ConfigPtr: category=DATA_REFERENCE, direction=IN, sw-pointer-target-props={target-category=VALUE, implementation-data-type=E2E_SMConfigType}  # Pointer to configuration of the state machine
    E2E_SMCheck: service-id=48  # E2E communication generic state check with status history handling | Checks the communication channel. It determines if the data can be used for safety-related application, based on history of checks performed by a corresponding E2E_P0XCheck() function. | Example: The following example shows the usage of the state machine check functionality: /*-------------------------------- SM - Check Example -------------------------------*/ /*-------------------------------- SM - Declaration of variables --------------------*/ E2E_SMConfigType r_Config_SM; /* This structure holds the SM-check-configuration */ E2E_SMCheckStateType r_State_SM; /* This structure holds the SM-check-state */ uint8 r_ProfileStatusWindow_SM[8]; /* Array used to store the receive statuses */ E2E_PCheckStatusType r_PcheckValue_P02; /* This variable holds the generic check status value used by state machine */ /*-------------------------------- SM - Setup ----------------------------------------*/ /* ************************************************************************************* * Add configuration parameters * ***************************************************************************************/ r_Config_SM.WindowSize = 8; /* Size of the monitoring window for the state machine */ r_Config_SM.MinOkStateInit = 2; r_Config_SM.MaxErrorStateInit = 1; r_Config_SM.MinOkStateValid = 2; r_Config_SM.MaxErrorStateValid = 2; r_Config_SM.MinOkStateInvalid = 2; r_Config_SM.MaxErrorStateInvalid = 1; /* ************************************************************************************* * Link window status array to state structure * ***************************************************************************************/ r_State_SM.ProfileStatusWindow = (uint8*)r_ProfileStatusWindow_SM; /*---------------------------- SM - Call of the CheckInit Function --------------------*/ E2E_SMCheckInit(&r_State_SM, &r_Config_SM); /* Initialize the receiver state structure before first usage */ /*-------------------------------- Setup a sample status as input ---------------------*/ r_PcheckValue_P02 = E2E_P_OK; /*-------------------------------- Call of the SM Check Function ----------------------*/ E2E_SMCheck(r_PcheckValue_P02, &r_Config_SM, &r_State_SM); /* Performing the channel state check */
      return type Std_ReturnType: implementation-data-type=Std_ReturnType  # For definitions of the return values, see the preprocessor constants chapter. | E2E_E_INPUTERR_NULL E2E_E_INPUTERR_WRONG E2E_E_INTERR E2E_E_OK E2E_E_WRONGSTATE
      sw service arg ProfileStatus: direction=IN, implementation-data-type=E2E_PCheckStatusType  # Profile-independent status of the reception of a single message in one cycle.
      sw service arg ConfigPtr: category=DATA_REFERENCE, direction=IN, sw-pointer-target-props={target-category=VALUE, implementation-data-type=E2E_SMConfigType}  # Pointer to static configuration.
      sw service arg StatePtr: category=DATA_REFERENCE, direction=INOUT, sw-pointer-target-props={target-category=VALUE, implementation-data-type=E2E_SMCheckStateType}  # Pointer to port/data communication state.
    E2E_GetVersionInfo: service-id=20  # Returns the version information of this module. | The function E2E_GetVersionInfo shall store the version information of this module into the parameter VersionInfo. The version information includes: | vendor ID module ID instance ID sw_major_version sw_minor_version sw_patch_version Example: The following example shows the usage of the GetVersionInfo function: /*--------------------------------- E2E GetVersionInfo Example ------------------------*/ /*--------------------------------- Declaration of Variable ---------------------------*/ Std_VersionInfoType VersionInfo; /* Into VersionInfo the version information shall be saved */ /*--------------------------------- Call of the GetVersionInf Function ----------------*/ E2E_GetVersionInfo(&VersionInfo); /* Saving the version information in VersionInfo */
      sw service arg VersionInfoPtr: category=DATA_REFERENCE, direction=OUT, sw-pointer-target-props={target-category=VALUE, implementation-data-type=Std_VersionInfoType}  # Pointer to where to store the version information of this module.
package /AUTOSAR_E2E/ImplementationDataTypes
  42 x impl type, all with type-emitter=HEADER_FILE:
    E2E_P01DataIDMode: compu {0=E2E_P01_DATAID_BOTH (Two bytes are included in the CRC (double ID configuration). This is used in E2E variant 1A.), 1=E2E_P01_DATAID_ALT (One of the two bytes is included, alternating high and low byte, depending on parity of the counter (alternating ID configuration). For an even counter, the low byte is included. For an odd counter, the high byte is included. This is used in E2E variant 1B.), 2=E2E_P01_DATAID_LOW (Only the low byte is included, the high byte is never used. This is applicable if the IDs in a particular system are 8 bits.), 2=E2E_P01_DATAID_NIBBLE (The low byte is included in the implicit CRC calculation, the low nibble of the high byte is transmitted along with the data (i.e. it is explicitly included), the high nibble of the high byte is not used. This is applicable for the IDs up to 12 bits. This is used in E2E variant 1C.)}, implementation-data-type=uint8  # Enumeration type for Profile 01 Data ID mode | The Data ID is two bytes long in E2E Profile 1. There are four inclusion modes how the implicit two-byte Data ID is included in the one-byte CRC.
    E2E_P01CheckStatusType: compu {0=E2E_P01STATUS_OK (OK: The new data has been received according to communication medium, the CRC is correct, the counter is incremented by 1 with respect to the most recent Data received with status _INITIAL, _OK, or _OKSOMELOST. This means that no data has been lost since the last correct data reception.), 1=E2E_P01STATUS_NONEWDATA (Error: the Check function has been invoked but no new data is not available since the last call, according to communication medium (e.g. RTE, COM). As a result, no E2E checks of data have been consequently executed.), 2=E2E_P01STATUS_WRONGCRC (Error: The data has been received according to communication medium, but 1. the CRC is incorrect (applicable for all E2E Profile 1 configurations) or 2. the low nibble of the high byte of Data ID is incorrect (applicable only for E2E Profile 1 with E2E_P01DataIDMode = E2E_P01_DATAID_NIBBLE). The two above errors can be a result of corruption, incorrect addressing or masquerade.), 3=E2E_P01STATUS_SYNC (NOT VALID: The new data has been received after detection of an unexpected behavior of counter. The data has a correct CRC and a counter within the expected range with respect to the most recent Data received, but the determined continuity check for the counter is not finalized yet.), 4=E2E_P01STATUS_INITIAL (Initial: The new data has been received according to communication medium, the CRC is correct, but this is the first data since the receiver's initialization or reinitialization, so the counter cannot be verified yet.), 5=E2E_P01STATUS_REPEATED (Error: The new data has been received according to communication medium, the CRC is correct, but the Counter is identical to the most recent data received with status _INITIAL, _OK, or _OKSOMELOST.), 6=E2E_P01STATUS_OKSOMELOST (OK: The new data has been received according to communication medium, the CRC is correct, the Counter is incremented by DeltaCounter (1 < DeltaCounter = MaxDeltaCounter) with respect to the most recent data received with status _INITIAL, _OK, or _OKSOMELOST. This means that some Data in the sequence have been probably lost since the last correct/initial reception, but this is within the configured tolerance range.), 7=E2E_P01STATUS_WRONGSEQUENCE (Error: The new data has been received according to communication medium, the CRC is correct, but the counter delta is too big (DeltaCounter > MaxDeltaCounter) with respect to the most recent data received with status _INITIAL, _OK, or _OKSOMELOST. This means that too many data in the sequence have been probably lost since the last correct/initial reception.)}, implementation-data-type=uint8  # Result of the verification of the data in E2E Profile 1, determined by the Check function. | When the configuration parameter E2ERbCheckStatusTypeCompatibilityMode is TRUE then the enumeraiton has the following values: E2E_P01STATUS_OK = 0 E2E_P01STATUS_NONEWDATA = 1 E2E_P01STATUS_WRONGCRC = 2 E2E_P01STATUS_SYNC = 3 E2E_P01STATUS_INITIAL = 4 E2E_P01STATUS_REPEATED = 5 E2E_P01STATUS_OKSOMELOST = 6 E2E_P01STATUS_WRONGSEQUENCE = 7
    E2E_P01ProtectStateType: category=STRUCTURE  # State of the sender for a Data protected with E2E Profile 1.
      element Counter: implementation-data-type=uint8  # Counter to be used for protecting the next data. The initial value is 0, which means that the first data will have the counter 0. After the protection by the counter, the counter is incremented modulo 0xF. The value 0xF is skipped (after 0xE the next is 0x0), as 0xF value represents the error value. The four high bits are always 0.
    E2E_P01CheckStateType: category=STRUCTURE  # State of the receiver for a data protected with E2E Profile 1.
      8 x element, all with category=TYPE_REFERENCE:
        LastValidCounter: implementation-data-type=uint8  # Counter value most recently received. If no data has been yet received, then the value is 0x0. After each reception, the counter is updated with the value received.
        MaxDeltaCounter: implementation-data-type=uint8  # MaxDeltaCounter specifies the maximum allowed difference between two counter values of consecutively received valid messages.
        WaitForFirstData: implementation-data-type=boolean  # If true means that no correct data (with correct Data ID and CRC) has been yet received after the receiver initialization or reinitialization.
        NewDataAvailable: implementation-data-type=boolean  # Indicates to E2E library that a new data is available for Library to be checked. This attribute is set by the E2E library caller, and not by the E2E Library.
        LostData: implementation-data-type=uint8  # Number of data (messages) lost since reception of last valid one. This attribute is set only if status equals E2E_P01STATUS_OK or E2E_P01STATUS_OKSOMELOST. For other values of status, the value of LostData is undefined. E2E_P01CheckStatusType status result of the verification of the data, determined by the Check function.
        Status: implementation-data-type=E2E_P01CheckStatusType  # Result of the verification of the data, determined by the Check function.
        SyncCounter: implementation-data-type=uint8  # Number of data required for validating the consistency of the counter that must be received with a valid counter (i.e. counter within the allowed lock-in range) after the detection of an unexpected behavior of a received counter.
        NoNewOrRepeatedDataCounter: implementation-data-type=uint8  # Amount of consecutive reception cycles in which either (1) there was no new data, or (2) when the data was repeated.
    E2E_P01ConfigType: category=STRUCTURE  # Configuration of transmitted data (Data Element or I-PDU), for E2E Profile 1. For each transmitted data, there is an instance of this typedef.
      9 x element, all with category=TYPE_REFERENCE:
        CounterOffset: implementation-data-type=uint16  # Bit offset of counter in MSB first order. In variants 1A and 1B, CounterOffset is 8. The offset shall be a multiple of 4.
        CRCOffset: implementation-data-type=uint16  # Bit offset of CRC (i.e. since *Data) in MSB first order. In variants 1A and 1B, CRCOffset is 0. The offset shall be a multiple of 8.
        DataID: implementation-data-type=uint16  # A unique identifier, for protection against masquerading. There are some constraints on the selection of ID values, described in section "Configuration constraints on Data IDs".
        DataIDNibbleOffset: implementation-data-type=uint16  # Bit offset of the low nibble of the high byte of Data ID. This parameter is used by E2E Library only if DataIDMode = E2E_P01_DATAID_NIBBLE (otherwise it is ignored by E2E Library). For DataIDMode different than E2E_P01_DATAID_NIBBLE, DataIDNibbleOffset shall be initialized to 0 (even if it is ignored by E2E Library).
        DataIDMode: implementation-data-type=E2E_P01DataIDMode  # Inclusion mode of ID in CRC computation (both bytes, alternating, or low byte only of ID included).
        DataLength: implementation-data-type=uint16  # Length of data, in bits. The value shall be a multiple of 8 and shall be ≤ 240.
        MaxDeltaCounterInit: implementation-data-type=uint8  # Initial maximum allowed gap between two counter values of two consecutively received valid data. For example, if the receiver gets Data with counter 1 and MaxDeltaCounterInit is 1, then at the next reception the receiver can accept counters with values 2 and 3, but not 4. Note that if the receiver does not receive new data at a consecutive read, then the receiver increments the tolerance by 1.
        MaxNoNewOrRepeatedData: implementation-data-type=uint8  # The maximum amount of missing or repeated data which the receiver does not expect to exceed under normal communication conditions.
        SyncCounterInit: implementation-data-type=uint8  # Number of data required for validating the consistency of the counter that must be received with a valid counter (i.e. counter within the allowed lock-in range) after the detection of an unexpected behavior of a received counter.
    E2E_P02CheckStatusType: compu {0=E2E_P02STATUS_OK (OK: The new data has been received according to communication medium, the CRC is correct, the counter is incremented by 1 with respect to the most recent data received with status _INITIAL, _OK, or _OKSOMELOST. This means that no data has been lost since the last correct data reception.), 1=E2E_P02STATUS_NONEWDATA (Error: The Check function has been invoked but no new Data is not available since the last call, according to communication medium (e.g. RTE, COM). As a result, no E2E checks of data have been consequently executed.), 2=E2E_P02STATUS_WRONGCRC (Error: The data has been received according to communication medium, but 1. the CRC is incorrect (applicable for all E2E Profile 1 configurations) or 2. the low nibble of the high byte of Data ID is incorrect (applicable only for E2E Profile 1 with E2E_P02DataIDMode = E2E_P02_DATAID_NIBBLE). The two above errors can be a result of corruption, incorrect addressing or masquerade.), 3=E2E_P02STATUS_SYNC (NOT VALID: The new data has been received after detection of an unexpected behavior of counter. The data has a correct CRC and a counter within the expected range with respect to the most recent Data received, but the determined continuity check for the counter is not finalized yet.), 4=E2E_P02STATUS_INITIAL (Initial: The new data has been received according to communication medium, the CRC is correct, but this is the first data since the receiver's initialization or reinitialization, so the counter cannot be verified yet.), 5=E2E_P02STATUS_REPEATED (Error: The new data has been received according to communication medium, the CRC is correct, but the counter is identical to the most recent data received with status _INITIAL, _OK, or _OKSOMELOST.), 6=E2E_P02STATUS_OKSOMELOST (OK: The new data has been received according to communication medium, the CRC is correct, the counter is incremented by DeltaCounter (1 < DeltaCounter = MaxDeltaCounter) with respect to the most recent data received with status _INITIAL, _OK, or _OKSOMELOST. This means that some data in the sequence have been probably lost since the last correct/initial reception, but this is within the configured tolerance range.), 7=E2E_P02STATUS_WRONGSEQUENCE (Error: The new data has been received according to communication medium, the CRC is correct, but the counter delta is too big (DeltaCounter > MaxDeltaCounter) with respect to the most recent data received with status _INITIAL, _OK, or _OKSOMELOST. This means that too many data in the sequence have been probably lost since the last correct/initial reception.)}, implementation-data-type=uint8  # Result of the verification of the data in E2E Profile 2, determined by the Check function. | When the configuration parameter E2ERbCheckStatusTypeCompatibilityMode is TRUE then the enumeraiton has the following values: E2E_P02STATUS_OK = 0 E2E_P02STATUS_NONEWDATA = 1 E2E_P02STATUS_WRONGCRC = 2 E2E_P02STATUS_SYNC = 3 E2E_P02STATUS_INITIAL = 4 E2E_P02STATUS_REPEATED = 5 E2E_P02STATUS_OKSOMELOST = 6 E2E_P02STATUS_WRONGSEQUENCE = 7
    E2E_P02ProtectStateType: category=STRUCTURE  # State of the sender for a data protected with E2E Profile 2.
      element Counter: implementation-data-type=uint8  # Counter to be used for protecting the data. The initial value is 0, which means that the first data will have the counter 0. After the protection by the counter, the counter is incremented modulo 16.
    E2E_P02CheckStateType: category=STRUCTURE  # State of the receiver for a data protected with E2E Profile 2.
      8 x element, all with category=TYPE_REFERENCE:
        LastValidCounter: implementation-data-type=uint8  # Counter value most recently received. If no data has been yet received, then the value is 0x0. After each reception, the counter is updated with the value received.
        MaxDeltaCounter: implementation-data-type=uint8  # MaxDeltaCounter specifies the maximum allowed difference between two counter values of consecutively received valid messages.
        WaitForFirstData: implementation-data-type=boolean  # If true means that no correct data (with correct Data ID and CRC) has been yet received after the receiver initialization or reinitialization.
        NewDataAvailable: implementation-data-type=boolean  # Indicates to E2E library that a new data is available for library to be checked. This attribute is set by the E2E library caller, and not by the E2E library.
        LostData: implementation-data-type=uint8  # Number of data (messages) lost since reception of last valid one. This attribute is set only if status equals E2E_P02STATUS_OK or E2E_P02STATUS_OKSOMELOST. For other values of Ssatus, the value of LostData is undefined. E2E_P02CheckStatusType status result of the verification of the data, determined by the Check function.
        Status: implementation-data-type=E2E_P02CheckStatusType  # Result of the verification of the data, determined by the Check function.
        SyncCounter: implementation-data-type=uint8  # Number of data required for validating the consistency of the counter that must be received with a valid counter (i.e. counter within the allowed lock-in range) after the detection of an unexpected behavior of a received counter.
        NoNewOrRepeatedDataCounter: implementation-data-type=uint8  # Amount of consecutive reception cycles in which either (1) there was no new data, or (2) when the data was repeated.
    E2E_P02ConfigType: category=STRUCTURE  # Configuration of transmitted data (Data Element or I-PDU), for E2E Profile 2. The position of the counter and CRC is not configurable in profile 2.
      6 x element:
        DataLength: implementation-data-type=uint16  # Length of data, in bits. The value shall be a multiple of 8.
        DataIDList: category=ARRAY  # An array of appropriately chosen Data IDs for protection against masquerading.
          element DataIDListElement: array-size=16, array-size-semantics=FIXED-SIZE, implementation-data-type=uint8
        MaxDeltaCounterInit: implementation-data-type=uint8  # Initial maximum allowed gap between two counter values of two consecutively received valid data. For example, if the receiver gets data with counter 1 and MaxDeltaCounterInit is 1, then at the next reception the receiver can accept counters with values 2 and 3, but not 4. Note that if the receiver does not receive new data at a consecutive read, then the receiver increments the tolerance by 1.
        MaxNoNewOrRepeatedData: implementation-data-type=uint8  # The maximum amount of missing or repeated data which the receiver does not expect to exceed under normal communication conditions.
        SyncCounterInit: implementation-data-type=uint8  # Number of data required for validating the consistency of the counter that must be received with a valid counter (i.e. counter within the allowed lock-in range) after the detection of an unexpected behavior of a received counter.
        Offset: implementation-data-type=uint16  # Offset of the E2E header in the data[] array in bits. It shall be: 0 ≤ Offset ≤ MaxDataLength-(2*8).
    E2E_P04CheckStatusType: compu {0=E2E_P04STATUS_OK (OK: The new data has been received according to communication medium, the CRC is correct, the counter is incremented by 1 with respect to the most recent data received with Status _OK or _OKSOMELOST. This means that no data has been lost since the last correct data reception.), 1=E2E_P04STATUS_NONEWDATA (Error: The Check function has been invoked but no new data is not available since the last call, according to communication medium (e.g. RTE, COM). As a result, no E2E checks of data have been consequently executed.), 2=E2E_P04STATUS_ERROR (Error: The data has been received according to communication medium, but the CRC or the received length of data is incorrect. The error can be a result of corruption, incorrect addressing or masquerade.), 8=E2E_P04STATUS_REPEATED (Error: The new data has been received according to communication medium, the CRC and received lenth are correct, but the Counter is identical to the most recent data received with status _OK or _OKSOMELOST.), 32=E2E_P04STATUS_OKSOMELOST (OK: The new data has been received according to communication medium, the CRC and received lenth are correct, the counter is incremented by DeltaCounter (1 < DeltaCounter = MaxDeltaCounter) with respect to the most recent data received with status _OK or _OKSOMELOST. This means that some data in the sequence have been probably lost since the last correct reception, but this is within the configured tolerance range.), 64=E2E_P04STATUS_WRONGSEQUENCE (Error: The new data has been received according to communication medium, the CRC and received lenth are correct, but the counter delta is too big (DeltaCounter > MaxDeltaCounter) with respect to the most recent data received with Status _OK or _OKSOMELOST. This means that too many data in the sequence have been probably lost since the last correct reception.)}, implementation-data-type=uint8  # Result of the verification of the data in E2E Profile 4, determined by the Check function. | E2E_P04STATUS_OK = 0 E2E_P04STATUS_NONEWDATA = 1 E2E_P04STATUS_ERROR = 2 E2E_P04STATUS_REPEATED = 8 E2E_P04STATUS_OKSOMELOST = 32 E2E_P04STATUS_WRONGSEQUENCE = 64
    E2E_P04ProtectStateType: category=STRUCTURE  # State of the sender for a data protected with E2E Profile 4.
      element Counter: implementation-data-type=uint8  # Counter to be used for protecting the data. The initial value is 0, which means that the first data will have the counter 0. After protecting a message, the counter is incremented.
    E2E_P04CheckStateType: category=STRUCTURE  # State of the receiver for a data protected with E2E Profile 4.
      element Status: implementation-data-type=E2E_P04CheckStatusType  # Result of the verification of the data, determined by the Check function.
      element Counter: implementation-data-type=uint8  # Counter value most recently received. If no data has been yet received, then the value is 0x0. After each reception, the counter is updated with the value received.
    E2E_P04ConfigType: category=STRUCTURE  # Configuration of transmitted data (Data Element or I-PDU), for E2E Profile 4. The position of the counter, CRC, length and Data ID are configurable in profile 4.
      5 x element, all with category=TYPE_REFERENCE:
        DataID: implementation-data-type=uint32  # Data ID for protection against masquerading.
        Offset: implementation-data-type=uint16  # Offset of the E2E header in the data[] array in bits. It shall be: 0 ≤ Offset ≤ MaxDataLength - (12*8).
        MinDataLength: implementation-data-type=uint16  # Minimum length of data, in bits. The value shall be a multiple of 8 and higher or equal 96.
        MaxDataLength: implementation-data-type=uint16  # Maximum length of data, in bits. The value shall be a multiple of 8 and higher or equal 96 and MinDataLength.
        MaxDeltaCounter: implementation-data-type=uint16  # Maximum allowed gap between two counter values of two consecutively received valid data streams. For example, if the receiver gets data with counter 1 and MaxDeltaCounter is 1, then at the next reception the receiver can accept counters with values 2 and 3, but not 4.
    E2E_P05CheckStatusType: compu {0=E2E_P05STATUS_OK (OK: The new data has been received according to communication medium, the CRC is correct, the counter is incremented by 1 with respect to the most recent data received with status _OK or _OKSOMELOST. This means that no data has been lost since the last correct data reception.), 1=E2E_P05STATUS_NONEWDATA (Error: The Check function has been invoked but no new data is not available since the last call, according to communication medium (e.g. RTE, COM). As a result, no E2E checks of data have been consequently executed.), 7=E2E_P05STATUS_ERROR (Error: The data has been received according to communication medium, but the CRC is incorrect. The error can be a result of corruption, incorrect addressing or masquerade.), 8=E2E_P05STATUS_REPEATED (Error: The new data has been received according to communication medium, the CRC is correct, but the counter is identical to the most recent data received with status _OK or _OKSOMELOST.), 32=E2E_P05STATUS_OKSOMELOST (OK: The new data has been received according to communication medium, the CRC is correct, the counter is incremented by DeltaCounter (1 < DeltaCounter = MaxDeltaCounter) with respect to the most recent data received with status _OK or _OKSOMELOST. This means that some data in the sequence have been probably lost since the last correct reception, but this is within the configured tolerance range.), 64=E2E_P05STATUS_WRONGSEQUENCE (Error: The new data has been received according to communication medium, the CRC is correct, but the counter delta is too big (DeltaCounter > MaxDeltaCounter) with respect to the most recent data received with status _OK or _OKSOMELOST. This means that too many data in the sequence have been probably lost since the last correct reception.)}, implementation-data-type=uint8  # Result of the verification of the data in E2E Profile 5, determined by the Check function. | E2E_P05STATUS_OK = 0 E2E_P05STATUS_NONEWDATA = 1 E2E_P05STATUS_ERROR = 7 E2E_P05STATUS_REPEATED = 8 E2E_P05STATUS_OKSOMELOST = 32 E2E_P05STATUS_WRONGSEQUENCE = 64
    E2E_P05ProtectStateType: category=STRUCTURE  # State of the sender for a data protected with E2E Profile 5.
      element Counter: implementation-data-type=uint8  # Counter to be used for protecting the data. The initial value is 0, which means that the first data will have the counter 0. After the protection by the counter, the counter is incremented.
    E2E_P05CheckStateType: category=STRUCTURE  # State of the receiver for a data protected with E2E Profile 5.
      element Status: implementation-data-type=E2E_P05CheckStatusType  # Result of the verification of the data, determined by the Check function.
      element Counter: implementation-data-type=uint8  # Counter value most recently received. If no data has been yet received, then the value is 0x0. After each reception, the counter is updated with the value received.
    E2E_P05ConfigType: category=STRUCTURE  # Configuration of transmitted data (Data Element or I-PDU), for E2E Profile 5. The position of the counter and CRC are configurable in profile 5.
      4 x element, all with category=TYPE_REFERENCE:
        Offset: implementation-data-type=uint16  # Offset of the E2E header in the data[] array in bits. It shall be: 0 ≤ Offset ≤ DataLength-(3*8).
        DataLength: implementation-data-type=uint16  # Length of data, in bits. The value shall be a multiple of 8.
        DataID: implementation-data-type=uint16  # Data ID for protection against masquerading.
        MaxDeltaCounter: implementation-data-type=uint8  # Maximum allowed gap between two counter values of two consecutively received valid data. For example, if the receiver gets data with counter 1 and MaxDeltaCounter is 1, then at the next reception the receiver can accept counters with values 2 and 3, but not 4.
    E2E_P06CheckStatusType: compu {0=E2E_P06STATUS_OK (OK: The new data has been received according to communication medium, the CRC is correct, the counter is incremented by 1 with respect to the most recent data received with Status _OK or _OKSOMELOST. This means that no data has been lost since the last correct data reception.), 1=E2E_P06STATUS_NONEWDATA (Error: The Check function has been invoked but no new data is not available since the last call, according to communication medium (e.g. RTE, COM). As a result, no E2E checks of data have been consequently executed.), 7=E2E_P06STATUS_ERROR (Error: The data has been received according to communication medium, but the CRC or the received length of data is incorrect. The error can be a result of corruption, incorrect addressing or masquerade.), 8=E2E_P06STATUS_REPEATED (Error: The new data has been received according to communication medium, the CRC and received lenth are correct, but the Counter is identical to the most recent data received with status _OK or _OKSOMELOST.), 32=E2E_P06STATUS_OKSOMELOST (OK: The new data has been received according to communication medium, the CRC and received lenth are correct, the counter is incremented by DeltaCounter (1 < DeltaCounter = MaxDeltaCounter) with respect to the most recent data received with status _OK or _OKSOMELOST. This means that some data in the sequence have been probably lost since the last correct reception, but this is within the configured tolerance range.), 64=E2E_P06STATUS_WRONGSEQUENCE (Error: The new data has been received according to communication medium, the CRC and received lenth are correct, but the counter delta is too big (DeltaCounter > MaxDeltaCounter) with respect to the most recent data received with Status _OK or _OKSOMELOST. This means that too many data in the sequence have been probably lost since the last correct reception.)}, implementation-data-type=uint8  # Result of the verification of the data in E2E Profile 6, determined by the Check function. | E2E_P06STATUS_OK = 0 E2E_P06STATUS_NONEWDATA = 1 E2E_P06STATUS_ERROR = 7 E2E_P06STATUS_REPEATED = 8 E2E_P06STATUS_OKSOMELOST = 32 E2E_P06STATUS_WRONGSEQUENCE = 64
    E2E_P06ProtectStateType: category=STRUCTURE  # State of the sender for a data protected with E2E Profile 6.
      element Counter: implementation-data-type=uint8  # Counter to be used for protecting the data. The initial value is 0, which means that the first data will have the counter 0. After the protection by the counter, the counter is incremented.
    E2E_P06CheckStateType: category=STRUCTURE  # State of the receiver for a data protected with E2E Profile 6.
      element Status: implementation-data-type=E2E_P06CheckStatusType  # Result of the verification of the data, determined by the Check function.
      element Counter: implementation-data-type=uint8  # Counter value most recently received. If no data has been yet received, then the value is 0x0. After each reception, the counter is updated with the value received.
    E2E_P06ConfigType: category=STRUCTURE  # Configuration of transmitted data (Data Element or I-PDU), for E2E Profile 6. The position of the counter, CRC and length are configurable in profile 6.
      5 x element, all with category=TYPE_REFERENCE:
        Offset: implementation-data-type=uint16  # Offset of the E2E header in the data[] array in bits. It shall be: 0 ≤ Offset ≤ MaxDataLength-(5*8).
        MinDataLength: implementation-data-type=uint16  # Minimum length of data, in bits. The value shall be a multiple of 8.
        MaxDataLength: implementation-data-type=uint16  # Maximum length of data, in bits. The value shall be a multiple of 8.
        DataID: implementation-data-type=uint16  # Data ID for protection against masquerading.
        MaxDeltaCounter: implementation-data-type=uint8  # Maximum allowed gap between two counter values of two consecutively received valid data. For example, if the receiver gets data with counter 1 and MaxDeltaCounter is 1, then at the next reception the receiver can accept counters with values 2 and 3, but not 4.
    E2E_P07CheckStatusType: compu {0=E2E_P07STATUS_OK (OK: The new data has been received according to communication medium, the CRC is correct, the counter is incremented by 1 with respect to the most recent data received with Status _OK or _OKSOMELOST. This means that no data has been lost since the last correct data reception.), 1=E2E_P07STATUS_NONEWDATA (Error: The Check function has been invoked but no new data is not available since the last call, according to communication medium (e.g. RTE, COM). As a result, no E2E checks of data have been consequently executed.), 2=E2E_P07STATUS_ERROR (Error: The data has been received according to communication medium, but the CRC or the received length of data is incorrect. The error can be a result of corruption, incorrect addressing or masquerade.), 8=E2E_P07STATUS_REPEATED (Error: The new data has been received according to communication medium, the CRC and received lenth are correct, but the Counter is identical to the most recent data received with status _OK or _OKSOMELOST.), 32=E2E_P07STATUS_OKSOMELOST (OK: The new data has been received according to communication medium, the CRC and received lenth are correct, the counter is incremented by DeltaCounter (1 < DeltaCounter = MaxDeltaCounter) with respect to the most recent data received with status _OK or _OKSOMELOST. This means that some data in the sequence have been probably lost since the last correct reception, but this is within the configured tolerance range.), 64=E2E_P07STATUS_WRONGSEQUENCE (Error: The new data has been received according to communication medium, the CRC and received lenth are correct, but the counter delta is too big (DeltaCounter > MaxDeltaCounter) with respect to the most recent data received with Status _OK or _OKSOMELOST. This means that too many data in the sequence have been probably lost since the last correct reception.)}, implementation-data-type=uint8  # Result of the verification of the data in E2E Profile 7, determined by the Check function. | E2E_P07STATUS_OK = 0 E2E_P07STATUS_NONEWDATA = 1 E2E_P07STATUS_ERROR = 2 E2E_P07STATUS_REPEATED = 8 E2E_P07STATUS_OKSOMELOST = 32 E2E_P07STATUS_WRONGSEQUENCE = 64
    E2E_P07ProtectStateType: category=STRUCTURE  # State of the sender for a data protected with E2E Profile 7.
      element Counter: implementation-data-type=uint8  # Counter to be used for protecting the data. The initial value is 0, which means that the first data will have the counter 0. After protecting a message, the counter is incremented.
    E2E_P07CheckStateType: category=STRUCTURE  # State of the receiver for a data protected with E2E Profile 7.
      element Status: implementation-data-type=E2E_P07CheckStatusType  # Result of the verification of the data, determined by the Check function.
      element Counter: implementation-data-type=uint8  # Counter value most recently received. If no data has been yet received, then the value is 0x0. After each reception, the counter is updated with the value received.
    E2E_P07ConfigType: category=STRUCTURE  # Configuration of transmitted data (Data Element or I-PDU), for E2E Profile 7. The position of the counter, CRC, length and Data ID are configurable in profile 7.
      5 x element, all with category=TYPE_REFERENCE, implementation-data-type=uint32:
        DataID  # Data ID for protection against masquerading.
        Offset  # Offset of the E2E header in the data[] array in bits. It shall be: 0 ≤ Offset ≤ MaxDataLength - (20*8).
        MinDataLength  # Minimum length of data, in bits. The value shall be a multiple of 8 and higher or equal 160.
        MaxDataLength  # Maximum length of data, in bits. The value shall be a multiple of 8 and higher or equal 160 and MinDataLength.
        MaxDeltaCounter  # Maximum allowed gap between two counter values of two consecutively received valid data streams. For example, if the receiver gets data with counter 1 and MaxDeltaCounter is 1, then at the next reception the receiver can accept counters with values 2 and 3, but not 4.
    E2E_P11DataIDMode: compu {0=E2E_P11_DATAID_BOTH (Two bytes are included in the CRC (double ID configuration). This is used in E2E variant 1A.), 3=E2E_P11_DATAID_NIBBLE (The low byte is included in the implicit CRC calculation, the low nibble of the high byte is transmitted along with the data (i.e. it is explicitly included), the high nibble of the high byte is not used. This is applicable for the IDs up to 12 bits. This is used in E2E variant 1C.)}, implementation-data-type=uint8  # Enumeration type for Profile 11 Data ID mode | The Data ID is two bytes long in E2E Profile 11. There are two inclusion modes how the implicit two-byte Data ID is included in the one-byte CRC.
    E2E_P11CheckStatusType: compu {0=E2E_P11STATUS_OK (OK: The new data has been received according to communication medium, the CRC is correct, the counter is incremented by 1 with respect to the most recent data received with Status _OK or _OKSOMELOST. This means that no data has been lost since the last correct data reception.), 1=E2E_P11STATUS_NONEWDATA (Error: The Check function has been invoked but no new data is not available since the last call, according to communication medium (e.g. RTE, COM). As a result, no E2E checks of data have been consequently executed.), 2=E2E_P11STATUS_ERROR (Error: The data has been received according to communication medium, but the CRC or the received length of data is incorrect. The error can be a result of corruption, incorrect addressing or masquerade.), 8=E2E_P11STATUS_REPEATED (Error: The new data has been received according to communication medium, the CRC and received lenth are correct, but the Counter is identical to the most recent data received with status _OK or _OKSOMELOST.), 32=E2E_P11STATUS_OKSOMELOST (OK: The new data has been received according to communication medium, the CRC and received lenth are correct, the counter is incremented by DeltaCounter (1 < DeltaCounter = MaxDeltaCounter) with respect to the most recent data received with status _OK or _OKSOMELOST. This means that some data in the sequence have been probably lost since the last correct reception, but this is within the configured tolerance range.), 64=E2E_P11STATUS_WRONGSEQUENCE (Error: The new data has been received according to communication medium, the CRC and received lenth are correct, but the counter delta is too big (DeltaCounter > MaxDeltaCounter) with respect to the most recent data received with Status _OK or _OKSOMELOST. This means that too many data in the sequence have been probably lost since the last correct reception.)}, implementation-data-type=uint8  # Result of the verification of the data in E2E Profile 11, determined by the Check function. | E2E_P11STATUS_OK = 0 E2E_P11STATUS_NONEWDATA = 1 E2E_P11STATUS_ERROR = 7 E2E_P11STATUS_REPEATED = 8 E2E_P11STATUS_OKSOMELOST = 20 E2E_P11STATUS_WRONGSEQUENCE = 40
    E2E_P11ProtectStateType: category=STRUCTURE  # State of the sender for a data protected with E2E Profile 11.
      element Counter: implementation-data-type=uint8  # Counter to be used for protecting the data. The initial value is 0, which means that the first data will have the counter 0. After protecting a message, the counter is incremented.
    E2E_P11CheckStateType: category=STRUCTURE  # State of the receiver for a data protected with E2E Profile 11.
      element Status: implementation-data-type=E2E_P11CheckStatusType  # Result of the verification of the data, determined by the Check function.
      element Counter: implementation-data-type=uint8  # Counter value most recently received. If no data has been yet received, then the value is 0x0. After each reception, the counter is updated with the value received.
    E2E_P11ConfigType: category=STRUCTURE  # Configuration of transmitted data (Data Element or I-PDU), for E2E Profile 11. For each transmitted data, there is an instance of this typedef.
      7 x element, all with category=TYPE_REFERENCE:
        CounterOffset: implementation-data-type=uint16  # Bit offset of counter in MSB first order. In variants 1A and 1B, CounterOffset is 8. The offset shall be a multiple of 4.
        CRCOffset: implementation-data-type=uint16  # Bit offset of CRC (i.e. since *Data) in MSB first order. In variants 1A and 1B, CRCOffset is 0. The offset shall be a multiple of 8.
        DataID: implementation-data-type=uint16  # A unique identifier, for protection against masquerading. There are some constraints on the selection of ID values, described in section "Configuration constraints on Data IDs".
        DataIDNibbleOffset: implementation-data-type=uint16  # Bit offset of the low nibble of the high byte of Data ID. This parameter is used by E2E Library only if DataIDMode = E2E_P11_DATAID_NIBBLE (otherwise it is ignored by E2E Library). For DataIDMode different than E2E_P11_DATAID_NIBBLE, DataIDNibbleOffset shall be initialized to 0 (even if it is ignored by E2E Library).
        DataIDMode: implementation-data-type=E2E_P11DataIDMode  # Inclusion mode of ID in CRC computation (both bytes, alternating, or low byte only of ID included).
        DataLength: implementation-data-type=uint16  # Length of data, in bits. The value shall be a multiple of 8 and shall be ≤ 240.
        MaxDeltaCounter: implementation-data-type=uint8  # Maximum allowed gap between two counter values of two consecutively received valid data. For example, if the receiver gets Data with counter 1 and MaxDeltaCounter is 3, then at the next reception the receiver can accept counters with values 2 and 3 or 4.
    E2E_P22CheckStatusType: compu {0=E2E_P22STATUS_OK (OK: The new data has been received according to communication medium, the CRC is correct, the counter is incremented by 1 with respect to the most recent data received with Status _OK or _OKSOMELOST. This means that no data has been lost since the last correct data reception.), 1=E2E_P22STATUS_NONEWDATA (Error: The Check function has been invoked but no new data is not available since the last call, according to communication medium (e.g. RTE, COM). As a result, no E2E checks of data have been consequently executed.), 2=E2E_P22STATUS_ERROR (Error: The data has been received according to communication medium, but the CRC or the received length of data is incorrect. The error can be a result of corruption, incorrect addressing or masquerade.), 8=E2E_P22STATUS_REPEATED (Error: The new data has been received according to communication medium, the CRC and received lenth are correct, but the Counter is identical to the most recent data received with status _OK or _OKSOMELOST.), 32=E2E_P22STATUS_OKSOMELOST (OK: The new data has been received according to communication medium, the CRC and received lenth are correct, the counter is incremented by DeltaCounter (1 < DeltaCounter = MaxDeltaCounter) with respect to the most recent data received with status _OK or _OKSOMELOST. This means that some data in the sequence have been probably lost since the last correct reception, but this is within the configured tolerance range.), 64=E2E_P22STATUS_WRONGSEQUENCE (Error: The new data has been received according to communication medium, the CRC and received lenth are correct, but the counter delta is too big (DeltaCounter > MaxDeltaCounter) with respect to the most recent data received with Status _OK or _OKSOMELOST. This means that too many data in the sequence have been probably lost since the last correct reception.)}, implementation-data-type=uint8  # Result of the verification of the data in E2E Profile 22, determined by the Check function. | E2E_P22STATUS_OK = 0 E2E_P22STATUS_NONEWDATA = 1 E2E_P22STATUS_ERROR = 7 E2E_P22STATUS_REPEATED = 8 E2E_P22STATUS_OKSOMELOST = 20 E2E_P22STATUS_WRONGSEQUENCE = 40
    E2E_P22ProtectStateType: category=STRUCTURE  # State of the sender for a data protected with E2E Profile 22.
      element Counter: implementation-data-type=uint8  # Counter to be used for protecting the data. The initial value is 0, which means that the first data will have the counter 0. After protecting a message, the counter is incremented.
    E2E_P22CheckStateType: category=STRUCTURE  # State of the receiver for a data protected with E2E Profile 22.
      element Status: implementation-data-type=E2E_P22CheckStatusType  # Result of the verification of the data, determined by the Check function.
      element Counter: implementation-data-type=uint8  # Counter of last valid recieved message.
    E2E_P22ConfigType: category=STRUCTURE  # Configuration of transmitted data (Data Element or I-PDU), for E2E Profile 22. For each transmitted data, there is an instance of this typedef.
      4 x element, all with category=TYPE_REFERENCE:
        Offset: implementation-data-type=uint16  # Offset of E2E header in the Data[] array in bits. It shall be : Offset limit - [0,MaxDataLength-(2*8)] .
        DataIDList: implementation-data-type=uint16  # An array of appropriately chosen DataIDs for protection against masqerading.
        DataLength: implementation-data-type=uint16  # Length of data, in bits. The value shall be a multiple of 8.
        MaxDeltaCounter: implementation-data-type=uint8  # Maximum allowed gap between two counter values of two consecutively received valid data. For example, if the receiver gets Data with counter 1 and MaxDeltaCounter is 3, then at the next reception the receiver can accept counters with values 2 and 3 but not 4. Note that if receiver does not receive new Data at a consecutive read, then the receiver increments the tolerance by 1.
    E2E_P44CheckStatusType: compu {0=E2E_P44STATUS_OK (OK: The new data has been received according to communication medium, the CRC is correct, the counter is incremented by 1 with respect to the most recent data received with Status _OK or _OKSOMELOST. This means that no data has been lost since the last correct data reception.), 1=E2E_P44STATUS_NONEWDATA (Error: The Check function has been invoked but no new data is not available since the last call, according to communication medium (e.g. RTE, COM). As a result, no E2E checks of data have been consequently executed.), 2=E2E_P44STATUS_ERROR (Error: The data has been received according to communication medium, but the CRC or the received length of data is incorrect. The error can be a result of corruption, incorrect addressing or masquerade.), 8=E2E_P44STATUS_REPEATED (Error: The new data has been received according to communication medium, the CRC and received lenth are correct, but the Counter is identical to the most recent data received with status _OK or _OKSOMELOST.), 32=E2E_P44STATUS_OKSOMELOST (OK: The new data has been received according to communication medium, the CRC and received lenth are correct, the counter is incremented by DeltaCounter (1 < DeltaCounter = MaxDeltaCounter) with respect to the most recent data received with status _OK or _OKSOMELOST. This means that some data in the sequence have been probably lost since the last correct reception, but this is within the configured tolerance range.), 64=E2E_P44STATUS_WRONGSEQUENCE (Error: The new data has been received according to communication medium, the CRC and received lenth are correct, but the counter delta is too big (DeltaCounter > MaxDeltaCounter) with respect to the most recent data received with Status _OK or _OKSOMELOST. This means that too many data in the sequence have been probably lost since the last correct reception.)}, implementation-data-type=uint8  # Result of the verification of the data in E2E Profile 44, determined by the Check function. | E2E_P44STATUS_OK = 0 E2E_P44STATUS_NONEWDATA = 1 E2E_P44STATUS_ERROR = 2 E2E_P44STATUS_REPEATED = 8 E2E_P44STATUS_OKSOMELOST = 32 E2E_P44STATUS_WRONGSEQUENCE = 64
    E2E_P44ProtectStateType: category=STRUCTURE  # State of the sender for a data protected with E2E Profile 44.
      element Counter: implementation-data-type=uint8  # Counter to be used for protecting the data. The initial value is 0, which means that the first data will have the counter 0. After protecting a message, the counter is incremented.
    E2E_P44CheckStateType: category=STRUCTURE  # State of the receiver for a data protected with E2E Profile 44.
      element Status: implementation-data-type=E2E_P44CheckStatusType  # Result of the verification of the data, determined by the Check function.
      element Counter: implementation-data-type=uint8  # Counter value most recently received. If no data has been yet received, then the value is 0x0. After each reception, the counter is updated with the value received.
    E2E_P44ConfigType: category=STRUCTURE  # Configuration of transmitted data (Data Element or I-PDU), for E2E Profile 44. The position of the counter, CRC, length and Data ID are configurable in profile 44.
      5 x element, all with category=TYPE_REFERENCE:
        DataID: implementation-data-type=uint32  # Data ID for protection against masquerading.
        Offset: implementation-data-type=uint32  # Offset of the E2E header in the data[] array in bits. It shall be: 0 ≤ Offset ≤ MaxDataLength - (12*8).
        MinDataLength: implementation-data-type=uint32  # Minimum length of data, in bits. The value shall be a multiple of 8 and higher or equal 96.
        MaxDataLength: implementation-data-type=uint32  # Maximum length of data, in bits. The value shall be a multiple of 8 and higher or equal 96 and MinDataLength.
        MaxDeltaCounter: implementation-data-type=uint16  # Maximum allowed gap between two counter values of two consecutively received valid data streams. For example, if the receiver gets data with counter 1 and MaxDeltaCounter is 1, then at the next reception the receiver can accept counters with values 2 and 3, but not 4.
    E2E_SMConfigType: category=STRUCTURE  # Configuration of a communication channel for exchanging Data.
      7 x element, all with category=TYPE_REFERENCE, implementation-data-type=uint8:
        WindowSize  # Size of the monitoring window for the state machine.
        MinOkStateInit  # Minimal number of checks in which ProfileStatus equal to E2E_P_OK was determined within the last WindowSize checks (for the state E2E_SM_INIT) required to change to state E2E_SM_VALID.
        MaxErrorStateInit  # Maximal number of checks in which ProfileStatus equal to E2E_P_ERROR was determined, within the last WindowSize checks (for the state E2E_SM_INIT).
        MinOkStateValid  # Minimal number of checks in which ProfileStatus equal to E2E_P_OK was determined within the last WindowSize checks (for the state E2E_SM_VALID) required to keep in state E2E_SM_VALID.
        MaxErrorStateValid  # Maximal number of checks in which ProfileStatus equal to E2E_P_ERROR was determined, within the last WindowSize checks (for the state E2E_SM_VALID).
        MinOkStateInvalid  # Minimum number of checks in which ProfileStatus equal to E2E_P_OK was determined within the last WindowSize checks (for the state E2E_SM_INVALID) required to change to state E2E_SM_VALID.
        MaxErrorStateInvalid  # Maximal number of checks in which ProfileStatus equal to E2E_P_ERROR was determined, within the last WindowSize checks (for the state E2E_SM_INVALID).
    E2E_SMCheckStateType: category=STRUCTURE  # State of the protection of a communication channel.
      5 x element:
        ProfileStatusWindow: category=DATA_REFERENCE, sw-pointer-target-props={target-category=TYPE_REFERENCE, implementation-data-type=uint8}  # Pointer to an array, in which the ProfileStatus-es of the last E2Echecks are stored. The array size shall be WindowSize.
        WindowTopIndex: implementation-data-type=uint8  # Index in the array, at which the next ProfileStatus is to be written.
        OkCount: implementation-data-type=uint8  # Count of checks in which ProfileStatus equal to E2E_P_OK was determined, within the last WindowSize checks.
        ErrorCount: implementation-data-type=uint8  # Count of checks in which ProfileStatus equal to E2E_P_ERROR was determined,within the last WindowSize checks.
        SMState: implementation-data-type=E2E_SMStateType  # The current state in the state machine.
    E2E_SMStateType: compu {0=E2E_SM_VALID (Communication functioning properly according to E2E, data can be used.), 1=E2E_SM_DEINIT (State before E2E_SMCheckInit() is invoked, data cannot be used.), 2=E2E_SM_NODATA (No data from the sender is available since the initialization, data cannot be used.), 3=E2E_SM_INIT (There has been some data received since startup, but it is not yet possible use it, data cannot be used.), 4=E2E_SM_INVALID (Communication not functioning properly, data cannot be used.)}, implementation-data-type=uint8  # Status of the communication channel exchanging the data. If the status is OK, then the data may be used.
    E2E_PCheckStatusType: compu {0=E2E_P_OK (OK: The checks of the data in this cycle were successful (including counter check).), 1=E2E_P_REPEATED (Data has a repeated counter.), 2=E2E_P_WRONGSEQUENCE (The checks of the data in this cycle were successful, with the exception of counter jump, which changed more than the allowed delta.), 3=E2E_P_ERROR (Error not related to counters occurred (e.g. wrong crc, wrong length, wrong Data ID) or the return of the check function was not OK.), 4=E2E_P_NOTAVAILABLE (No value has been received yet (e.g. during initialization). This is used as the initialization value for the buffer, it is not returned by any E2E profile.), 5=E2E_P_NONEWDATA (No new data is available.)}, implementation-data-type=uint8  # Profile-independent status of the reception of a single message in one cycle.
