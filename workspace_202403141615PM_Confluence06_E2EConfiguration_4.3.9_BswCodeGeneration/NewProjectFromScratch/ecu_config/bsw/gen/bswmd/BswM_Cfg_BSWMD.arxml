AUTOSAR XML (schema 4-2-2)
package /AUTOSAR_BswM/BswModuleEntrys
  17 x bsw module entry, all with sw-service-impl-policy=STANDARD:
    BswM_Deinit: service-id=0x04, is-reentrant=false, is-synchronous=true, call-type=REGULAR, execution-context=TASK  # API to Deinitialize the BSW Mode Manager | Function call to deinitialize the BSW Mode Manager | After execution of this routine no mode processing shall be performed by BswM even if any mode requests are made or the BswM main function is called.
    BswM_Init: service-id=0x00, is-reentrant=false, is-synchronous=true, call-type=REGULAR, execution-context=TASK  # API to Initialize the BSW Mode Manager | Function call to Initialize the BSW Mode Manager | This API will initialise the BSW Mode Manager module by intializing the global variables with the data provided by the configuration pointer.
      sw service arg ConfigPtr: category=DATA_REFERENCE, direction=INOUT, sw-impl-policy=CONST, sw-pointer-target-props={target-category=VALUE, implementation-data-type=BswM_ConfigType}  # Pointer to post-build configuration data
    BswM_GetVersionInfo: service-id=0x01, is-reentrant=true, is-synchronous=true, call-type=REGULAR, execution-context=TASK  # API to Return the version information of BswM module | Returns the version information of BswM module | This API will return the version information of BswM module
      sw service arg VersionInfo: category=DATA_REFERENCE, direction=INOUT, sw-impl-policy=CONST, sw-pointer-target-props={target-category=VALUE, implementation-data-type=Std_VersionInfoType}  # Pointer to where to store the version information of the module
    BswM_RequestMode: service-id=0x02, is-reentrant=true, is-synchronous=true, call-type=REGULAR, execution-context=TASK  # API to sevice Generic Request. | Generic function call to request modes. This function shall only be used by other BSW modules that does not have a specific mode request interface. | The corresponding configuration container for this API is BswMGenericRequest, i.e. this mode request originates from a requester that is not among the list of standardized mode requesters.
      sw service arg Requesting_user: direction=IN, implementation-data-type=BswM_UserType  # The user that requests the mode.
      sw service arg Requested_mode: direction=IN, implementation-data-type=BswM_ModeType  # The requested mode.
    BswM_MainFunction: is-reentrant=false, is-synchronous=false, call-type=SCHEDULED, execution-context=TASK
    BswM_Cfg_ImdtBswNotification_BswM_MRP_BswM_MDG_ECU_STARTUP_ONE: is-reentrant=true, is-synchronous=true, call-type=SCHEDULED, execution-context=TASK
    BswM_Cfg_ImdtBswNotification_BswM_MRP_BswM_MDG_ECU_STARTUP_TWO: is-reentrant=true, is-synchronous=true, call-type=SCHEDULED, execution-context=TASK
    BswM_Cfg_ImdtBswNotification_BswM_MRP_BswM_MDG_ECU_RUN: is-reentrant=true, is-synchronous=true, call-type=SCHEDULED, execution-context=TASK
    BswM_Cfg_ImdtBswNotification_BswM_MRP_BswM_MDG_ECU_APP_RUN: is-reentrant=true, is-synchronous=true, call-type=SCHEDULED, execution-context=TASK
    BswM_Cfg_ImdtBswNotification_BswM_MRP_BswM_MDG_ECU_APP_POST_RUN: is-reentrant=true, is-synchronous=true, call-type=SCHEDULED, execution-context=TASK
    BswM_Cfg_ImdtBswNotification_BswM_MRP_BswM_MDG_: is-reentrant=true, is-synchronous=true, call-type=SCHEDULED, execution-context=TASK
    BswM_Cfg_DfrdBswNotification_MRP_R_BswM_AR_InitBlockTwo_0_ECU_STARTUP_ONE: is-reentrant=true, is-synchronous=true, call-type=SCHEDULED, execution-context=TASK
    BswM_Cfg_AC_SchMSwitch_0_BswM_AI_BswMSwitchAppRun: is-reentrant=true, is-synchronous=true, call-type=REGULAR, execution-context=UNSPECIFIED
    BswM_Cfg_AC_SchMSwitch_1_BswM_AI_BswMSwitchPostRun: is-reentrant=true, is-synchronous=true, call-type=REGULAR, execution-context=UNSPECIFIED
    BswM_Cfg_AC_SchMSwitch_2_BswM_AI_BswMSwitchPrepShutdown: is-reentrant=true, is-synchronous=true, call-type=REGULAR, execution-context=UNSPECIFIED
    BswM_Cfg_AC_SchMSwitch_3_BswM_AI_BswMSwitchRun: is-reentrant=true, is-synchronous=true, call-type=REGULAR, execution-context=UNSPECIFIED
    BswM_Cfg_AC_SchMSwitch_4_BswM_AI_BswMSwitchStartupTwo: is-reentrant=true, is-synchronous=true, call-type=REGULAR, execution-context=UNSPECIFIED
package /AUTOSAR_BswM/ImplementationDataTypes
  impl type BswM_ConfigType: category=STRUCTURE, type-emitter=HEADER_FILE
    element dataVersionInfo_st: implementation-data-type=Std_VersionInfoType
  impl type BswM_ModeType: implementation-data-type=uint16
  impl type BswM_UserType: implementation-data-type=uint16
package /AUTOSAR_BswM/BswModuleDescriptions
  bsw module description BswM: category=BSW_MODULE, module-id=42
    provided-entrys:
      BswM_MainFunction
      BswM_Init
      BswM_Deinit
      BswM_GetVersionInfo
      BswM_RequestMode
      BswM_Cfg_ImdtBswNotification_BswM_MRP_BswM_MDG_ECU_STARTUP_ONE
      BswM_Cfg_ImdtBswNotification_BswM_MRP_BswM_MDG_ECU_STARTUP_TWO
      BswM_Cfg_ImdtBswNotification_BswM_MRP_BswM_MDG_ECU_RUN
      BswM_Cfg_ImdtBswNotification_BswM_MRP_BswM_MDG_ECU_APP_RUN
      BswM_Cfg_ImdtBswNotification_BswM_MRP_BswM_MDG_ECU_APP_POST_RUN
      BswM_Cfg_ImdtBswNotification_BswM_MRP_BswM_MDG_
      BswM_Cfg_DfrdBswNotification_MRP_R_BswM_AR_InitBlockTwo_0_ECU_STARTUP_ONE
      BswM_Cfg_AC_SchMSwitch_0_BswM_AI_BswMSwitchAppRun
      BswM_Cfg_AC_SchMSwitch_1_BswM_AI_BswMSwitchPostRun
      BswM_Cfg_AC_SchMSwitch_2_BswM_AI_BswMSwitchPrepShutdown
      BswM_Cfg_AC_SchMSwitch_3_BswM_AI_BswMSwitchRun
      BswM_Cfg_AC_SchMSwitch_4_BswM_AI_BswMSwitchStartupTwo
    provided-mode-groups:
      mode declaration group prototype MDGP_AUTOSAR_BswM_ModeDeclarationGroups_MDG_ECUM_STATE: type=MDG_ECUM_STATE
    required-mode-groups:
      mode declaration group prototype MDGR_BswM_MRP_BswM_MDG: type=MDG_ECUM_STATE
      mode declaration group prototype MDGR_MRP_R_BswM_AR_InitBlockTwo_0: type=MDG_ECUM_STATE
    bsw internal behavior IB_BswM: data-type-mapping=[ECUM_STATE_Mapping, MG_Shutdown_Mapping], bsw-mode-sender-policy{provided-mode-group=MDGP_AUTOSAR_BswM_ModeDeclarationGroups_MDG_ECUM_STATE, queue-length=1}
      8 x bsw schedulable entity:
        SE_BswM_MainFunction: implemented-entry=BswM_MainFunction
        SE_BswM_Cfg_ImdtBswNotification_BswM_MRP_BswM_MDG_ECU_STARTUP_ONE: accessed-mode-groups=MDGR_BswM_MRP_BswM_MDG, implemented-entry=BswM_Cfg_ImdtBswNotification_BswM_MRP_BswM_MDG_ECU_STARTUP_ONE
        SE_BswM_Cfg_ImdtBswNotification_BswM_MRP_BswM_MDG_ECU_STARTUP_TWO: accessed-mode-groups=MDGR_BswM_MRP_BswM_MDG, implemented-entry=BswM_Cfg_ImdtBswNotification_BswM_MRP_BswM_MDG_ECU_STARTUP_TWO
        SE_BswM_Cfg_ImdtBswNotification_BswM_MRP_BswM_MDG_ECU_RUN: accessed-mode-groups=MDGR_BswM_MRP_BswM_MDG, implemented-entry=BswM_Cfg_ImdtBswNotification_BswM_MRP_BswM_MDG_ECU_RUN
        SE_BswM_Cfg_ImdtBswNotification_BswM_MRP_BswM_MDG_ECU_APP_RUN: accessed-mode-groups=MDGR_BswM_MRP_BswM_MDG, implemented-entry=BswM_Cfg_ImdtBswNotification_BswM_MRP_BswM_MDG_ECU_APP_RUN
        SE_BswM_Cfg_ImdtBswNotification_BswM_MRP_BswM_MDG_ECU_APP_POST_RUN: accessed-mode-groups=MDGR_BswM_MRP_BswM_MDG, implemented-entry=BswM_Cfg_ImdtBswNotification_BswM_MRP_BswM_MDG_ECU_APP_POST_RUN
        SE_BswM_Cfg_ImdtBswNotification_BswM_MRP_BswM_MDG_: accessed-mode-groups=MDGR_BswM_MRP_BswM_MDG, implemented-entry=BswM_Cfg_ImdtBswNotification_BswM_MRP_BswM_MDG_
        SE_BswM_Cfg_DfrdBswNotification_MRP_R_BswM_AR_InitBlockTwo_0_ECU_STARTUP_ONE: accessed-mode-groups=MDGR_MRP_R_BswM_AR_InitBlockTwo_0, implemented-entry=BswM_Cfg_DfrdBswNotification_MRP_R_BswM_AR_InitBlockTwo_0_ECU_STARTUP_ONE
      5 x bsw called entity:
        CE_BswM_Action_BswM_AI_BswMSwitchAppRun: implemented-entry=BswM_Cfg_AC_SchMSwitch_0_BswM_AI_BswMSwitchAppRun, managed-mode-groups=MDGP_AUTOSAR_BswM_ModeDeclarationGroups_MDG_ECUM_STATE
        CE_BswM_Action_BswM_AI_BswMSwitchPostRun: implemented-entry=BswM_Cfg_AC_SchMSwitch_1_BswM_AI_BswMSwitchPostRun, managed-mode-groups=MDGP_AUTOSAR_BswM_ModeDeclarationGroups_MDG_ECUM_STATE
        CE_BswM_Action_BswM_AI_BswMSwitchPrepShutdown: implemented-entry=BswM_Cfg_AC_SchMSwitch_2_BswM_AI_BswMSwitchPrepShutdown
        CE_BswM_Action_BswM_AI_BswMSwitchRun: implemented-entry=BswM_Cfg_AC_SchMSwitch_3_BswM_AI_BswMSwitchRun, managed-mode-groups=MDGP_AUTOSAR_BswM_ModeDeclarationGroups_MDG_ECUM_STATE
        CE_BswM_Action_BswM_AI_BswMSwitchStartupTwo: implemented-entry=BswM_Cfg_AC_SchMSwitch_4_BswM_AI_BswMSwitchStartupTwo, managed-mode-groups=MDGP_AUTOSAR_BswM_ModeDeclarationGroups_MDG_ECUM_STATE
      bsw timing event TE_BswM_MainFunction: starts-on-event=SE_BswM_MainFunction, period=0.01
      7 x bsw mode switch event, all with activation=ON-ENTRY:
        MSE_BswM_Cfg_ImdtBswNotification_BswM_MRP_BswM_MDG_ECU_STARTUP_ONE: starts-on-event=SE_BswM_Cfg_ImdtBswNotification_BswM_MRP_BswM_MDG_ECU_STARTUP_ONE, mode=MDGR_BswM_MRP_BswM_MDG.ECU_STARTUP_ONE
        MSE_BswM_Cfg_ImdtBswNotification_BswM_MRP_BswM_MDG_ECU_STARTUP_TWO: starts-on-event=SE_BswM_Cfg_ImdtBswNotification_BswM_MRP_BswM_MDG_ECU_STARTUP_TWO, mode=MDGR_BswM_MRP_BswM_MDG.ECU_STARTUP_TWO
        MSE_BswM_Cfg_ImdtBswNotification_BswM_MRP_BswM_MDG_ECU_RUN: starts-on-event=SE_BswM_Cfg_ImdtBswNotification_BswM_MRP_BswM_MDG_ECU_RUN, mode=MDGR_BswM_MRP_BswM_MDG.ECU_RUN
        MSE_BswM_Cfg_ImdtBswNotification_BswM_MRP_BswM_MDG_ECU_APP_RUN: starts-on-event=SE_BswM_Cfg_ImdtBswNotification_BswM_MRP_BswM_MDG_ECU_APP_RUN, mode=MDGR_BswM_MRP_BswM_MDG.ECU_APP_RUN
        MSE_BswM_Cfg_ImdtBswNotification_BswM_MRP_BswM_MDG_ECU_APP_POST_RUN: starts-on-event=SE_BswM_Cfg_ImdtBswNotification_BswM_MRP_BswM_MDG_ECU_APP_POST_RUN, mode=MDGR_BswM_MRP_BswM_MDG.ECU_APP_POST_RUN
        MSE_BswM_Cfg_ImdtBswNotification_BswM_MRP_BswM_MDG_: starts-on-event=SE_BswM_Cfg_ImdtBswNotification_BswM_MRP_BswM_MDG_, mode=MDGR_BswM_MRP_BswM_MDG.
        MSE_BswM_Cfg_DfrdBswNotification_MRP_R_BswM_AR_InitBlockTwo_0_ECU_STARTUP_ONE: starts-on-event=SE_BswM_Cfg_DfrdBswNotification_MRP_R_BswM_AR_InitBlockTwo_0_ECU_STARTUP_ONE, mode=MDGR_MRP_R_BswM_AR_InitBlockTwo_0.ECU_STARTUP_ONE
      mode-receiver-policys:
        required-mode-group=MDGR_BswM_MRP_BswM_MDG, supports-asynchronous-mode-switch=true
        required-mode-group=MDGR_MRP_R_BswM_AR_InitBlockTwo_0, supports-asynchronous-mode-switch=true
package /AUTOSAR_BswM/BswImplementations
  bsw implementation BSWIMPL_BswM: programming-language=C, sw-version=5.0.0, swc-bsw-mapping=BswM, ar-release-version=4.5.0, behavior=IB_BswM
    code-descriptors:
      code CodeDescriptor: artifact-descriptors=autosar-engineering-object={short-label=ArEngObj, category=SWSRC}
    resource consumption BswM_ResourceConsumption
      16 x memory section:
        BSWM_VAR_CLEARED_8: prefix=BSWM, sw-addrmethod=VAR_CLEARED, symbol=VAR_CLEARED_8
        BSWM_VAR_CLEARED_32: prefix=BSWM, sw-addrmethod=VAR_CLEARED, symbol=VAR_CLEARED_32
        BSWM_VAR_CLEARED_BOOLEAN: prefix=BSWM, sw-addrmethod=VAR_CLEARED, symbol=VAR_CLEARED_BOOLEAN
        BSWM_VAR_INIT_8: prefix=BSWM, sw-addrmethod=VAR_INIT, symbol=VAR_INIT_8
        BSWM_VAR_INIT_16: prefix=BSWM, sw-addrmethod=VAR_INIT, symbol=VAR_INIT_16
        BSWM_VAR_INIT_UNSPECIFIED: prefix=BSWM, sw-addrmethod=VAR_INIT, symbol=VAR_INIT_UNSPECIFIED
        BSWM_VAR_CLEARED_UNSPECIFIED: prefix=BSWM, sw-addrmethod=VAR_CLEARED, symbol=VAR_CLEARED_UNSPECIFIED
        BSWM_VAR_INIT_BOOLEAN: prefix=BSWM, sw-addrmethod=VAR_INIT, symbol=VAR_INIT_BOOLEAN
        BSWM_CONST_8: prefix=BSWM, sw-addrmethod=CONST, symbol=CONST_8
        BSWM_CONST_16: prefix=BSWM, sw-addrmethod=CONST, symbol=CONST_16
        BSWM_CONST_UNSPECIFIED: prefix=BSWM, sw-addrmethod=CONST, symbol=CONST_UNSPECIFIED
        BSWM_CONFIG_DATA_POSTBUILD_32: prefix=BSWM, sw-addrmethod=CONFIG_DATA_POSTBUILD, symbol=CONFIG_DATA_POSTBUILD_32
        BSWM_CONFIG_DATA_POSTBUILD_UNSPECIFIED: prefix=BSWM, sw-addrmethod=CONFIG_DATA_POSTBUILD, symbol=CONFIG_DATA_POSTBUILD_UNSPECIFIED
        BSWM_CODE: prefix=BSWM, sw-addrmethod=CODE, symbol=CODE
        BswM_CODE: prefix=BswM, sw-addrmethod=CODE, symbol=CODE
        BSWM_VAR_SAVED_ZONE_UNSPECIFIED: prefix=BSWM, sw-addrmethod=VAR_SAVED_ZONE, symbol=VAR_SAVED_ZONE_UNSPECIFIED
      section name prefix BSWM
      section name prefix BswM
