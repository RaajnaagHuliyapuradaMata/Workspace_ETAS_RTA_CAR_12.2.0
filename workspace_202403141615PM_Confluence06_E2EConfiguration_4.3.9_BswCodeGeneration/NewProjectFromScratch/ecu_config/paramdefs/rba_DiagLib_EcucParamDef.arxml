AUTOSAR XML (schema 00048)
package /RB/RBA/rba_DiagLib/EcucModuleDefs
  module definition rba_DiagLib [0..1]: category=VENDOR_SPECIFIC_MODULE_DEFINITION, refined-module-def=rba_DiagLib, variants pre-compile  # ConfigurationItems of DiagLib.
    container rba_DiagLib_DataStructure [1..*]  # DataStructure | DataStructure for code generation.
      string rba_DiagLib_AssertIsLockedMacro [0..1]: multiplicity set at pre-compile, set at pre-compile  # AssertIsLockedMacro | Specify the component specific is-locked check macro. it will be used to check atomic access of array elements. intended to be used during test execution
      string rba_DiagLib_IndexType: multiplicity set at pre-compile, set at pre-compile  # IndexType | IndexType used for accessing the array elements (e.g. Dem_EventIdType).
      boolean rba_DiagLib_InvalidIndex [0..1]: multiplicity set at pre-compile, set at pre-compile, default-value=false  # InvalidIndex | Should the first entry in the datastructure be generated with an additional invalid entry
      integer rba_DiagLib_NumberOfDataItems [0..1]: multiplicity set at pre-compile, set at pre-compile  # NumberOfDataItems | NumberOfDataItems used to define the number of items in case it is used for RAM data structures. It shall not be set in case ROM data is generated.
      string rba_DiagLib_RangeCheckMacro [0..1]: multiplicity set at pre-compile, set at pre-compile  # RangeCheckMacro | Specify the component specific range check macro. it will be used to check array access (avoid out of bounds access). intended to be used during test execution
      string rba_DiagLib_UnusedParamMacro [0..1]: multiplicity set at pre-compile, set at pre-compile  # UnusedParamMacro | Specify the component specific unused param macro. it will be used to avoid error messages with unsed indx variable
      container rba_DiagLib_Attribute [0..*]  # Attribute | Defines the different attributes of the DataStructure.
        integer rba_DiagLib_BitSize: 0..255, multiplicity set at pre-compile, origin=RB:AR40.4.0.0:2012-06-01, set at pre-compile, default-value=255  # BitSize | Bitsize required for the Attribute.
        string rba_DiagLib_IdenticalValueOfAllDataItems [0..1]: multiplicity set at pre-compile, set at pre-compile  # IdenticalValueOfAllDataItems | In case all DataItems have the same value, this globally common value can be stored here.
        boolean rba_DiagLib_RequiresAtomicAccess [0..1]: multiplicity set at pre-compile, set at pre-compile, default-value=false  # RequiresAtomicAccess | Specify whether this attribute has to be accessed within a LOCK. An assert IS_LOCKED will be integrated into access functions.
        string rba_DiagLib_ReturnValueIfDisabled [0..1]: multiplicity set at pre-compile, set at pre-compile  # ReturnValueIfDisabled | In case the attribute is sset to disabled (due to project configuration), this value will be returned in the corresponding access function.
        string rba_DiagLib_Type: multiplicity set at pre-compile, set at pre-compile  # Type | Type used, if not bitencoded.
        boolean rba_DiagLib_usesCalibration [0..1]: multiplicity set at pre-compile, set at pre-compile, default-value=false  # UsesCalibration | Specify whether this attribute shall be moved to separate DataContainer for calibration usecase (separate flashing).
        reference rba_DiagLib_DataContainerRef [0..1]: multiplicity set at pre-compile, set at pre-compile, destination=rba_DiagLib_DataContainer  # DataContainerRef | Reference to the container the attribute will be encoded to.
      container rba_DiagLib_DataContainer [0..*]  # DataContainer | Defines the dataContainer used for generating the code. The actual attributes are mapped to the dataCnotainers.
        boolean rba_DiagLib_isCalibrationContainer [0..1]: multiplicity set at pre-compile, set at pre-compile, default-value=false  # isCalibrationContainer | Specify whether this container is filled with attributes using calibration.
        integer rba_DiagLib_OccupiedBitSize [1..32]: 0..32, multiplicity set at pre-compile, origin=RB:AR40.4.0.0:2012-06-01, set at pre-compile, default-value=255  # OccupiedBitSize | Number of Bits in container already used for storing data.
        integer rba_DiagLib_TotalBitSize: 0..32, multiplicity set at pre-compile, origin=RB:AR40.4.0.0:2012-06-01, set at pre-compile, default-value=255  # TotalBitSize | Number of Bits available in container for storing data attributes.
      container rba_DiagLib_DataItem [1..*]  # DataItem | DataItem for code generation of type DataStructure.
        container rba_DiagLib_AttributeValue [0..*]  # AttributeValue | Defines the value of a certain DataObject-Attribute.
          string rba_DiagLib_Value: multiplicity set at pre-compile, set at pre-compile  # Value | Value of the DataItem.
          reference rba_DiagLib_AttributeRef [0..1]: multiplicity set at pre-compile, set at pre-compile, destination=rba_DiagLib_Attribute  # AttributeRef | Reference to the Attribute in DataStructure.
