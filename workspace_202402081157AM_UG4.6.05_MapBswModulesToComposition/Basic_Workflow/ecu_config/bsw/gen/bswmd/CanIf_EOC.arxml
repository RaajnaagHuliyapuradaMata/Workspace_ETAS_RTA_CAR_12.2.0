AUTOSAR XML (schema 4-3-0)
package /CanIf_EOC
  bsw module timing CanIf: behavior=BswInternalBehavior
    timing-requirements:
      execution order constraint EOC_CanIf_Init: execution-order-constraint-type=ORDINARY-EOC, is-event=false, permit-multiple-references-to-ee=false
        ordered-elements:
          eoc executable entity ref EOCExecutableEntityRef_CanIf_Init: bsw-module-instance=CanIf, executable=CE_Init
