AUTOSAR XML (schema 00050)
package /ETAS_Project/EcucModuleConfigurationValuess
  module config rba_BswSrv
    rba_BswSrv_Config: rba_BswSrv_Config_Disable_Lock_support=true
