AUTOSAR XML (schema 4-2-2)
package /RB/UBK/Project/EcucModuleConfigurationValuess
  module config rba_ArxmlGen
    ComM (rba_ArxmlGen_Comp):
      rba_ArxmlGen_CompCategory = BswModule
      rba_ArxmlGen_CompId = 12
      rba_ArxmlGen_CompIsConfigurable = true
      rba_ArxmlGen_CompIsStandalone = false
      rba_ArxmlGen_CompIsStandardized = true
      rba_ArxmlGen_CompLongName = COMManager
      8 x rba_ArxmlGen_ApplDataType:
        ComM_uint8_App: rba_ArxmlGen_ApplDataTypeCategory=Simple, rba_ArxmlGen_ApplDataTypeDispFormat=%5.0f, rba_ArxmlGen_ApplDataTypeLongName=uint8 application datatype in ComM, rba_ArxmlGen_ApplDataTypeCompuMethodRef=Identical, rba_ArxmlGen_ApplDataTypeDataConstrOwnRef=ComM_DataConstraint_u8, rba_ArxmlGen_ApplDataTypeImplOwnRef=ComM_uint8_Impl
        ComM_boolean_App: rba_ArxmlGen_ApplDataTypeCategory=Simple, rba_ArxmlGen_ApplDataTypeDispFormat=%5.0f, rba_ArxmlGen_ApplDataTypeLongName=boolean application datatype in ComM, rba_ArxmlGen_ApplDataTypeCompuMethodRef=Identical, rba_ArxmlGen_ApplDataTypeDataConstrOwnRef=ComM_DataConstraint_u8, rba_ArxmlGen_ApplDataTypeImplOwnRef=ComM_bool_Impl
        ComM_UserStruct_Array_App: rba_ArxmlGen_ApplDataTypeCategory=Array, rba_ArxmlGen_ApplDataTypeLongName=Array for usermode requested by ComMUser of type uint8, rba_ArxmlGen_ApplDataTypeImplOwnRef=ComM_UserStruct_Array_Impl
          ComM_UserStruct_Sub_App (rba_ArxmlGen_ApplDataTypeSub): rba_ArxmlGen_ApplDataTypeSubOwnRef=ComM_UserStruct_App
        ComM_ChannelStruct_App: rba_ArxmlGen_ApplDataTypeCategory=Struct, rba_ArxmlGen_ApplDataTypeLongName=Structure containing all channel related parameters, rba_ArxmlGen_ApplDataTypeImplOwnRef=ComM_ChannelStruct_Impl
          16 x rba_ArxmlGen_ApplDataTypeSub:
            ChannelState_e: rba_ArxmlGen_ApplDataTypeSubOwnRef=ComM_uint32_App
            LightTimeoutCtr_u32: rba_ArxmlGen_ApplDataTypeSubOwnRef=ComM_uint32_App
            MinFullComTimeoutCtr_u16: rba_ArxmlGen_ApplDataTypeSubOwnRef=ComM_unit16_App
            UserRequestCtr_u16: rba_ArxmlGen_ApplDataTypeSubOwnRef=ComM_unit16_App
            ChannelMode_u8: rba_ArxmlGen_ApplDataTypeSubOwnRef=ComM_uint8_App
            BusSmMode_u8: rba_ArxmlGen_ApplDataTypeSubOwnRef=ComM_uint8_App
            PassiveRequestState_u8: rba_ArxmlGen_ApplDataTypeSubOwnRef=ComM_uint8_App
            PncRequestCtr_u8: rba_ArxmlGen_ApplDataTypeSubOwnRef=ComM_uint8_App
            InhibitionReqStatus_u8: rba_ArxmlGen_ApplDataTypeSubOwnRef=ComM_uint8_App
            NmNetworkRequestStatus_b: rba_ArxmlGen_ApplDataTypeSubOwnRef=ComM_boolean_App
            DiagnosticRequestState_b: rba_ArxmlGen_ApplDataTypeSubOwnRef=ComM_boolean_App
            CommunicationAllowed_b: rba_ArxmlGen_ApplDataTypeSubOwnRef=ComM_boolean_App
            NmBusSleepIndicationStatus_b: rba_ArxmlGen_ApplDataTypeSubOwnRef=ComM_boolean_App
            BusSMSleepIndicationStatus_b: rba_ArxmlGen_ApplDataTypeSubOwnRef=ComM_boolean_App
            NmPrepareBusSleepIndicationStatus_b: rba_ArxmlGen_ApplDataTypeSubOwnRef=ComM_boolean_App
            NmNetworkModeStatus_b: rba_ArxmlGen_ApplDataTypeSubOwnRef=ComM_boolean_App
        ComM_ChannelStruct_Array_App: rba_ArxmlGen_ApplDataTypeCategory=Array, rba_ArxmlGen_ApplDataTypeLongName=Array of channel structure, rba_ArxmlGen_ApplDataTypeImplOwnRef=ComM_ChannelStruct_Array_Impl
          ComM_ChannelStruct_Sub_App (rba_ArxmlGen_ApplDataTypeSub): rba_ArxmlGen_ApplDataTypeSubOwnRef=ComM_ChannelStruct_App
        ComM_unit16_App: rba_ArxmlGen_ApplDataTypeCategory=Simple, rba_ArxmlGen_ApplDataTypeDispFormat=%5.0f, rba_ArxmlGen_ApplDataTypeLongName=uint16 application data type in ComM, rba_ArxmlGen_ApplDataTypeCompuMethodRef=Identical, rba_ArxmlGen_ApplDataTypeDataConstrOwnRef=ComM_DataConstraint_u16, rba_ArxmlGen_ApplDataTypeImplOwnRef=ComM_uint16_Impl
        ComM_uint32_App: rba_ArxmlGen_ApplDataTypeCategory=Simple, rba_ArxmlGen_ApplDataTypeDispFormat=%5.0f, rba_ArxmlGen_ApplDataTypeLongName=application data type for uint32 in ComM, rba_ArxmlGen_ApplDataTypeCompuMethodRef=Identical, rba_ArxmlGen_ApplDataTypeDataConstrOwnRef=ComM_DataConstraint_u32, rba_ArxmlGen_ApplDataTypeImplOwnRef=ComM_uint32_Impl
        ComM_UserStruct_App: rba_ArxmlGen_ApplDataTypeCategory=Struct, rba_ArxmlGen_ApplDataTypeLongName=Structure containing all user related parameters, rba_ArxmlGen_ApplDataTypeImplOwnRef=ComM_UserStruct_Impl
          7 x rba_ArxmlGen_ApplDataTypeSub:
            WakeUpInhibitionCtr_u16: rba_ArxmlGen_ApplDataTypeSubOwnRef=ComM_unit16_App
            LimitToNoComCtr_u16: rba_ArxmlGen_ApplDataTypeSubOwnRef=ComM_unit16_App
            RequestedUserMode_u8: rba_ArxmlGen_ApplDataTypeSubOwnRef=ComM_uint8_App
            IndicatedUserMode_u8: rba_ArxmlGen_ApplDataTypeSubOwnRef=ComM_uint8_App
            numChannelsInFullCom_u8: rba_ArxmlGen_ApplDataTypeSubOwnRef=ComM_uint8_App
            numChannelsInSilentCom_u8: rba_ArxmlGen_ApplDataTypeSubOwnRef=ComM_uint8_App
            numChannelsInNoCom_u8: rba_ArxmlGen_ApplDataTypeSubOwnRef=ComM_uint8_App
      3 x rba_ArxmlGen_DataConstraint, all with rba_ArxmlGen_DataConstraintCategory=Physical, rba_ArxmlGen_DataConstraintLower=0, rba_ArxmlGen_DataConstraintUnitRef=NoUnit:
        ComM_DataConstraint_u8: rba_ArxmlGen_DataConstraintUpper=255
        ComM_DataConstraint_u16: rba_ArxmlGen_DataConstraintUpper=65535
        ComM_DataConstraint_u32: rba_ArxmlGen_DataConstraintUpper=4294967295
      CE_Init (rba_ArxmlGen_ExecEntity): rba_ArxmlGen_ExecEntityCategory=Called, rba_ArxmlGen_ExecEntityImplEntryRef=ComM_Init
      8 x rba_ArxmlGen_ImplDataType:
        ComM_bool_Impl: rba_ArxmlGen_ImplDataTypeCategory=Simple, rba_ArxmlGen_ImplDataTypeLongName=implementation data type for application data type boolean, rba_ArxmlGen_ImplDataTypeBaseRef=uint8
        ComM_UserStruct_Array_Impl: rba_ArxmlGen_ImplDataTypeCategory=Array, rba_ArxmlGen_ImplDataTypeLongName=Array for user structure
          ComM_UserStruct_Sub_impl (rba_ArxmlGen_ImplDataTypeSub): rba_ArxmlGen_ImplDataTypeSubOwnRef=ComM_UserStruct_Impl
        ComM_ChannelStruct_Impl: rba_ArxmlGen_ImplDataTypeCategory=Struct, rba_ArxmlGen_ImplDataTypeLongName=Structure containing all channel related parameters
          16 x rba_ArxmlGen_ImplDataTypeSub:
            ChannelState_e: rba_ArxmlGen_ImplDataTypeSubOwnRef=ComM_uint32_Impl
            LightTimeoutCtr_u32: rba_ArxmlGen_ImplDataTypeSubOwnRef=ComM_uint32_Impl
            MinFullComTimeoutCtr_u16: rba_ArxmlGen_ImplDataTypeSubOwnRef=ComM_uint16_Impl
            UserRequestCtr_u16: rba_ArxmlGen_ImplDataTypeSubOwnRef=ComM_uint16_Impl
            ChannelMode_u8: rba_ArxmlGen_ImplDataTypeSubOwnRef=ComM_uint8_Impl
            BusSmMode_u8: rba_ArxmlGen_ImplDataTypeSubOwnRef=ComM_uint8_Impl
            PassiveRequestState_u8: rba_ArxmlGen_ImplDataTypeSubOwnRef=ComM_uint8_Impl
            PncRequestCtr_u8: rba_ArxmlGen_ImplDataTypeSubOwnRef=ComM_uint8_Impl
            InhibitionReqStatus_u8: rba_ArxmlGen_ImplDataTypeSubOwnRef=ComM_uint8_Impl
            NmNetworkRequestStatus_b: rba_ArxmlGen_ImplDataTypeSubOwnRef=ComM_bool_Impl
            DiagnosticRequestState_b: rba_ArxmlGen_ImplDataTypeSubOwnRef=ComM_bool_Impl
            CommunicationAllowed_b: rba_ArxmlGen_ImplDataTypeSubOwnRef=ComM_bool_Impl
            NmBusSleepIndicationStatus_b: rba_ArxmlGen_ImplDataTypeSubOwnRef=ComM_bool_Impl
            BusSMSleepIndicationStatus_b: rba_ArxmlGen_ImplDataTypeSubOwnRef=ComM_bool_Impl
            NmPrepareBusSleepIndicationStatus_b: rba_ArxmlGen_ImplDataTypeSubOwnRef=ComM_bool_Impl
            NmNetworkModeStatus_b: rba_ArxmlGen_ImplDataTypeSubOwnRef=ComM_bool_Impl
        ComM_ChannelStruct_Array_Impl: rba_ArxmlGen_ImplDataTypeCategory=Array, rba_ArxmlGen_ImplDataTypeLongName=Array of channel structure
          ComM_ChannelStruct_Sub_Impl (rba_ArxmlGen_ImplDataTypeSub): rba_ArxmlGen_ImplDataTypeSubOwnRef=ComM_ChannelStruct_Impl
        ComM_uint8_Impl: rba_ArxmlGen_ImplDataTypeCategory=Simple, rba_ArxmlGen_ImplDataTypeLongName=Implementation data type for uint8, rba_ArxmlGen_ImplDataTypeBaseRef=uint8
        ComM_uint16_Impl: rba_ArxmlGen_ImplDataTypeCategory=Simple, rba_ArxmlGen_ImplDataTypeLongName=Implementation datatype for uint16, rba_ArxmlGen_ImplDataTypeBaseRef=uint16
        ComM_uint32_Impl: rba_ArxmlGen_ImplDataTypeCategory=Simple, rba_ArxmlGen_ImplDataTypeLongName=Implementation data type for uint32, rba_ArxmlGen_ImplDataTypeBaseRef=uint32
        ComM_UserStruct_Impl: rba_ArxmlGen_ImplDataTypeCategory=Struct, rba_ArxmlGen_ImplDataTypeLongName=Structure containing all user related data
          7 x rba_ArxmlGen_ImplDataTypeSub:
            WakeUpInhibitionCtr_u16: rba_ArxmlGen_ImplDataTypeSubOwnRef=ComM_uint16_Impl
            LimitToNoComCtr_u16: rba_ArxmlGen_ImplDataTypeSubOwnRef=ComM_uint16_Impl
            RequestedUserMode_u8: rba_ArxmlGen_ImplDataTypeSubOwnRef=ComM_uint8_Impl
            IndicatedUserMode_u8: rba_ArxmlGen_ImplDataTypeSubOwnRef=ComM_uint8_Impl
            numChannelsInFullCom_u8: rba_ArxmlGen_ImplDataTypeSubOwnRef=ComM_uint8_Impl
            numChannelsInSilentCom_u8: rba_ArxmlGen_ImplDataTypeSubOwnRef=ComM_uint8_Impl
            numChannelsInNoCom_u8: rba_ArxmlGen_ImplDataTypeSubOwnRef=ComM_uint8_Impl
      ComM_UserStruct (rba_ArxmlGen_Measurement):
        rba_ArxmlGen_MeasCategory = Array
        rba_ArxmlGen_MeasLongName = ComM user structure
        rba_ArxmlGen_MeasAddrMethodRef = INTERNAL_VAR_CLEARED
        rba_ArxmlGen_MeasApplDataTypeOwnRef = ComM_UserStruct_Array_App
      ComM_ChannelStruct (rba_ArxmlGen_Measurement):
        rba_ArxmlGen_MeasCategory = Array
        rba_ArxmlGen_MeasLongName = ComM Channel structure
        rba_ArxmlGen_MeasAddrMethodRef = INTERNAL_VAR_CLEARED
        rba_ArxmlGen_MeasApplDataTypeOwnRef = ComM_ChannelStruct_Array_App
      4 x rba_ArxmlGen_Memsection:
        CODE: rba_ArxmlGen_MemsectionAddrMethodRef=CODE
        CONFIG_DATA: rba_ArxmlGen_MemsectionDatatype_08=true, rba_ArxmlGen_MemsectionDatatype_16=true, rba_ArxmlGen_MemsectionDatatype_UNSPECIFIED=true, rba_ArxmlGen_MemsectionAddrMethodRef=CONFIG_DATA
        CONST: rba_ArxmlGen_MemsectionDatatype_08=true, rba_ArxmlGen_MemsectionDatatype_UNSPECIFIED=true, rba_ArxmlGen_MemsectionAddrMethodRef=CONST
        VAR_CLEARED: rba_ArxmlGen_MemsectionDatatype_08=true, rba_ArxmlGen_MemsectionDatatype_UNSPECIFIED=true, rba_ArxmlGen_MemsectionDatatype_16=true, rba_ArxmlGen_MemsectionAddrMethodRef=VAR_CLEARED
