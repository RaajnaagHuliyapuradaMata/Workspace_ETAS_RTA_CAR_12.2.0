AUTOSAR XML (schema 4-2-2)
package /RB/UBK/Project/EcucModuleConfigurationValuess
  module config rba_ArxmlGen
    Com (rba_ArxmlGen_Comp):
      rba_ArxmlGen_CompCategory = BswModule
      rba_ArxmlGen_CompId = 50
      rba_ArxmlGen_CompIsConfigurable = true
      rba_ArxmlGen_CompIsStandalone = false
      rba_ArxmlGen_CompIsStandardized = true
      rba_ArxmlGen_CompLongName = Communication
      5 x rba_ArxmlGen_ApplDataType, all with rba_ArxmlGen_ApplDataTypeCategory=Simple, rba_ArxmlGen_ApplDataTypeDispFormat=%5.0f:
        Com_IPduStatus_type: rba_ArxmlGen_ApplDataTypeLongName=unsigned char, rba_ArxmlGen_ApplDataTypeCompuMethodOwnRef=Com_IPduStatus_enum_type, rba_ArxmlGen_ApplDataTypeDataConstrOwnRef=Com_DataConstraint_b, rba_ArxmlGen_ApplDataTypeImplOwnRef=Com_impl_b
        Com_uint8: rba_ArxmlGen_ApplDataTypeLongName=unsigned char, rba_ArxmlGen_ApplDataTypeCompuMethodRef=Identical, rba_ArxmlGen_ApplDataTypeDataConstrOwnRef=Com_DataConstraint_u8, rba_ArxmlGen_ApplDataTypeImplOwnRef=Com_impl_u8
        Com_uint16: rba_ArxmlGen_ApplDataTypeLongName=unsigned short, rba_ArxmlGen_ApplDataTypeCompuMethodRef=Identical, rba_ArxmlGen_ApplDataTypeDataConstrOwnRef=Com_DataConstraint_u16, rba_ArxmlGen_ApplDataTypeImplOwnRef=Com_impl_u16
        Com_uint32: rba_ArxmlGen_ApplDataTypeLongName=unsigned int, rba_ArxmlGen_ApplDataTypeCompuMethodRef=Identical, rba_ArxmlGen_ApplDataTypeDataConstrOwnRef=Com_DataConstraint_u32, rba_ArxmlGen_ApplDataTypeImplOwnRef=Com_impl_u32
        Com_uint64: rba_ArxmlGen_ApplDataTypeLongName=unsigned long long, rba_ArxmlGen_ApplDataTypeCompuMethodRef=Identical, rba_ArxmlGen_ApplDataTypeDataConstrOwnRef=Com_DataConstraint_u64, rba_ArxmlGen_ApplDataTypeImplOwnRef=Com_impl_u64
      9 x rba_ArxmlGen_BswModuleEntry, all with rba_ArxmlGen_IsReentrant=false, rba_ArxmlGen_BswExecutionContext=UNSPECIFIED, rba_ArxmlGen_swServiceImplPolicy=STANDARD:
        Com_Init: rba_ArxmlGen_IsSynchronus=true, rba_ArxmlGen_BswCallType=REGULAR
        Com_TxConfirmation: rba_ArxmlGen_IsSynchronus=false, rba_ArxmlGen_BswCallType=CALLBACK
        Com_RxIndication: rba_ArxmlGen_IsSynchronus=false, rba_ArxmlGen_BswCallType=CALLBACK
        Com_TriggerTransmit: rba_ArxmlGen_IsSynchronus=true, rba_ArxmlGen_BswCallType=CALLBACK
        Com_CopyTxData: rba_ArxmlGen_IsSynchronus=false, rba_ArxmlGen_BswCallType=CALLBACK
        Com_TpTxConfirmation: rba_ArxmlGen_IsSynchronus=false, rba_ArxmlGen_BswCallType=CALLBACK
        Com_StartOfReception: rba_ArxmlGen_IsSynchronus=false, rba_ArxmlGen_BswCallType=CALLBACK
        Com_CopyRxData: rba_ArxmlGen_IsSynchronus=false, rba_ArxmlGen_BswCallType=CALLBACK
        Com_TpRxIndication: rba_ArxmlGen_IsSynchronus=false, rba_ArxmlGen_BswCallType=CALLBACK
      Com_IPduStatus_enum_type (rba_ArxmlGen_CompuMethod): rba_ArxmlGen_CompuMethodCategory=TextTable, rba_ArxmlGen_CompuMethodLongName=Computation Method for ComIPdu Calibration Status
        IPDU_INACTIVE (rba_ArxmlGen_CompuMethodTextEntry): rba_ArxmlGen_CompuMethodTEIntVal=0, rba_ArxmlGen_CompuMethodTENumVals=1, rba_ArxmlGen_CompuMethodTEText=INACTIVE
        IPDU_ACTIVE (rba_ArxmlGen_CompuMethodTextEntry): rba_ArxmlGen_CompuMethodTEIntVal=1, rba_ArxmlGen_CompuMethodTENumVals=1, rba_ArxmlGen_CompuMethodTEText=ACTIVE
      5 x rba_ArxmlGen_DataConstraint, all with rba_ArxmlGen_DataConstraintCategory=Physical, rba_ArxmlGen_DataConstraintLower=0, rba_ArxmlGen_DataConstraintUnitRef=NoUnit:
        Com_DataConstraint_b: rba_ArxmlGen_DataConstraintUpper=1
        Com_DataConstraint_u8: rba_ArxmlGen_DataConstraintUpper=255
        Com_DataConstraint_u16: rba_ArxmlGen_DataConstraintUpper=65535
        Com_DataConstraint_u32: rba_ArxmlGen_DataConstraintUpper=4294967295
        Com_DataConstraint_u64: rba_ArxmlGen_DataConstraintUpper=9223372036854775807
      CE_Init (rba_ArxmlGen_ExecEntity): rba_ArxmlGen_ExecEntityCategory=Called, rba_ArxmlGen_ExecEntityImplEntryRef=Com_Init
      5 x rba_ArxmlGen_ImplDataType, all with rba_ArxmlGen_ImplDataTypeCategory=Simple:
        Com_impl_b: rba_ArxmlGen_ImplDataTypeLongName=unsigned char, rba_ArxmlGen_ImplDataTypeBaseRef=boolean
        Com_impl_u8: rba_ArxmlGen_ImplDataTypeLongName=unsigned char, rba_ArxmlGen_ImplDataTypeBaseRef=uint8
        Com_impl_u16: rba_ArxmlGen_ImplDataTypeLongName=unsigned short, rba_ArxmlGen_ImplDataTypeBaseRef=uint16
        Com_impl_u32: rba_ArxmlGen_ImplDataTypeLongName=unsigned long, rba_ArxmlGen_ImplDataTypeBaseRef=uint32
        Com_impl_u64: rba_ArxmlGen_ImplDataTypeLongName=unsigned long long, rba_ArxmlGen_ImplDataTypeBaseRef=uint64
