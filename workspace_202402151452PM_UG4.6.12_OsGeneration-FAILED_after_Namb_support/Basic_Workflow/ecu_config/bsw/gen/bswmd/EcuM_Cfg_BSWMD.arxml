AUTOSAR XML (schema 4-2-2)
package /AUTOSAR_EcuM/BswModuleEntrys
  bsw module entry EcuM_MainFunction: is-reentrant=true, is-synchronous=false, call-type=SCHEDULED, execution-context=TASK, sw-service-impl-policy=STANDARD
package /AUTOSAR_EcuM/BswModuleDescriptions
  bsw module description EcuM: category=BSW_MODULE, module-id=10  # ECU State Manager
    bsw internal behavior BswInternalBehavior
      bsw schedulable entity SE_MainFunction: implemented-entry=EcuM_MainFunction
      bsw timing event TE_EcuM_MainFunction: starts-on-event=SE_MainFunction, period=0.01
package /AUTOSAR_EcuM/BswImplementations
  bsw implementation EcuM: programming-language=C, sw-version=5.0.1, ar-release-version=4.5.0, behavior=BswInternalBehavior
    code-descriptors:
      code CodeDescriptor: artifact-descriptors=autosar-engineering-object={short-label=ArEngObj, category=SWSRC}
    resource consumption EcuM_ResourceConsumption
      23 x memory section:
        ECUM_VAR_CLEARED_8: prefix=ECUM, sw-addrmethod=VAR_CLEARED, symbol=VAR_CLEARED_8
        ECUM_VAR_CLEARED_16: prefix=ECUM, sw-addrmethod=VAR_CLEARED, symbol=VAR_CLEARED_16
        ECUM_VAR_CLEARED_32: prefix=ECUM, sw-addrmethod=VAR_CLEARED, symbol=VAR_CLEARED_32
        ECUM_VAR_CLEARED_BOOLEAN: prefix=ECUM, sw-addrmethod=VAR_CLEARED, symbol=VAR_CLEARED_BOOLEAN
        ECUM_VAR_INIT_BOOLEAN: prefix=ECUM, sw-addrmethod=VAR_INIT, symbol=VAR_INIT_BOOLEAN
        ECUM_VAR_INIT_16: prefix=ECUM, sw-addrmethod=VAR_INIT, symbol=VAR_INIT_16
        ECUM_VAR_CLEARED_UNSPECIFIED: prefix=ECUM, sw-addrmethod=VAR_CLEARED, symbol=VAR_CLEARED_UNSPECIFIED
        ECUM_VAR_INIT_UNSPECIFIED: prefix=ECUM, sw-addrmethod=VAR_INIT, symbol=VAR_INIT_UNSPECIFIED
        ECUM_VAR_POWER_ON_CLEARED_8: prefix=ECUM, sw-addrmethod=VAR_POWER_ON_CLEARED, symbol=VAR_POWER_ON_CLEARED_8
        ECUM_VAR_POWER_ON_CLEARED_32: prefix=ECUM, sw-addrmethod=VAR_POWER_ON_CLEARED, symbol=VAR_POWER_ON_CLEARED_32
        ECUM_VAR_POWER_ON_CLEARED_UNSPECIFIED: prefix=ECUM, sw-addrmethod=VAR_POWER_ON_CLEARED, symbol=VAR_POWER_ON_CLEARED_UNSPECIFIED
        ECUM_VAR_SAVED_ZONE_BOOLEAN: prefix=ECUM, sw-addrmethod=VAR_SAVED_ZONE, symbol=VAR_SAVED_ZONE_BOOLEAN
        ECUM_VAR_SAVED_ZONE_UNSPECIFIED: prefix=ECUM, sw-addrmethod=VAR_SAVED_ZONE, symbol=VAR_SAVED_ZONE_UNSPECIFIED
        ECUM_CONST_8: prefix=ECUM, sw-addrmethod=CONST, symbol=CONST_8
        ECUM_CONST_UNSPECIFIED: prefix=ECUM, sw-addrmethod=CONST, symbol=CONST_UNSPECIFIED
        ECUM_CONST_16: prefix=ECUM, sw-addrmethod=CONST, symbol=CONST_16
        ECUM_CONST_32: prefix=ECUM, sw-addrmethod=CONST, symbol=CONST_32
        ECUM_CONFIG_DATA_8: prefix=ECUM, sw-addrmethod=CONFIG_DATA, symbol=CONFIG_DATA_8
        ECUM_CONFIG_DATA_POSTBUILD_UNSPECIFIED: prefix=ECUM, sw-addrmethod=CONFIG_DATA_POSTBUILD, symbol=CONFIG_DATA_POSTBUILD_UNSPECIFIED
        ECUM_CALLOUT_CODE: prefix=ECUM, sw-addrmethod=CALLOUT_CODE, symbol=CALLOUT_CODE
        ECUM_VAR_INIT_8: prefix=ECUM, sw-addrmethod=VAR_INIT, symbol=VAR_INIT_8
        ECUM_CODE: prefix=ECUM, sw-addrmethod=CODE, symbol=CODE
        EcuM_CODE: prefix=EcuM, sw-addrmethod=CODE, symbol=CODE
      section name prefix ECUM
      section name prefix EcuM
