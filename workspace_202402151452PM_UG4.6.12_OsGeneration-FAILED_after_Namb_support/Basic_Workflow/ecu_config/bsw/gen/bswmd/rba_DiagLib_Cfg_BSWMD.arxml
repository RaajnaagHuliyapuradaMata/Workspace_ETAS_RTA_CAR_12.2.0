AUTOSAR XML (schema 4-2-2)
package /AUTOSAR_rba_DiagLib/BswModuleDescriptions
  bsw module description rba_DiagLib: category=BSW_MODULE
    bsw internal behavior BswInternalBehavior
package /AUTOSAR_rba_DiagLib/BswImplementations
  bsw implementation rba_DiagLib: programming-language=C, sw-version=6.1.0, vendor-id=6, ar-release-version=4.5.0, behavior=BswInternalBehavior
    code-descriptors:
      code CodeDescriptor: artifact-descriptors=autosar-engineering-object={short-label=ArEngObj, category=SWSRC}
    resource consumption rba_DiagLib_ResourceConsumption
      memory section RBA_DIAGLIB_CODE: prefix=RBA_DIAGLIB, sw-addrmethod=CODE, symbol=CODE
      section name prefix RBA_DIAGLIB
