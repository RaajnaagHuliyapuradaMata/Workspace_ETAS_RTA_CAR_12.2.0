AUTOSAR XML (schema 4-3-0)
package /AUTOSAR_PduR/ApplicationDataTypes
  app type PduR_uint8: category=VALUE, sw-calibration-access=READ-WRITE, compu-method=Identical, range phys 0..255, display-format=%5.0f  # uint8
package /AUTOSAR_PduR/BswImplementations
  bsw implementation PduR: programming-language=C, sw-version=8.0.0, ar-release-version=4.5.0, behavior=BswInternalBehavior
    code-descriptors:
      code CodeDescriptor: artifact-descriptors=autosar-engineering-object={short-label=ArEngObj, category=SWSRC}
    resource consumption PduR_ResourceConsumption
      11 x memory section:
        PDUR_CONFIG_DATA_8: alignment=8, prefix=PDUR, sw-addrmethod=CONFIG_DATA, symbol=CONFIG_DATA_8
        PDUR_CONFIG_DATA_UNSPECIFIED: alignment=UNSPECIFIED, prefix=PDUR, sw-addrmethod=CONFIG_DATA, symbol=CONFIG_DATA_UNSPECIFIED
        PduR_CODE: prefix=PduR, sw-addrmethod=CODE, symbol=CODE
        PDUR_CODE: prefix=PDUR, sw-addrmethod=CODE, symbol=CODE
        PDUR_VAR_INIT_UNSPECIFIED: alignment=UNSPECIFIED, prefix=PDUR, sw-addrmethod=VAR_INIT, symbol=VAR_INIT_UNSPECIFIED
        PDUR_CONST_8: alignment=8, prefix=PDUR, sw-addrmethod=CONST, symbol=CONST_8
        PDUR_CONST_32: alignment=32, prefix=PDUR, sw-addrmethod=CONST, symbol=CONST_32
        PDUR_CONST_UNSPECIFIED: alignment=UNSPECIFIED, prefix=PDUR, sw-addrmethod=CONST, symbol=CONST_UNSPECIFIED
        PDUR_VAR_CLEARED_8: alignment=8, prefix=PDUR, sw-addrmethod=VAR_CLEARED, symbol=VAR_CLEARED_8
        PDUR_VAR_CLEARED_16: alignment=16, prefix=PDUR, sw-addrmethod=VAR_CLEARED, symbol=VAR_CLEARED_16
        PDUR_VAR_CLEARED_UNSPECIFIED: alignment=UNSPECIFIED, prefix=PDUR, sw-addrmethod=VAR_CLEARED, symbol=VAR_CLEARED_UNSPECIFIED
      section name prefix PduR
      section name prefix PDUR
package /AUTOSAR_PduR/BswModuleDescriptions
  bsw module description PduR: provided-entrys=[PduR_Init, PduR_GetVersionInfo]
    bsw internal behavior BswInternalBehavior: data-type-mapping=DataTypeMappingSet
      static-memorys:
        data PduR_State: category=VALUE, sw-addr-method=INTERNAL_VAR_CLEARED, sw-calibration-access=READ-ONLY, display-format=%5.0f, type=PduR_uint8  # State information of Pdur module
      bsw called entity CE_Init: implemented-entry=PduR_Init
package /AUTOSAR_PduR/BswModuleEntrys
  bsw module entry PduR_Init: is-reentrant=false, is-synchronous=true, call-type=REGULAR, execution-context=UNSPECIFIED, sw-service-impl-policy=STANDARD
  bsw module entry PduR_GetVersionInfo: is-reentrant=false, is-synchronous=true, call-type=CALLBACK, execution-context=UNSPECIFIED, sw-service-impl-policy=STANDARD
package /AUTOSAR_PduR/DataTypeMappingSets
  data type mapping set DataTypeMappingSet: data-type-map{application-data-type=PduR_uint8, implementation-data-type=PduR_uint8_impl}
package /AUTOSAR_PduR/ImplementationDataTypes
  impl type PduR_uint8_impl: implementation-data-type=uint8  # implementation data type for application data type uint8
package /AUTOSAR_PduR/Units
  unit NoUnit: display-name=noUnit, factor-si-to-unit=1.0, offset-si-to-unit=0.0, physical-dimension=NoUnit  # No Unit
package /AUTOSAR_PduR/PhysicalDimensions
  physical dimension NoUnit: length-exp=0
