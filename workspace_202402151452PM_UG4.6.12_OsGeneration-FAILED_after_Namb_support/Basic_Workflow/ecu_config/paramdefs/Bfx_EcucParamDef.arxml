AUTOSAR XML (schema 4-2-2)
package /AUTOSAR_Bfx/EcucModuleDefs
  module definition Bfx [0..1]: category=VENDOR_SPECIFIC_MODULE_DEFINITION, refined-module-def=Bfx, variants pre-compile  # Bit Handling Library
    container BfxGeneral  # General settings for Bfx | General settings for Bfx with selections for used controller and activation of GetVersionInfo interface
      enumeration BfxRbOptimization [0..1]: multiplicity set at pre-compile, origin=RB:1.0.0:2010-12-15, set at pre-compile  # Select for which controller optimized implementations shall be used
        TC17xx  # Tricore TC17xx controller
        TC27xx  # Tricore TC27xx controller
        MPC57xx  # JDP MPC57xx controller
        MPCCut2  # JDP MPC Cut2 controller
        ARMV8X32  # ARMV8X32 controllers
        NO_OPTIMIZATION  # No optimization, standard C implementations shall be used
      boolean BfxRbOptimizationMcuExtract [0..1]: multiplicity set at pre-compile, origin=RB:10.0.0:2015-06-18, set at pre-compile, default-value=false  # Select whether to fetch machine type from MCU and configure for controller optimized implementation | If BfxRbOptimizationMcuExtract is chosen as "True", then the controller information will be extracted from MCU.Based on this, optimized implementations will be selected.Hence the user should not configure "BfxRbOptimization".If BfxRbOptimizationMcuExtract is chosen as "False", the controller information will not be extracted from MCU and so the user needs to configure "BfxRbOptimization" manually.
      enumeration Bfx_VersionInfoAPI: origin=RB:1.0.0:2010-12-15, set at pre-compile  # Configuration parameter for activation of Bfx_GetVersionInfo function. | If BfxVersionInfoAPI is set to "ON", the function BfxGetVersionInfo shall return the version information of the Bfx library. If BfxVersionInfoAPI is set to "OFF", the Bfx library shall not provide the function Bfx_GetVersionInfo
        ON  # Activate BfxGetVersionInfo function.
        OFF  # Deactivate BfxGetVersionInfo function.
    container BfxRbMemoryLocations  # Memory locations | Choose memory location settings for each single service
      enumeration bfxRbMemLocClrBitMasku16u16: origin=RB:1.0.0:2010-12-17, set at pre-compile  # Bfx_ClrBitMask_u16u16 | Select one of following values: NORMAL for location in normal flash, FAST for location in fast flash, SLOW for location in slow flash, INLINE for inlining of the service
        NORMAL  # Location in normal flash
        FAST  # Location in fast flash
        SLOW  # Location in slow flash
        INLINE  # Service is inlined
      enumeration bfxRbMemLocClrBitMasku32u32: origin=RB:1.0.0:2010-12-17, set at pre-compile  # Bfx_ClrBitMask_u32u32 | Select one of following values: NORMAL for location in normal flash, FAST for location in fast flash, SLOW for location in slow flash, INLINE for inlining of the service
        NORMAL  # Location in normal flash
        FAST  # Location in fast flash
        SLOW  # Location in slow flash
        INLINE  # Service is inlined
      enumeration bfxRbMemLocClrBitMasku64u64: origin=RB:5.1.0:2019-02-04, set at pre-compile  # Bfx_ClrBitMask_u64u64 | Select one of following values: NORMAL for location in normal flash, FAST for location in fast flash, SLOW for location in slow flash, INLINE for inlining of the service
        NORMAL  # Location in normal flash
        FAST  # Location in fast flash
        SLOW  # Location in slow flash
        INLINE  # Service is inlined
      enumeration bfxRbMemLocClrBitMasku8u8: origin=RB:1.0.0:2010-12-17, set at pre-compile  # Bfx_ClrBitMask_u8u8 | Select one of following values: NORMAL for location in normal flash, FAST for location in fast flash, SLOW for location in slow flash, INLINE for inlining of the service
        NORMAL  # Location in normal flash
        FAST  # Location in fast flash
        SLOW  # Location in slow flash
        INLINE  # Service is inlined
      enumeration bfxRbMemLocClrBitu16u8: origin=RB:1.0.0:2010-12-17, set at pre-compile  # Bfx_ClrBit_u16u8 | Select one of following values: NORMAL for location in normal flash, FAST for location in fast flash, SLOW for location in slow flash, INLINE for inlining of the service
        NORMAL  # Location in normal flash
        FAST  # Location in fast flash
        SLOW  # Location in slow flash
        INLINE  # Service is inlined
      enumeration bfxRbMemLocClrBitu32u8: origin=RB:1.0.0:2010-12-17, set at pre-compile  # Bfx_ClrBit_u32u8 | Select one of following values: NORMAL for location in normal flash, FAST for location in fast flash, SLOW for location in slow flash, INLINE for inlining of the service
        NORMAL  # Location in normal flash
        FAST  # Location in fast flash
        SLOW  # Location in slow flash
        INLINE  # Service is inlined
      enumeration bfxRbMemLocClrBitu64u8: origin=RB:5.1.0:2019-02-04, set at pre-compile  # Bfx_ClrBit_u64u8 | Select one of following values: NORMAL for location in normal flash, FAST for location in fast flash, SLOW for location in slow flash, INLINE for inlining of the service
        NORMAL  # Location in normal flash
        FAST  # Location in fast flash
        SLOW  # Location in slow flash
        INLINE  # Service is inlined
      enumeration bfxRbMemLocClrBitu8u8: origin=RB:1.0.0:2010-12-17, set at pre-compile  # Bfx_ClrBit_u8u8 | Select one of following values: NORMAL for location in normal flash, FAST for location in fast flash, SLOW for location in slow flash, INLINE for inlining of the service
        NORMAL  # Location in normal flash
        FAST  # Location in fast flash
        SLOW  # Location in slow flash
        INLINE  # Service is inlined
      enumeration bfxRbMemLocCopyBitu16u8u16u8: origin=RB:2.0.0:2011-06-30, set at pre-compile  # Bfx_CopyBit_u16u8u16u8 | Select one of following values: NORMAL for location in normal flash, FAST for location in fast flash, SLOW for location in slow flash, INLINE for inlining of the service
        NORMAL  # Location in normal flash
        FAST  # Location in fast flash
        SLOW  # Location in slow flash
        INLINE  # Service is inlined
      enumeration bfxRbMemLocCopyBitu32u8u32u8: origin=RB:1.0.0:2010-12-17, set at pre-compile  # Bfx_CopyBit_u32u8u32u8 | Select one of following values: NORMAL for location in normal flash, FAST for location in fast flash, SLOW for location in slow flash, INLINE for inlining of the service
        NORMAL  # Location in normal flash
        FAST  # Location in fast flash
        SLOW  # Location in slow flash
        INLINE  # Service is inlined
      enumeration bfxRbMemLocCopyBitu64u8u64u8: origin=RB:5.1.0:2019-02-04, set at pre-compile  # Bfx_CopyBit_u64u8u64u8 | Select one of following values: NORMAL for location in normal flash, FAST for location in fast flash, SLOW for location in slow flash, INLINE for inlining of the service
        NORMAL  # Location in normal flash
        FAST  # Location in fast flash
        SLOW  # Location in slow flash
        INLINE  # Service is inlined
      enumeration bfxRbMemLocCopyBitu8u8u8u8: origin=RB:2.0.0:2011-06-30, set at pre-compile  # Bfx_CopyBit_u8u8u8u8 | Select one of following values: NORMAL for location in normal flash, FAST for location in fast flash, SLOW for location in slow flash, INLINE for inlining of the service
        NORMAL  # Location in normal flash
        FAST  # Location in fast flash
        SLOW  # Location in slow flash
        INLINE  # Service is inlined
      enumeration bfxRbMemLocGetBitsu16u8u8u16: origin=RB:1.0.0:2010-12-17, set at pre-compile  # Bfx_GetBits_u16u8u8_u16 | Select one of following values: NORMAL for location in normal flash, FAST for location in fast flash, SLOW for location in slow flash, INLINE for inlining of the service
        NORMAL  # Location in normal flash
        FAST  # Location in fast flash
        SLOW  # Location in slow flash
        INLINE  # Service is inlined
      enumeration bfxRbMemLocGetBitsu32u8u8u32: origin=RB:1.0.0:2010-12-17, set at pre-compile  # Bfx_GetBits_u32u8u8_u32 | Select one of following values: NORMAL for location in normal flash, FAST for location in fast flash, SLOW for location in slow flash, INLINE for inlining of the service
        NORMAL  # Location in normal flash
        FAST  # Location in fast flash
        SLOW  # Location in slow flash
        INLINE  # Service is inlined
      enumeration bfxRbMemLocGetBitsu64u8u8u64: origin=RB:5.1.0:2019-02-04, set at pre-compile  # Bfx_GetBits_u64u8u8_u64 | Select one of following values: NORMAL for location in normal flash, FAST for location in fast flash, SLOW for location in slow flash, INLINE for inlining of the service
        NORMAL  # Location in normal flash
        FAST  # Location in fast flash
        SLOW  # Location in slow flash
        INLINE  # Service is inlined
      enumeration bfxRbMemLocGetBitsu8u8u8u8: origin=RB:1.0.0:2010-12-17, set at pre-compile  # Bfx_GetBits_u8u8u8_u8 | Select one of following values: NORMAL for location in normal flash, FAST for location in fast flash, SLOW for location in slow flash, INLINE for inlining of the service
        NORMAL  # Location in normal flash
        FAST  # Location in fast flash
        SLOW  # Location in slow flash
        INLINE  # Service is inlined
      enumeration bfxRbMemLocGetBitu16u8u8: origin=RB:1.0.0:2010-12-17, set at pre-compile  # Bfx_GetBit_u16u8_u8 | Select one of following values: NORMAL for location in normal flash, FAST for location in fast flash, SLOW for location in slow flash, INLINE for inlining of the service
        NORMAL  # Location in normal flash
        FAST  # Location in fast flash
        SLOW  # Location in slow flash
        INLINE  # Service is inlined
      enumeration bfxRbMemLocGetBitu32u8u8: origin=RB:1.0.0:2010-12-17, set at pre-compile  # Bfx_GetBit_u32u8_u8 | Select one of following values: NORMAL for location in normal flash, FAST for location in fast flash, SLOW for location in slow flash, INLINE for inlining of the service
        NORMAL  # Location in normal flash
        FAST  # Location in fast flash
        SLOW  # Location in slow flash
        INLINE  # Service is inlined
      enumeration bfxRbMemLocGetBitu64u8u8: origin=RB:5.1.0:2019-02-04, set at pre-compile  # Bfx_GetBit_u64u8_u8 | Select one of following values: NORMAL for location in normal flash, FAST for location in fast flash, SLOW for location in slow flash, INLINE for inlining of the service
        NORMAL  # Location in normal flash
        FAST  # Location in fast flash
        SLOW  # Location in slow flash
        INLINE  # Service is inlined
      enumeration bfxRbMemLocGetBitu8u8u8: origin=RB:1.0.0:2010-12-17, set at pre-compile  # Bfx_GetBit_u8u8_u8 | Select one of following values: NORMAL for location in normal flash, FAST for location in fast flash, SLOW for location in slow flash, INLINE for inlining of the service
        NORMAL  # Location in normal flash
        FAST  # Location in fast flash
        SLOW  # Location in slow flash
        INLINE  # Service is inlined
      enumeration bfxRbMemLocPutBitsMasku16u16u16: origin=RB:1.0.0:2010-12-17, set at pre-compile  # Bfx_PutBitsMask_u16u16u16 | Select one of following values: NORMAL for location in normal flash, FAST for location in fast flash, SLOW for location in slow flash, INLINE for inlining of the service
        NORMAL  # Location in normal flash
        FAST  # Location in fast flash
        SLOW  # Location in slow flash
        INLINE  # Service is inlined
      enumeration bfxRbMemLocPutBitsMasku32u32u32: origin=RB:1.0.0:2010-12-17, set at pre-compile  # Bfx_PutBitsMask_u32u32u32 | Select one of following values: NORMAL for location in normal flash, FAST for location in fast flash, SLOW for location in slow flash, INLINE for inlining of the service
        NORMAL  # Location in normal flash
        FAST  # Location in fast flash
        SLOW  # Location in slow flash
        INLINE  # Service is inlined
      enumeration bfxRbMemLocPutBitsMasku64u64u64: origin=RB:5.1.0:2019-02-04, set at pre-compile  # Bfx_PutBitsMask_u64u64u64 | Select one of following values: NORMAL for location in normal flash, FAST for location in fast flash, SLOW for location in slow flash, INLINE for inlining of the service
        NORMAL  # Location in normal flash
        FAST  # Location in fast flash
        SLOW  # Location in slow flash
        INLINE  # Service is inlined
      enumeration bfxRbMemLocPutBitsMasku8u8u8: origin=RB:1.0.0:2010-12-17, set at pre-compile  # Bfx_PutBitsMask_u8u8u8 | Select one of following values: NORMAL for location in normal flash, FAST for location in fast flash, SLOW for location in slow flash, INLINE for inlining of the service
        NORMAL  # Location in normal flash
        FAST  # Location in fast flash
        SLOW  # Location in slow flash
        INLINE  # Service is inlined
      enumeration bfxRbMemLocPutBitsu16u8u8u16: origin=RB:4.0.0:2015-12-11, set at pre-compile  # Bfx_PutBits_u16u8u8u16 | Select one of following values: NORMAL for location in normal flash, FAST for location in fast flash, SLOW for location in slow flash, INLINE for inlining of the service
        NORMAL  # Location in normal flash
        FAST  # Location in fast flash
        SLOW  # Location in slow flash
        INLINE  # Service is inlined
      enumeration bfxRbMemLocPutBitsu32u8u8u32: origin=RB:4.0.0:2015-12-11, set at pre-compile  # Bfx_PutBits_u32u8u8u32 | Select one of following values: NORMAL for location in normal flash, FAST for location in fast flash, SLOW for location in slow flash, INLINE for inlining of the service
        NORMAL  # Location in normal flash
        FAST  # Location in fast flash
        SLOW  # Location in slow flash
        INLINE  # Service is inlined
      enumeration bfxRbMemLocPutBitsu64u8u8u64: origin=RB:5.1.0:2019-02-04, set at pre-compile  # Bfx_PutBits_u64u8u8u64 | Select one of following values: NORMAL for location in normal flash, FAST for location in fast flash, SLOW for location in slow flash, INLINE for inlining of the service
        NORMAL  # Location in normal flash
        FAST  # Location in fast flash
        SLOW  # Location in slow flash
        INLINE  # Service is inlined
      enumeration bfxRbMemLocPutBitsu8u8u8u8: origin=RB:4.0.0:2015-12-11, set at pre-compile  # Bfx_PutBits_u8u8u8u8 | Select one of following values: NORMAL for location in normal flash, FAST for location in fast flash, SLOW for location in slow flash, INLINE for inlining of the service
        NORMAL  # Location in normal flash
        FAST  # Location in fast flash
        SLOW  # Location in slow flash
        INLINE  # Service is inlined
      enumeration bfxRbMemLocPutBitu16u8u8: origin=RB:1.0.0:2010-12-17, set at pre-compile  # Bfx_PutBit_u16u8u8 | Select one of following values: NORMAL for location in normal flash, FAST for location in fast flash, SLOW for location in slow flash, INLINE for inlining of the service
        NORMAL  # Location in normal flash
        FAST  # Location in fast flash
        SLOW  # Location in slow flash
        INLINE  # Service is inlined
      enumeration bfxRbMemLocPutBitu32u8u8: origin=RB:1.0.0:2010-12-17, set at pre-compile  # Bfx_PutBit_u32u8u8 | Select one of following values: NORMAL for location in normal flash, FAST for location in fast flash, SLOW for location in slow flash, INLINE for inlining of the service
        NORMAL  # Location in normal flash
        FAST  # Location in fast flash
        SLOW  # Location in slow flash
        INLINE  # Service is inlined
      enumeration bfxRbMemLocPutBitu64u8u8: origin=RB:5.1.0:2019-02-04, set at pre-compile  # Bfx_PutBit_u64u8u8 | Select one of following values: NORMAL for location in normal flash, FAST for location in fast flash, SLOW for location in slow flash, INLINE for inlining of the service
        NORMAL  # Location in normal flash
        FAST  # Location in fast flash
        SLOW  # Location in slow flash
        INLINE  # Service is inlined
      enumeration bfxRbMemLocPutBitu8u8u8: origin=RB:1.0.0:2010-12-17, set at pre-compile  # Bfx_PutBit_u8u8u8 | Select one of following values: NORMAL for location in normal flash, FAST for location in fast flash, SLOW for location in slow flash, INLINE for inlining of the service
        NORMAL  # Location in normal flash
        FAST  # Location in fast flash
        SLOW  # Location in slow flash
        INLINE  # Service is inlined
      enumeration bfxRbMemLocRotBitLtu16u8: origin=RB:4.0.0:2015-12-09, set at pre-compile  # Bfx_RotBitLt_u16u8 | Select one of following values: NORMAL for location in normal flash, FAST for location in fast flash, SLOW for location in slow flash, INLINE for inlining of the service
        NORMAL  # Location in normal flash
        FAST  # Location in fast flash
        SLOW  # Location in slow flash
        INLINE  # Service is inlined
      enumeration bfxRbMemLocRotBitLtu32u8: origin=RB:4.0.0:2015-12-09, set at pre-compile  # Bfx_RotBitLt_u32u8 | Select one of following values: NORMAL for location in normal flash, FAST for location in fast flash, SLOW for location in slow flash, INLINE for inlining of the service
        NORMAL  # Location in normal flash
        FAST  # Location in fast flash
        SLOW  # Location in slow flash
        INLINE  # Service is inlined
      enumeration bfxRbMemLocRotBitLtu64u8: origin=RB:5.1.0:2019-02-04, set at pre-compile  # Bfx_RotBitLt_u64u8 | Select one of following values: NORMAL for location in normal flash, FAST for location in fast flash, SLOW for location in slow flash, INLINE for inlining of the service
        NORMAL  # Location in normal flash
        FAST  # Location in fast flash
        SLOW  # Location in slow flash
        INLINE  # Service is inlined
      enumeration bfxRbMemLocRotBitLtu8u8: origin=RB:4.0.0:2015-12-09, set at pre-compile  # Bfx_RotBitLt_u8u8 | Select one of following values: NORMAL for location in normal flash, FAST for location in fast flash, SLOW for location in slow flash, INLINE for inlining of the service
        NORMAL  # Location in normal flash
        FAST  # Location in fast flash
        SLOW  # Location in slow flash
        INLINE  # Service is inlined
      enumeration bfxRbMemLocRotBitRtu16u8: origin=RB:4.0.0:2015-12-09, set at pre-compile  # Bfx_RotBitRt_u16u8 | Select one of following values: NORMAL for location in normal flash, FAST for location in fast flash, SLOW for location in slow flash, INLINE for inlining of the service
        NORMAL  # Location in normal flash
        FAST  # Location in fast flash
        SLOW  # Location in slow flash
        INLINE  # Service is inlined
      enumeration bfxRbMemLocRotBitRtu32u8: origin=RB:4.0.0:2015-12-09, set at pre-compile  # Bfx_RotBitRt_u32u8 | Select one of following values: NORMAL for location in normal flash, FAST for location in fast flash, SLOW for location in slow flash, INLINE for inlining of the service
        NORMAL  # Location in normal flash
        FAST  # Location in fast flash
        SLOW  # Location in slow flash
        INLINE  # Service is inlined
      enumeration bfxRbMemLocRotBitRtu64u8: origin=RB:5.1.0:2019-02-04, set at pre-compile  # Bfx_RotBitRt_u64u8 | Select one of following values: NORMAL for location in normal flash, FAST for location in fast flash, SLOW for location in slow flash, INLINE for inlining of the service
        NORMAL  # Location in normal flash
        FAST  # Location in fast flash
        SLOW  # Location in slow flash
        INLINE  # Service is inlined
      enumeration bfxRbMemLocRotBitRtu8u8: origin=RB:4.0.0:2015-12-09, set at pre-compile  # Bfx_RotBitRt_u8u8 | Select one of following values: NORMAL for location in normal flash, FAST for location in fast flash, SLOW for location in slow flash, INLINE for inlining of the service
        NORMAL  # Location in normal flash
        FAST  # Location in fast flash
        SLOW  # Location in slow flash
        INLINE  # Service is inlined
      enumeration bfxRbMemLocSetBitMasku16u16: origin=RB:1.0.0:2010-12-17, set at pre-compile  # Bfx_SetBitMask_u16u16 | Select one of following values: NORMAL for location in normal flash, FAST for location in fast flash, SLOW for location in slow flash, INLINE for inlining of the service
        NORMAL  # Location in normal flash
        FAST  # Location in fast flash
        SLOW  # Location in slow flash
        INLINE  # Service is inlined
      enumeration bfxRbMemLocSetBitMasku32u32: origin=RB:1.0.0:2010-12-17, set at pre-compile  # Bfx_SetBitMask_u32u32 | Select one of following values: NORMAL for location in normal flash, FAST for location in fast flash, SLOW for location in slow flash, INLINE for inlining of the service
        NORMAL  # Location in normal flash
        FAST  # Location in fast flash
        SLOW  # Location in slow flash
        INLINE  # Service is inlined
      enumeration bfxRbMemLocSetBitMasku64u64: origin=RB:5.1.0:2019-02-04, set at pre-compile  # Bfx_SetBitMask_u64u64 | Select one of following values: NORMAL for location in normal flash, FAST for location in fast flash, SLOW for location in slow flash, INLINE for inlining of the service
        NORMAL  # Location in normal flash
        FAST  # Location in fast flash
        SLOW  # Location in slow flash
        INLINE  # Service is inlined
      enumeration bfxRbMemLocSetBitMasku8u8: origin=RB:1.0.0:2010-12-17, set at pre-compile  # Bfx_SetBitMask_u8u8 | Select one of following values: NORMAL for location in normal flash, FAST for location in fast flash, SLOW for location in slow flash, INLINE for inlining of the service
        NORMAL  # Location in normal flash
        FAST  # Location in fast flash
        SLOW  # Location in slow flash
        INLINE  # Service is inlined
      enumeration bfxRbMemLocSetBitsu16u8u8u8: origin=RB:2.0.0:2011-06-30, set at pre-compile  # Bfx_SetBits_u16u8u8u8 | Select one of following values: NORMAL for location in normal flash, FAST for location in fast flash, SLOW for location in slow flash, INLINE for inlining of the service
        NORMAL  # Location in normal flash
        FAST  # Location in fast flash
        SLOW  # Location in slow flash
        INLINE  # Service is inlined
      enumeration bfxRbMemLocSetBitsu32u8u8u8: origin=RB:2.0.0:2011-06-30, set at pre-compile  # Bfx_SetBits_u32u8u8u8 | Select one of following values: NORMAL for location in normal flash, FAST for location in fast flash, SLOW for location in slow flash, INLINE for inlining of the service
        NORMAL  # Location in normal flash
        FAST  # Location in fast flash
        SLOW  # Location in slow flash
        INLINE  # Service is inlined
      enumeration bfxRbMemLocSetBitsu64u8u8u8: origin=RB:5.1.0:2019-02-04, set at pre-compile  # Bfx_SetBits_u64u8u8u8 | Select one of following values: NORMAL for location in normal flash, FAST for location in fast flash, SLOW for location in slow flash, INLINE for inlining of the service
        NORMAL  # Location in normal flash
        FAST  # Location in fast flash
        SLOW  # Location in slow flash
        INLINE  # Service is inlined
      enumeration bfxRbMemLocSetBitsu8u8u8u8: origin=RB:2.0.0:2011-06-30, set at pre-compile  # Bfx_SetBits_u8u8u8u8 | Select one of following values: NORMAL for location in normal flash, FAST for location in fast flash, SLOW for location in slow flash, INLINE for inlining of the service
        NORMAL  # Location in normal flash
        FAST  # Location in fast flash
        SLOW  # Location in slow flash
        INLINE  # Service is inlined
      enumeration bfxRbMemLocSetBitu16u8: origin=RB:1.0.0:2010-12-17, set at pre-compile  # Bfx_SetBit_u16u8 | Select one of following values: NORMAL for location in normal flash, FAST for location in fast flash, SLOW for location in slow flash, INLINE for inlining of the service
        NORMAL  # Location in normal flash
        FAST  # Location in fast flash
        SLOW  # Location in slow flash
        INLINE  # Service is inlined
      enumeration bfxRbMemLocSetBitu32u8: origin=RB:1.0.0:2010-12-17, set at pre-compile  # Bfx_SetBit_u32u8 | Select one of following values: NORMAL for location in normal flash, FAST for location in fast flash, SLOW for location in slow flash, INLINE for inlining of the service
        NORMAL  # Location in normal flash
        FAST  # Location in fast flash
        SLOW  # Location in slow flash
        INLINE  # Service is inlined
      enumeration bfxRbMemLocSetBitu64u8: origin=RB:5.1.0:2019-02-04, set at pre-compile  # Bfx_SetBit_u64u8 | Select one of following values: NORMAL for location in normal flash, FAST for location in fast flash, SLOW for location in slow flash, INLINE for inlining of the service
        NORMAL  # Location in normal flash
        FAST  # Location in fast flash
        SLOW  # Location in slow flash
        INLINE  # Service is inlined
      enumeration bfxRbMemLocSetBitu8u8: origin=RB:1.0.0:2010-12-17, set at pre-compile  # Bfx_SetBit_u8u8 | Select one of following values: NORMAL for location in normal flash, FAST for location in fast flash, SLOW for location in slow flash, INLINE for inlining of the service
        NORMAL  # Location in normal flash
        FAST  # Location in fast flash
        SLOW  # Location in slow flash
        INLINE  # Service is inlined
      enumeration bfxRbMemLocShiftBitLtu16u8: origin=RB:2.0.0:2011-06-30, set at pre-compile  # Bfx_ShiftBitLt_u16u8 | Select one of following values: NORMAL for location in normal flash, FAST for location in fast flash, SLOW for location in slow flash, INLINE for inlining of the service
        NORMAL  # Location in normal flash
        FAST  # Location in fast flash
        SLOW  # Location in slow flash
        INLINE  # Service is inlined
      enumeration bfxRbMemLocShiftBitLtu32u8: origin=RB:2.0.0:2011-06-30, set at pre-compile  # Bfx_ShiftBitLt_u32u8 | Select one of following values: NORMAL for location in normal flash, FAST for location in fast flash, SLOW for location in slow flash, INLINE for inlining of the service
        NORMAL  # Location in normal flash
        FAST  # Location in fast flash
        SLOW  # Location in slow flash
        INLINE  # Service is inlined
      enumeration bfxRbMemLocShiftBitLtu64u8: origin=RB:5.1.0:2019-02-04, set at pre-compile  # Bfx_ShiftBitLt_u64u8 | Select one of following values: NORMAL for location in normal flash, FAST for location in fast flash, SLOW for location in slow flash, INLINE for inlining of the service
        NORMAL  # Location in normal flash
        FAST  # Location in fast flash
        SLOW  # Location in slow flash
        INLINE  # Service is inlined
      enumeration bfxRbMemLocShiftBitLtu8u8: origin=RB:2.0.0:2011-06-30, set at pre-compile  # Bfx_ShiftBitLt_u8u8 | Select one of following values: NORMAL for location in normal flash, FAST for location in fast flash, SLOW for location in slow flash, INLINE for inlining of the service
        NORMAL  # Location in normal flash
        FAST  # Location in fast flash
        SLOW  # Location in slow flash
        INLINE  # Service is inlined
      enumeration bfxRbMemLocShiftBitRtu16u8: origin=RB:2.0.0:2011-06-30, set at pre-compile  # Bfx_ShiftBitRt_u16u8 | Select one of following values: NORMAL for location in normal flash, FAST for location in fast flash, SLOW for location in slow flash, INLINE for inlining of the service
        NORMAL  # Location in normal flash
        FAST  # Location in fast flash
        SLOW  # Location in slow flash
        INLINE  # Service is inlined
      enumeration bfxRbMemLocShiftBitRtu32u8: origin=RB:2.0.0:2011-06-30, set at pre-compile  # Bfx_ShiftBitRt_u32u8 | Select one of following values: NORMAL for location in normal flash, FAST for location in fast flash, SLOW for location in slow flash, INLINE for inlining of the service
        NORMAL  # Location in normal flash
        FAST  # Location in fast flash
        SLOW  # Location in slow flash
        INLINE  # Service is inlined
      enumeration bfxRbMemLocShiftBitRtu64u8: origin=RB:5.1.0:2019-02-04, set at pre-compile  # Bfx_ShiftBitRt_u64u8 | Select one of following values: NORMAL for location in normal flash, FAST for location in fast flash, SLOW for location in slow flash, INLINE for inlining of the service
        NORMAL  # Location in normal flash
        FAST  # Location in fast flash
        SLOW  # Location in slow flash
        INLINE  # Service is inlined
      enumeration bfxRbMemLocShiftBitRtu8u8: origin=RB:2.0.0:2011-06-30, set at pre-compile  # Bfx_ShiftBitRt_u8u8 | Select one of following values: NORMAL for location in normal flash, FAST for location in fast flash, SLOW for location in slow flash, INLINE for inlining of the service
        NORMAL  # Location in normal flash
        FAST  # Location in fast flash
        SLOW  # Location in slow flash
        INLINE  # Service is inlined
      enumeration bfxRbMemLocToggleBitMasku16u16: origin=RB:2.0.0:2011-06-30, set at pre-compile  # Bfx_ToggleBitMask_u16u16 | Select one of following values: NORMAL for location in normal flash, FAST for location in fast flash, SLOW for location in slow flash, INLINE for inlining of the service
        NORMAL  # Location in normal flash
        FAST  # Location in fast flash
        SLOW  # Location in slow flash
        INLINE  # Service is inlined
      enumeration bfxRbMemLocToggleBitMasku32u32: origin=RB:2.0.0:2011-06-30, set at pre-compile  # Bfx_ToggleBitMask_u32u32 | Select one of following values: NORMAL for location in normal flash, FAST for location in fast flash, SLOW for location in slow flash, INLINE for inlining of the service
        NORMAL  # Location in normal flash
        FAST  # Location in fast flash
        SLOW  # Location in slow flash
        INLINE  # Service is inlined
      enumeration bfxRbMemLocToggleBitMasku64u64: origin=RB:5.1.0:2019-02-04, set at pre-compile  # Bfx_ToggleBitMask_u64u64 | Select one of following values: NORMAL for location in normal flash, FAST for location in fast flash, SLOW for location in slow flash, INLINE for inlining of the service
        NORMAL  # Location in normal flash
        FAST  # Location in fast flash
        SLOW  # Location in slow flash
        INLINE  # Service is inlined
      enumeration bfxRbMemLocToggleBitMasku8u8: origin=RB:2.0.0:2011-06-30, set at pre-compile  # Bfx_ToggleBitMask_u8u8 | Select one of following values: NORMAL for location in normal flash, FAST for location in fast flash, SLOW for location in slow flash, INLINE for inlining of the service
        NORMAL  # Location in normal flash
        FAST  # Location in fast flash
        SLOW  # Location in slow flash
        INLINE  # Service is inlined
      enumeration bfxRbMemLocToggleBitsu16: origin=RB:2.0.0:2011-06-30, set at pre-compile  # Bfx_ToggleBits_u16 | Select one of following values: NORMAL for location in normal flash, FAST for location in fast flash, SLOW for location in slow flash, INLINE for inlining of the service
        NORMAL  # Location in normal flash
        FAST  # Location in fast flash
        SLOW  # Location in slow flash
        INLINE  # Service is inlined
      enumeration bfxRbMemLocToggleBitsu32: origin=RB:2.0.0:2011-06-30, set at pre-compile  # Bfx_ToggleBits_u32 | Select one of following values: NORMAL for location in normal flash, FAST for location in fast flash, SLOW for location in slow flash, INLINE for inlining of the service
        NORMAL  # Location in normal flash
        FAST  # Location in fast flash
        SLOW  # Location in slow flash
        INLINE  # Service is inlined
      enumeration bfxRbMemLocToggleBitsu64: origin=RB:5.1.0:2019-02-04, set at pre-compile  # Bfx_ToggleBits_u64 | Select one of following values: NORMAL for location in normal flash, FAST for location in fast flash, SLOW for location in slow flash, INLINE for inlining of the service
        NORMAL  # Location in normal flash
        FAST  # Location in fast flash
        SLOW  # Location in slow flash
        INLINE  # Service is inlined
      enumeration bfxRbMemLocToggleBitsu8: origin=RB:2.0.0:2011-06-30, set at pre-compile  # Bfx_ToggleBits_u8 | Select one of following values: NORMAL for location in normal flash, FAST for location in fast flash, SLOW for location in slow flash, INLINE for inlining of the service
        NORMAL  # Location in normal flash
        FAST  # Location in fast flash
        SLOW  # Location in slow flash
        INLINE  # Service is inlined
      enumeration bfxRbMemLocTstBitLnMasku16u16u8: origin=RB:1.0.0:2010-12-17, set at pre-compile  # Bfx_TstBitLnMask_u16u16_u8 | Select one of following values: NORMAL for location in normal flash, FAST for location in fast flash, SLOW for location in slow flash, INLINE for inlining of the service
        NORMAL  # Location in normal flash
        FAST  # Location in fast flash
        SLOW  # Location in slow flash
        INLINE  # Service is inlined
      enumeration bfxRbMemLocTstBitLnMasku32u32u8: origin=RB:1.0.0:2010-12-17, set at pre-compile  # Bfx_TstBitLnMask_u32u32_u8 | Select one of following values: NORMAL for location in normal flash, FAST for location in fast flash, SLOW for location in slow flash, INLINE for inlining of the service
        NORMAL  # Location in normal flash
        FAST  # Location in fast flash
        SLOW  # Location in slow flash
        INLINE  # Service is inlined
      enumeration bfxRbMemLocTstBitLnMasku64u64u8: origin=RB:5.1.0:2019-02-04, set at pre-compile  # Bfx_TstBitLnMask_u64u64_u8 | Select one of following values: NORMAL for location in normal flash, FAST for location in fast flash, SLOW for location in slow flash, INLINE for inlining of the service
        NORMAL  # Location in normal flash
        FAST  # Location in fast flash
        SLOW  # Location in slow flash
        INLINE  # Service is inlined
      enumeration bfxRbMemLocTstBitLnMasku8u8u8: origin=RB:1.0.0:2010-12-17, set at pre-compile  # Bfx_TstBitLnMask_u8u8_u8 | Select one of following values: NORMAL for location in normal flash, FAST for location in fast flash, SLOW for location in slow flash, INLINE for inlining of the service
        NORMAL  # Location in normal flash
        FAST  # Location in fast flash
        SLOW  # Location in slow flash
        INLINE  # Service is inlined
      enumeration bfxRbMemLocTstBitMasku16u16u8: origin=RB:1.0.0:2010-12-17, set at pre-compile  # Bfx_TstBitMask_u16u16_u8 | Select one of following values: NORMAL for location in normal flash, FAST for location in fast flash, SLOW for location in slow flash, INLINE for inlining of the service
        NORMAL  # Location in normal flash
        FAST  # Location in fast flash
        SLOW  # Location in slow flash
        INLINE  # Service is inlined
      enumeration bfxRbMemLocTstBitMasku32u32u8: origin=RB:1.0.0:2010-12-17, set at pre-compile  # Bfx_TstBitMask_u32u32_u8 | Select one of following values: NORMAL for location in normal flash, FAST for location in fast flash, SLOW for location in slow flash, INLINE for inlining of the service
        NORMAL  # Location in normal flash
        FAST  # Location in fast flash
        SLOW  # Location in slow flash
        INLINE  # Service is inlined
      enumeration bfxRbMemLocTstBitMasku64u64u8: origin=RB:5.1.0:2019-02-04, set at pre-compile  # Bfx_TstBitMask_u64u64_u8 | Select one of following values: NORMAL for location in normal flash, FAST for location in fast flash, SLOW for location in slow flash, INLINE for inlining of the service
        NORMAL  # Location in normal flash
        FAST  # Location in fast flash
        SLOW  # Location in slow flash
        INLINE  # Service is inlined
      enumeration bfxRbMemLocTstBitMasku8u8u8: origin=RB:1.0.0:2010-12-17, set at pre-compile  # Bfx_TstBitMask_u8u8_u8 | Select one of following values: NORMAL for location in normal flash, FAST for location in fast flash, SLOW for location in slow flash, INLINE for inlining of the service
        NORMAL  # Location in normal flash
        FAST  # Location in fast flash
        SLOW  # Location in slow flash
        INLINE  # Service is inlined
      enumeration bfxRbMemLocTstParityEvenu16u8: origin=RB:2.0.0:2011-06-30, set at pre-compile  # Bfx_TstParityEven_u16_u8 | Select one of following values: NORMAL for location in normal flash, FAST for location in fast flash, SLOW for location in slow flash, INLINE for inlining of the service
        NORMAL  # Location in normal flash
        FAST  # Location in fast flash
        SLOW  # Location in slow flash
        INLINE  # Service is inlined
      enumeration bfxRbMemLocTstParityEvenu32u8: origin=RB:1.0.0:2010-12-17, set at pre-compile  # Bfx_TstParityEven_u32_u8 | Select one of following values: NORMAL for location in normal flash, FAST for location in fast flash, SLOW for location in slow flash, INLINE for inlining of the service
        NORMAL  # Location in normal flash
        FAST  # Location in fast flash
        SLOW  # Location in slow flash
        INLINE  # Service is inlined
      enumeration bfxRbMemLocTstParityEvenu64u8: origin=RB:5.1.0:2019-02-04, set at pre-compile  # Bfx_TstParityEven_u64_u8 | Select one of following values: NORMAL for location in normal flash, FAST for location in fast flash, SLOW for location in slow flash, INLINE for inlining of the service
        NORMAL  # Location in normal flash
        FAST  # Location in fast flash
        SLOW  # Location in slow flash
        INLINE  # Service is inlined
      enumeration bfxRbMemLocTstParityEvenu8u8: origin=RB:2.0.0:2011-06-30, set at pre-compile  # Bfx_TstParityEven_u8_u8 | Select one of following values: NORMAL for location in normal flash, FAST for location in fast flash, SLOW for location in slow flash, INLINE for inlining of the service
        NORMAL  # Location in normal flash
        FAST  # Location in fast flash
        SLOW  # Location in slow flash
        INLINE  # Service is inlined
