AUTOSAR XML (schema 00048)
package /AUTOSAR_Gpt/EcucModuleDefs
  module definition Gpt [0..1]: category=VENDOR_SPECIFIC_MODULE_DEFINITION, post-build-variant-support=true, refined-module-def=Gpt, variants pre-compile  # MCAL Gpt Driver | Configuration of the MCAL module GPT
    container GptChannelConfigSet  # Channel configuration data set | This container is the base of a Configuration Set which contains the configured GPT channels. This way, different configuration sets can be defined for post-build process.
      container GptChannelConfiguration [1..1000]: multiplicity set at pre-compile, post-build-variant-multiplicity=true  # Gpt channel Channel configuration | Configuration of an individual GPT channel.
        integer GptChannelId: 0..4294967295, multiplicity set at pre-compile, set at pre-compile, symbolic-name-value=true, with-auto=true  # Gpt channel Id | Channel Id of the GPT channel. This value will be assigned to the symbolic name derived of the GptChannelConfiguration container short name.Please don't assign any value to this parameter. It would be calculated automatically.
        enumeration GptChannelMode: post-build-variant-value=true, set at pre-compile  # Gpt channel Mode | Specifies the behaviour of the timer channel after the target time is reached.
          GPT_CH_MODE_CONTINUOUS  # Timer restarts after reaching the target time
          GPT_CH_MODE_ONESHOT  # Timer stops after reaching the target time
        float GptChannelTickFrequency: 0..INF, post-build-variant-value=true, set at pre-compile  # Gpt channel Tick Frequency | Specifies the tick frequency of the timer channel in Hz. Here are the possible values for ATOM: 1. 50000000 (50 MHz) 2. 20000000 (20 MHz) 3. 2500000 (2.5 MHz) 4. 100000000 (100 MHz) For TOM: 1) 50000000 (50 MHz) 2) 3125000 (3.125 MHz) 3) 195312 (195.312 KHz) 4) 12207 5) 763
        integer GptChannelTickValueMax: 0..16777215, post-build-variant-value=true, set at pre-compile  # Gpt Channel Tick Value Max | Maximum value in ticks, the timer channel is able to count.With the next tick, the timer rolls over to zero
        boolean GptEnableWakeup: post-build-variant-value=true, set at pre-compile  # Gpt Enable Wakeup | Enables the wakeup capability of a Gpt channel. Wake up functionality is not supported by Gpt driver. Irrespective of the value given for "Gpt Enable Wakeup", it will always be taken as FALSE.
        function name GptNotification [0..1]: multiplicity set at pre-compile, post-build-variant-multiplicity=true, post-build-variant-value=true, set at pre-compile  # Gpt Notification | Function pointer to callback function (for non-wakeup notification)
        function name GptRbUserHeaderFileNameInclusion [0..1]: multiplicity set at pre-compile, post-build-variant-multiplicity=true, post-build-variant-value=true, set at pre-compile  # Gpt User Header File Name Inclusion | Include end user (Application) required header file name into Gpt Notifiy file. Example if one want to include " Gpt.h " header file, just enter " Gpt "
        enumeration rba_GtmChannel: {CH0, CH1, CH2, CH3, CH4, CH5, CH6, CH7, CH8, CH9, CH10, CH11, CH12, CH13, CH14, CH15}, origin=RB:0.1.0:2012-08-28, post-build-variant-value=true, set at pre-compile  # GTM Timer channel | GTM Timer channel. If you are still assigning the GTM Timer channel in the rba_Gtm configuration, please don't create this element.
        enumeration rba_GtmModule: {ATOM0, ATOM1, ATOM2, ATOM3, ATOM4, ATOM5, ATOM6, ATOM7, ATOM8, ATOM9, ATOM10, ATOM11, TOM0, TOM1, TOM2, TOM3, TOM4, TOM5}, origin=RB:0.1.0:2012-08-28, post-build-variant-value=true, set at pre-compile  # GTM Timer module | GTM Timer module. If you are still assigning the GTM Timer module in the rba_Gtm configuration, please don't create this element.
        reference GptChannelClkSrcRef [0..1]: multiplicity set at pre-compile, post-build-variant-multiplicity=true, post-build-variant-value=true, set at pre-compile, destination=GptClockReferencePoint  # Reference to GptClockReference | Reference to the GptClockReferencePoint from which the channel clock is derived
        container GptWakeupConfiguration [0..1]: multiplicity set at pre-compile, post-build-variant-multiplicity=true  # Gpt Wakeup configuration | Function pointer to callback function (for non-wakeup notification). Wake up functionality is not supported by Gpt driver.
          reference GptWakeupSourceRef: post-build-variant-value=true, set at pre-compile, destination=EcuMWakeupSource  # Gpt Wakeup Ref | In case the wakeup-capability is true this value is transmitted to the Ecu State Manager. Implementation Type: reference to EcuM_WakeupSourceType. Wake up functionality is not supported by Gpt driver.
    container GptConfigurationOfOptApiServices  # Gpt Configuration of optional API services | This container contains all configuration switches for configuring optional API services of the GPT driver
      boolean GptEnableDisableNotificationApi: set at pre-compile  # Adds / removes the services Gpt_EnableNotification() and Gpt_DisableNotification from the code.
      boolean GptTimeElapsedApi: set at pre-compile  # Gpt Time Elapsed API | Adds / removes the service Gpt_GetTimeElapsed() from the code
      boolean GptTimeRemainingApi: set at pre-compile  # Gpt Time RemainingApi API | Adds / removes the service Gpt_GetTimeRemaining() from the code.
      boolean GptVersionInfoApi: set at pre-compile  # Gpt VersionInfo API | Adds / removes the service Gpt_GetVersionInfo() from the code.
      boolean GptWakeupFunctionalityApi [0..1]: multiplicity set at pre-compile, set at pre-compile  # Gpt Wakeup functionality | Adds / removes the services Gpt_SetMode(), Gpt_EnableWakeup() Gpt_DisableWakeup() and Gpt_CheckWakeup() from the code. Wake up functionality is not supported by Gpt driver.
    container GptDriverConfiguration  # Gpt Driver configuration | This container contains configuration options for general services of the GPT driver
      boolean GptDevErrorDetect: set at pre-compile  # Gpt Error Detection | Enables/Disables development error detection.
      boolean GptReportWakeupSource: set at pre-compile  # GPT Report Wakeup source | Enables/Disables wakeup source reporting. Wake up functionality is not supported by Gpt driver.
      container GptClockReferencePoint [0..*]: multiplicity set at pre-compile  # Gpt clock reference point | This container contains a parameter, which represents a reference to a container of the type McuClockReferencePoint (defined in module MCU).
        reference GptClockReference [0..1]: multiplicity set at pre-compile, set at pre-compile, destination=McuClockReferencePoint  # GPT Clock Reference | Reference to a container of the type McuClockReferencePoint, to select an input clock. The configuration editor for the GPT module can support the integrator by only allowing a selection of those clock referencepoints that can be connected physically to the GPT hardware peripheral. The desired frequency (desired by GPT) has to be the same as the selected and provided frequency of the MCU configuration. This has to be checked automatically.
