AUTOSAR XML (schema 00046)
package /AUTOSAR/EcucDestinationUriDefSets
  ecuc destination uri def set LdComUserUriDefSet  # Defines the set of DestinationUriDefs for the LdCom module.
    ecuc destination uri def LdComUser  # Defines the configuration container content of the LdCom user modules relevant settings.
      destination-uri-policy destination-uri-nesting-contract=VERTEX-OF-TARGET-CONTAINER:
        container LdComUserModuleCnf [0..1]: destination-uri=LdComUser, multiplicity set at pre-compile  # Contains the configuration parameters of the LdCom user module.
          string LdComUserHeaderInclude [0..1]: multiplicity set at pre-compile, set at pre-compile  # Defines the header file where the LdLom user provides the function declarations for configured callbacks.
          container LdComUserCallback [0..*]: multiplicity set at link in variant link-time+post-build / pre-compile in variant pre-compile, post-build-variant-multiplicity=true  # This container defines a LdCom callback function for a LdComIPdu.
            function name LdComUserCallbackName: scope=ECU, multiplicity set at link in variant link-time+post-build / pre-compile in variant pre-compile, set at link in variant link-time+post-build / pre-compile in variant pre-compile  # The name of the callback function to be called.
            enumeration LdComUserCallbackType: {LDCOM_RX_INDICATION, LDCOM_RX_START_OF_RECEPTION, LDCOM_TP_COPY_RX_DATA, LDCOM_TP_COPY_TX_DATA, LDCOM_TP_RX_INDICATION, LDCOM_TP_TX_CONFIRMATION, LDCOM_TX_CONFIRMATION, LDCOM_TX_TRIGGER_TRANSMIT}, scope=ECU, multiplicity set at link in variant link-time+post-build / pre-compile in variant pre-compile, set at link in variant link-time+post-build / pre-compile in variant pre-compile  # The type of the LdCom callback
          container LdComUserIPdu [0..*]: multiplicity set at link in variant link-time / post-build in variant post-build / pre-compile in variant pre-compile, post-build-variant-multiplicity=true  # Contains the configuration parameters for the LdCom's signal (LdComIPdu) inside a LdCom user module.
            integer LdComUserCbkHandleId [0..1]: 0..65535, scope=ECU, set at pre-compile, symbolic-name-value=true  # The numerical value used as the LdCom user callback handle Id. | This is the ID used by LdCom to invoke callbacks of a LdCom user (Rte, ScCluC LdCom Low Proxy or CDDs) using LdComUserCbkHandleId parameter respectively. A corresponding symbolic name reference is created, which may be used for the invocations of the user.
            reference LdComUserCallbackRef [0..*]: scope=ECU, multiplicity set at link in variant link-time / post-build in variant post-build / pre-compile in variant pre-compile, post-build-variant-multiplicity=true, post-build-variant-value=true, set at link in variant link-time+post-build / pre-compile in variant pre-compile, destination=LdComUserCallback  # Reference(s) to all callback(s) of this LdComIPdu.
            foreign reference LdComUserSystemTemplateSignalRef: scope=ECU, multiplicity set at link in variant link-time / post-build in variant post-build / pre-compile in variant pre-compile, post-build-variant-multiplicity=true, post-build-variant-value=true, set at link in variant link-time / post-build in variant post-build / pre-compile in variant pre-compile, destination-type=I-SIGNAL-TO-I-PDU-MAPPING  # Reference to the ISignalToIPduMapping that contains a reference to the ISignal (System Template).
