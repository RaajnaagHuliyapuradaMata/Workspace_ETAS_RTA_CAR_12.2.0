AUTOSAR XML (schema 00048)
package /AUTOSAR_LinIf/EcucModuleDefs
  module definition LinIf [0..1]: category=VENDOR_SPECIFIC_MODULE_DEFINITION, post-build-variant-support=true, refined-module-def=LinIf, variants link-time/post-build/pre-compile  # Configuration of the LinIf (LIN Interface) module.
    container LinIfGeneral  # This container contains the general parameters of LIN Interface module.
      boolean LinIfBusMirroringSupported [0..0]: set at pre-compile, default-value=false  # States if Bus Mirroring is enabled in the LIN Interface or not. The reason for this parameter is to reduce the size of LIN Interface if the Bus Mirroring is not used. | Bus mirroring feature is not implemented yet.
      boolean LinIfDevErrorDetect: set at pre-compile, default-value=false  # Switches the development error detection and notification on or off. | * true: detection and notification is enabled. * false: detection and notification is disabled.
      boolean LinIfRbForeignDrvSupport [0..1]: multiplicity set at pre-compile, origin=RB:45.4.0.0:2023-01-04, set at pre-compile, default-value=false  # Enable third party driver support. | When enabled, the callback APIs of LinIf will be named LinIf_Integn_{CallbackAPIName} and also re-routes driver API calls to integration code. When this configuration parameter is enabled, the template files LinIf_Integn.c_tpl and LinIf_Integn.h_tpl shall be used for call adaptation between LinIf and drivers.
      boolean LinIfErrorRecovery: origin=RB:2015-04-10, set at pre-compile, default-value=false  # Enables/Disables the LINIF_ERROR_RECOVERY_SUPPORT.If LINIF_ERROR_RECOVERY_SUPPORT is enabled, Monitoring hooks enabled.If LINIF_ERROR_RECOVERY_SUPPORT is disabled, Monitoring hooks disabled.
      boolean LinIfMultipleDriversSupported: set at pre-compile  # States if multiple drivers are supported by the LIN Interface or not. The reason for this parameter is to reduce the size of LIN Interface if multiple drivers are not used.
      boolean LinIfMultipleTrcvDriverSupported [0..0]: set at pre-compile  # States if multiple transceiver drivers are supported by the LIN Interface or not. The reason for this parameter is to reduce the size of LIN Interface if multiple transceiver drivers are not used.
      boolean LinIfNcOptionalRequestSupported: set at pre-compile  # States if the node configuration commands Assign NAD and Conditional Change NAD are supported.
      string LinIfPublicCddHeaderFile [0..*]: scope=ECU, multiplicity set at pre-compile, set at pre-compile, max-length=32, min-length=1  # Defines header files for callback functions which shall be included in case of CDDs. Range of characters is 1.. 32.
      boolean LinIfRbLastEntryOfSchelTblConfrm [0..1]: multiplicity set at pre-compile, origin=RB:2019-03-30, set at pre-compile, default-value=false  # Switches the Schedule table end notification callback ON or OFF.Schedule table end notification callback functions are enabled when this parameter is set to trueand disabled when set to false. * true: enabled (ON).* false: disabled (OFF).
      function name LinIfResponseErrorSignalChangedCallout [0..1]: set at pre-compile  # This parameter contains the name of the callout function that is called after a response error signal change. | Only applicable for LIN slave nodes.
      function name LinIfSaveConfigurationCallout [0..1]: set at pre-compile  # This parameter contains the name of the callout function that is called when a save configuration node configuration command is processed by this slave node. The service is only supported when this parameter is configured. | Only applicable for LIN slave nodes.
      boolean LinIfTpSupported: set at pre-compile  # States if the TP is included in the LIN Interface or not. The reason for this parameter is to reduce the size of LIN Interface if the TP is not used.
      boolean LinIfTrcvDriverSupported: set at pre-compile  # States if transceiver driver support is included in the LIN Interface or not. The reason for this parameter is to reduce the size of LIN Interface if transceiver drivers are not used.
      boolean LinIfVersionInfoApi: set at pre-compile, default-value=false  # Switches the LinIf_GetVersionInfo function ON or OFF.
      boolean LinIfidCalibrationSupport [0..1]: multiplicity set at pre-compile, origin=RB:2017-08-30, set at pre-compile, default-value=false  # Switches the Calibration of LinIf id (The id for Lin frames is provided from calibration tool) ON or OFF. * true: enabled (ON).* false: disabled (OFF).
    container LinIfGlobalConfig  # This container contains the global configuration parameters of the LinIf.
      container LinIfChannel [1..*]: multiplicity set at pre-compile  # Describes each LIN channel the LinIf is connected to.
        float LinIfBusIdleTimeoutPeriod [0..1]: 0.1..INF, post-build-variant-value=true, set at link in variant link-time / post-build in variant post-build / pre-compile in variant pre-compile, default-value=4  # Bus idle timeout in seconds. | According to the LIN protocol specification, the bus idle timeout period shall be in range [4, 10] seconds.
        integer LinIfChannelId: 0..255, origin=RB:2017-01-17, set at pre-compile, symbolic-name-value=true  # This parameter holds the unique channel index value. The value shall be the same as the ComMChannelId of the ComMChannel referenced by LinIfComMNetworkHandleRef.Implementation Type: NetworkHandleType
        enumeration LinIfGotoSleepConfirmationUL: {CDD, LIN_SM}, scope=ECU, post-build-variant-value=true, set at link in variant link-time+post-build / pre-compile in variant pre-compile  # This parameter defines the upper layer (UL) module to which the confirmation of the goto-sleep command shall be sent.
        function name LinIfGotoSleepConfirmationULName [0..1]: multiplicity set at pre-compile, origin=RB:2015-04-10, set at pre-compile, max-length=32, min-length=1  # This parameter defines the name of the "User_GotoSleepConfirmation()" LinIfGotoSleepConfirmationULName | Only used for LIN Slave nodes, ignored for master nodes.
        enumeration LinIfGotoSleepIndicationUL [0..1]: {CDD, LIN_SM}, scope=ECU, multiplicity set at link in variant link-time+post-build / pre-compile in variant pre-compile, post-build-variant-value=true, set at link in variant link-time+post-build / pre-compile in variant pre-compile  # This parameter defines the upper layer (UL) module to which the indication of the goto-sleep command shall be sent. | Only used for LIN Slave nodes, ignored for master nodes.
        function name LinIfGotoSleepIndicationULName [0..1]: origin=RB:2015-04-10, set at pre-compile, max-length=32, min-length=1  # This parameter defines the name of the "User_GotoSleepIndication()" LinIfGotoSleepConfirmationULName
        float LinIfMainFunctionPeriod: 0..INF, set at link in variant link-time+post-build / pre-compile in variant pre-compile, default-value=false  # Defines the interval of calls to main functions per channel in seconds.
        integer LinIfMaxFrameCnt [0..1]: 0..65535, multiplicity set at link in variant link-time+post-build / pre-compile in variant pre-compile, set at link in variant link-time+post-build / pre-compile in variant pre-compile, default-value=false  # Maximum number of Frames. This parameter is needed only in case of post-build loadable implementation using static memory allocation.
        boolean LinIfRbDiagMonHookSupport [0..1]: multiplicity set at pre-compile, origin=RB:2018-06-08, set at pre-compile, default-value=false  # Enables or disables the Monitoring Hook function notification updation in case of Diagnostic frames. | True: LinIf selects a new schedule table in next main function. Only applicable for LIN Master nodes.
        boolean LinIfScheduleChangeNextTimeBase [0..1]: multiplicity set at link in variant link-time / post-build in variant post-build / pre-compile in variant pre-compile, post-build-variant-value=true, set at link in variant link-time / post-build in variant post-build / pre-compile in variant pre-compile  # Enables/disables the switch to a new schedule table at the start of the next time base after status check. | True: LinIf selects a new schedule table in next main function. Only applicable for LIN Master nodes.
        enumeration LinIfScheduleRequestConfirmationUL [0..1]: {CDD, LIN_SM}, scope=ECU, multiplicity set at link in variant link-time+post-build / pre-compile in variant pre-compile, post-build-variant-value=true, set at link in variant link-time+post-build / pre-compile in variant pre-compile  # This parameter defines the upper layer (UL) module to which the confirmation of the successfully performed schedule table change shall be sent. | Only applicable to LIN master nodes.
        function name LinIfScheduleRequestConfirmationULName [0..1]: multiplicity set at pre-compile, origin=RB:2015-04-10, set at pre-compile, max-length=32, min-length=1  # This parameter defines the name of the "User_ScheduleRequestConfirmation()" LinIfScheduleRequestConfirmationULName. | Only used for LIN Slave nodes, ignored for master nodes.
        enumeration LinIfWakeupConfirmationUL: {CDD, LIN_SM}, scope=ECU, post-build-variant-value=true, set at link in variant link-time+post-build / pre-compile in variant pre-compile  # This parameter defines the upper layer (UL) module to which the confirmation of the wake-up shall be sent.
        function name LinIfWakeupConfirmationULName [0..1]: multiplicity set at pre-compile, origin=RB:2015-04-10, set at pre-compile, max-length=32, min-length=1  # This parameter defines the name of the "User_WakeupConfirmation()" LinIfWakeupConfirmationULName | Only used for LIN Slave nodes, ignored for master nodes.
        boolean LinIfDiagInterleavedModesupport [0..1]: origin=RB:2022-01-17, set at pre-compile, default-value=false  # This parameter enables/disables the support of Diagnostic Interleaved Mode
        foreign reference LinIfCddRef [0..1]: multiplicity set at pre-compile, set at pre-compile, destination-type=ECUC-MODULE-CONFIGURATION-VALUES  # Reference to the CDD module description. This parameter is only required when LinIfWakeupConfirmationUL, LinIfScheduleRequestConfirmationUL, LinIfGotoSleepConfirmationUL and/or LinIfGotoSleepIndicationUL is set to CDD.
        reference LinIfChannelRef: scope=ECU, set at link in variant link-time+post-build / pre-compile in variant pre-compile, requires-symbolic-name-value=true, destination=LinChannel  # Reference to the channel definition in the LIN driver.
        reference LinIfComMNetworkHandleRef: set at link in variant link-time+post-build / pre-compile in variant pre-compile, requires-symbolic-name-value=true, destination=ComMChannel  # Unique handle to identify one LIN network. Reference to one of the network handles configured for the ComM.
        reference LinIfDriverRef: multiplicity set at pre-compile, origin=RB:2015-04-10, set at pre-compile, requires-symbolic-name-value=true, destination=Lin  # Reference to the LIN Driver
        container LinIfFrame [0..*]: multiplicity set at link in variant link-time / post-build in variant post-build / pre-compile in variant pre-compile, post-build-variant-multiplicity=true  # Generic container for all types of LIN frames.
          enumeration LinIfChecksumType [0..1]: {CLASSIC, ENHANCED}, multiplicity set at link in variant link-time / post-build in variant post-build / pre-compile in variant pre-compile, post-build-variant-value=true, set at link in variant link-time / post-build in variant post-build / pre-compile in variant pre-compile  # Type of checksum that the frame is using. | This parameter is optional because in case of sporadic frames it should not be set.
          integer LinIfFrameId [0..1]: 0..63, multiplicity set at link in variant link-time / post-build in variant post-build / pre-compile in variant pre-compile, post-build-variant-multiplicity=true, post-build-variant-value=true, set at link in variant link-time / post-build in variant post-build / pre-compile in variant pre-compile, default-value=false  # ID of the LIN frame. The Protected ID including parity is calculated by the generation tool.
          integer LinIfFrameIndex [0..1]: 0..63, multiplicity set at link in variant link-time / post-build in variant post-build / pre-compile in variant pre-compile, post-build-variant-multiplicity=true, post-build-variant-value=true, set at link in variant link-time / post-build in variant post-build / pre-compile in variant pre-compile, default-value=false  # PID index of the frame. This index is used in the AssignFrameIdentifierRange node configuration service to identify the frame(s) to which a new PID shall be assigned. | It corresponds to the order of the frames in the configurable frames list in the node attributes section of the LDF / NCF of the slave node. Only relevant for LIN slave nodes.
          enumeration LinIfFrameType: {ASSIGN, ASSIGN_FRAME_ID_RANGE, ASSIGN_NAD, CONDITIONAL, EVENT_TRIGGERED, FREE, MRF, SAVE_CONFIGURATION, SPORADIC, SRF, UNASSIGN, UNCONDITIONAL}, post-build-variant-value=true, set at link in variant link-time / post-build in variant post-build / pre-compile in variant pre-compile  # This parameter defines the type of frame (e.g. sporadic frame). | For master nodes, all frame types are permitted. A sporadic slot may be used by a set of unconditional frames in the role of substitution frames. For slave nodes, only following types are permitted: Uncondtional, MRF, SRF, Event-triggered. An event-triggered slot may be used by a set of unconditional frames in the role of substitution frames.
          integer LinIfLength: 1..8, origin=RB:2017-01-15, post-build-variant-value=true, set at pre-compile, default-value=false  # Length of the LIN SDU in bytes.
          container LinIfFixedFrameSdu [0..1]: multiplicity set at pre-compile  # In case this is a fixed frame this is the SDU (response). | This container represents an eight byte array. The Byte order shall be MSB first. Only applicable to LIN master nodes.
            container LinIfFixedFrameSduByte [8..8]  # This container represents a byte within the 8 byte array.
              integer LinIfFixedFrameSduBytePos: 0..7, post-build-variant-value=true, set at link in variant link-time / post-build in variant post-build / pre-compile in variant pre-compile  # Index of the Byte in the SDU (response) 8 byte array.
              integer LinIfFixedFrameSduByteVal: 0..255, post-build-variant-value=true, set at link in variant link-time / post-build in variant post-build / pre-compile in variant pre-compile  # Byte value in the SDU (response) 8-byte array.
          choice container LinIfPduDirection [0..1]: multiplicity set at pre-compile  # Direction of the frame
            container LinIfInternalPdu [0..1]  # Represents a Diagnostic or Configuration frame : no Message ID (no PduId). | Only applicable to LIN master nodes.
            container LinIfRxPdu [0..1]  # represents a received PDU/frame
              function name LinIfRxIndicationUL [0..1]: scope=ECU, multiplicity set at link in variant link-time+post-build / pre-compile in variant pre-compile, post-build-variant-multiplicity=true, post-build-variant-value=true, set at link in variant link-time+post-build / pre-compile in variant pre-compile  # This parameter defines the name of the <User_RxIndication>. This parameter depends on the parameter LinIfUserRxIndicationUL. | If LinIfUserRxIndicationUL equals PDUR, the name of the <User_RxIndication> is fixed. If LinIfUserRxIndicationUL equals CDD, the name of the <User_RxIndication> is selectable.
              enumeration LinIfUserRxIndicationUL: {CDD, PDUR}, scope=ECU, post-build-variant-value=true, set at link in variant link-time+post-build / pre-compile in variant pre-compile  # This parameter defines the upper layer (UL) module to which the indication of the successfully received LinIfRxPdu has to be routed via <User_RxIndication>.
              integer LinIfUserTargetRxPduId [0..1]: 0..INF, origin=RB:2015-04-10, set at pre-compile, symbolic-name-value=true  # Defines the target Id of the CDD for Rx Pdus.
              reference LinIfRxPduRef: scope=ECU, post-build-variant-value=true, set at link in variant link-time / post-build in variant post-build / pre-compile in variant pre-compile, destination=Pdu  # Reference to the PDU that is received in this frame.
            container LinIfSlaveToSlavePdu [0..1]  # Represents a slave-to-slave PDU/frame. Master does only send the header but doesn't receive the response. | Only relevant for master nodes.
            container LinIfTxPdu [0..1]: post-build-variant-multiplicity=true  # represents a transmitted PDU/frame
              function name LinIfTxConfirmationUL [0..1]: scope=ECU, multiplicity set at link in variant link-time+post-build / pre-compile in variant pre-compile, post-build-variant-multiplicity=true, post-build-variant-value=true, set at link in variant link-time+post-build / pre-compile in variant pre-compile  # This parameter defines the name of the <User_TxConfirmation>. This parameter depends on the parameter LinIfUserTxUL. | If LinIfUserTxUL equals PDUR, the name of the <User_TxConfirmation> is fixed. If LinIfUserTxUL equals CDD, the name of the <User_TxConfirmation> is selectable.
              integer LinIfTxPduId: 0..65535, set at pre-compile, symbolic-name-value=true, default-value=false  # Identifier of the Pdu for the upper layer.
              function name LinIfTxTriggerTransmitUL [0..1]: scope=ECU, multiplicity set at link in variant link-time+post-build / pre-compile in variant pre-compile, post-build-variant-multiplicity=true, post-build-variant-value=true, set at link in variant link-time+post-build / pre-compile in variant pre-compile  # This parameter defines the name of the <User_TriggerTransmit>. This parameter depends on the parameter LinIfUserTxUL. If LinIfUserTxUL equals PDUR, the name of the <User_TriggerTransmit> is fixed. | If LinIfUserTxUL equals CDD, the name of the <User_TriggerTransmit> is selectable.
              integer LinIfUserTargetTxPduId [0..1]: 0..INF, origin=RB:2015-04-10, set at pre-compile, symbolic-name-value=true, default-value=false  # Defines the target Id of the CDD for Tx Pdus.
              enumeration LinIfUserTxUL: {CDD, PDUR}, scope=ECU, post-build-variant-value=true, set at link in variant link-time+post-build / pre-compile in variant pre-compile  # This parameter defines the upper layer (UL) module to which the trigger of the transmitted LinTxPdu (via the <User_TriggerTransmit>) or the confirmation of the successfully transmitted LinTxPdu has to be routed (via the <User_TxConfirmation>).
              reference LinIfTxPduRef: scope=ECU, post-build-variant-value=true, set at link in variant link-time / post-build in variant post-build / pre-compile in variant pre-compile, destination=Pdu  # Reference to the PDU that is transmitted in this frame.
          container LinIfSubstitutionFrames [0..*]: multiplicity set at pre-compile  # List of sporadic frames that can be sent in a sporadic frame slot (master node) or list of unconditional frames that can be sent in an event-triggered frame slot (slave node).
            integer LinIfFramePriority: 0..255, post-build-variant-value=true, set at link in variant link-time / post-build in variant post-build / pre-compile in variant pre-compile, default-value=false  # Priority of sporadic frame in a master node or of event-triggered frame in slave node.
            reference LinIfSubstitutionFrameRef: post-build-variant-value=true, set at link in variant link-time / post-build in variant post-build / pre-compile in variant pre-compile, destination=LinIfFrame  # Reference to an unconditional Frame that is used as sporadic frame in a master node or event-triggered frame in a slave node.
        choice container LinIfNodeType  # This container defines the LIN node type of this channel.
          container LinIfMaster [0..1]  # Each Master can only be connected to one physical channel. This could be compared to the Node parameter in a LDF file.
            float LinIfJitter [0..0]: 0..0.255, set at pre-compile, default-value=false  # The jitter specifies the differences between the maximum and minimum delay from time base tick to the header sending start point in seconds. | This parameter is not yet supported.
          container LinIfSlave [0..1]  # Describes all parameters which are only relevant for a LIN Slave node.
            enumeration LinIfLinProtocolVersion [0..1]: {ISO17987, LIN13, LIN20, LIN21, LIN22}, set at pre-compile  # Defines the LIN protocol version of the slave node. | This information is relevant for the LIN conformance test execution.
            reference LinIfResponseErrorSignal [0..1]: scope=ECU, set at link in variant link-time+post-build / pre-compile in variant pre-compile, requires-symbolic-name-value=true, destination=ComSignal  # Reference to the response_error signal. | Mandatory for all LIN 2.x and ISO LIN slave nodes, not relevant for LIN 1.3 slave nodes.
            container LinIfNodeConfigurationIdentification [0..1]  # This container is mandatory for all LIN 2.x and ISO17987 LIN slave nodes, and ignored for LIN 1.3 slave nodes and all master nodes,
              integer LinIfConfiguredNAD [0..1]: 1..125, post-build-variant-value=true, set at link in variant link-time / post-build in variant post-build / pre-compile in variant pre-compile, default-value=false  # Slave node configured NAD.
              integer LinIfFunctionId [0..1]: 0..65535, post-build-variant-value=true, set at link in variant link-time / post-build in variant post-build / pre-compile in variant pre-compile, default-value=false  # LIN function Id.
              integer LinIfInitialNAD [0..1]: 1..125, post-build-variant-value=true, set at link in variant link-time / post-build in variant post-build / pre-compile in variant pre-compile, default-value=false  # Slave node initial NAD.
              float LinIfNasTimeout [0..1]: 0..1, post-build-variant-value=true, set at link in variant link-time / post-build in variant post-build / pre-compile in variant pre-compile, default-value=false  # N_As timeout in seconds.
              integer LinIfSupplierId [0..1]: 0..32767, post-build-variant-value=true, set at link in variant link-time / post-build in variant post-build / pre-compile in variant pre-compile, default-value=false  # LIN consortium or ISO LIN supplier Id.
              integer LinIfVariantId [0..1]: 0..255, post-build-variant-value=true, set at link in variant link-time / post-build in variant post-build / pre-compile in variant pre-compile, default-value=false  # LIN variant Id.
        container LinIfScheduleTable [0..*]: multiplicity set at link in variant link-time / post-build in variant post-build / pre-compile in variant pre-compile, post-build-variant-multiplicity=true  # Describes a schedule table. Each LinIfChannel may have several schedule tables. Each schedule table can only be connected to one channel. | Mandatory for LIN Master nodes. The SHORT-NAME of the LinIfScheduleTable container represents the symbolic name of the schedule table.
          enumeration LinIfResumePosition: {CONTINUE_AT_IT_POINT, START_FROM_BEGINNING}, post-build-variant-value=true, set at link in variant link-time / post-build in variant post-build / pre-compile in variant pre-compile  # Defines where a RUN_CONTINUOUS schedule table shall proceed in case it has been interrupted by a RUN_ONCE table.
          enumeration LinIfRunMode: {RUN_CONTINUOUS, RUN_ONCE}, post-build-variant-value=true, set at link in variant link-time / post-build in variant post-build / pre-compile in variant pre-compile  # The schedule table can be executed in two different modes.
          integer LinIfScheduleTableIndex: 0..255, set at pre-compile, symbolic-name-value=true  # This is the unique index used by upper layers to identify a schedule. Note that the NULL_SCHEDULE for each channel must have index 0.
          container LinIfEntry [0..*]: multiplicity set at link in variant link-time / post-build in variant post-build / pre-compile in variant pre-compile, post-build-variant-multiplicity=true  # Describes an entry in the schedule table (also known as Frame Slot).
            float LinIfDelay: 0..0.255, post-build-variant-value=true, set at link in variant link-time / post-build in variant post-build / pre-compile in variant pre-compile, default-value=false  # Delay to next entry in schedule table in seconds.
            integer LinIfEntryIndex: 0..255, post-build-variant-value=true, set at link in variant link-time / post-build in variant post-build / pre-compile in variant pre-compile, default-value=false  # Position of the Frame Entry in the Schedule Table. The first entry index in the schedule table is 0.
            reference LinIfCollisionResolvingRef [0..1]: multiplicity set at link in variant link-time / post-build in variant post-build / pre-compile in variant pre-compile, post-build-variant-value=true, set at link in variant link-time / post-build in variant post-build / pre-compile in variant pre-compile, destination=LinIfScheduleTable  # Reference to the schedule table, which resolves the collision. This parameter is only used if the referenced frames are event triggered frames.
            reference LinIfFrameRef: post-build-variant-value=true, set at link in variant link-time / post-build in variant post-build / pre-compile in variant pre-compile, destination=LinIfFrame  # Reference to the frames that belong to this schedule table entry.
        container LinIfTransceiverDrvConfig [0..1]: multiplicity set at pre-compile  # This container contains the configuration parameters of each underlying LIN Transceiver Driver.
          boolean LinIfTrcvWakeupNotification: origin=RB:2017-01-16, set at pre-compile, default-value=false  # Selects whether wakeup indication notification is supported.True: EnabledFalse: Disabled
          reference LinIfTrcvIdRef: scope=ECU, set at link in variant link-time+post-build / pre-compile in variant pre-compile, requires-symbolic-name-value=true, destination=LinTrcvChannel  # Logical handle of the underlying LIN transceiver to be served by the LIN Interface.
