AUTOSAR XML (schema 00048)
package /AUTOSAR_Port/EcucModuleDefs
  module definition Port [0..1]: category=VENDOR_SPECIFIC_MODULE_DEFINITION, post-build-variant-support=true, refined-module-def=Port, variants pre-compile  # MCAL Port Driver | Configuration of the MCAL module for uC ports.
    container PortConfigSet [0..1]  # Configuration data set | Defines one data set of post-build configuration. Which of these data sets is actually active is controlled by EcuM. Data sets can only be switched at initialization time.
      container PortContainer [1..*]: multiplicity set at pre-compile, post-build-variant-multiplicity=true  # Port Container | Configuration of a single port, consisting of pins. The scheme to be used is uC dependent: Port_<PortIdx>. <PortIdx> specifies the index of the uC port. PortIdx for ST uC: <A-Z> PortIdx for IFX uC: <00,01,...10,11...>
        container PortPin [1..*]: multiplicity set at pre-compile, post-build-variant-multiplicity=true  # Pin Container | Configuration of an individual Port pin.
          enumeration PortPinDirection: post-build-variant-value=true, set at pre-compile  # Direction | Configuration of the initial Port pin direction (In or Out).
            PORT_PIN_DIRECTION_IN  # In
            PORT_PIN_DIRECTION_OUT  # Out
          boolean PortPinDirectionChangeable [0..1]: multiplicity set at pre-compile, post-build-variant-multiplicity=true, post-build-variant-value=true, set at pre-compile, default-value=false  # Direction changeable | Enables/disables if a pin direction is changeable by Port_SetPinDirection API call If set to true there needs to be at least one input mode and one output mode configured for this pin container.
          string PortPinInitialMode: post-build-variant-value=true, set at pre-compile  # Initial mode | Configuration of the initial port pin mode. This mode will be active after Port_Init() function is called. The initial mode needs to be configured also as PortPinMode (PortPinMode contains all available modes and PortPinInitialMode selects the one which is initialized) Valid names are PORT_PIN_MODE_INPUT_xxx PORT_PIN_MODE_OUTPUT_xxx Since xxx depends on the current Machine Type please have a look at: Port_Cfg.h (only available after successful SW build) or the JSON files in Port/src-java/port/devices/[ifx/st] There you can find all supported modes for the current Machine Type. If you configure an invalid string here the error message will also tell you which modes are supported on the current pin for the current Machine Type.
          enumeration PortPinLevelValue [0..1]: multiplicity set at pre-compile, post-build-variant-multiplicity=true, post-build-variant-value=true, set at pre-compile  # Output Level | Configuration of the initial pin output level. This tag is only needed if PORT_PIN_MODE_OUTPUT_DIO is present in PortPinMode tag. If a configuration has PORT_PIN_MODE_OUTPUT_DIO in the PortPinMode tag but the PortPinInitialMode tag contains another mode the PortPinLevelValue will be visible on the pin only after swichting the mode to PORT_PIN_MODE_OUTPUT_DIO.
            PORT_PIN_LEVEL_HIGH  # High
            PORT_PIN_LEVEL_LOW  # Low
          string PortPinMode [1..*]: multiplicity set at pre-compile, post-build-variant-multiplicity=true, post-build-variant-value=true, set at pre-compile  # Mode | Configuration of the allowed port pin modes, which can be set by Port_SetPinMode API call. See tag PortPinInitialMode for possible values.
          boolean PortPinModeChangeable [0..1]: multiplicity set at pre-compile, post-build-variant-multiplicity=true, post-build-variant-value=true, set at pre-compile, default-value=false  # Mode changeable | Enables/disables if a pin mode is changeable by Port_SetPinMode API call. The possible modes which can be used in Port_SetPinMode API call are configured under PortPinMode
          boolean PortPinRbAllowOutputOverwrite [0..1]: multiplicity set at pre-compile, origin=RB, post-build-variant-multiplicity=true, post-build-variant-value=true, set at pre-compile  # Allow override by Output signal | This tag needs to be set to true for an input pin, to allow an additional output signal in parallel on the same physical port pin. By setting this tag to true the integrator confirms that an input and an output on the same pin is the intended configuration, and it is not a configuration error which would lead to a malfunction of the input configuration.
          boolean PortPinRbBootCtrlForward [0..1]: multiplicity set at pre-compile, origin=RB, post-build-variant-multiplicity=true, post-build-variant-value=true, set at pre-compile  # Enable BootCtrl Forward | To be able to communicate with the voltage regulator on the PCB, rba_BootCrl needs to know which pins are used for communication with this device. This tag needs to be true for the following pins. SPI: SDO, SDI, CLK, CS MSC: SIP, SIN, FCLP, FCLN, SDO, SSY
          enumeration PortPinRbCallbackEdgeSelection [0..1]: multiplicity set at pre-compile, origin=RB, post-build-variant-multiplicity=true, post-build-variant-value=true, set at pre-compile  # Callback edge selection | Selects on which edge of the signal a callback should be called
            PORT_PIN_CALLBACK_EDGE_RISING  # RISING
            PORT_PIN_CALLBACK_EDGE_FALLING  # FALLING
            PORT_PIN_CALLBACK_EDGE_BOTH  # BOTH
          string PortPinRbCallbackFunctionName [0..1]: multiplicity set at pre-compile, origin=RB, post-build-variant-multiplicity=true, post-build-variant-value=true, set at pre-compile  # Callback function name | The name of the callback function to be called. This needs to be a void void function. Do not append () to the function name
          string PortPinRbCallbackHeaderName [0..1]: multiplicity set at pre-compile, origin=RB, post-build-variant-multiplicity=true, post-build-variant-value=true, set at pre-compile  # Callback header name | The name of the header file where the extern decleration for the function configured in tag PortPinRbCallbackFunctionName can be found.
          enumeration PortPinRbCharacteristicOutput [0..1]: multiplicity set at pre-compile, origin=RB, post-build-variant-multiplicity=true, post-build-variant-value=true, set at pre-compile  # Output characteristic | Configuration of the Port pin output characteristics (PushPull or OpenDrain).
            PORT_PIN_CHARACTERISTIC_OUTPUT_PUSHPULL  # PushPull
            PORT_PIN_CHARACTERISTIC_OUTPUT_OPENDRAIN  # OpenDrain
            PORT_PIN_CHARACTERISTIC_OUTPUT_OPENSOURCE  # OpenSource
          string PortPinRbCustSpecName [0..1]: multiplicity set at pre-compile, origin=RB, post-build-variant-multiplicity=true, post-build-variant-value=true, set at pre-compile  # Customerspecific name | Customer-specific name of this signal. If present, this name is visible in the report.
          string PortPinRbHwConnector: origin=RB, post-build-variant-value=true, set at pre-compile  # Hardware connector | Specifies to which port and which pin on the uC this signal is connected to. The scheme to be used is a (uC dependent) BSW typical generic HW name: PORT_<PortIdx>_<PinIdx>. <PortIdx> specifies the index of the uC port. <PinIdx> specifies the index of the particular pin. PortIdx for ST uC: <A-Z> PortIdx for IFX uC: <00,01,...10,11...> PinIdx: two decimals (This means a leading '0' must be used for numbers < 10)
          enumeration PortPinRbInputLevel [0..1]: multiplicity set at pre-compile, origin=RB, post-build-variant-multiplicity=true, post-build-variant-value=true, set at pre-compile  # Input Level | Selects the used input level for the pin
            PORT_PIN_INPUT_LEVEL_AUTOMOTIVE  # AUTOMOTIVE
            PORT_PIN_INPUT_LEVEL_TTL  # TTL
            PORT_PIN_INPUT_LEVEL_CMOS  # CMOS
            PORT_PIN_INPUT_LEVEL_RGMII  # RGMII (only IFX)
          string PortPinRbModeFunction [0..*]: multiplicity set at pre-compile, origin=RB, post-build-variant-multiplicity=true, post-build-variant-value=true, set at pre-compile  # Mode function | Only configure this tag if the Port script tells you to do so. Then the script will also print the possible values for the tag. This tag is needed for example if PORT_PIN_MODE_OUTPUT_SPI for tag PortPinInitialMode or PortPinMode is ambigious. This happens if the port pin has more than one alternate function for SPI output (for ex. A DATA or CLK output). In this case the port configuration script will abort and print out the possible alternatives which needs then configured here.
          enumeration PortPinRbPullConfig [0..1]: multiplicity set at pre-compile, origin=RB, post-build-variant-multiplicity=true, post-build-variant-value=true, set at pre-compile  # Pull resistor configuration | Configuration of the Port pin input characteristics (PullUp, PullDown, NoPull).
            PORT_PIN_CHARACTERISTIC_INPUT_PULLUP  # PullUp
            PORT_PIN_CHARACTERISTIC_INPUT_PULLDOWN  # PullDown
            PORT_PIN_CHARACTERISTIC_INPUT_NOPULL  # NoPull
          boolean PortPinRbSafeMode [0..1]: multiplicity set at pre-compile, origin=RB, post-build-variant-multiplicity=true, post-build-variant-value=true, set at pre-compile  # Safe Mode | If set to true for a output pin, the output buffer of the pin is disable in case the chip enters safe mode
          enumeration PortPinStrength [0..1]: multiplicity set at pre-compile, post-build-variant-multiplicity=true, post-build-variant-value=true, set at pre-compile  # Output strength | Output driver strength. This is the driver strength wich is mentioned in the hardware manual of the device datasheet
            PORT_PIN_STRENGTH_ST_WEAK  # ST Weak
            PORT_PIN_STRENGTH_ST_MEDIUM  # ST Medium
            PORT_PIN_STRENGTH_ST_STRONG  # ST Strong
            PORT_PIN_STRENGTH_ST_VERY_STRONG  # ST Very Stong
            PORT_PIN_STRENGTH_ST_ULTRA_STRONG  # ST Ultra Stong
            PORT_PIN_STRENGTH_IFX_MEDIUM  # IFX Medium
            PORT_PIN_STRENGTH_IFX_MEDIUM_SHARP_EDGE  # IFX Medium Sharp Edge
            PORT_PIN_STRENGTH_IFX_STRONG_MEDIUM_EDGE  # IFX Strong Medium Edge
            PORT_PIN_STRENGTH_IFX_STRONG_SHARP_EDGE  # IFX Strong Sharp
            PORT_PIN_STRENGTH_IFX_RGMII  # IFX RGMII
          container PortRbIfxLvdsConfig [0..1]: multiplicity set at pre-compile, post-build-variant-multiplicity=true  # IFX LVDS configuration | Container for IFX LVDS configuration
            boolean PortRbIfxLvdsMode: multiplicity set at pre-compile, origin=RB, post-build-variant-multiplicity=true, post-build-variant-value=true, set at pre-compile  # Enable LVDS Mode | Selects LVDS mode for the pin, since LVDS needs two pins this tag must be configured for both pins the positiv and the negativ pin
            enumeration PortRbIfxLvds_LVDSM [0..1]: multiplicity set at pre-compile, origin=RB, post-build-variant-multiplicity=true, post-build-variant-value=true, set at pre-compile  # LVDS-M Mode | LVDS-M Mode Selects reduced frequency mode “LVDS-M” of the receiver. This mode reduces the static current of the RX pad. The max data rate is reduced to 160 Mbps (80 MHz).
              LVDS_H_MODE  # LVDS-H Mode
              LVDS_M_MODE  # LVDS-M Mode
            enumeration PortRbIfxLvds_REN_CTRL [0..1]: multiplicity set at pre-compile, origin=RB, post-build-variant-multiplicity=true, post-build-variant-value=true, set at pre-compile  # LVDS RX_EN controller | LVDS RX_EN controller The LVDS RX_EN control function can be selected from the Port (default) or HSCT module (where this is connected).
              PORT_CONTROLLED  # Port controlled
              HSCT_CONTROLLED  # HSCT controlled
            enumeration PortRbIfxLvds_TEN_CTRL [0..1]: multiplicity set at pre-compile, origin=RB, post-build-variant-multiplicity=true, post-build-variant-value=true, set at pre-compile  # LVDS TX_EN controller | LVDS TX_EN controller The LVDS TX_EN control function can be selected from the Port (default) or HSCT module (where this is connected).
              PORT_CONTROLLED  # Port controlled
              HSCT_CONTROLLED  # HSCT controlled
            enumeration PortRbIfxLvds_TERM [0..1]: multiplicity set at pre-compile, origin=RB, post-build-variant-multiplicity=true, post-build-variant-value=true, set at pre-compile  # Receiver Termination Mode | Select Receiver Termination Mode Selects a suitable internal load resistor between both pads.
              EXT_TERM  # external termination - on the PCB
              INT_TERM  # 100 Ohm Receiver internal termination
            enumeration PortRbIfxLvds_TX_PWDPD [0..1]: multiplicity set at pre-compile, origin=RB, post-build-variant-multiplicity=true, post-build-variant-value=true, set at pre-compile  # TX Power down pull down | Enable TX Power down pull down. This function disables or enables the LVDS pull down resistor. The application code must disable TX power down pull down resistor with a power up. With a LVDS Power Down configuration the pull down function must be enabled, if required.
              DISABLE_TX_POWER_DOWN_PD_RESISTOR  # disabled TX Power down pull down resistor
              ENABLE_TX_POWER_DOWN_PD_RESISTOR  # enabled TX Power down pull down resistor
            enumeration PortRbIfxLvds_VDIFFADJ [0..1]: multiplicity set at pre-compile, origin=RB, post-build-variant-multiplicity=true, post-build-variant-value=true, set at pre-compile  # LVDS Output Amplitude Tuning | LVDS Output Amplitude Tuning With these two configuration bits the LVDS output current/amplitude can be adjusted. The voltage swing depending on VDIFFADJ setting is documented in the Data Sheet, see parameter V_OD.
              VAL_0  # 00
              VAL_1  # 01
              VAL_2  # 10
              VAL_3  # 11
          container PortRbStLvdsConfig [0..1]: multiplicity set at pre-compile, post-build-variant-multiplicity=true  # ST LVDS configuration | Container for ST LVDS configuration
            boolean PortRbStLvdsMode: multiplicity set at pre-compile, origin=RB, post-build-variant-multiplicity=true, post-build-variant-value=true, set at pre-compile  # Enable LVDS Mode | Selects LVDS mode for the pin, since LVDS needs two pins this tag must be configured for both pins the positiv and the negativ pin
            enumeration PortRbStLvdsOdcConfig [0..1]: multiplicity set at pre-compile, post-build-variant-multiplicity=true, post-build-variant-value=true, set at pre-compile  # Output Drive Control | Configures the output driver to be used for LVDS output port pins. Therefore this only needs to be configured for OUTPUT pins.
              MSC_LVDS  # Microsecond Channel LVDS
              LFAST_LVDS  # LFAST LVDS
      container PortRbMuxContainer [0..*]: multiplicity set at pre-compile, post-build-variant-multiplicity=true  # Port Multiplexer Container | This container is only used for ST controllers with SIUL hardware unit. Use this container to make connections described on tab Input Muxing in Centauri_Pinout.xlsx
        string PortRbInput: multiplicity set at pre-compile, origin=RB, post-build-variant-multiplicity=true, post-build-variant-value=true, set at pre-compile  # Input | Content of column Input form tab Input Muxing in Centauri_Pinout.xlsx
        string PortRbInstance: origin=RB, post-build-variant-value=true, set at pre-compile  # Instance | Content of column Instance form tab Input Muxing in Centauri_Pinout.xlsx
        string PortRbSourceInstance: origin=RB, post-build-variant-value=true, set at pre-compile  # Source Instance | Content of column Source Instance form tab Input Muxing in Centauri_Pinout.xlsx
        string PortRbSourceSignal: origin=RB, post-build-variant-value=true, set at pre-compile  # Source Signal | Content of column Source Signal form tab Input Muxing in Centauri_Pinout.xlsx
      container PortRbPowerDomain [0..*]: multiplicity set at pre-compile, post-build-variant-multiplicity=true  # Port Power Domain | This container is only used for IFX controllers. If tag PortConfigSet->PortContainer->PortPin->PortPinRbInputLevel is set to TTL the voltage of the power domain of this port pin needs to be configured. Configure this tag only if the Port script aborts and shows an error that this contanier should be configured.
        enumeration PortRbPadSupplyVoltage: multiplicity set at pre-compile, origin=RB, post-build-variant-multiplicity=true, post-build-variant-value=true, set at pre-compile  # Pad Supply Voltage | Select the pad supply voltage for the current power domain
          V5  # 5 Volt
          V3_3  # 3.3 Volt
    container PortGeneral  # General settings | Configuration of general aspects of the Port module.
      boolean PortDevErrorDetect: set at pre-compile  # Development error detection | Enables/disables the detection and notification of development errors. If this parameter is enabled, then extended error checking is performed during runtime
    container PortRbPartition [0..*]  # Port Partition (ST Devices) | Shortname of partition. This shortname can be used with the following APIs Port_Rb_ResetPinToInitialState and Port_Rb_IsResourceValid This container is only needed in Partition Manager usecases, for the software running in the Partition Manager (not in the partitions). When this configuration exists then the following APIs can be used: Port_Rb_ResetPinToInitialState and Port_Rb_IsResourceValid This container is only supported for ST devices
      container PortRbInputMuxResources [0..1]  # Input Mux Resources | Container to collect all input multiplexer settings which are allowed to be written in the current partition.
        container PortRbInputMuxResource [1..*]  # Input Mux Resource | Container for one input multiplexer. The information can be found in the IO_DEFINITION.xlsx attached to the spec on the sheet Input Muxing.
          string PortRbMuxInput: origin=RB, set at pre-compile  # Mux Input | Input column in xlsx on the sheet Input Muxing.
          string PortRbMuxInstance: origin=RB, set at pre-compile  # Mux Instance | Instance column in xlsx on the sheet Input Muxing.
      container PortRbPortResources [0..1]  # Port Resources | Container to collect all PortPins which are allowed to be written in the current partition. The configured pins here are all processed by the Port_Rb_ResetPinToInitialState API
        string PortRbPortResource [1..*]: origin=RB, set at pre-compile  # Port Resource | Port connector to specify the allowed pins Format: PORT_<PortIdx>_<PinIdx>. <PortIdx> specifies the index of the uC port. <PinIdx> specifies the index of the particular pin. PortIdx: <A-Z> PinIdx: two decimals (This means a leading '0' must be used for numbers < 10)
