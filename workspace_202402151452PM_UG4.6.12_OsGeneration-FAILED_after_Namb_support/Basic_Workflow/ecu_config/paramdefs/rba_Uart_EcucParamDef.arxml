AUTOSAR XML (schema 4-2-2)
package /RB/RBA/rba_Uart/EcucModuleDefs
  module definition rba_Uart: category=VENDOR_SPECIFIC_MODULE_DEFINITION, post-build-variant-support=true, variants post-build  # MCAL rba_Uart Driver | Configuration of the rba_Uart module.
    container rba_UartConfigSet  # Configuration Data Sets | This container contains the configuration parameters and sub containers of rba_Uart module.
      container rba_UartCBCchannel [0..*]: multiplicity set at pre-compile  # rba_Uart CBC | This is the container of Uart CBC channel
        integer rba_Uart_CBC0_ChannelNumber: 0..3, origin=RB:42.1.0.0:2016-11-29, post-build-variant-value=true, set at post-build in variant post-build / pre-compile in variant pre-compile  # Uart_CBC Channel number | The used UART Hardware channel number for circular buffer implementation
        integer rba_Uart_CBC1_PaddingByte: origin=RB:42.1.0.0:2016-11-29, post-build-variant-value=true, set at post-build in variant post-build / pre-compile in variant pre-compile  # Uart_CBC_PaddingByte | Padding byte for the data packet configured
        string rba_Uart_CBC2_CTS_PINID: origin=RB:42.1.0.0:2016-11-29, post-build-variant-value=true, set at post-build in variant post-build / pre-compile in variant pre-compile  # Uart_CBC_CTS_PINID | CTS PINID from port
        string rba_Uart_CBC3_RTS_PINID: origin=RB:42.1.0.0:2016-11-29, post-build-variant-value=true, set at post-build in variant post-build / pre-compile in variant pre-compile  # Uart_CBC_RTS_PINID | RTS PINID from port
        integer rba_Uart_CBC4_Rxtimeout: origin=RB:42.1.0.0:2016-11-29, post-build-variant-value=true, set at post-build in variant post-build / pre-compile in variant pre-compile  # Uart_CBC_RXTimeout | RxTimeout per UartCBC_MainFunctionRx
        integer rba_Uart_CBC5_TxBlockSizeLimit: origin=RB:42.1.0.0:2016-11-29, post-build-variant-value=true, set at post-build in variant post-build / pre-compile in variant pre-compile  # Uart_CBC_TxBlockSizeLimit | RxTimeout per UartCBC_MainFunctionRx
        integer rba_Uart_CBC6_RxBlockSizeLimit: origin=RB:42.1.0.0:2016-11-29, post-build-variant-value=true, set at post-build in variant post-build / pre-compile in variant pre-compile  # Uart_CBC_RxBlockSizeLimit | RxTimeout per UartCBC_MainFunctionRx
        integer rba_Uart_CBC7_TxBufferLen: origin=RB:42.1.0.0:2016-11-29, post-build-variant-value=true, set at post-build in variant post-build / pre-compile in variant pre-compile  # Uart_CBC_TxBufferLen | RxTimeout per UartCBC_MainFunctionRx
        integer rba_Uart_CBC8_RxBufferLen: origin=RB:42.1.0.0:2016-11-29, post-build-variant-value=true, set at post-build in variant post-build / pre-compile in variant pre-compile  # Uart_CBC_RxBufferLen | RxTimeout per UartCBC_MainFunctionRx
        integer rba_Uart_CBC9_RxRTSThreshold: origin=RB:42.1.0.0:2016-11-29, post-build-variant-value=true, set at post-build in variant post-build / pre-compile in variant pre-compile  # Uart_CBC_RxRTSThreshold | RxTimeout per UartCBC_MainFunctionRx
        function name rba_Uart_UCBC1_TXNotificationFunction [0..1]: origin=RB:42.1.0.0:2016-11-29, post-build-variant-value=true, set at post-build in variant post-build / pre-compile in variant pre-compile  # Uart TX_CBC_notification function | Address of transmission notification function with parameters
        function name rba_Uart_UCBC2_RXNotificationFunction [0..1]: origin=RB:42.1.0.0:2016-11-29, post-build-variant-value=true, set at post-build in variant post-build / pre-compile in variant pre-compile  # Uart RX_CBC notification function | Address of transmission notification function with parameters
      container rba_Uartchannel [1..*]: multiplicity set at pre-compile, post-build-variant-multiplicity=true  # rba_Uart channel | This is the container of Uart channel
        integer rba_Uart_0_ChannelNumber: 0..7, origin=RB:42.1.0.0:2016-10-05, post-build-variant-value=true, set at post-build in variant post-build / pre-compile in variant pre-compile  # Uart channel number | The used UART Hardware channel number | In RH850P1X UART has 4 hardware channels so values from 0-3 selected
        enumeration rba_Uart_0_ChannelPmode: origin=RB:42.1.0.0:2016-10-06, post-build-variant-value=true, set at post-build in variant post-build / pre-compile in variant pre-compile  # Uart_Channel mode | The used UART Hardware channel Mode
          UART_MODE_DMA  # DMA mode
        enumeration rba_Uart_1_ChannelParity: origin=RB:42.1.0.0:2016-10-05, post-build-variant-value=true, set at post-build in variant post-build / pre-compile in variant pre-compile  # Uart channel parity | Selection of required parity bits for the data | In RH850P1X UART Frame can have even ,odd and no parity set.
          UART_PARITY_NONE  # NO parity
          UART_PARITY_ODD  # ODD parity
          UART_PARITY_EVEN  # EVEN parity
        enumeration rba_Uart_2_DataBitsNumber: origin=RB:42.1.0.0:2016-10-05, post-build-variant-value=true, set at post-build in variant post-build / pre-compile in variant pre-compile  # Uart channel number of data bits | Selection of character length for one frame in UART | In RH850P1X UART Character length can be 7 bits or 8 bits.
          UART_DATA_BITS_7  # 7 bits
          UART_DATA_BITS_8  # 8 bits
        enumeration rba_Uart_3_TXPolarity: origin=RB:42.1.0.0:2016-10-05, post-build-variant-value=true, set at post-build in variant post-build / pre-compile in variant pre-compile  # Uart output Polarity | Sets the output polarity for UART communication. | In RH850 Output polarity can be inverted
          UART_TX_DATA_NOT_INVERTED  # NO Inversion
          UART_TX_DATA_INVERTED  # Data Inverted
        enumeration rba_Uart_4_RXPolarity: origin=RB:42.1.0.0:2016-10-05, post-build-variant-value=true, set at post-build in variant post-build / pre-compile in variant pre-compile  # Uart input Polarity | Sets the input polarity for UART communication. | In RH850 input polarity can be inverted
          UART_RX_DATA_NOT_INVERTED  # NO Inversion
          UART_RX_DATA_INVERTED  # Data Inverted
        enumeration rba_Uart_5_StopBitsNumber: origin=RB:42.1.0.0:2016-10-05, post-build-variant-value=true, set at post-build in variant post-build / pre-compile in variant pre-compile  # Uart channel number of stop bits | Sets the stop bit length of data for UART communication.
          UART_STOP_BITS_1  # 1 stop bit
          UART_STOP_BITS_2  # 2 stop bits
        enumeration rba_Uart_6_TransferDirection: origin=RB:42.1.0.0:2016-10-05, post-build-variant-value=true, set at post-build in variant post-build / pre-compile in variant pre-compile  # Uart channel transfer direction | Sets the bit order of data for UART communication.
          UART_MSB_FIRST  # MSB First
          UART_LSB_FIRST  # LSB First
        enumeration rba_Uart_7_Baudrate: origin=RB:42.1.0.0:2016-10-05, post-build-variant-value=true, set at post-build in variant post-build / pre-compile in variant pre-compile  # Uart channel baudrate | Selection of baudrate for UART channel
          UART_40MHZ_BAUDRATE_9600BIT  # 9600bps baudrate
          UART_40MHZ_BAUDRATE_19_2KBIT  # 19_2kbps baudrate
          UART_40MHZ_BAUDRATE_112_5KBIT  # 112_5kbps baudrate
          UART_40MHZ_BAUDRATE_115_2KBIT  # 115_2kbps baudrate
          UART_40MHZ_BAUDRATE_500KBIT  # 500kbps baudrate
          UART_40MHZ_BAUDRATE_1MBIT  # 1Mbps baudrate
          UART_40MHZ_BAUDRATE_1_5MBIT  # 1_5Mbps baudrate
          UART_40MHZ_BAUDRATE_2MBIT  # 2Mps baudrate
          UART_40MHZ_BAUDRATE_3MBIT  # 3Mps baudrate
          UART_40MHZ_BAUDRATE_3_5MBIT  # 3_5Mps baudrate
          UART_40MHZ_BAUDRATE_3_636MBIT  # 3_636 Mbps
          UART_40MHZ_BAUDRATE_6_6MBIT  # 6_6 Mbps
        integer rba_Uart_8_TXBlockSize: origin=RB:42.1.0.0:2016-10-05, post-build-variant-value=true, set at post-build in variant post-build / pre-compile in variant pre-compile  # Uart channel maximum TX block size | Maximum block size on transmission side
        integer rba_Uart_9_RXBlockSize: origin=RB:42.1.0.0:2016-10-05, post-build-variant-value=true, set at post-build in variant post-build / pre-compile in variant pre-compile  # Uart channel maximum RX block size | Maximum block size on reception side
        enumeration rba_Uart_U1_RXDefaultState: origin=RB:42.1.0.0:2016-10-05, post-build-variant-value=true, set at post-build in variant post-build / pre-compile in variant pre-compile  # Uart RX default state | Selection of default state for Receive channel on UART
          UART_CHANNEL_RX_STARTED  # Uart rx enabled
          UART_CHANNEL_RX_STOPPED  # Uart rx disabled
        boolean rba_Uart_U2_ChannelTXISRON: origin=RB:42.1.0.0:2016-10-05, post-build-variant-value=true, set at post-build in variant post-build / pre-compile in variant pre-compile  # Uart channel TXISR | Selection of transmission complete ISR is ON or OFF
        boolean rba_Uart_U3_RXISRON: origin=RB:42.1.0.0:2016-10-05, post-build-variant-value=true, set at post-build in variant post-build / pre-compile in variant pre-compile  # Uart channel RXISR | Selection of Reception complete ISR is ON or OFF
        boolean rba_Uart_U3_StatusISR: origin=RB:42.1.0.0:2016-10-06, post-build-variant-value=true, set at post-build in variant post-build / pre-compile in variant pre-compile  # Uart_Channel StatusISR | Selection of Status complete ISR is ON or OFF
        function name rba_Uart_U4_TXNotificationFunction [0..1]: origin=RB:42.1.0.0:2016-10-05, post-build-variant-value=true, set at post-build in variant post-build / pre-compile in variant pre-compile  # Uart TX notification function | Address of transmission notification function with parameters
        function name rba_Uart_U5_RXNotificationFunction [0..1]: origin=RB:42.1.0.0:2016-10-05, post-build-variant-value=true, set at post-build in variant post-build / pre-compile in variant pre-compile  # Uart RX notification function | Address of reception notification function with parameters
        function name rba_Uart_U6_ErrorNotificationFunction [0..1]: origin=RB:42.1.0.0:2016-10-05, post-build-variant-value=true, set at post-build in variant post-build / pre-compile in variant pre-compile  # Uart error notification function | Address of error notification function with parameters
        container rba_Uart_U7_TXDmaconfiqset: multiplicity set at pre-compile  # Uart TX- DMA channel | Configuration of DMA channels used for UART channel
          enumeration rba_UartDmaChannelMode: origin=RB:42.1.0.0:2016-10-05, post-build-variant-value=true, set at post-build in variant post-build / pre-compile in variant pre-compile  # TX DMA mode | Selection of DMA channel mode
            UART_DMA_TXMODE_ONESHOT  # oneshot mode for DMA channel
          integer rba_UartDmaChannelNumber: 0..31, origin=RB:42.1.0.0:2016-10-05, post-build-variant-value=true, set at post-build in variant post-build / pre-compile in variant pre-compile  # TX DMA channel | Selection of DMA channel number for UART Transmission
        container rba_Uart_U8_RXDmaconfiqset: multiplicity set at pre-compile  # Uart RX- DMA channel | Configuration of DMA channels used for UART channel
          enumeration rba_UartDmaChannelMode: origin=RB:42.1.0.0:2016-10-05, post-build-variant-value=true, set at post-build in variant post-build / pre-compile in variant pre-compile  # RX DMA mode | Selection of DMA channel mode
            UART_DMA_RXMODE_ONESHOT  # oneshot mode for DMA channel
            UART_DMA_RXMODE_FREERUNNING  # continous mode for DMA channel
          integer rba_UartDmaChannelNumber: 0..31, origin=RB:42.1.0.0:2016-10-05, post-build-variant-value=true, set at post-build in variant post-build / pre-compile in variant pre-compile  # RX DMA channel | Selection of DMA channel number for UART Reception
    container rba_UartGeneral: multiplicity set at pre-compile  # General Settings | Configuration of general rba_Uart parameters.
      boolean rba_U1_AtleastoneDMAchannelselected: origin=RB:42.1.0.0:2016-10-05, post-build-variant-value=true, set at post-build in variant post-build / pre-compile in variant pre-compile  # Uart atleast one channel dma | Select whether atleast one DMA channel is used or not
      integer rba_U2_GlobalTXbuffersize: origin=RB:42.1.0.0:2016-10-05, post-build-variant-value=true, set at post-build in variant post-build / pre-compile in variant pre-compile  # Uart Global TX buffer | Global transmission buffer size
      integer rba_U3_GlobalRXbuffersize: origin=RB:42.1.0.0:2016-10-05, post-build-variant-value=true, set at post-build in variant post-build / pre-compile in variant pre-compile  # Uart Global RX buffer | Global reception buffer size
      boolean rba_U4_DeverrorON: origin=RB:42.1.0.0:2016-10-05, post-build-variant-value=true, set at post-build in variant post-build / pre-compile in variant pre-compile  # Uart Dev error detect | Switches the Default Error Tracer (Det) detection ON or OFF.
      integer rba_U5_ModuleID: origin=RB:42.1.0.0:2016-11-29, post-build-variant-value=true, set at post-build in variant post-build / pre-compile in variant pre-compile  # Uart Module ID | Selction of module ID for this component
      boolean rba_U6_CBC_Support: origin=RB:42.1.0.0:2016-11-29, post-build-variant-value=true, set at post-build in variant post-build / pre-compile in variant pre-compile  # Uart CBC_Support | Uart Circular buffer support
      boolean rba_U7_CBC_FlowControl: origin=RB:42.1.0.0:2016-11-29, post-build-variant-value=true, set at post-build in variant post-build / pre-compile in variant pre-compile  # Uart CBC_FlowControl | Uart Flowcontrol support
      boolean rba_U8_CBC_BufferPadding: origin=RB:42.1.0.0:2016-11-29, post-build-variant-value=true, set at post-build in variant post-build / pre-compile in variant pre-compile  # Uart CBC_BufferPadding | Uart Buffer Padding support
      boolean rba_U9_Precompile_Support: multiplicity set at pre-compile, origin=RB:42.1.0.0:2016-11-29, post-build-variant-value=true, set at post-build in variant post-build / pre-compile in variant pre-compile  # Precompile Variant | If this parameter is true, Uart Component is precompile variant If this parameter is false, Uart Component is postbuild variant
