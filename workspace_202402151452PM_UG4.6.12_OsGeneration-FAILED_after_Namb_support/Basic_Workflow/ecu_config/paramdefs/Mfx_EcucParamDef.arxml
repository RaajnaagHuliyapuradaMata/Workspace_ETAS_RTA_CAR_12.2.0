[part 2 of 2: package /AUTOSAR_Mfx/EcucModuleDefs]
AUTOSAR XML (schema 4-2-2)
package /AUTOSAR_Mfx/EcucModuleDefs  (continued)
  module definition Mfx [0..1]: category=VENDOR_SPECIFIC_MODULE_DEFINITION, refined-module-def=Mfx, variants pre-compile  (continued)
    container MfxRbMemoryLocations  (continued)
      enumeration mfxRbMemLocMulDivs16s16u16s16: origin=RB:2.0.0:2011-06-30, set at pre-compile  # Mfx_MulDiv_s16s16u16_s16 | Select one of following values: NORMAL for location in normal flash, FAST for location in fast flash, SLOW for location in slow flash, INLINE for inlining of the service
        NORMAL  # Location in normal flash
        FAST  # Location in fast flash
        SLOW  # Location in slow flash
        INLINE  # Service is inlined
      enumeration mfxRbMemLocMulDivs16u16s16s16: origin=RB:2.0.0:2011-06-30, set at pre-compile  # Mfx_MulDiv_s16u16s16_s16 | Select one of following values: NORMAL for location in normal flash, FAST for location in fast flash, SLOW for location in slow flash, INLINE for inlining of the service
        NORMAL  # Location in normal flash
        FAST  # Location in fast flash
        SLOW  # Location in slow flash
        INLINE  # Service is inlined
      enumeration mfxRbMemLocMulDivs16u16s16u16: origin=RB:2.0.0:2011-06-30, set at pre-compile  # Mfx_MulDiv_s16u16s16_u16 | Select one of following values: NORMAL for location in normal flash, FAST for location in fast flash, SLOW for location in slow flash, INLINE for inlining of the service
        NORMAL  # Location in normal flash
        FAST  # Location in fast flash
        SLOW  # Location in slow flash
        INLINE  # Service is inlined
      enumeration mfxRbMemLocMulDivs16u16u16s16: origin=RB:2.0.0:2011-06-30, set at pre-compile  # Mfx_MulDiv_s16u16u16_s16 | Select one of following values: NORMAL for location in normal flash, FAST for location in fast flash, SLOW for location in slow flash, INLINE for inlining of the service
        NORMAL  # Location in normal flash
        FAST  # Location in fast flash
        SLOW  # Location in slow flash
        INLINE  # Service is inlined
      enumeration mfxRbMemLocMulDivs16u16u16u16: origin=RB:2.0.0:2011-06-30, set at pre-compile  # Mfx_MulDiv_s16u16u16_u16 | Select one of following values: NORMAL for location in normal flash, FAST for location in fast flash, SLOW for location in slow flash, INLINE for inlining of the service
        NORMAL  # Location in normal flash
        FAST  # Location in fast flash
        SLOW  # Location in slow flash
        INLINE  # Service is inlined
      enumeration mfxRbMemLocMulDivs32s32s16s16: origin=RB:2.0.0:2011-06-30, set at pre-compile  # Mfx_MulDiv_s32s32s16_s16 | Select one of following values: NORMAL for location in normal flash, FAST for location in fast flash, SLOW for location in slow flash, INLINE for inlining of the service
        NORMAL  # Location in normal flash
        FAST  # Location in fast flash
        SLOW  # Location in slow flash
        INLINE  # Service is inlined
      enumeration mfxRbMemLocMulDivs32s32s32s16: origin=RB:1.0.0:2010-12-17, set at pre-compile  # Mfx_MulDiv_s32s32s32_s16 | Select one of following values: NORMAL for location in normal flash, FAST for location in fast flash, SLOW for location in slow flash, INLINE for inlining of the service
        NORMAL  # Location in normal flash
        FAST  # Location in fast flash
        SLOW  # Location in slow flash
        INLINE  # Service is inlined
      enumeration mfxRbMemLocMulDivs32s32s32s32: origin=RB:1.0.0:2010-12-17, set at pre-compile  # Mfx_MulDiv_s32s32s32_s32 | Select one of following values: NORMAL for location in normal flash, FAST for location in fast flash, SLOW for location in slow flash, INLINE for inlining of the service
        NORMAL  # Location in normal flash
        FAST  # Location in fast flash
        SLOW  # Location in slow flash
        INLINE  # Service is inlined
      enumeration mfxRbMemLocMulDivs32s32s32u16: origin=RB:1.0.0:2010-12-17, set at pre-compile  # Mfx_MulDiv_s32s32s32_u16 | Select one of following values: NORMAL for location in normal flash, FAST for location in fast flash, SLOW for location in slow flash, INLINE for inlining of the service
        NORMAL  # Location in normal flash
        FAST  # Location in fast flash
        SLOW  # Location in slow flash
        INLINE  # Service is inlined
      enumeration mfxRbMemLocMulDivs32s32u32s32: origin=RB:4.0.0:2016-12-01, set at pre-compile  # Mfx_MulDiv_s32s32u32_s32 | Select one of following values: NORMAL for location in normal flash, FAST for location in fast flash, SLOW for location in slow flash, INLINE for inlining of the service
        NORMAL  # Location in normal flash
        FAST  # Location in fast flash
        SLOW  # Location in slow flash
        INLINE  # Service is inlined
      enumeration mfxRbMemLocMulDivs32u32s32s32: origin=RB:4.0.0:2016-12-01, set at pre-compile  # Mfx_MulDiv_s32u32s32_s32 | Select one of following values: NORMAL for location in normal flash, FAST for location in fast flash, SLOW for location in slow flash, INLINE for inlining of the service
        NORMAL  # Location in normal flash
        FAST  # Location in fast flash
        SLOW  # Location in slow flash
        INLINE  # Service is inlined
      enumeration mfxRbMemLocMulDivs32u32u32s32: origin=RB:4.0.0:2016-12-01, set at pre-compile  # Mfx_MulDiv_s32u32u32_s32 | Select one of following values: NORMAL for location in normal flash, FAST for location in fast flash, SLOW for location in slow flash, INLINE for inlining of the service
        NORMAL  # Location in normal flash
        FAST  # Location in fast flash
        SLOW  # Location in slow flash
        INLINE  # Service is inlined
      enumeration mfxRbMemLocMulDivu16s16s16s16: origin=RB:5.0.0:2012-12-17, set at pre-compile  # Mfx_MulDiv_u16s16s16_s16 | Select one of following values: NORMAL for location in normal flash, FAST for location in fast flash, SLOW for location in slow flash, INLINE for inlining of the service
        NORMAL  # Location in normal flash
        FAST  # Location in fast flash
        SLOW  # Location in slow flash
        INLINE  # Service is inlined
      enumeration mfxRbMemLocMulDivu16s16s16u16: origin=RB:5.0.0:2012-12-17, set at pre-compile  # Mfx_MulDiv_u16s16s16_u16 | Select one of following values: NORMAL for location in normal flash, FAST for location in fast flash, SLOW for location in slow flash, INLINE for inlining of the service
        NORMAL  # Location in normal flash
        FAST  # Location in fast flash
        SLOW  # Location in slow flash
        INLINE  # Service is inlined
      enumeration mfxRbMemLocMulDivu16s16u16s16: origin=RB:5.0.0:2012-12-17, set at pre-compile  # Mfx_MulDiv_u16s16u16_s16 | Select one of following values: NORMAL for location in normal flash, FAST for location in fast flash, SLOW for location in slow flash, INLINE for inlining of the service
        NORMAL  # Location in normal flash
        FAST  # Location in fast flash
        SLOW  # Location in slow flash
        INLINE  # Service is inlined
      enumeration mfxRbMemLocMulDivu16s16u16u16: origin=RB:5.0.0:2012-12-17, set at pre-compile  # Mfx_MulDiv_u16s16u16_u16 | Select one of following values: NORMAL for location in normal flash, FAST for location in fast flash, SLOW for location in slow flash, INLINE for inlining of the service
        NORMAL  # Location in normal flash
        FAST  # Location in fast flash
        SLOW  # Location in slow flash
        INLINE  # Service is inlined
      enumeration mfxRbMemLocMulDivu16u16u16u16: origin=RB:2.0.0:2011-06-30, set at pre-compile  # Mfx_MulDiv_u16u16u16_u16 | Select one of following values: NORMAL for location in normal flash, FAST for location in fast flash, SLOW for location in slow flash, INLINE for inlining of the service
        NORMAL  # Location in normal flash
        FAST  # Location in fast flash
        SLOW  # Location in slow flash
        INLINE  # Service is inlined
      enumeration mfxRbMemLocMulDivu32s32s32s32: origin=RB:5.0.0:2012-12-17, set at pre-compile  # Mfx_MulDiv_u32s32s32_s32 | Select one of following values: NORMAL for location in normal flash, FAST for location in fast flash, SLOW for location in slow flash, INLINE for inlining of the service
        NORMAL  # Location in normal flash
        FAST  # Location in fast flash
        SLOW  # Location in slow flash
        INLINE  # Service is inlined
      enumeration mfxRbMemLocMulDivu32s32s32u32: origin=RB:4.0.0:2016-12-01, set at pre-compile  # Mfx_MulDiv_u32s32s32_u32 | Select one of following values: NORMAL for location in normal flash, FAST for location in fast flash, SLOW for location in slow flash, INLINE for inlining of the service
        NORMAL  # Location in normal flash
        FAST  # Location in fast flash
        SLOW  # Location in slow flash
        INLINE  # Service is inlined
      enumeration mfxRbMemLocMulDivu32s32u32s32: origin=RB:5.0.0:2012-12-17, set at pre-compile  # Mfx_MulDiv_u32s32u32_s32 | Select one of following values: NORMAL for location in normal flash, FAST for location in fast flash, SLOW for location in slow flash, INLINE for inlining of the service
        NORMAL  # Location in normal flash
        FAST  # Location in fast flash
        SLOW  # Location in slow flash
        INLINE  # Service is inlined
      enumeration mfxRbMemLocMulDivu32s32u32u32: origin=RB:4.0.0:2016-12-01, set at pre-compile  # Mfx_MulDiv_u32s32u32_u32 | Select one of following values: NORMAL for location in normal flash, FAST for location in fast flash, SLOW for location in slow flash, INLINE for inlining of the service
        NORMAL  # Location in normal flash
        FAST  # Location in fast flash
        SLOW  # Location in slow flash
        INLINE  # Service is inlined
      enumeration mfxRbMemLocMulDivu32u32s32u32: origin=RB:4.0.0:2016-12-01, set at pre-compile  # Mfx_MulDiv_u32u32s32_u32 | Select one of following values: NORMAL for location in normal flash, FAST for location in fast flash, SLOW for location in slow flash, INLINE for inlining of the service
        NORMAL  # Location in normal flash
        FAST  # Location in fast flash
        SLOW  # Location in slow flash
        INLINE  # Service is inlined
      enumeration mfxRbMemLocMulDivu32u32u16u16: origin=RB:2.0.0:2011-06-30, set at pre-compile  # Mfx_MulDiv_u32u32u16_u16 | Select one of following values: NORMAL for location in normal flash, FAST for location in fast flash, SLOW for location in slow flash, INLINE for inlining of the service
        NORMAL  # Location in normal flash
        FAST  # Location in fast flash
        SLOW  # Location in slow flash
        INLINE  # Service is inlined
      enumeration mfxRbMemLocMulDivu32u32u32u16: origin=RB:1.0.0:2010-12-17, set at pre-compile  # Mfx_MulDiv_u32u32u32_u16 | Select one of following values: NORMAL for location in normal flash, FAST for location in fast flash, SLOW for location in slow flash, INLINE for inlining of the service
        NORMAL  # Location in normal flash
        FAST  # Location in fast flash
        SLOW  # Location in slow flash
        INLINE  # Service is inlined
      enumeration mfxRbMemLocMulDivu32u32u32u32: origin=RB:1.0.0:2010-12-17, set at pre-compile  # Mfx_MulDiv_u32u32u32_u32 | Select one of following values: NORMAL for location in normal flash, FAST for location in fast flash, SLOW for location in slow flash, INLINE for inlining of the service
        NORMAL  # Location in normal flash
        FAST  # Location in fast flash
        SLOW  # Location in slow flash
        INLINE  # Service is inlined
      enumeration mfxRbMemLocMulP2s16s16s16: origin=RB:4.0.0:2016-12-01, set at pre-compile  # Mfx_MulP2_s16s16_s16 | Select one of following values: NORMAL for location in normal flash, FAST for location in fast flash, SLOW for location in slow flash, INLINE for inlining of the service
        NORMAL  # Location in normal flash
        FAST  # Location in fast flash
        SLOW  # Location in slow flash
        INLINE  # Service is inlined
      enumeration mfxRbMemLocMulP2s16s16u16: origin=RB:4.0.0:2016-12-01, set at pre-compile  # Mfx_MulP2_s16s16_u16 | Select one of following values: NORMAL for location in normal flash, FAST for location in fast flash, SLOW for location in slow flash, INLINE for inlining of the service
        NORMAL  # Location in normal flash
        FAST  # Location in fast flash
        SLOW  # Location in slow flash
        INLINE  # Service is inlined
      enumeration mfxRbMemLocMulP2s32s32s32: origin=RB:4.0.0:2016-12-01, set at pre-compile  # Mfx_MulP2_s32s32_s32 | Select one of following values: NORMAL for location in normal flash, FAST for location in fast flash, SLOW for location in slow flash, INLINE for inlining of the service
        NORMAL  # Location in normal flash
        FAST  # Location in fast flash
        SLOW  # Location in slow flash
        INLINE  # Service is inlined
      enumeration mfxRbMemLocMulP2s32s32u32: origin=RB:4.0.0:2016-12-01, set at pre-compile  # Mfx_MulP2_s32s32_u32 | Select one of following values: NORMAL for location in normal flash, FAST for location in fast flash, SLOW for location in slow flash, INLINE for inlining of the service
        NORMAL  # Location in normal flash
        FAST  # Location in fast flash
        SLOW  # Location in slow flash
        INLINE  # Service is inlined
      enumeration mfxRbMemLocMulP2u16s16s16: origin=RB:4.0.0:2016-12-01, set at pre-compile  # Mfx_MulP2_u16s16_s16 | Select one of following values: NORMAL for location in normal flash, FAST for location in fast flash, SLOW for location in slow flash, INLINE for inlining of the service
        NORMAL  # Location in normal flash
        FAST  # Location in fast flash
        SLOW  # Location in slow flash
        INLINE  # Service is inlined
      enumeration mfxRbMemLocMulP2u16s16u16: origin=RB:4.0.0:2016-12-01, set at pre-compile  # Mfx_MulP2_u16s16_u16 | Select one of following values: NORMAL for location in normal flash, FAST for location in fast flash, SLOW for location in slow flash, INLINE for inlining of the service
        NORMAL  # Location in normal flash
        FAST  # Location in fast flash
        SLOW  # Location in slow flash
        INLINE  # Service is inlined
      enumeration mfxRbMemLocMulP2u16u16s16: origin=RB:4.0.0:2016-12-01, set at pre-compile  # Mfx_MulP2_u16u16_s16 | Select one of following values: NORMAL for location in normal flash, FAST for location in fast flash, SLOW for location in slow flash, INLINE for inlining of the service
        NORMAL  # Location in normal flash
        FAST  # Location in fast flash
        SLOW  # Location in slow flash
        INLINE  # Service is inlined
      enumeration mfxRbMemLocMulP2u16u16u16: origin=RB:4.0.0:2016-12-01, set at pre-compile  # Mfx_MulP2_u16u16_u16 | Select one of following values: NORMAL for location in normal flash, FAST for location in fast flash, SLOW for location in slow flash, INLINE for inlining of the service
        NORMAL  # Location in normal flash
        FAST  # Location in fast flash
        SLOW  # Location in slow flash
        INLINE  # Service is inlined
      enumeration mfxRbMemLocMulP2u32s32s32: origin=RB:4.0.0:2016-12-01, set at pre-compile  # Mfx_MulP2_u32s32_s32 | Select one of following values: NORMAL for location in normal flash, FAST for location in fast flash, SLOW for location in slow flash, INLINE for inlining of the service
        NORMAL  # Location in normal flash
        FAST  # Location in fast flash
        SLOW  # Location in slow flash
        INLINE  # Service is inlined
      enumeration mfxRbMemLocMulP2u32s32u32: origin=RB:4.0.0:2016-12-01, set at pre-compile  # Mfx_MulP2_u32s32_u32 | Select one of following values: NORMAL for location in normal flash, FAST for location in fast flash, SLOW for location in slow flash, INLINE for inlining of the service
        NORMAL  # Location in normal flash
        FAST  # Location in fast flash
        SLOW  # Location in slow flash
        INLINE  # Service is inlined
      enumeration mfxRbMemLocMulP2u32u32s32: origin=RB:4.0.0:2016-12-01, set at pre-compile  # Mfx_MulP2_u32u32_s32 | Select one of following values: NORMAL for location in normal flash, FAST for location in fast flash, SLOW for location in slow flash, INLINE for inlining of the service
        NORMAL  # Location in normal flash
        FAST  # Location in fast flash
        SLOW  # Location in slow flash
        INLINE  # Service is inlined
      enumeration mfxRbMemLocMulP2u32u32u32: origin=RB:4.0.0:2016-12-01, set at pre-compile  # Mfx_MulP2_u32u32_u32 | Select one of following values: NORMAL for location in normal flash, FAST for location in fast flash, SLOW for location in slow flash, INLINE for inlining of the service
        NORMAL  # Location in normal flash
        FAST  # Location in fast flash
        SLOW  # Location in slow flash
        INLINE  # Service is inlined
      enumeration mfxRbMemLocMulShRights16s16u8s16: origin=RB:2.0.0:2011-06-30, set at pre-compile  # Mfx_MulShRight_s16s16u8_s16 | Select one of following values: NORMAL for location in normal flash, FAST for location in fast flash, SLOW for location in slow flash, INLINE for inlining of the service
        NORMAL  # Location in normal flash
        FAST  # Location in fast flash
        SLOW  # Location in slow flash
        INLINE  # Service is inlined
      enumeration mfxRbMemLocMulShRights16s16u8s8: origin=RB:2.0.0:2011-06-30, set at pre-compile  # Mfx_MulShRight_s16s16u8_s8 | Select one of following values: NORMAL for location in normal flash, FAST for location in fast flash, SLOW for location in slow flash, INLINE for inlining of the service
        NORMAL  # Location in normal flash
        FAST  # Location in fast flash
        SLOW  # Location in slow flash
        INLINE  # Service is inlined
      enumeration mfxRbMemLocMulShRights16s16u8u16: origin=RB:2.0.0:2011-06-30, set at pre-compile  # Mfx_MulShRight_s16s16u8_u16 | Select one of following values: NORMAL for location in normal flash, FAST for location in fast flash, SLOW for location in slow flash, INLINE for inlining of the service
        NORMAL  # Location in normal flash
        FAST  # Location in fast flash
        SLOW  # Location in slow flash
        INLINE  # Service is inlined
      enumeration mfxRbMemLocMulShRights16s16u8u8: origin=RB:2.0.0:2011-06-30, set at pre-compile  # Mfx_MulShRight_s16s16u8_u8 | Select one of following values: NORMAL for location in normal flash, FAST for location in fast flash, SLOW for location in slow flash, INLINE for inlining of the service
        NORMAL  # Location in normal flash
        FAST  # Location in fast flash
        SLOW  # Location in slow flash
        INLINE  # Service is inlined
      enumeration mfxRbMemLocMulShRights32s32u8s16: origin=RB:1.0.0:2010-12-17, set at pre-compile  # Mfx_MulShRight_s32s32u8_s16 | Select one of following values: NORMAL for location in normal flash, FAST for location in fast flash, SLOW for location in slow flash, INLINE for inlining of the service
        NORMAL  # Location in normal flash
        FAST  # Location in fast flash
        SLOW  # Location in slow flash
        INLINE  # Service is inlined
      enumeration mfxRbMemLocMulShRights32s32u8s32: origin=RB:1.0.0:2010-12-17, set at pre-compile  # Mfx_MulShRight_s32s32u8_s32 | Select one of following values: NORMAL for location in normal flash, FAST for location in fast flash, SLOW for location in slow flash, INLINE for inlining of the service
        NORMAL  # Location in normal flash
        FAST  # Location in fast flash
        SLOW  # Location in slow flash
        INLINE  # Service is inlined
      enumeration mfxRbMemLocMulShRights32s32u8s8: origin=RB:1.0.0:2010-12-17, set at pre-compile  # Mfx_MulShRight_s32s32u8_s8 | Select one of following values: NORMAL for location in normal flash, FAST for location in fast flash, SLOW for location in slow flash, INLINE for inlining of the service
        NORMAL  # Location in normal flash
        FAST  # Location in fast flash
        SLOW  # Location in slow flash
        INLINE  # Service is inlined
      enumeration mfxRbMemLocMulShRights32s32u8u16: origin=RB:1.0.0:2010-12-17, set at pre-compile  # Mfx_MulShRight_s32s32u8_u16 | Select one of following values: NORMAL for location in normal flash, FAST for location in fast flash, SLOW for location in slow flash, INLINE for inlining of the service
        NORMAL  # Location in normal flash
        FAST  # Location in fast flash
        SLOW  # Location in slow flash
        INLINE  # Service is inlined
      enumeration mfxRbMemLocMulShRights32s32u8u32: origin=RB:1.0.0:2010-12-17, set at pre-compile  # Mfx_MulShRight_s32s32u8_u32 | Select one of following values: NORMAL for location in normal flash, FAST for location in fast flash, SLOW for location in slow flash, INLINE for inlining of the service
        NORMAL  # Location in normal flash
        FAST  # Location in fast flash
        SLOW  # Location in slow flash
        INLINE  # Service is inlined
      enumeration mfxRbMemLocMulShRights32s32u8u8: origin=RB:1.0.0:2010-12-17, set at pre-compile  # Mfx_MulShRight_s32s32u8_u8 | Select one of following values: NORMAL for location in normal flash, FAST for location in fast flash, SLOW for location in slow flash, INLINE for inlining of the service
        NORMAL  # Location in normal flash
        FAST  # Location in fast flash
        SLOW  # Location in slow flash
        INLINE  # Service is inlined
      enumeration mfxRbMemLocMulShRightu32s32u8s16: origin=RB:1.0.0:2010-12-17, set at pre-compile  # Mfx_MulShRight_u32s32u8_s16 | Select one of following values: NORMAL for location in normal flash, FAST for location in fast flash, SLOW for location in slow flash, INLINE for inlining of the service
        NORMAL  # Location in normal flash
        FAST  # Location in fast flash
        SLOW  # Location in slow flash
        INLINE  # Service is inlined
      enumeration mfxRbMemLocMulShRightu32s32u8s32: origin=RB:1.0.0:2010-12-17, set at pre-compile  # Mfx_MulShRight_u32s32u8_s32 | Select one of following values: NORMAL for location in normal flash, FAST for location in fast flash, SLOW for location in slow flash, INLINE for inlining of the service
        NORMAL  # Location in normal flash
        FAST  # Location in fast flash
        SLOW  # Location in slow flash
        INLINE  # Service is inlined
      enumeration mfxRbMemLocMulShRightu32s32u8s8: origin=RB:1.0.0:2010-12-17, set at pre-compile  # Mfx_MulShRight_u32s32u8_s8 | Select one of following values: NORMAL for location in normal flash, FAST for location in fast flash, SLOW for location in slow flash, INLINE for inlining of the service
        NORMAL  # Location in normal flash
        FAST  # Location in fast flash
        SLOW  # Location in slow flash
        INLINE  # Service is inlined
      enumeration mfxRbMemLocMulShRightu32s32u8u16: origin=RB:1.0.0:2010-12-17, set at pre-compile  # Mfx_MulShRight_u32s32u8_u16 | Select one of following values: NORMAL for location in normal flash, FAST for location in fast flash, SLOW for location in slow flash, INLINE for inlining of the service
        NORMAL  # Location in normal flash
        FAST  # Location in fast flash
        SLOW  # Location in slow flash
        INLINE  # Service is inlined
      enumeration mfxRbMemLocMulShRightu32s32u8u32: origin=RB:1.0.0:2010-12-17, set at pre-compile  # Mfx_MulShRight_u32s32u8_u32 | Select one of following values: NORMAL for location in normal flash, FAST for location in fast flash, SLOW for location in slow flash, INLINE for inlining of the service
        NORMAL  # Location in normal flash
        FAST  # Location in fast flash
        SLOW  # Location in slow flash
        INLINE  # Service is inlined
      enumeration mfxRbMemLocMulShRightu32s32u8u8: origin=RB:1.0.0:2010-12-17, set at pre-compile  # Mfx_MulShRight_u32s32u8_u8 | Select one of following values: NORMAL for location in normal flash, FAST for location in fast flash, SLOW for location in slow flash, INLINE for inlining of the service
        NORMAL  # Location in normal flash
        FAST  # Location in fast flash
        SLOW  # Location in slow flash
        INLINE  # Service is inlined
      enumeration mfxRbMemLocMulShRightu32u32u8s16: origin=RB:1.0.0:2010-12-17, set at pre-compile  # Mfx_MulShRight_u32u32u8_s16 | Select one of following values: NORMAL for location in normal flash, FAST for location in fast flash, SLOW for location in slow flash, INLINE for inlining of the service
        NORMAL  # Location in normal flash
        FAST  # Location in fast flash
        SLOW  # Location in slow flash
        INLINE  # Service is inlined
      enumeration mfxRbMemLocMulShRightu32u32u8s32: origin=RB:1.0.0:2010-12-17, set at pre-compile  # Mfx_MulShRight_u32u32u8_s32 | Select one of following values: NORMAL for location in normal flash, FAST for location in fast flash, SLOW for location in slow flash, INLINE for inlining of the service
        NORMAL  # Location in normal flash
        FAST  # Location in fast flash
        SLOW  # Location in slow flash
        INLINE  # Service is inlined
      enumeration mfxRbMemLocMulShRightu32u32u8s8: origin=RB:1.0.0:2010-12-17, set at pre-compile  # Mfx_MulShRight_u32u32u8_s8 | Select one of following values: NORMAL for location in normal flash, FAST for location in fast flash, SLOW for location in slow flash, INLINE for inlining of the service
        NORMAL  # Location in normal flash
        FAST  # Location in fast flash
        SLOW  # Location in slow flash
        INLINE  # Service is inlined
      enumeration mfxRbMemLocMulShRightu32u32u8u16: origin=RB:1.0.0:2010-12-17, set at pre-compile  # Mfx_MulShRight_u32u32u8_u16 | Select one of following values: NORMAL for location in normal flash, FAST for location in fast flash, SLOW for location in slow flash, INLINE for inlining of the service
        NORMAL  # Location in normal flash
        FAST  # Location in fast flash
        SLOW  # Location in slow flash
        INLINE  # Service is inlined
      enumeration mfxRbMemLocMulShRightu32u32u8u32: origin=RB:1.0.0:2010-12-17, set at pre-compile  # Mfx_MulShRight_u32u32u8_u32 | Select one of following values: NORMAL for location in normal flash, FAST for location in fast flash, SLOW for location in slow flash, INLINE for inlining of the service
        NORMAL  # Location in normal flash
        FAST  # Location in fast flash
        SLOW  # Location in slow flash
        INLINE  # Service is inlined
      enumeration mfxRbMemLocMulShRightu32u32u8u8: origin=RB:1.0.0:2010-12-17, set at pre-compile  # Mfx_MulShRight_u32u32u8_u8 | Select one of following values: NORMAL for location in normal flash, FAST for location in fast flash, SLOW for location in slow flash, INLINE for inlining of the service
        NORMAL  # Location in normal flash
        FAST  # Location in fast flash
        SLOW  # Location in slow flash
        INLINE  # Service is inlined
      enumeration mfxRbMemLocMuls16s16s16: origin=RB:2.0.0:2011-06-30, set at pre-compile  # Mfx_Mul_s16s16_s16 | Select one of following values: NORMAL for location in normal flash, FAST for location in fast flash, SLOW for location in slow flash, INLINE for inlining of the service
        NORMAL  # Location in normal flash
        FAST  # Location in fast flash
        SLOW  # Location in slow flash
        INLINE  # Service is inlined
      enumeration mfxRbMemLocMuls16s16s32: origin=RB:2.0.0:2011-06-30, set at pre-compile  # Mfx_Mul_s16s16_s32 | Select one of following values: NORMAL for location in normal flash, FAST for location in fast flash, SLOW for location in slow flash, INLINE for inlining of the service
        NORMAL  # Location in normal flash
        FAST  # Location in fast flash
        SLOW  # Location in slow flash
        INLINE  # Service is inlined
      enumeration mfxRbMemLocMuls16s16s8: origin=RB:2.0.0:2011-06-30, set at pre-compile  # Mfx_Mul_s16s16_s8 | Select one of following values: NORMAL for location in normal flash, FAST for location in fast flash, SLOW for location in slow flash, INLINE for inlining of the service
        NORMAL  # Location in normal flash
        FAST  # Location in fast flash
        SLOW  # Location in slow flash
        INLINE  # Service is inlined
      enumeration mfxRbMemLocMuls16s16u16: origin=RB:2.0.0:2011-06-30, set at pre-compile  # Mfx_Mul_s16s16_u16 | Select one of following values: NORMAL for location in normal flash, FAST for location in fast flash, SLOW for location in slow flash, INLINE for inlining of the service
        NORMAL  # Location in normal flash
        FAST  # Location in fast flash
        SLOW  # Location in slow flash
        INLINE  # Service is inlined
      enumeration mfxRbMemLocMuls16s16u8: origin=RB:2.0.0:2011-06-30, set at pre-compile  # Mfx_Mul_s16s16_u8 | Select one of following values: NORMAL for location in normal flash, FAST for location in fast flash, SLOW for location in slow flash, INLINE for inlining of the service
        NORMAL  # Location in normal flash
        FAST  # Location in fast flash
        SLOW  # Location in slow flash
        INLINE  # Service is inlined
      enumeration mfxRbMemLocMuls16u16s16: origin=RB:2.0.0:2011-06-30, set at pre-compile  # Mfx_Mul_s16u16_s16 | Select one of following values: NORMAL for location in normal flash, FAST for location in fast flash, SLOW for location in slow flash, INLINE for inlining of the service
        NORMAL  # Location in normal flash
        FAST  # Location in fast flash
        SLOW  # Location in slow flash
        INLINE  # Service is inlined
      enumeration mfxRbMemLocMuls16u16s32: origin=RB:2.0.0:2011-06-30, set at pre-compile  # Mfx_Mul_s16u16_s32 | Select one of following values: NORMAL for location in normal flash, FAST for location in fast flash, SLOW for location in slow flash, INLINE for inlining of the service
        NORMAL  # Location in normal flash
        FAST  # Location in fast flash
        SLOW  # Location in slow flash
        INLINE  # Service is inlined
      enumeration mfxRbMemLocMuls16u16u16: origin=RB:2.0.0:2011-06-30, set at pre-compile  # Mfx_Mul_s16u16_u16 | Select one of following values: NORMAL for location in normal flash, FAST for location in fast flash, SLOW for location in slow flash, INLINE for inlining of the service
        NORMAL  # Location in normal flash
        FAST  # Location in fast flash
        SLOW  # Location in slow flash
        INLINE  # Service is inlined
      enumeration mfxRbMemLocMuls32s32s16: origin=RB:1.0.0:2010-12-17, set at pre-compile  # Mfx_Mul_s32s32_s16 | Select one of following values: NORMAL for location in normal flash, FAST for location in fast flash, SLOW for location in slow flash, INLINE for inlining of the service
        NORMAL  # Location in normal flash
        FAST  # Location in fast flash
        SLOW  # Location in slow flash
        INLINE  # Service is inlined
      enumeration mfxRbMemLocMuls32s32s32: origin=RB:1.0.0:2010-12-17, set at pre-compile  # Mfx_Mul_s32s32_s32 | Select one of following values: NORMAL for location in normal flash, FAST for location in fast flash, SLOW for location in slow flash, INLINE for inlining of the service
        NORMAL  # Location in normal flash
        FAST  # Location in fast flash
        SLOW  # Location in slow flash
        INLINE  # Service is inlined
      enumeration mfxRbMemLocMuls32s32s8: origin=RB:1.0.0:2010-12-17, set at pre-compile  # Mfx_Mul_s32s32_s8 | Select one of following values: NORMAL for location in normal flash, FAST for location in fast flash, SLOW for location in slow flash, INLINE for inlining of the service
        NORMAL  # Location in normal flash
        FAST  # Location in fast flash
        SLOW  # Location in slow flash
        INLINE  # Service is inlined
      enumeration mfxRbMemLocMuls32s32u16: origin=RB:1.0.0:2010-12-17, set at pre-compile  # Mfx_Mul_s32s32_u16 | Select one of following values: NORMAL for location in normal flash, FAST for location in fast flash, SLOW for location in slow flash, INLINE for inlining of the service
        NORMAL  # Location in normal flash
        FAST  # Location in fast flash
        SLOW  # Location in slow flash
        INLINE  # Service is inlined
      enumeration mfxRbMemLocMuls32s32u32: origin=RB:1.0.0:2010-12-17, set at pre-compile  # Mfx_Mul_s32s32_u32 | Select one of following values: NORMAL for location in normal flash, FAST for location in fast flash, SLOW for location in slow flash, INLINE for inlining of the service
        NORMAL  # Location in normal flash
        FAST  # Location in fast flash
        SLOW  # Location in slow flash
        INLINE  # Service is inlined
      enumeration mfxRbMemLocMuls32s32u8: origin=RB:1.0.0:2010-12-17, set at pre-compile  # Mfx_Mul_s32s32_u8 | Select one of following values: NORMAL for location in normal flash, FAST for location in fast flash, SLOW for location in slow flash, INLINE for inlining of the service
        NORMAL  # Location in normal flash
        FAST  # Location in fast flash
        SLOW  # Location in slow flash
        INLINE  # Service is inlined
      enumeration mfxRbMemLocMuls32u16s32: origin=RB:2.0.0:2011-06-30, set at pre-compile  # Mfx_Mul_s32u16_s32 | Select one of following values: NORMAL for location in normal flash, FAST for location in fast flash, SLOW for location in slow flash, INLINE for inlining of the service
        NORMAL  # Location in normal flash
        FAST  # Location in fast flash
        SLOW  # Location in slow flash
        INLINE  # Service is inlined
      enumeration mfxRbMemLocMuls8s8s8: origin=RB:2.0.0:2011-06-30, set at pre-compile  # Mfx_Mul_s8s8_s8 | Select one of following values: NORMAL for location in normal flash, FAST for location in fast flash, SLOW for location in slow flash, INLINE for inlining of the service
        NORMAL  # Location in normal flash
        FAST  # Location in fast flash
        SLOW  # Location in slow flash
        INLINE  # Service is inlined
      enumeration mfxRbMemLocMuls8s8u8: origin=RB:2.0.0:2011-06-30, set at pre-compile  # Mfx_Mul_s8s8_u8 | Select one of following values: NORMAL for location in normal flash, FAST for location in fast flash, SLOW for location in slow flash, INLINE for inlining of the service
        NORMAL  # Location in normal flash
        FAST  # Location in fast flash
        SLOW  # Location in slow flash
        INLINE  # Service is inlined
      enumeration mfxRbMemLocMuls8u8s8: origin=RB:2.0.0:2011-06-30, set at pre-compile  # Mfx_Mul_s8u8_s8 | Select one of following values: NORMAL for location in normal flash, FAST for location in fast flash, SLOW for location in slow flash, INLINE for inlining of the service
        NORMAL  # Location in normal flash
        FAST  # Location in fast flash
        SLOW  # Location in slow flash
        INLINE  # Service is inlined
      enumeration mfxRbMemLocMuls8u8u8: origin=RB:2.0.0:2011-06-30, set at pre-compile  # Mfx_Mul_s8u8_u8 | Select one of following values: NORMAL for location in normal flash, FAST for location in fast flash, SLOW for location in slow flash, INLINE for inlining of the service
        NORMAL  # Location in normal flash
        FAST  # Location in fast flash
        SLOW  # Location in slow flash
        INLINE  # Service is inlined
      enumeration mfxRbMemLocMulu16s16s16: origin=RB:5.0.0:2012-12-17, set at pre-compile  # Mfx_Mul_u16s16_s16 | Select one of following values: NORMAL for location in normal flash, FAST for location in fast flash, SLOW for location in slow flash, INLINE for inlining of the service
        NORMAL  # Location in normal flash
        FAST  # Location in fast flash
        SLOW  # Location in slow flash
        INLINE  # Service is inlined
      enumeration mfxRbMemLocMulu16s16s32: origin=RB:5.0.0:2012-12-17, set at pre-compile  # Mfx_Mul_u16s16_s32 | Select one of following values: NORMAL for location in normal flash, FAST for location in fast flash, SLOW for location in slow flash, INLINE for inlining of the service
        NORMAL  # Location in normal flash
        FAST  # Location in fast flash
        SLOW  # Location in slow flash
        INLINE  # Service is inlined
      enumeration mfxRbMemLocMulu16s16s8: origin=RB:5.0.0:2012-12-17, set at pre-compile  # Mfx_Mul_u16s16_s8 | Select one of following values: NORMAL for location in normal flash, FAST for location in fast flash, SLOW for location in slow flash, INLINE for inlining of the service
        NORMAL  # Location in normal flash
        FAST  # Location in fast flash
        SLOW  # Location in slow flash
        INLINE  # Service is inlined
      enumeration mfxRbMemLocMulu16s16u16: origin=RB:5.0.0:2012-12-17, set at pre-compile  # Mfx_Mul_u16s16_u16 | Select one of following values: NORMAL for location in normal flash, FAST for location in fast flash, SLOW for location in slow flash, INLINE for inlining of the service
        NORMAL  # Location in normal flash
        FAST  # Location in fast flash
        SLOW  # Location in slow flash
        INLINE  # Service is inlined
      enumeration mfxRbMemLocMulu16s16u8: origin=RB:5.0.0:2012-12-17, set at pre-compile  # Mfx_Mul_u16s16_u8 | Select one of following values: NORMAL for location in normal flash, FAST for location in fast flash, SLOW for location in slow flash, INLINE for inlining of the service
        NORMAL  # Location in normal flash
        FAST  # Location in fast flash
        SLOW  # Location in slow flash
        INLINE  # Service is inlined
      enumeration mfxRbMemLocMulu16u16s16: origin=RB:5.0.0:2012-12-17, set at pre-compile  # Mfx_Mul_u16u16_s16 | Select one of following values: NORMAL for location in normal flash, FAST for location in fast flash, SLOW for location in slow flash, INLINE for inlining of the service
        NORMAL  # Location in normal flash
        FAST  # Location in fast flash
        SLOW  # Location in slow flash
        INLINE  # Service is inlined
      enumeration mfxRbMemLocMulu16u16s8: origin=RB:5.0.0:2012-12-17, set at pre-compile  # Mfx_Mul_u16u16_s8 | Select one of following values: NORMAL for location in normal flash, FAST for location in fast flash, SLOW for location in slow flash, INLINE for inlining of the service
        NORMAL  # Location in normal flash
        FAST  # Location in fast flash
        SLOW  # Location in slow flash
        INLINE  # Service is inlined
      enumeration mfxRbMemLocMulu16u16u16: origin=RB:2.0.0:2011-06-30, set at pre-compile  # Mfx_Mul_u16u16_u16 | Select one of following values: NORMAL for location in normal flash, FAST for location in fast flash, SLOW for location in slow flash, INLINE for inlining of the service
        NORMAL  # Location in normal flash
        FAST  # Location in fast flash
        SLOW  # Location in slow flash
        INLINE  # Service is inlined
      enumeration mfxRbMemLocMulu16u16u32: origin=RB:2.0.0:2011-06-30, set at pre-compile  # Mfx_Mul_u16u16_u32 | Select one of following values: NORMAL for location in normal flash, FAST for location in fast flash, SLOW for location in slow flash, INLINE for inlining of the service
        NORMAL  # Location in normal flash
        FAST  # Location in fast flash
        SLOW  # Location in slow flash
        INLINE  # Service is inlined
      enumeration mfxRbMemLocMulu16u16u8: origin=RB:5.0.0:2012-12-17, set at pre-compile  # Mfx_Mul_u16u16_u8 | Select one of following values: NORMAL for location in normal flash, FAST for location in fast flash, SLOW for location in slow flash, INLINE for inlining of the service
        NORMAL  # Location in normal flash
        FAST  # Location in fast flash
        SLOW  # Location in slow flash
        INLINE  # Service is inlined
      enumeration mfxRbMemLocMulu32s32s16: origin=RB:1.0.0:2010-12-17, set at pre-compile  # Mfx_Mul_u32s32_s16 | Select one of following values: NORMAL for location in normal flash, FAST for location in fast flash, SLOW for location in slow flash, INLINE for inlining of the service
        NORMAL  # Location in normal flash
        FAST  # Location in fast flash
        SLOW  # Location in slow flash
        INLINE  # Service is inlined
      enumeration mfxRbMemLocMulu32s32s32: origin=RB:1.0.0:2010-12-17, set at pre-compile  # Mfx_Mul_u32s32_s32 | Select one of following values: NORMAL for location in normal flash, FAST for location in fast flash, SLOW for location in slow flash, INLINE for inlining of the service
        NORMAL  # Location in normal flash
        FAST  # Location in fast flash
        SLOW  # Location in slow flash
        INLINE  # Service is inlined
      enumeration mfxRbMemLocMulu32s32s8: origin=RB:1.0.0:2010-12-17, set at pre-compile  # Mfx_Mul_u32s32_s8 | Select one of following values: NORMAL for location in normal flash, FAST for location in fast flash, SLOW for location in slow flash, INLINE for inlining of the service
        NORMAL  # Location in normal flash
        FAST  # Location in fast flash
        SLOW  # Location in slow flash
        INLINE  # Service is inlined
      enumeration mfxRbMemLocMulu32s32u16: origin=RB:1.0.0:2010-12-17, set at pre-compile  # Mfx_Mul_u32s32_u16 | Select one of following values: NORMAL for location in normal flash, FAST for location in fast flash, SLOW for location in slow flash, INLINE for inlining of the service
        NORMAL  # Location in normal flash
        FAST  # Location in fast flash
        SLOW  # Location in slow flash
        INLINE  # Service is inlined
      enumeration mfxRbMemLocMulu32s32u32: origin=RB:1.0.0:2010-12-17, set at pre-compile  # Mfx_Mul_u32s32_u32 | Select one of following values: NORMAL for location in normal flash, FAST for location in fast flash, SLOW for location in slow flash, INLINE for inlining of the service
        NORMAL  # Location in normal flash
        FAST  # Location in fast flash
        SLOW  # Location in slow flash
        INLINE  # Service is inlined
      enumeration mfxRbMemLocMulu32s32u8: origin=RB:1.0.0:2010-12-17, set at pre-compile  # Mfx_Mul_u32s32_u8 | Select one of following values: NORMAL for location in normal flash, FAST for location in fast flash, SLOW for location in slow flash, INLINE for inlining of the service
        NORMAL  # Location in normal flash
        FAST  # Location in fast flash
        SLOW  # Location in slow flash
        INLINE  # Service is inlined
      enumeration mfxRbMemLocMulu32u16u32: origin=RB:2.0.0:2011-06-30, set at pre-compile  # Mfx_Mul_u32u16_u32 | Select one of following values: NORMAL for location in normal flash, FAST for location in fast flash, SLOW for location in slow flash, INLINE for inlining of the service
        NORMAL  # Location in normal flash
        FAST  # Location in fast flash
        SLOW  # Location in slow flash
        INLINE  # Service is inlined
      enumeration mfxRbMemLocMulu32u32s16: origin=RB:1.0.0:2010-12-17, set at pre-compile  # Mfx_Mul_u32u32_s16 | Select one of following values: NORMAL for location in normal flash, FAST for location in fast flash, SLOW for location in slow flash, INLINE for inlining of the service
        NORMAL  # Location in normal flash
        FAST  # Location in fast flash
        SLOW  # Location in slow flash
        INLINE  # Service is inlined
      enumeration mfxRbMemLocMulu32u32s32: origin=RB:1.0.0:2010-12-17, set at pre-compile  # Mfx_Mul_u32u32_s32 | Select one of following values: NORMAL for location in normal flash, FAST for location in fast flash, SLOW for location in slow flash, INLINE for inlining of the service
        NORMAL  # Location in normal flash
        FAST  # Location in fast flash
        SLOW  # Location in slow flash
        INLINE  # Service is inlined
      enumeration mfxRbMemLocMulu32u32s8: origin=RB:1.0.0:2010-12-17, set at pre-compile  # Mfx_Mul_u32u32_s8 | Select one of following values: NORMAL for location in normal flash, FAST for location in fast flash, SLOW for location in slow flash, INLINE for inlining of the service
        NORMAL  # Location in normal flash
        FAST  # Location in fast flash
        SLOW  # Location in slow flash
        INLINE  # Service is inlined
      enumeration mfxRbMemLocMulu32u32u16: origin=RB:1.0.0:2010-12-17, set at pre-compile  # Mfx_Mul_u32u32_u16 | Select one of following values: NORMAL for location in normal flash, FAST for location in fast flash, SLOW for location in slow flash, INLINE for inlining of the service
        NORMAL  # Location in normal flash
        FAST  # Location in fast flash
        SLOW  # Location in slow flash
        INLINE  # Service is inlined
      enumeration mfxRbMemLocMulu32u32u32: origin=RB:1.0.0:2010-12-17, set at pre-compile  # Mfx_Mul_u32u32_u32 | Select one of following values: NORMAL for location in normal flash, FAST for location in fast flash, SLOW for location in slow flash, INLINE for inlining of the service
        NORMAL  # Location in normal flash
        FAST  # Location in fast flash
        SLOW  # Location in slow flash
        INLINE  # Service is inlined
      enumeration mfxRbMemLocMulu32u32u8: origin=RB:1.0.0:2010-12-17, set at pre-compile  # Mfx_Mul_u32u32_u8 | Select one of following values: NORMAL for location in normal flash, FAST for location in fast flash, SLOW for location in slow flash, INLINE for inlining of the service
        NORMAL  # Location in normal flash
        FAST  # Location in fast flash
        SLOW  # Location in slow flash
        INLINE  # Service is inlined
      enumeration mfxRbMemLocMulu8s8s8: origin=RB:5.0.0:2012-12-17, set at pre-compile  # Mfx_Mul_u8s8_s8 | Select one of following values: NORMAL for location in normal flash, FAST for location in fast flash, SLOW for location in slow flash, INLINE for inlining of the service
        NORMAL  # Location in normal flash
        FAST  # Location in fast flash
        SLOW  # Location in slow flash
        INLINE  # Service is inlined
      enumeration mfxRbMemLocMulu8s8u8: origin=RB:5.0.0:2012-12-17, set at pre-compile  # Mfx_Mul_u8s8_u8 | Select one of following values: NORMAL for location in normal flash, FAST for location in fast flash, SLOW for location in slow flash, INLINE for inlining of the service
        NORMAL  # Location in normal flash
        FAST  # Location in fast flash
        SLOW  # Location in slow flash
        INLINE  # Service is inlined
      enumeration mfxRbMemLocMulu8u8s8: origin=RB:5.0.0:2012-12-17, set at pre-compile  # Mfx_Mul_u8u8_s8 | Select one of following values: NORMAL for location in normal flash, FAST for location in fast flash, SLOW for location in slow flash, INLINE for inlining of the service
        NORMAL  # Location in normal flash
        FAST  # Location in fast flash
        SLOW  # Location in slow flash
        INLINE  # Service is inlined
      enumeration mfxRbMemLocMulu8u8u8: origin=RB:2.0.0:2011-06-30, set at pre-compile  # Mfx_Mul_u8u8_u8 | Select one of following values: NORMAL for location in normal flash, FAST for location in fast flash, SLOW for location in slow flash, INLINE for inlining of the service
        NORMAL  # Location in normal flash
        FAST  # Location in fast flash
        SLOW  # Location in slow flash
        INLINE  # Service is inlined
      enumeration mfxRbMemLocRDivs16s16s16: origin=RB:4.0.0:2016-12-01, set at pre-compile  # Mfx_RDiv_s16s16_s16 | Select one of following values: NORMAL for location in normal flash, FAST for location in fast flash, SLOW for location in slow flash, INLINE for inlining of the service
        NORMAL  # Location in normal flash
        FAST  # Location in fast flash
        SLOW  # Location in slow flash
        INLINE  # Service is inlined
      enumeration mfxRbMemLocRDivs16s16s8: origin=RB:4.0.0:2016-12-01, set at pre-compile  # Mfx_RDiv_s16s16_s8 | Select one of following values: NORMAL for location in normal flash, FAST for location in fast flash, SLOW for location in slow flash, INLINE for inlining of the service
        NORMAL  # Location in normal flash
        FAST  # Location in fast flash
        SLOW  # Location in slow flash
        INLINE  # Service is inlined
      enumeration mfxRbMemLocRDivs16s16u16: origin=RB:4.0.0:2016-12-01, set at pre-compile  # Mfx_RDiv_s16s16_u16 | Select one of following values: NORMAL for location in normal flash, FAST for location in fast flash, SLOW for location in slow flash, INLINE for inlining of the service
        NORMAL  # Location in normal flash
        FAST  # Location in fast flash
        SLOW  # Location in slow flash
        INLINE  # Service is inlined
      enumeration mfxRbMemLocRDivs16s16u8: origin=RB:4.0.0:2016-12-01, set at pre-compile  # Mfx_RDiv_s16s16_u8 | Select one of following values: NORMAL for location in normal flash, FAST for location in fast flash, SLOW for location in slow flash, INLINE for inlining of the service
        NORMAL  # Location in normal flash
        FAST  # Location in fast flash
        SLOW  # Location in slow flash
        INLINE  # Service is inlined
      enumeration mfxRbMemLocRDivs16u16s16: origin=RB:4.0.0:2016-12-01, set at pre-compile  # Mfx_RDiv_s16u16_s16 | Select one of following values: NORMAL for location in normal flash, FAST for location in fast flash, SLOW for location in slow flash, INLINE for inlining of the service
        NORMAL  # Location in normal flash
        FAST  # Location in fast flash
        SLOW  # Location in slow flash
        INLINE  # Service is inlined
      enumeration mfxRbMemLocRDivs16u16s8: origin=RB:4.0.0:2016-12-01, set at pre-compile  # Mfx_RDiv_s16u16_s8 | Select one of following values: NORMAL for location in normal flash, FAST for location in fast flash, SLOW for location in slow flash, INLINE for inlining of the service
        NORMAL  # Location in normal flash
        FAST  # Location in fast flash
        SLOW  # Location in slow flash
        INLINE  # Service is inlined
      enumeration mfxRbMemLocRDivs16u16u16: origin=RB:4.0.0:2016-12-01, set at pre-compile  # Mfx_RDiv_s16u16_u16 | Select one of following values: NORMAL for location in normal flash, FAST for location in fast flash, SLOW for location in slow flash, INLINE for inlining of the service
        NORMAL  # Location in normal flash
        FAST  # Location in fast flash
        SLOW  # Location in slow flash
        INLINE  # Service is inlined
      enumeration mfxRbMemLocRDivs16u16u8: origin=RB:4.0.0:2016-12-01, set at pre-compile  # Mfx_RDiv_s16u16_u8 | Select one of following values: NORMAL for location in normal flash, FAST for location in fast flash, SLOW for location in slow flash, INLINE for inlining of the service
        NORMAL  # Location in normal flash
        FAST  # Location in fast flash
        SLOW  # Location in slow flash
        INLINE  # Service is inlined
      enumeration mfxRbMemLocRDivs32s16s16: origin=RB:4.0.0:2016-12-01, set at pre-compile  # Mfx_RDiv_s32s16_s16 | Select one of following values: NORMAL for location in normal flash, FAST for location in fast flash, SLOW for location in slow flash, INLINE for inlining of the service
        NORMAL  # Location in normal flash
        FAST  # Location in fast flash
        SLOW  # Location in slow flash
        INLINE  # Service is inlined
      enumeration mfxRbMemLocRDivs32s32s16: origin=RB:4.0.0:2016-12-01, set at pre-compile  # Mfx_RDiv_s32s32_s16 | Select one of following values: NORMAL for location in normal flash, FAST for location in fast flash, SLOW for location in slow flash, INLINE for inlining of the service
        NORMAL  # Location in normal flash
        FAST  # Location in fast flash
        SLOW  # Location in slow flash
        INLINE  # Service is inlined
      enumeration mfxRbMemLocRDivs32s32s32: origin=RB:4.0.0:2016-12-01, set at pre-compile  # Mfx_RDiv_s32s32_s32 | Select one of following values: NORMAL for location in normal flash, FAST for location in fast flash, SLOW for location in slow flash, INLINE for inlining of the service
        NORMAL  # Location in normal flash
        FAST  # Location in fast flash
        SLOW  # Location in slow flash
        INLINE  # Service is inlined
      enumeration mfxRbMemLocRDivs32s32s8: origin=RB:4.0.0:2016-12-01, set at pre-compile  # Mfx_RDiv_s32s32_s8 | Select one of following values: NORMAL for location in normal flash, FAST for location in fast flash, SLOW for location in slow flash, INLINE for inlining of the service
        NORMAL  # Location in normal flash
        FAST  # Location in fast flash
        SLOW  # Location in slow flash
        INLINE  # Service is inlined
      enumeration mfxRbMemLocRDivs32s32u16: origin=RB:4.0.0:2016-12-01, set at pre-compile  # Mfx_RDiv_s32s32_u16 | Select one of following values: NORMAL for location in normal flash, FAST for location in fast flash, SLOW for location in slow flash, INLINE for inlining of the service
        NORMAL  # Location in normal flash
        FAST  # Location in fast flash
        SLOW  # Location in slow flash
        INLINE  # Service is inlined
      enumeration mfxRbMemLocRDivs32s32u32: origin=RB:4.0.0:2016-12-01, set at pre-compile  # Mfx_RDiv_s32s32_u32 | Select one of following values: NORMAL for location in normal flash, FAST for location in fast flash, SLOW for location in slow flash, INLINE for inlining of the service
        NORMAL  # Location in normal flash
        FAST  # Location in fast flash
        SLOW  # Location in slow flash
        INLINE  # Service is inlined
      enumeration mfxRbMemLocRDivs32s32u8: origin=RB:4.0.0:2016-12-01, set at pre-compile  # Mfx_RDiv_s32s32_u8 | Select one of following values: NORMAL for location in normal flash, FAST for location in fast flash, SLOW for location in slow flash, INLINE for inlining of the service
        NORMAL  # Location in normal flash
        FAST  # Location in fast flash
        SLOW  # Location in slow flash
        INLINE  # Service is inlined
      enumeration mfxRbMemLocRDivs32u16u16: origin=RB:4.0.0:2016-12-01, set at pre-compile  # Mfx_RDiv_s32u16_u16 | Select one of following values: NORMAL for location in normal flash, FAST for location in fast flash, SLOW for location in slow flash, INLINE for inlining of the service
        NORMAL  # Location in normal flash
        FAST  # Location in fast flash
        SLOW  # Location in slow flash
        INLINE  # Service is inlined
      enumeration mfxRbMemLocRDivs32u32s16: origin=RB:4.0.0:2016-12-01, set at pre-compile  # Mfx_RDiv_s32u32_s16 | Select one of following values: NORMAL for location in normal flash, FAST for location in fast flash, SLOW for location in slow flash, INLINE for inlining of the service
        NORMAL  # Location in normal flash
        FAST  # Location in fast flash
        SLOW  # Location in slow flash
        INLINE  # Service is inlined
      enumeration mfxRbMemLocRDivs32u32s32: origin=RB:4.0.0:2016-12-01, set at pre-compile  # Mfx_RDiv_s32u32_s32 | Select one of following values: NORMAL for location in normal flash, FAST for location in fast flash, SLOW for location in slow flash, INLINE for inlining of the service
        NORMAL  # Location in normal flash
        FAST  # Location in fast flash
        SLOW  # Location in slow flash
        INLINE  # Service is inlined
      enumeration mfxRbMemLocRDivs32u32s8: origin=RB:4.0.0:2016-12-01, set at pre-compile  # Mfx_RDiv_s32u32_s8 | Select one of following values: NORMAL for location in normal flash, FAST for location in fast flash, SLOW for location in slow flash, INLINE for inlining of the service
        NORMAL  # Location in normal flash
        FAST  # Location in fast flash
        SLOW  # Location in slow flash
        INLINE  # Service is inlined
      enumeration mfxRbMemLocRDivs32u32u16: origin=RB:4.0.0:2016-12-01, set at pre-compile  # Mfx_RDiv_s32u32_u16 | Select one of following values: NORMAL for location in normal flash, FAST for location in fast flash, SLOW for location in slow flash, INLINE for inlining of the service
        NORMAL  # Location in normal flash
        FAST  # Location in fast flash
        SLOW  # Location in slow flash
        INLINE  # Service is inlined
      enumeration mfxRbMemLocRDivs32u32u32: origin=RB:4.0.0:2016-12-01, set at pre-compile  # Mfx_RDiv_s32u32_u32 | Select one of following values: NORMAL for location in normal flash, FAST for location in fast flash, SLOW for location in slow flash, INLINE for inlining of the service
        NORMAL  # Location in normal flash
        FAST  # Location in fast flash
        SLOW  # Location in slow flash
        INLINE  # Service is inlined
      enumeration mfxRbMemLocRDivs32u32u8: origin=RB:4.0.0:2016-12-01, set at pre-compile  # Mfx_RDiv_s32u32_u8 | Select one of following values: NORMAL for location in normal flash, FAST for location in fast flash, SLOW for location in slow flash, INLINE for inlining of the service
        NORMAL  # Location in normal flash
        FAST  # Location in fast flash
        SLOW  # Location in slow flash
        INLINE  # Service is inlined
      enumeration mfxRbMemLocRDivs8s8s8: origin=RB:4.0.0:2016-12-01, set at pre-compile  # Mfx_RDiv_s8s8_s8 | Select one of following values: NORMAL for location in normal flash, FAST for location in fast flash, SLOW for location in slow flash, INLINE for inlining of the service
        NORMAL  # Location in normal flash
        FAST  # Location in fast flash
        SLOW  # Location in slow flash
        INLINE  # Service is inlined
      enumeration mfxRbMemLocRDivs8s8u8: origin=RB:4.0.0:2016-12-01, set at pre-compile  # Mfx_RDiv_s8s8_u8 | Select one of following values: NORMAL for location in normal flash, FAST for location in fast flash, SLOW for location in slow flash, INLINE for inlining of the service
        NORMAL  # Location in normal flash
        FAST  # Location in fast flash
        SLOW  # Location in slow flash
        INLINE  # Service is inlined
      enumeration mfxRbMemLocRDivs8u8s8: origin=RB:4.0.0:2016-12-01, set at pre-compile  # Mfx_RDiv_s8u8_s8 | Select one of following values: NORMAL for location in normal flash, FAST for location in fast flash, SLOW for location in slow flash, INLINE for inlining of the service
        NORMAL  # Location in normal flash
        FAST  # Location in fast flash
        SLOW  # Location in slow flash
        INLINE  # Service is inlined
      enumeration mfxRbMemLocRDivs8u8u8: origin=RB:4.0.0:2016-12-01, set at pre-compile  # Mfx_RDiv_s8u8_u8 | Select one of following values: NORMAL for location in normal flash, FAST for location in fast flash, SLOW for location in slow flash, INLINE for inlining of the service
        NORMAL  # Location in normal flash
        FAST  # Location in fast flash
        SLOW  # Location in slow flash
        INLINE  # Service is inlined
      enumeration mfxRbMemLocRDivu16s16s16: origin=RB:4.0.0:2016-12-01, set at pre-compile  # Mfx_RDiv_u16s16_s16 | Select one of following values: NORMAL for location in normal flash, FAST for location in fast flash, SLOW for location in slow flash, INLINE for inlining of the service
        NORMAL  # Location in normal flash
        FAST  # Location in fast flash
        SLOW  # Location in slow flash
        INLINE  # Service is inlined
      enumeration mfxRbMemLocRDivu16s16s8: origin=RB:4.0.0:2016-12-01, set at pre-compile  # Mfx_RDiv_u16s16_s8 | Select one of following values: NORMAL for location in normal flash, FAST for location in fast flash, SLOW for location in slow flash, INLINE for inlining of the service
        NORMAL  # Location in normal flash
        FAST  # Location in fast flash
        SLOW  # Location in slow flash
        INLINE  # Service is inlined
      enumeration mfxRbMemLocRDivu16s16u16: origin=RB:4.0.0:2016-12-01, set at pre-compile  # Mfx_RDiv_u16s16_u16 | Select one of following values: NORMAL for location in normal flash, FAST for location in fast flash, SLOW for location in slow flash, INLINE for inlining of the service
        NORMAL  # Location in normal flash
        FAST  # Location in fast flash
        SLOW  # Location in slow flash
        INLINE  # Service is inlined
      enumeration mfxRbMemLocRDivu16s16u8: origin=RB:4.0.0:2016-12-01, set at pre-compile  # Mfx_RDiv_u16s16_u8 | Select one of following values: NORMAL for location in normal flash, FAST for location in fast flash, SLOW for location in slow flash, INLINE for inlining of the service
        NORMAL  # Location in normal flash
        FAST  # Location in fast flash
        SLOW  # Location in slow flash
        INLINE  # Service is inlined
      enumeration mfxRbMemLocRDivu16u16s16: origin=RB:4.0.0:2016-12-01, set at pre-compile  # Mfx_RDiv_u16u16_s16 | Select one of following values: NORMAL for location in normal flash, FAST for location in fast flash, SLOW for location in slow flash, INLINE for inlining of the service
        NORMAL  # Location in normal flash
        FAST  # Location in fast flash
        SLOW  # Location in slow flash
        INLINE  # Service is inlined
      enumeration mfxRbMemLocRDivu16u16s8: origin=RB:4.0.0:2016-12-01, set at pre-compile  # Mfx_RDiv_u16u16_s8 | Select one of following values: NORMAL for location in normal flash, FAST for location in fast flash, SLOW for location in slow flash, INLINE for inlining of the service
        NORMAL  # Location in normal flash
        FAST  # Location in fast flash
        SLOW  # Location in slow flash
        INLINE  # Service is inlined
      enumeration mfxRbMemLocRDivu16u16u16: origin=RB:4.0.0:2016-12-01, set at pre-compile  # Mfx_RDiv_u16u16_u16 | Select one of following values: NORMAL for location in normal flash, FAST for location in fast flash, SLOW for location in slow flash, INLINE for inlining of the service
        NORMAL  # Location in normal flash
        FAST  # Location in fast flash
        SLOW  # Location in slow flash
        INLINE  # Service is inlined
      enumeration mfxRbMemLocRDivu16u16u8: origin=RB:4.0.0:2016-12-01, set at pre-compile  # Mfx_RDiv_u16u16_u8 | Select one of following values: NORMAL for location in normal flash, FAST for location in fast flash, SLOW for location in slow flash, INLINE for inlining of the service
        NORMAL  # Location in normal flash
        FAST  # Location in fast flash
        SLOW  # Location in slow flash
        INLINE  # Service is inlined
      enumeration mfxRbMemLocRDivu32s32s16: origin=RB:4.0.0:2016-12-01, set at pre-compile  # Mfx_RDiv_u32s32_s16 | Select one of following values: NORMAL for location in normal flash, FAST for location in fast flash, SLOW for location in slow flash, INLINE for inlining of the service
        NORMAL  # Location in normal flash
        FAST  # Location in fast flash
        SLOW  # Location in slow flash
        INLINE  # Service is inlined
      enumeration mfxRbMemLocRDivu32s32s32: origin=RB:4.0.0:2016-12-01, set at pre-compile  # Mfx_RDiv_u32s32_s32 | Select one of following values: NORMAL for location in normal flash, FAST for location in fast flash, SLOW for location in slow flash, INLINE for inlining of the service
        NORMAL  # Location in normal flash
        FAST  # Location in fast flash
        SLOW  # Location in slow flash
        INLINE  # Service is inlined
      enumeration mfxRbMemLocRDivu32s32s8: origin=RB:4.0.0:2016-12-01, set at pre-compile  # Mfx_RDiv_u32s32_s8 | Select one of following values: NORMAL for location in normal flash, FAST for location in fast flash, SLOW for location in slow flash, INLINE for inlining of the service
        NORMAL  # Location in normal flash
        FAST  # Location in fast flash
        SLOW  # Location in slow flash
        INLINE  # Service is inlined
      enumeration mfxRbMemLocRDivu32s32u16: origin=RB:4.0.0:2016-12-01, set at pre-compile  # Mfx_RDiv_u32s32_u16 | Select one of following values: NORMAL for location in normal flash, FAST for location in fast flash, SLOW for location in slow flash, INLINE for inlining of the service
        NORMAL  # Location in normal flash
        FAST  # Location in fast flash
        SLOW  # Location in slow flash
        INLINE  # Service is inlined
      enumeration mfxRbMemLocRDivu32s32u32: origin=RB:4.0.0:2016-12-01, set at pre-compile  # Mfx_RDiv_u32s32_u32 | Select one of following values: NORMAL for location in normal flash, FAST for location in fast flash, SLOW for location in slow flash, INLINE for inlining of the service
        NORMAL  # Location in normal flash
        FAST  # Location in fast flash
        SLOW  # Location in slow flash
        INLINE  # Service is inlined
      enumeration mfxRbMemLocRDivu32s32u8: origin=RB:4.0.0:2016-12-01, set at pre-compile  # Mfx_RDiv_u32s32_u8 | Select one of following values: NORMAL for location in normal flash, FAST for location in fast flash, SLOW for location in slow flash, INLINE for inlining of the service
        NORMAL  # Location in normal flash
        FAST  # Location in fast flash
        SLOW  # Location in slow flash
        INLINE  # Service is inlined
      enumeration mfxRbMemLocRDivu32u16u16: origin=RB:4.0.0:2016-12-01, set at pre-compile  # Mfx_RDiv_u32u16_u16 | Select one of following values: NORMAL for location in normal flash, FAST for location in fast flash, SLOW for location in slow flash, INLINE for inlining of the service
        NORMAL  # Location in normal flash
        FAST  # Location in fast flash
        SLOW  # Location in slow flash
        INLINE  # Service is inlined
      enumeration mfxRbMemLocRDivu32u16u32: origin=RB:4.0.0:2016-12-01, set at pre-compile  # Mfx_RDiv_u32u16_u32 | Select one of following values: NORMAL for location in normal flash, FAST for location in fast flash, SLOW for location in slow flash, INLINE for inlining of the service
        NORMAL  # Location in normal flash
        FAST  # Location in fast flash
        SLOW  # Location in slow flash
        INLINE  # Service is inlined
      enumeration mfxRbMemLocRDivu32u32s16: origin=RB:4.0.0:2016-12-01, set at pre-compile  # Mfx_RDiv_u32u32_s16 | Select one of following values: NORMAL for location in normal flash, FAST for location in fast flash, SLOW for location in slow flash, INLINE for inlining of the service
        NORMAL  # Location in normal flash
        FAST  # Location in fast flash
        SLOW  # Location in slow flash
        INLINE  # Service is inlined
      enumeration mfxRbMemLocRDivu32u32s32: origin=RB:4.0.0:2016-12-01, set at pre-compile  # Mfx_RDiv_u32u32_s32 | Select one of following values: NORMAL for location in normal flash, FAST for location in fast flash, SLOW for location in slow flash, INLINE for inlining of the service
        NORMAL  # Location in normal flash
        FAST  # Location in fast flash
        SLOW  # Location in slow flash
        INLINE  # Service is inlined
      enumeration mfxRbMemLocRDivu32u32s8: origin=RB:4.0.0:2016-12-01, set at pre-compile  # Mfx_RDiv_u32u32_s8 | Select one of following values: NORMAL for location in normal flash, FAST for location in fast flash, SLOW for location in slow flash, INLINE for inlining of the service
        NORMAL  # Location in normal flash
        FAST  # Location in fast flash
        SLOW  # Location in slow flash
        INLINE  # Service is inlined
      enumeration mfxRbMemLocRDivu32u32u16: origin=RB:4.0.0:2016-12-01, set at pre-compile  # Mfx_RDiv_u32u32_u16 | Select one of following values: NORMAL for location in normal flash, FAST for location in fast flash, SLOW for location in slow flash, INLINE for inlining of the service
        NORMAL  # Location in normal flash
        FAST  # Location in fast flash
        SLOW  # Location in slow flash
        INLINE  # Service is inlined
      enumeration mfxRbMemLocRDivu32u32u32: origin=RB:4.0.0:2016-12-01, set at pre-compile  # Mfx_RDiv_u32u32_u32 | Select one of following values: NORMAL for location in normal flash, FAST for location in fast flash, SLOW for location in slow flash, INLINE for inlining of the service
        NORMAL  # Location in normal flash
        FAST  # Location in fast flash
        SLOW  # Location in slow flash
        INLINE  # Service is inlined
      enumeration mfxRbMemLocRDivu32u32u8: origin=RB:4.0.0:2016-12-01, set at pre-compile  # Mfx_RDiv_u32u32_u8 | Select one of following values: NORMAL for location in normal flash, FAST for location in fast flash, SLOW for location in slow flash, INLINE for inlining of the service
        NORMAL  # Location in normal flash
        FAST  # Location in fast flash
        SLOW  # Location in slow flash
        INLINE  # Service is inlined
      enumeration mfxRbMemLocRDivu8s8s8: origin=RB:4.0.0:2016-12-01, set at pre-compile  # Mfx_RDiv_u8s8_s8 | Select one of following values: NORMAL for location in normal flash, FAST for location in fast flash, SLOW for location in slow flash, INLINE for inlining of the service
        NORMAL  # Location in normal flash
        FAST  # Location in fast flash
        SLOW  # Location in slow flash
        INLINE  # Service is inlined
      enumeration mfxRbMemLocRDivu8s8u8: origin=RB:4.0.0:2016-12-01, set at pre-compile  # Mfx_RDiv_u8s8_u8 | Select one of following values: NORMAL for location in normal flash, FAST for location in fast flash, SLOW for location in slow flash, INLINE for inlining of the service
        NORMAL  # Location in normal flash
        FAST  # Location in fast flash
        SLOW  # Location in slow flash
        INLINE  # Service is inlined
      enumeration mfxRbMemLocRDivu8u8s8: origin=RB:4.0.0:2016-12-01, set at pre-compile  # Mfx_RDiv_u8u8_s8 | Select one of following values: NORMAL for location in normal flash, FAST for location in fast flash, SLOW for location in slow flash, INLINE for inlining of the service
        NORMAL  # Location in normal flash
        FAST  # Location in fast flash
        SLOW  # Location in slow flash
        INLINE  # Service is inlined
      enumeration mfxRbMemLocRDivu8u8u8: origin=RB:4.0.0:2016-12-01, set at pre-compile  # Mfx_RDiv_u8u8_u8 | Select one of following values: NORMAL for location in normal flash, FAST for location in fast flash, SLOW for location in slow flash, INLINE for inlining of the service
        NORMAL  # Location in normal flash
        FAST  # Location in fast flash
        SLOW  # Location in slow flash
        INLINE  # Service is inlined
      enumeration mfxRbMemLocRMulDivs16s16s16s16: origin=RB:4.0.0:2016-12-01, set at pre-compile  # Mfx_RMulDiv_s16s16s16_s16 | Select one of following values: NORMAL for location in normal flash, FAST for location in fast flash, SLOW for location in slow flash, INLINE for inlining of the service
        NORMAL  # Location in normal flash
        FAST  # Location in fast flash
        SLOW  # Location in slow flash
        INLINE  # Service is inlined
      enumeration mfxRbMemLocRMulDivs16s16u16s16: origin=RB:4.0.0:2016-12-01, set at pre-compile  # Mfx_RMulDiv_s16s16u16_s16 | Select one of following values: NORMAL for location in normal flash, FAST for location in fast flash, SLOW for location in slow flash, INLINE for inlining of the service
        NORMAL  # Location in normal flash
        FAST  # Location in fast flash
        SLOW  # Location in slow flash
        INLINE  # Service is inlined
      enumeration mfxRbMemLocRMulDivs16u16s16s16: origin=RB:4.0.0:2016-12-01, set at pre-compile  # Mfx_RMulDiv_s16u16s16_s16 | Select one of following values: NORMAL for location in normal flash, FAST for location in fast flash, SLOW for location in slow flash, INLINE for inlining of the service
        NORMAL  # Location in normal flash
        FAST  # Location in fast flash
        SLOW  # Location in slow flash
        INLINE  # Service is inlined
      enumeration mfxRbMemLocRMulDivs16u16s16u16: origin=RB:4.0.0:2016-12-01, set at pre-compile  # Mfx_RMulDiv_s16u16s16_u16 | Select one of following values: NORMAL for location in normal flash, FAST for location in fast flash, SLOW for location in slow flash, INLINE for inlining of the service
        NORMAL  # Location in normal flash
        FAST  # Location in fast flash
        SLOW  # Location in slow flash
        INLINE  # Service is inlined
      enumeration mfxRbMemLocRMulDivs16u16u16s16: origin=RB:4.0.0:2016-12-01, set at pre-compile  # Mfx_RMulDiv_s16u16u16_s16 | Select one of following values: NORMAL for location in normal flash, FAST for location in fast flash, SLOW for location in slow flash, INLINE for inlining of the service
        NORMAL  # Location in normal flash
        FAST  # Location in fast flash
        SLOW  # Location in slow flash
        INLINE  # Service is inlined
      enumeration mfxRbMemLocRMulDivs16u16u16u16: origin=RB:4.0.0:2016-12-01, set at pre-compile  # Mfx_RMulDiv_s16u16u16_u16 | Select one of following values: NORMAL for location in normal flash, FAST for location in fast flash, SLOW for location in slow flash, INLINE for inlining of the service
        NORMAL  # Location in normal flash
        FAST  # Location in fast flash
        SLOW  # Location in slow flash
        INLINE  # Service is inlined
      enumeration mfxRbMemLocRMulDivs32s32s16s16: origin=RB:4.0.0:2016-12-01, set at pre-compile  # Mfx_RMulDiv_s32s32s16_s16 | Select one of following values: NORMAL for location in normal flash, FAST for location in fast flash, SLOW for location in slow flash, INLINE for inlining of the service
        NORMAL  # Location in normal flash
        FAST  # Location in fast flash
        SLOW  # Location in slow flash
        INLINE  # Service is inlined
      enumeration mfxRbMemLocRMulDivs32s32s32s16: origin=RB:4.0.0:2016-12-01, set at pre-compile  # Mfx_RMulDiv_s32s32s32_s16 | Select one of following values: NORMAL for location in normal flash, FAST for location in fast flash, SLOW for location in slow flash, INLINE for inlining of the service
        NORMAL  # Location in normal flash
        FAST  # Location in fast flash
        SLOW  # Location in slow flash
        INLINE  # Service is inlined
      enumeration mfxRbMemLocRMulDivs32s32s32s32: origin=RB:4.0.0:2016-12-01, set at pre-compile  # Mfx_RMulDiv_s32s32s32_s32 | Select one of following values: NORMAL for location in normal flash, FAST for location in fast flash, SLOW for location in slow flash, INLINE for inlining of the service
        NORMAL  # Location in normal flash
        FAST  # Location in fast flash
        SLOW  # Location in slow flash
        INLINE  # Service is inlined
      enumeration mfxRbMemLocRMulDivs32s32s32u16: origin=RB:4.0.0:2016-12-01, set at pre-compile  # Mfx_RMulDiv_s32s32s32_u16 | Select one of following values: NORMAL for location in normal flash, FAST for location in fast flash, SLOW for location in slow flash, INLINE for inlining of the service
        NORMAL  # Location in normal flash
        FAST  # Location in fast flash
        SLOW  # Location in slow flash
        INLINE  # Service is inlined
      enumeration mfxRbMemLocRMulDivs32s32u32s32: origin=RB:4.0.0:2016-12-01, set at pre-compile  # Mfx_RMulDiv_s32s32u32_s32 | Select one of following values: NORMAL for location in normal flash, FAST for location in fast flash, SLOW for location in slow flash, INLINE for inlining of the service
        NORMAL  # Location in normal flash
        FAST  # Location in fast flash
        SLOW  # Location in slow flash
        INLINE  # Service is inlined
      enumeration mfxRbMemLocRMulDivs32u32s32s32: origin=RB:4.0.0:2016-12-01, set at pre-compile  # Mfx_RMulDiv_s32u32s32_s32 | Select one of following values: NORMAL for location in normal flash, FAST for location in fast flash, SLOW for location in slow flash, INLINE for inlining of the service
        NORMAL  # Location in normal flash
        FAST  # Location in fast flash
        SLOW  # Location in slow flash
        INLINE  # Service is inlined
      enumeration mfxRbMemLocRMulDivs32u32u32s32: origin=RB:4.0.0:2016-12-01, set at pre-compile  # Mfx_RMulDiv_s32u32u32_s32 | Select one of following values: NORMAL for location in normal flash, FAST for location in fast flash, SLOW for location in slow flash, INLINE for inlining of the service
        NORMAL  # Location in normal flash
        FAST  # Location in fast flash
        SLOW  # Location in slow flash
        INLINE  # Service is inlined
      enumeration mfxRbMemLocRMulDivu16s16s16s16: origin=RB:4.0.0:2016-12-01, set at pre-compile  # Mfx_RMulDiv_u16s16s16_s16 | Select one of following values: NORMAL for location in normal flash, FAST for location in fast flash, SLOW for location in slow flash, INLINE for inlining of the service
        NORMAL  # Location in normal flash
        FAST  # Location in fast flash
        SLOW  # Location in slow flash
        INLINE  # Service is inlined
      enumeration mfxRbMemLocRMulDivu16s16s16u16: origin=RB:4.0.0:2016-12-01, set at pre-compile  # Mfx_RMulDiv_u16s16s16_u16 | Select one of following values: NORMAL for location in normal flash, FAST for location in fast flash, SLOW for location in slow flash, INLINE for inlining of the service
        NORMAL  # Location in normal flash
        FAST  # Location in fast flash
        SLOW  # Location in slow flash
        INLINE  # Service is inlined
      enumeration mfxRbMemLocRMulDivu16s16u16s16: origin=RB:4.0.0:2016-12-01, set at pre-compile  # Mfx_RMulDiv_u16s16u16_s16 | Select one of following values: NORMAL for location in normal flash, FAST for location in fast flash, SLOW for location in slow flash, INLINE for inlining of the service
        NORMAL  # Location in normal flash
        FAST  # Location in fast flash
        SLOW  # Location in slow flash
        INLINE  # Service is inlined
      enumeration mfxRbMemLocRMulDivu16s16u16u16: origin=RB:4.0.0:2016-12-01, set at pre-compile  # Mfx_RMulDiv_u16s16u16_u16 | Select one of following values: NORMAL for location in normal flash, FAST for location in fast flash, SLOW for location in slow flash, INLINE for inlining of the service
        NORMAL  # Location in normal flash
        FAST  # Location in fast flash
        SLOW  # Location in slow flash
        INLINE  # Service is inlined
      enumeration mfxRbMemLocRMulDivu16u16u16u16: origin=RB:4.0.0:2016-12-01, set at pre-compile  # Mfx_RMulDiv_u16u16u16_u16 | Select one of following values: NORMAL for location in normal flash, FAST for location in fast flash, SLOW for location in slow flash, INLINE for inlining of the service
        NORMAL  # Location in normal flash
        FAST  # Location in fast flash
        SLOW  # Location in slow flash
        INLINE  # Service is inlined
      enumeration mfxRbMemLocRMulDivu32s32s32s32: origin=RB:4.0.0:2016-12-01, set at pre-compile  # Mfx_RMulDiv_u32s32s32_s32 | Select one of following values: NORMAL for location in normal flash, FAST for location in fast flash, SLOW for location in slow flash, INLINE for inlining of the service
        NORMAL  # Location in normal flash
        FAST  # Location in fast flash
        SLOW  # Location in slow flash
        INLINE  # Service is inlined
      enumeration mfxRbMemLocRMulDivu32s32s32u32: origin=RB:4.0.0:2016-12-01, set at pre-compile  # Mfx_RMulDiv_u32s32s32_u32 | Select one of following values: NORMAL for location in normal flash, FAST for location in fast flash, SLOW for location in slow flash, INLINE for inlining of the service
        NORMAL  # Location in normal flash
        FAST  # Location in fast flash
        SLOW  # Location in slow flash
        INLINE  # Service is inlined
      enumeration mfxRbMemLocRMulDivu32s32u32s32: origin=RB:4.0.0:2016-12-01, set at pre-compile  # Mfx_RMulDiv_u32s32u32_s32 | Select one of following values: NORMAL for location in normal flash, FAST for location in fast flash, SLOW for location in slow flash, INLINE for inlining of the service
        NORMAL  # Location in normal flash
        FAST  # Location in fast flash
        SLOW  # Location in slow flash
        INLINE  # Service is inlined
      enumeration mfxRbMemLocRMulDivu32s32u32u32: origin=RB:4.0.0:2016-12-01, set at pre-compile  # Mfx_RMulDiv_u32s32u32_u32 | Select one of following values: NORMAL for location in normal flash, FAST for location in fast flash, SLOW for location in slow flash, INLINE for inlining of the service
        NORMAL  # Location in normal flash
        FAST  # Location in fast flash
        SLOW  # Location in slow flash
        INLINE  # Service is inlined
      enumeration mfxRbMemLocRMulDivu32u32s32u32: origin=RB:4.0.0:2016-12-01, set at pre-compile  # Mfx_RMulDiv_u32u32s32_u32 | Select one of following values: NORMAL for location in normal flash, FAST for location in fast flash, SLOW for location in slow flash, INLINE for inlining of the service
        NORMAL  # Location in normal flash
        FAST  # Location in fast flash
        SLOW  # Location in slow flash
        INLINE  # Service is inlined
      enumeration mfxRbMemLocRMulDivu32u32u16u16: origin=RB:4.0.0:2016-12-01, set at pre-compile  # Mfx_RMulDiv_u32u32u16_u16 | Select one of following values: NORMAL for location in normal flash, FAST for location in fast flash, SLOW for location in slow flash, INLINE for inlining of the service
        NORMAL  # Location in normal flash
        FAST  # Location in fast flash
        SLOW  # Location in slow flash
        INLINE  # Service is inlined
      enumeration mfxRbMemLocRMulDivu32u32u32u16: origin=RB:4.0.0:2016-12-01, set at pre-compile  # Mfx_RMulDiv_u32u32u32_u16 | Select one of following values: NORMAL for location in normal flash, FAST for location in fast flash, SLOW for location in slow flash, INLINE for inlining of the service
        NORMAL  # Location in normal flash
        FAST  # Location in fast flash
        SLOW  # Location in slow flash
        INLINE  # Service is inlined
      enumeration mfxRbMemLocRMulDivu32u32u32u32: origin=RB:4.0.0:2016-12-01, set at pre-compile  # Mfx_RMulDiv_u32u32u32_u32 | Select one of following values: NORMAL for location in normal flash, FAST for location in fast flash, SLOW for location in slow flash, INLINE for inlining of the service
        NORMAL  # Location in normal flash
        FAST  # Location in fast flash
        SLOW  # Location in slow flash
        INLINE  # Service is inlined
      enumeration mfxRbMemLocSubP2s16s16s16: origin=RB:4.0.0:2016-12-01, set at pre-compile  # Mfx_SubP2_s16s16_s16 | Select one of following values: NORMAL for location in normal flash, FAST for location in fast flash, SLOW for location in slow flash, INLINE for inlining of the service
        NORMAL  # Location in normal flash
        FAST  # Location in fast flash
        SLOW  # Location in slow flash
        INLINE  # Service is inlined
      enumeration mfxRbMemLocSubP2s16s16u16: origin=RB:4.0.0:2016-12-01, set at pre-compile  # Mfx_SubP2_s16s16_u16 | Select one of following values: NORMAL for location in normal flash, FAST for location in fast flash, SLOW for location in slow flash, INLINE for inlining of the service
        NORMAL  # Location in normal flash
        FAST  # Location in fast flash
        SLOW  # Location in slow flash
        INLINE  # Service is inlined
      enumeration mfxRbMemLocSubP2s16u16s16: origin=RB:4.0.0:2016-12-01, set at pre-compile  # Mfx_SubP2_s16u16_s16 | Select one of following values: NORMAL for location in normal flash, FAST for location in fast flash, SLOW for location in slow flash, INLINE for inlining of the service
        NORMAL  # Location in normal flash
        FAST  # Location in fast flash
        SLOW  # Location in slow flash
        INLINE  # Service is inlined
      enumeration mfxRbMemLocSubP2s16u16u16: origin=RB:4.0.0:2016-12-01, set at pre-compile  # Mfx_SubP2_s16u16_u16 | Select one of following values: NORMAL for location in normal flash, FAST for location in fast flash, SLOW for location in slow flash, INLINE for inlining of the service
        NORMAL  # Location in normal flash
        FAST  # Location in fast flash
        SLOW  # Location in slow flash
        INLINE  # Service is inlined
      enumeration mfxRbMemLocSubP2s32s32s32: origin=RB:4.0.0:2016-12-01, set at pre-compile  # Mfx_SubP2_s32s32_s32 | Select one of following values: NORMAL for location in normal flash, FAST for location in fast flash, SLOW for location in slow flash, INLINE for inlining of the service
        NORMAL  # Location in normal flash
        FAST  # Location in fast flash
        SLOW  # Location in slow flash
        INLINE  # Service is inlined
      enumeration mfxRbMemLocSubP2s32s32u32: origin=RB:4.0.0:2016-12-01, set at pre-compile  # Mfx_SubP2_s32s32_u32 | Select one of following values: NORMAL for location in normal flash, FAST for location in fast flash, SLOW for location in slow flash, INLINE for inlining of the service
        NORMAL  # Location in normal flash
        FAST  # Location in fast flash
        SLOW  # Location in slow flash
        INLINE  # Service is inlined
      enumeration mfxRbMemLocSubP2s32u32s32: origin=RB:4.0.0:2016-12-01, set at pre-compile  # Mfx_SubP2_s32u32_s32 | Select one of following values: NORMAL for location in normal flash, FAST for location in fast flash, SLOW for location in slow flash, INLINE for inlining of the service
        NORMAL  # Location in normal flash
        FAST  # Location in fast flash
        SLOW  # Location in slow flash
        INLINE  # Service is inlined
      enumeration mfxRbMemLocSubP2s32u32u32: origin=RB:4.0.0:2016-12-01, set at pre-compile  # Mfx_SubP2_s32u32_u32 | Select one of following values: NORMAL for location in normal flash, FAST for location in fast flash, SLOW for location in slow flash, INLINE for inlining of the service
        NORMAL  # Location in normal flash
        FAST  # Location in fast flash
        SLOW  # Location in slow flash
        INLINE  # Service is inlined
      enumeration mfxRbMemLocSubP2u16s16s16: origin=RB:4.0.0:2016-12-01, set at pre-compile  # Mfx_SubP2_u16s16_s16 | Select one of following values: NORMAL for location in normal flash, FAST for location in fast flash, SLOW for location in slow flash, INLINE for inlining of the service
        NORMAL  # Location in normal flash
        FAST  # Location in fast flash
        SLOW  # Location in slow flash
        INLINE  # Service is inlined
      enumeration mfxRbMemLocSubP2u16s16u16: origin=RB:4.0.0:2016-12-01, set at pre-compile  # Mfx_SubP2_u16s16_u16 | Select one of following values: NORMAL for location in normal flash, FAST for location in fast flash, SLOW for location in slow flash, INLINE for inlining of the service
        NORMAL  # Location in normal flash
        FAST  # Location in fast flash
        SLOW  # Location in slow flash
        INLINE  # Service is inlined
      enumeration mfxRbMemLocSubP2u16u16s16: origin=RB:4.0.0:2016-12-01, set at pre-compile  # Mfx_SubP2_u16u16_s16 | Select one of following values: NORMAL for location in normal flash, FAST for location in fast flash, SLOW for location in slow flash, INLINE for inlining of the service
        NORMAL  # Location in normal flash
        FAST  # Location in fast flash
        SLOW  # Location in slow flash
        INLINE  # Service is inlined
      enumeration mfxRbMemLocSubP2u16u16u16: origin=RB:4.0.0:2016-12-01, set at pre-compile  # Mfx_SubP2_u16u16_u16 | Select one of following values: NORMAL for location in normal flash, FAST for location in fast flash, SLOW for location in slow flash, INLINE for inlining of the service
        NORMAL  # Location in normal flash
        FAST  # Location in fast flash
        SLOW  # Location in slow flash
        INLINE  # Service is inlined
      enumeration mfxRbMemLocSubP2u32s32s32: origin=RB:4.0.0:2016-12-01, set at pre-compile  # Mfx_SubP2_u32s32_s32 | Select one of following values: NORMAL for location in normal flash, FAST for location in fast flash, SLOW for location in slow flash, INLINE for inlining of the service
        NORMAL  # Location in normal flash
        FAST  # Location in fast flash
        SLOW  # Location in slow flash
        INLINE  # Service is inlined
      enumeration mfxRbMemLocSubP2u32s32u32: origin=RB:4.0.0:2016-12-01, set at pre-compile  # Mfx_SubP2_u32s32_u32 | Select one of following values: NORMAL for location in normal flash, FAST for location in fast flash, SLOW for location in slow flash, INLINE for inlining of the service
        NORMAL  # Location in normal flash
        FAST  # Location in fast flash
        SLOW  # Location in slow flash
        INLINE  # Service is inlined
      enumeration mfxRbMemLocSubP2u32u32s32: origin=RB:4.0.0:2016-12-01, set at pre-compile  # Mfx_SubP2_u32u32_s32 | Select one of following values: NORMAL for location in normal flash, FAST for location in fast flash, SLOW for location in slow flash, INLINE for inlining of the service
        NORMAL  # Location in normal flash
        FAST  # Location in fast flash
        SLOW  # Location in slow flash
        INLINE  # Service is inlined
      enumeration mfxRbMemLocSubP2u32u32u32: origin=RB:4.0.0:2016-12-01, set at pre-compile  # Mfx_SubP2_u32u32_u32 | Select one of following values: NORMAL for location in normal flash, FAST for location in fast flash, SLOW for location in slow flash, INLINE for inlining of the service
        NORMAL  # Location in normal flash
        FAST  # Location in fast flash
        SLOW  # Location in slow flash
        INLINE  # Service is inlined
      enumeration mfxRbMemLocSubs16s16s16: origin=RB:2.0.0:2011-06-30, set at pre-compile  # Mfx_Sub_s16s16_s16 | Select one of following values: NORMAL for location in normal flash, FAST for location in fast flash, SLOW for location in slow flash, INLINE for inlining of the service
        NORMAL  # Location in normal flash
        FAST  # Location in fast flash
        SLOW  # Location in slow flash
        INLINE  # Service is inlined
      enumeration mfxRbMemLocSubs16s16s8: origin=RB:2.0.0:2011-06-30, set at pre-compile  # Mfx_Sub_s16s16_s8 | Select one of following values: NORMAL for location in normal flash, FAST for location in fast flash, SLOW for location in slow flash, INLINE for inlining of the service
        NORMAL  # Location in normal flash
        FAST  # Location in fast flash
        SLOW  # Location in slow flash
        INLINE  # Service is inlined
      enumeration mfxRbMemLocSubs16s16u16: origin=RB:2.0.0:2011-06-30, set at pre-compile  # Mfx_Sub_s16s16_u16 | Select one of following values: NORMAL for location in normal flash, FAST for location in fast flash, SLOW for location in slow flash, INLINE for inlining of the service
        NORMAL  # Location in normal flash
        FAST  # Location in fast flash
        SLOW  # Location in slow flash
        INLINE  # Service is inlined
      enumeration mfxRbMemLocSubs16s16u8: origin=RB:2.0.0:2011-06-30, set at pre-compile  # Mfx_Sub_s16s16_u8 | Select one of following values: NORMAL for location in normal flash, FAST for location in fast flash, SLOW for location in slow flash, INLINE for inlining of the service
        NORMAL  # Location in normal flash
        FAST  # Location in fast flash
        SLOW  # Location in slow flash
        INLINE  # Service is inlined
      enumeration mfxRbMemLocSubs16u16s16: origin=RB:2.0.0:2011-06-30, set at pre-compile  # Mfx_Sub_s16u16_s16 | Select one of following values: NORMAL for location in normal flash, FAST for location in fast flash, SLOW for location in slow flash, INLINE for inlining of the service
        NORMAL  # Location in normal flash
        FAST  # Location in fast flash
        SLOW  # Location in slow flash
        INLINE  # Service is inlined
      enumeration mfxRbMemLocSubs16u16s8: origin=RB:5.0.0:2012-12-17, set at pre-compile  # Mfx_Sub_s16u16_s8 | Select one of following values: NORMAL for location in normal flash, FAST for location in fast flash, SLOW for location in slow flash, INLINE for inlining of the service
        NORMAL  # Location in normal flash
        FAST  # Location in fast flash
        SLOW  # Location in slow flash
        INLINE  # Service is inlined
      enumeration mfxRbMemLocSubs16u16u16: origin=RB:5.0.0:2012-12-17, set at pre-compile  # Mfx_Sub_s16u16_u16 | Select one of following values: NORMAL for location in normal flash, FAST for location in fast flash, SLOW for location in slow flash, INLINE for inlining of the service
        NORMAL  # Location in normal flash
        FAST  # Location in fast flash
        SLOW  # Location in slow flash
        INLINE  # Service is inlined
      enumeration mfxRbMemLocSubs16u16u8: origin=RB:5.0.0:2012-12-17, set at pre-compile  # Mfx_Sub_s16u16_u8 | Select one of following values: NORMAL for location in normal flash, FAST for location in fast flash, SLOW for location in slow flash, INLINE for inlining of the service
        NORMAL  # Location in normal flash
        FAST  # Location in fast flash
        SLOW  # Location in slow flash
        INLINE  # Service is inlined
      enumeration mfxRbMemLocSubs32s32s16: origin=RB:1.0.0:2010-12-17, set at pre-compile  # Mfx_Sub_s32s32_s16 | Select one of following values: NORMAL for location in normal flash, FAST for location in fast flash, SLOW for location in slow flash, INLINE for inlining of the service
        NORMAL  # Location in normal flash
        FAST  # Location in fast flash
        SLOW  # Location in slow flash
        INLINE  # Service is inlined
      enumeration mfxRbMemLocSubs32s32s32: origin=RB:1.0.0:2010-12-17, set at pre-compile  # Mfx_Sub_s32s32_s32 | Select one of following values: NORMAL for location in normal flash, FAST for location in fast flash, SLOW for location in slow flash, INLINE for inlining of the service
        NORMAL  # Location in normal flash
        FAST  # Location in fast flash
        SLOW  # Location in slow flash
        INLINE  # Service is inlined
      enumeration mfxRbMemLocSubs32s32s8: origin=RB:1.0.0:2010-12-17, set at pre-compile  # Mfx_Sub_s32s32_s8 | Select one of following values: NORMAL for location in normal flash, FAST for location in fast flash, SLOW for location in slow flash, INLINE for inlining of the service
        NORMAL  # Location in normal flash
        FAST  # Location in fast flash
        SLOW  # Location in slow flash
        INLINE  # Service is inlined
      enumeration mfxRbMemLocSubs32s32u16: origin=RB:1.0.0:2010-12-17, set at pre-compile  # Mfx_Sub_s32s32_u16 | Select one of following values: NORMAL for location in normal flash, FAST for location in fast flash, SLOW for location in slow flash, INLINE for inlining of the service
        NORMAL  # Location in normal flash
        FAST  # Location in fast flash
        SLOW  # Location in slow flash
        INLINE  # Service is inlined
      enumeration mfxRbMemLocSubs32s32u32: origin=RB:1.0.0:2010-12-17, set at pre-compile  # Mfx_Sub_s32s32_u32 | Select one of following values: NORMAL for location in normal flash, FAST for location in fast flash, SLOW for location in slow flash, INLINE for inlining of the service
        NORMAL  # Location in normal flash
        FAST  # Location in fast flash
        SLOW  # Location in slow flash
        INLINE  # Service is inlined
      enumeration mfxRbMemLocSubs32s32u8: origin=RB:1.0.0:2010-12-17, set at pre-compile  # Mfx_Sub_s32s32_u8 | Select one of following values: NORMAL for location in normal flash, FAST for location in fast flash, SLOW for location in slow flash, INLINE for inlining of the service
        NORMAL  # Location in normal flash
        FAST  # Location in fast flash
        SLOW  # Location in slow flash
        INLINE  # Service is inlined
      enumeration mfxRbMemLocSubs32u32s16: origin=RB:1.0.0:2010-12-17, set at pre-compile  # Mfx_Sub_s32u32_s16 | Select one of following values: NORMAL for location in normal flash, FAST for location in fast flash, SLOW for location in slow flash, INLINE for inlining of the service
        NORMAL  # Location in normal flash
        FAST  # Location in fast flash
        SLOW  # Location in slow flash
        INLINE  # Service is inlined
      enumeration mfxRbMemLocSubs32u32s32: origin=RB:1.0.0:2010-12-17, set at pre-compile  # Mfx_Sub_s32u32_s32 | Select one of following values: NORMAL for location in normal flash, FAST for location in fast flash, SLOW for location in slow flash, INLINE for inlining of the service
        NORMAL  # Location in normal flash
        FAST  # Location in fast flash
        SLOW  # Location in slow flash
        INLINE  # Service is inlined
      enumeration mfxRbMemLocSubs32u32s8: origin=RB:1.0.0:2010-12-17, set at pre-compile  # Mfx_Sub_s32u32_s8 | Select one of following values: NORMAL for location in normal flash, FAST for location in fast flash, SLOW for location in slow flash, INLINE for inlining of the service
        NORMAL  # Location in normal flash
        FAST  # Location in fast flash
        SLOW  # Location in slow flash
        INLINE  # Service is inlined
      enumeration mfxRbMemLocSubs32u32u16: origin=RB:1.0.0:2010-12-17, set at pre-compile  # Mfx_Sub_s32u32_u16 | Select one of following values: NORMAL for location in normal flash, FAST for location in fast flash, SLOW for location in slow flash, INLINE for inlining of the service
        NORMAL  # Location in normal flash
        FAST  # Location in fast flash
        SLOW  # Location in slow flash
        INLINE  # Service is inlined
      enumeration mfxRbMemLocSubs32u32u32: origin=RB:1.0.0:2010-12-17, set at pre-compile  # Mfx_Sub_s32u32_u32 | Select one of following values: NORMAL for location in normal flash, FAST for location in fast flash, SLOW for location in slow flash, INLINE for inlining of the service
        NORMAL  # Location in normal flash
        FAST  # Location in fast flash
        SLOW  # Location in slow flash
        INLINE  # Service is inlined
      enumeration mfxRbMemLocSubs32u32u8: origin=RB:1.0.0:2010-12-17, set at pre-compile  # Mfx_Sub_s32u32_u8 | Select one of following values: NORMAL for location in normal flash, FAST for location in fast flash, SLOW for location in slow flash, INLINE for inlining of the service
        NORMAL  # Location in normal flash
        FAST  # Location in fast flash
        SLOW  # Location in slow flash
        INLINE  # Service is inlined
      enumeration mfxRbMemLocSubs8s8s8: origin=RB:2.0.0:2011-06-30, set at pre-compile  # Mfx_Sub_s8s8_s8 | Select one of following values: NORMAL for location in normal flash, FAST for location in fast flash, SLOW for location in slow flash, INLINE for inlining of the service
        NORMAL  # Location in normal flash
        FAST  # Location in fast flash
        SLOW  # Location in slow flash
        INLINE  # Service is inlined
      enumeration mfxRbMemLocSubs8s8u8: origin=RB:5.0.0:2012-12-17, set at pre-compile  # Mfx_Sub_s8s8_u8 | Select one of following values: NORMAL for location in normal flash, FAST for location in fast flash, SLOW for location in slow flash, INLINE for inlining of the service
        NORMAL  # Location in normal flash
        FAST  # Location in fast flash
        SLOW  # Location in slow flash
        INLINE  # Service is inlined
      enumeration mfxRbMemLocSubs8u8s8: origin=RB:2.0.0:2011-06-30, set at pre-compile  # Mfx_Sub_s8u8_s8 | Select one of following values: NORMAL for location in normal flash, FAST for location in fast flash, SLOW for location in slow flash, INLINE for inlining of the service
        NORMAL  # Location in normal flash
        FAST  # Location in fast flash
        SLOW  # Location in slow flash
        INLINE  # Service is inlined
      enumeration mfxRbMemLocSubs8u8u8: origin=RB:5.0.0:2012-12-17, set at pre-compile  # Mfx_Sub_s8u8_u8 | Select one of following values: NORMAL for location in normal flash, FAST for location in fast flash, SLOW for location in slow flash, INLINE for inlining of the service
        NORMAL  # Location in normal flash
        FAST  # Location in fast flash
        SLOW  # Location in slow flash
        INLINE  # Service is inlined
      enumeration mfxRbMemLocSubu16s16s16: origin=RB:2.0.0:2011-06-30, set at pre-compile  # Mfx_Sub_u16s16_s16 | Select one of following values: NORMAL for location in normal flash, FAST for location in fast flash, SLOW for location in slow flash, INLINE for inlining of the service
        NORMAL  # Location in normal flash
        FAST  # Location in fast flash
        SLOW  # Location in slow flash
        INLINE  # Service is inlined
      enumeration mfxRbMemLocSubu16s16s8: origin=RB:5.0.0:2012-12-17, set at pre-compile  # Mfx_Sub_u16s16_s8 | Select one of following values: NORMAL for location in normal flash, FAST for location in fast flash, SLOW for location in slow flash, INLINE for inlining of the service
        NORMAL  # Location in normal flash
        FAST  # Location in fast flash
        SLOW  # Location in slow flash
        INLINE  # Service is inlined
      enumeration mfxRbMemLocSubu16s16u16: origin=RB:2.0.0:2011-06-30, set at pre-compile  # Mfx_Sub_u16s16_u16 | Select one of following values: NORMAL for location in normal flash, FAST for location in fast flash, SLOW for location in slow flash, INLINE for inlining of the service
        NORMAL  # Location in normal flash
        FAST  # Location in fast flash
        SLOW  # Location in slow flash
        INLINE  # Service is inlined
      enumeration mfxRbMemLocSubu16s16u8: origin=RB:5.0.0:2012-12-17, set at pre-compile  # Mfx_Sub_u16s16_u8 | Select one of following values: NORMAL for location in normal flash, FAST for location in fast flash, SLOW for location in slow flash, INLINE for inlining of the service
        NORMAL  # Location in normal flash
        FAST  # Location in fast flash
        SLOW  # Location in slow flash
        INLINE  # Service is inlined
      enumeration mfxRbMemLocSubu16u16s16: origin=RB:2.0.0:2011-06-30, set at pre-compile  # Mfx_Sub_u16u16_s16 | Select one of following values: NORMAL for location in normal flash, FAST for location in fast flash, SLOW for location in slow flash, INLINE for inlining of the service
        NORMAL  # Location in normal flash
        FAST  # Location in fast flash
        SLOW  # Location in slow flash
        INLINE  # Service is inlined
      enumeration mfxRbMemLocSubu16u16s8: origin=RB:2.0.0:2011-06-30, set at pre-compile  # Mfx_Sub_u16u16_s8 | Select one of following values: NORMAL for location in normal flash, FAST for location in fast flash, SLOW for location in slow flash, INLINE for inlining of the service
        NORMAL  # Location in normal flash
        FAST  # Location in fast flash
        SLOW  # Location in slow flash
        INLINE  # Service is inlined
      enumeration mfxRbMemLocSubu16u16u16: origin=RB:2.0.0:2011-06-30, set at pre-compile  # Mfx_Sub_u16u16_u16 | Select one of following values: NORMAL for location in normal flash, FAST for location in fast flash, SLOW for location in slow flash, INLINE for inlining of the service
        NORMAL  # Location in normal flash
        FAST  # Location in fast flash
        SLOW  # Location in slow flash
        INLINE  # Service is inlined
      enumeration mfxRbMemLocSubu16u16u8: origin=RB:2.0.0:2011-06-30, set at pre-compile  # Mfx_Sub_u16u16_u8 | Select one of following values: NORMAL for location in normal flash, FAST for location in fast flash, SLOW for location in slow flash, INLINE for inlining of the service
        NORMAL  # Location in normal flash
        FAST  # Location in fast flash
        SLOW  # Location in slow flash
        INLINE  # Service is inlined
      enumeration mfxRbMemLocSubu32s32s16: origin=RB:1.0.0:2010-12-17, set at pre-compile  # Mfx_Sub_u32s32_s16 | Select one of following values: NORMAL for location in normal flash, FAST for location in fast flash, SLOW for location in slow flash, INLINE for inlining of the service
        NORMAL  # Location in normal flash
        FAST  # Location in fast flash
        SLOW  # Location in slow flash
        INLINE  # Service is inlined
      enumeration mfxRbMemLocSubu32s32s32: origin=RB:1.0.0:2010-12-17, set at pre-compile  # Mfx_Sub_u32s32_s32 | Select one of following values: NORMAL for location in normal flash, FAST for location in fast flash, SLOW for location in slow flash, INLINE for inlining of the service
        NORMAL  # Location in normal flash
        FAST  # Location in fast flash
        SLOW  # Location in slow flash
        INLINE  # Service is inlined
      enumeration mfxRbMemLocSubu32s32s8: origin=RB:1.0.0:2010-12-17, set at pre-compile  # Mfx_Sub_u32s32_s8 | Select one of following values: NORMAL for location in normal flash, FAST for location in fast flash, SLOW for location in slow flash, INLINE for inlining of the service
        NORMAL  # Location in normal flash
        FAST  # Location in fast flash
        SLOW  # Location in slow flash
        INLINE  # Service is inlined
      enumeration mfxRbMemLocSubu32s32u16: origin=RB:1.0.0:2010-12-17, set at pre-compile  # Mfx_Sub_u32s32_u16 | Select one of following values: NORMAL for location in normal flash, FAST for location in fast flash, SLOW for location in slow flash, INLINE for inlining of the service
        NORMAL  # Location in normal flash
        FAST  # Location in fast flash
        SLOW  # Location in slow flash
        INLINE  # Service is inlined
      enumeration mfxRbMemLocSubu32s32u32: origin=RB:1.0.0:2010-12-17, set at pre-compile  # Mfx_Sub_u32s32_u32 | Select one of following values: NORMAL for location in normal flash, FAST for location in fast flash, SLOW for location in slow flash, INLINE for inlining of the service
        NORMAL  # Location in normal flash
        FAST  # Location in fast flash
        SLOW  # Location in slow flash
        INLINE  # Service is inlined
      enumeration mfxRbMemLocSubu32s32u8: origin=RB:1.0.0:2010-12-17, set at pre-compile  # Mfx_Sub_u32s32_u8 | Select one of following values: NORMAL for location in normal flash, FAST for location in fast flash, SLOW for location in slow flash, INLINE for inlining of the service
        NORMAL  # Location in normal flash
        FAST  # Location in fast flash
        SLOW  # Location in slow flash
        INLINE  # Service is inlined
      enumeration mfxRbMemLocSubu32u32s16: origin=RB:1.0.0:2010-12-17, set at pre-compile  # Mfx_Sub_u32u32_s16 | Select one of following values: NORMAL for location in normal flash, FAST for location in fast flash, SLOW for location in slow flash, INLINE for inlining of the service
        NORMAL  # Location in normal flash
        FAST  # Location in fast flash
        SLOW  # Location in slow flash
        INLINE  # Service is inlined
      enumeration mfxRbMemLocSubu32u32s32: origin=RB:1.0.0:2010-12-17, set at pre-compile  # Mfx_Sub_u32u32_s32 | Select one of following values: NORMAL for location in normal flash, FAST for location in fast flash, SLOW for location in slow flash, INLINE for inlining of the service
        NORMAL  # Location in normal flash
        FAST  # Location in fast flash
        SLOW  # Location in slow flash
        INLINE  # Service is inlined
      enumeration mfxRbMemLocSubu32u32s8: origin=RB:1.0.0:2010-12-17, set at pre-compile  # Mfx_Sub_u32u32_s8 | Select one of following values: NORMAL for location in normal flash, FAST for location in fast flash, SLOW for location in slow flash, INLINE for inlining of the service
        NORMAL  # Location in normal flash
        FAST  # Location in fast flash
        SLOW  # Location in slow flash
        INLINE  # Service is inlined
      enumeration mfxRbMemLocSubu32u32u16: origin=RB:1.0.0:2010-12-17, set at pre-compile  # Mfx_Sub_u32u32_u16 | Select one of following values: NORMAL for location in normal flash, FAST for location in fast flash, SLOW for location in slow flash, INLINE for inlining of the service
        NORMAL  # Location in normal flash
        FAST  # Location in fast flash
        SLOW  # Location in slow flash
        INLINE  # Service is inlined
      enumeration mfxRbMemLocSubu32u32u32: origin=RB:1.0.0:2010-12-17, set at pre-compile  # Mfx_Sub_u32u32_u32 | Select one of following values: NORMAL for location in normal flash, FAST for location in fast flash, SLOW for location in slow flash, INLINE for inlining of the service
        NORMAL  # Location in normal flash
        FAST  # Location in fast flash
        SLOW  # Location in slow flash
        INLINE  # Service is inlined
      enumeration mfxRbMemLocSubu32u32u8: origin=RB:1.0.0:2010-12-17, set at pre-compile  # Mfx_Sub_u32u32_u8 | Select one of following values: NORMAL for location in normal flash, FAST for location in fast flash, SLOW for location in slow flash, INLINE for inlining of the service
        NORMAL  # Location in normal flash
        FAST  # Location in fast flash
        SLOW  # Location in slow flash
        INLINE  # Service is inlined
      enumeration mfxRbMemLocSubu8s8s8: origin=RB:5.0.0:2012-12-17, set at pre-compile  # Mfx_Sub_u8s8_s8 | Select one of following values: NORMAL for location in normal flash, FAST for location in fast flash, SLOW for location in slow flash, INLINE for inlining of the service
        NORMAL  # Location in normal flash
        FAST  # Location in fast flash
        SLOW  # Location in slow flash
        INLINE  # Service is inlined
      enumeration mfxRbMemLocSubu8s8u8: origin=RB:2.0.0:2011-06-30, set at pre-compile  # Mfx_Sub_u8s8_u8 | Select one of following values: NORMAL for location in normal flash, FAST for location in fast flash, SLOW for location in slow flash, INLINE for inlining of the service
        NORMAL  # Location in normal flash
        FAST  # Location in fast flash
        SLOW  # Location in slow flash
        INLINE  # Service is inlined
      enumeration mfxRbMemLocSubu8u8s8: origin=RB:2.0.0:2011-06-30, set at pre-compile  # Mfx_Sub_u8u8_s8 | Select one of following values: NORMAL for location in normal flash, FAST for location in fast flash, SLOW for location in slow flash, INLINE for inlining of the service
        NORMAL  # Location in normal flash
        FAST  # Location in fast flash
        SLOW  # Location in slow flash
        INLINE  # Service is inlined
      enumeration mfxRbMemLocSubu8u8u8: origin=RB:2.0.0:2011-06-30, set at pre-compile  # Mfx_Sub_u8u8_u8 | Select one of following values: NORMAL for location in normal flash, FAST for location in fast flash, SLOW for location in slow flash, INLINE for inlining of the service
        NORMAL  # Location in normal flash
        FAST  # Location in fast flash
        SLOW  # Location in slow flash
        INLINE  # Service is inlined
