AUTOSAR XML (schema 00051)
package /PortInterfaces
  sender receiver interface My_SR_Interface
    data DE_MyDataElement: type=MyApplicationDataType
