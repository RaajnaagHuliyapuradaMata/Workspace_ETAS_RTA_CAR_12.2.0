AUTOSAR XML (schema 00051)
package /ApplicationECU_FlatView
  flat map ApplicationECU_FlatMap
    flat instance descriptor CPT_MySWC_ApplicationECU: upstream-reference=RootSwCompositionPrototype_0.CPT_MySWC_ApplicationECU, ecu-extract-reference=CPT_ApplicationECU_FlatView.CPT_MySWC_ApplicationECU
    flat instance descriptor DE_MyDataElement: sw-refresh-timing={cse-code=5, cse-code-factor=1}, upstream-reference=RootSwCompositionPrototype_0.CPT_MySWC_ApplicationECU.PPortPrototype_0.DE_MyDataElement, ecu-extract-reference=CPT_ApplicationECU_FlatView.CPT_MySWC_ApplicationECU.PPortPrototype_0.DE_MyDataElement
    flat instance descriptor DE_MyDataElement_0: sw-refresh-timing={cse-code=5, cse-code-factor=1}, upstream-reference=RootSwCompositionPrototype_0.CPT_MySWC_ApplicationECU.RPortPrototype_0.DE_MyDataElement, ecu-extract-reference=CPT_ApplicationECU_FlatView.CPT_MySWC_ApplicationECU.RPortPrototype_0.DE_MyDataElement
