AUTOSAR XML (schema 00048)
package /RB/RBA/Common/CentralElements/SwAddrMethods
  20 x sw addr method:
    HSM_SHARED_VAR: memory-allocation-keyword-policy=ADDR-METHOD-SHORT-NAME-AND-ALIGNMENT, section-initialization-policy=INIT, section-type=VAR  # Addressing method for exchange of Data with the Hardware Security Module. Restricted to Security
    VAR_RAM_ALL_CLEARED: memory-allocation-keyword-policy=ADDR-METHOD-SHORT-NAME-AND-ALIGNMENT, section-initialization-policy=CLEARED, section-type=VAR  # Addressing method for core local RAM specific buffers linked to the same address but mirrored from different RAM areas.
    VAR_RAM_ALL_INIT: memory-allocation-keyword-policy=ADDR-METHOD-SHORT-NAME-AND-ALIGNMENT, section-initialization-policy=INIT, section-type=VAR  # Addressing method for core local RAM specific buffers linked to the same address but mirrored from different RAM areas.
    VAR_NON_CACHED_RAM: memory-allocation-keyword-policy=ADDR-METHOD-SHORT-NAME-AND-ALIGNMENT, section-initialization-policy=INIT, section-type=VAR  # Addressing method for core local RAM buffers.
    VAR_NON_CACHED_SHARED_RAM: memory-allocation-keyword-policy=ADDR-METHOD-SHORT-NAME-AND-ALIGNMENT, section-initialization-policy=INIT, section-type=VAR  # Addressing method for RAM buffers shared between cores.
    VAR_EARLY_RAM_CLEARED: memory-allocation-keyword-policy=ADDR-METHOD-SHORT-NAME-AND-ALIGNMENT, section-initialization-policy=CLEARED, section-type=VAR  # Addressing method for RAM buffers required to be cleared before initialization code.
    VAR_EARLY_RAM_INIT: memory-allocation-keyword-policy=ADDR-METHOD-SHORT-NAME-AND-ALIGNMENT, section-initialization-policy=INIT, section-type=VAR  # Addressing method for RAM buffers required to initialized before initialization code.
    VAR_TRAPRST_CLEARED: memory-allocation-keyword-policy=ADDR-METHOD-SHORT-NAME-AND-ALIGNMENT, section-initialization-policy=CLEARED, section-type=VAR  # Addressing method for RAM buffers required to be cleared after system trap.
    VAR_TRAPRST_INIT: memory-allocation-keyword-policy=ADDR-METHOD-SHORT-NAME-AND-ALIGNMENT, section-initialization-policy=INIT, section-type=VAR  # Addressing method for RAM buffers required to be initialized after system trap.
    CONST_LABEL_ONLY: memory-allocation-keyword-policy=ADDR-METHOD-SHORT-NAME, section-type=CONST  # Addressing method for global or static constants for linker labels.
    CONST_FAST: memory-allocation-keyword-policy=ADDR-METHOD-SHORT-NAME-AND-ALIGNMENT, section-type=CONST  # Addressing method for global or static constants. This addressing method is an extension to AUTOSAR.
    VAR_SECURED_CLEARED: memory-allocation-keyword-policy=ADDR-METHOD-SHORT-NAME-AND-ALIGNMENT, section-initialization-policy=CLEARED, section-type=VAR  # To be used for Memory Sections that are read-protected against external access.Within these section, temporary copies of the user-data are stored before the data is transferred to the Nv-Media.So this is a security measure.
    VAR_SECURED_CACHED_RAM_ALIGNED_CLEARED: memory-allocation-keyword-policy=ADDR-METHOD-SHORT-NAME-AND-ALIGNMENT, section-initialization-policy=CLEARED, section-type=VAR  # This section in addition is aligned to a cache-line in the memory (in some controllers like ZynqUs) needed to perform DMA operations from external flash to the RAM location. If other data is stored in the same cache-line, then this will be corrupted due to the DMA data transfer which is bypassing the cache-mechanism.Cache-Line is typically 64 bytes (but could also be 128byte/256 byte).
    CODE_RAM: memory-allocation-keyword-policy=ADDR-METHOD-SHORT-NAME, section-type=CODE  # Addressing method for code that need to be located in RAM for functional reason.
    CODE_RAM_ALL: memory-allocation-keyword-policy=ADDR-METHOD-SHORT-NAME, section-type=CODE  # Addressing method for optimization of RAM code.
    VAR_GLOBAL_INIT: memory-allocation-keyword-policy=ADDR-METHOD-SHORT-NAME-AND-ALIGNMENT, section-initialization-policy=INIT, section-type=VAR  # Addressing method for global variables that are initialized with values after every reset and need to be written from all cores.
    VAR_GLOBAL_CLEARED: memory-allocation-keyword-policy=ADDR-METHOD-SHORT-NAME-AND-ALIGNMENT, section-initialization-policy=CLEARED, section-type=VAR  # Addressing method for global variables that are cleared with to zero after every reset and need to be written from all cores.
    VAR_CLEARED_ATOMIC: memory-allocation-keyword-policy=ADDR-METHOD-SHORT-NAME-AND-ALIGNMENT, section-initialization-policy=CLEARED, section-type=VAR  # Addressing method for Memory Sections that are used for variables requiring atomic operation. It should only be used in combination with BswSrv or other service routines like e.g. BCL.
    VAR_CLEARED_LOCK_SEMA: memory-allocation-keyword-policy=ADDR-METHOD-SHORT-NAME-AND-ALIGNMENT, section-initialization-policy=CLEARED, section-type=VAR  # Addressing method for Memory Sections that are used for variables related for semaphores and/or locks where read–modify–write operation is required.
    VAR_LABEL_ONLY: memory-allocation-keyword-policy=ADDR-METHOD-SHORT-NAME, section-type=VAR  # Addressing method for global or static variables for linker labels.
