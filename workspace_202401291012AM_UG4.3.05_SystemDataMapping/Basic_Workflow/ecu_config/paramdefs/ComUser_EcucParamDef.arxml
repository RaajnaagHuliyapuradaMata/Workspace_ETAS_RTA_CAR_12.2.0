AUTOSAR XML (schema 00051)
package /AUTOSAR/EcucDestinationUriDefSets
  ecuc destination uri def set ComUserUriDefSet
    ecuc destination uri def ComUser
      destination-uri-policy destination-uri-nesting-contract=VERTEX-OF-TARGET-CONTAINER:
        container ComUserModuleCnf [0..1]: destination-uri=ComUser, multiplicity set at pre-compile  # Contains the configuration parameters of the Com user module.
          string ComUserHeaderInclude [0..1]: multiplicity set at pre-compile, set at pre-compile  # Defines the header file where the Com user provides the function declarations for configured callbacks.
          container ComUserCallback [0..*]: multiplicity set at link in variant link-time+post-build / pre-compile in variant pre-compile, post-build-variant-multiplicity=true  # This container defines a Com callback function for signals and signal groups.
            function name ComUserCallbackName: scope=ECU, set at link in variant link-time+post-build / pre-compile in variant pre-compile  # The name of the callback function to be called.
            enumeration ComUserCallbackType: {COM_RX_ACK, COM_RX_INV, COM_RX_TOUT, COM_TX_ACK, COM_TX_ERR, COM_TX_TOUT}, scope=ECU, set at link in variant link-time+post-build / pre-compile in variant pre-compile  # The type of the Com callback
          container ComUserSignal [0..*]: multiplicity set at link in variant link-time / post-build in variant post-build / pre-compile in variant pre-compile, post-build-variant-multiplicity=true  # Contains the configuration parameters of a signal inside a Com user module. | Please note that it is valid to define ComUserSignal without any callback function.
            integer ComUserCbkHandleId [0..1]: 0..65535, scope=ECU, multiplicity set at pre-compile, set at pre-compile, symbolic-name-value=true  # The numerical value used as the Com user callback handle Id. | This ID identifies signals and signal groups in the COM callbacks using ComUserCbkHandleId parameter respectively.
            reference ComUserCallbackRef [0..*]: scope=ECU, multiplicity set at link in variant link-time / post-build in variant post-build / pre-compile in variant pre-compile, post-build-variant-multiplicity=true, post-build-variant-value=true, set at link in variant link-time+post-build / pre-compile in variant pre-compile, destination=ComUserCallback  # Reference(s) to all callback(s) of this signal or signal group.
            foreign reference ComUserSystemTemplateSystemSignalRef [0..1]: scope=ECU, multiplicity set at link in variant link-time / post-build in variant post-build / pre-compile in variant pre-compile, post-build-variant-multiplicity=true, post-build-variant-value=true, set at link in variant link-time / post-build in variant post-build / pre-compile in variant pre-compile, destination-type=I-SIGNAL-TO-I-PDU-MAPPING  # Reference to the ISignalToIPduMapping that contains a reference to the ISignal (System Template) which this ComUserSignal (or ComUserGroupSignal) represents.
          container ComUserSignalGroup [0..*]: multiplicity set at link in variant link-time / post-build in variant post-build / pre-compile in variant pre-compile, post-build-variant-multiplicity=true  # Contains the configuration parameters of a signal group inside a Com user module. | Please note that it is valid to define ComUserSignalGroup without any callback function.
            integer ComUserCbkHandleId [0..1]: 0..65535, scope=ECU, multiplicity set at pre-compile, set at pre-compile, symbolic-name-value=true  # The numerical value used as the Com user callback handle Id. | This ID identifies signals and signal groups in the COM callbacks using ComUserCbkHandleId parameter respectively.
            reference ComUserCallbackRef [0..*]: scope=ECU, multiplicity set at link in variant link-time / post-build in variant post-build / pre-compile in variant pre-compile, post-build-variant-multiplicity=true, post-build-variant-value=true, set at link in variant link-time+post-build / pre-compile in variant pre-compile, destination=ComUserCallback  # Reference(s) to all callback(s) of this signal or signal group.
            foreign reference ComUserSystemTemplateSignalGroupRef [0..1]: scope=ECU, multiplicity set at link in variant link-time / post-build in variant post-build / pre-compile in variant pre-compile, post-build-variant-multiplicity=true, post-build-variant-value=true, set at link in variant link-time / post-build in variant post-build / pre-compile in variant pre-compile, destination-type=I-SIGNAL-TO-I-PDU-MAPPING  # Reference to the ISignalToIPduMapping that contains a reference to the ISignalGroup (SystemTemplate) which this ComUserSignalGroup represents.
