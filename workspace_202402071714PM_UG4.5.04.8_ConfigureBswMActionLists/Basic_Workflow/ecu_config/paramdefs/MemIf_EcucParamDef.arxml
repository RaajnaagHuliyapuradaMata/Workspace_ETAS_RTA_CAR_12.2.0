AUTOSAR XML (schema 4-2-2)
package /AUTOSAR_MemIf/EcucModuleDefs
  module definition MemIf [0..1]: category=VENDOR_SPECIFIC_MODULE_DEFINITION, refined-module-def=MemIf, variants pre-compile  # Memory: Abstraction Interface | Configuration of the MemIf component
    container MemIfGeneral  # Configuration of the memory abstraction interface (Memif) module
      boolean MemIfDevErrorDetect [0..1]: multiplicity set at pre-compile, origin=RB:0.1.0:2011-11-15, set at pre-compile  # Switch for DevErrorDetect
      float MemIfMainFunctionCycleTime [0..1]: 0..1, multiplicity set at pre-compile, origin=RB:10.1.0:2017-08-22, set at pre-compile  # Defines the cycle time in seconds of the periodic calling of MemIf main function. Parameter is just meaningful if the parameter MemIfRbMainFunctionScheduling which defines the type of scheduling is set to MEMIF_RB_MAINFUNC_SCHEDULING_RTE_TIMED.
      integer MemIfNumberOfDevices [0..1]: origin=RB:0.1.0:2011-11-23, set at pre-compile  # Number of devices for MemIf
      boolean MemIfRbDisableForwardingScheduleInfo [0..1]: multiplicity set at pre-compile, origin=RB:18.1.0:2021-09-30, set at pre-compile  # MemIf Disable forwarding of scheduling Info | Defines if the scheduling info shall be prepared from NvM or not. If configured as false or unconfgured, the information from NvM is used to prepare MemIf scheduling info. If configured as true, MemIf will not read info from NvM, user has to manually configure scheduling info for MemIf, Fee/Ea and Fls/Eep.
      boolean MemIfRbFeeUsed [0..1]: multiplicity set at pre-compile, origin=RB:0.1.0:2011-11-21, set at pre-compile  # Status if Fee is configured
      enumeration MemIfRbMainFunctionScheduling [0..1]: multiplicity set at pre-compile, origin=RB:14.1.0:2019-10-31, set at pre-compile, default-value=MEMIF_RB_MAINFUNC_SCHEDULING_RTE_TIMED  # Scheduling of MemIf_Rb_MainFunction | Defines if MemIf_Rb_MainFunction() is beeing called in the background-task via RTE, in a scheduled task via RTE or if it is not called via RTE and therefore has to be scheduled manually. In case it is scheduled manually no RTE events or entities are generated. For the case that the parameter is set to MEMIF_RB_MAINFUNC_SCHEDULING_RTE_TIMED the corresponding period/cycle time of the timed task is defined via the parameter MemIfMainFunctionCycleTime.
        MEMIF_RB_MAINFUNC_SCHEDULING_RTE_BACKGROUND  # RTE background task
        MEMIF_RB_MAINFUNC_SCHEDULING_RTE_TIMED  # RTE timed task
        MEMIF_RB_MAINFUNC_SCHEDULING_MANUAL  # Manual scheduling
      integer MemIfRbNumberOfEADevices [0..1]: multiplicity set at pre-compile, origin=RB:0.1.0:2011-11-21, set at pre-compile  # Number of configured EA/Eep Devices
      boolean MemIfVersionInfoApi [0..1]: multiplicity set at pre-compile, origin=RB:0.1.0:2011-11-21, set at pre-compile  # Switch for VersionInfoApi
