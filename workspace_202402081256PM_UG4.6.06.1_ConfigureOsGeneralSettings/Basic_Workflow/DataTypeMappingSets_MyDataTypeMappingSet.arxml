AUTOSAR XML (schema 00051)
package /DataTypeMappingSets
  data type mapping set MyDataTypeMappingSet: data-type-map{application-data-type=MyApplicationDataType, implementation-data-type=uint8}
