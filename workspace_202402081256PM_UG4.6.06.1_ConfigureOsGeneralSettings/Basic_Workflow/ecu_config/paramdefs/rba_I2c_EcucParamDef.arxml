AUTOSAR XML (schema 00048)
package /RB/RBA/rba_I2c/EcucModuleDefs
  module definition rba_I2c [0..1]: category=VENDOR_SPECIFIC_MODULE_DEFINITION, post-build-variant-support=true, variants pre-compile  # MCAL Inter-Integrated Circuit | Configuration of the I2C (Inter-Integrated Circuit) module.
    container rba_I2c_ConfigSet  # Configuration data set | Configuration of one instance (if multiplicity is 1, it is the sole configuration) of an I2C driver. Defines one data set of post-build configuration. Which of these data sets is actually active is controlled by EcuM. Data sets can only be switched at initialization time.
      container rba_I2c_ExternalDevice [1..*]: multiplicity set at pre-compile, post-build-variant-multiplicity=true  # External device | Configuration of the communication settings of an external device.
        integer rba_I2c_Address: 0..127, origin=RB, post-build-variant-value=true, set at pre-compile  # Address | Address of the external device. Only 7-bit addressing is supported.
        function name rba_I2c_DevVirtFunc [0..1]: multiplicity set at pre-compile, origin=RB, post-build-variant-multiplicity=true, post-build-variant-value=true, set at pre-compile  # Virtualization function | Virtualization function.
        container rba_I2c_Sequence [1..*]: multiplicity set at pre-compile, post-build-variant-multiplicity=true  # Sequence | Configuration of an I2C sequence. The sequence name is specified by the containers short name. The generated I2C sequence symbolic name is composed like this: rba_I2cConf_rba_I2cSequence_<short name of the rba_I2c_Sequence container>
          function name rba_I2c_SeqEndNotification [0..1]: multiplicity set at pre-compile, origin=RB, post-build-variant-multiplicity=true, post-build-variant-value=true, set at pre-compile  # End notification function | This parameter is a reference to a notification function.
          string rba_I2c_SeqEndNotificationHeaderName [0..1]: multiplicity set at pre-compile, origin=RB, post-build-variant-multiplicity=true, post-build-variant-value=true, set at pre-compile  # Header file name | Reference to a header file, in which the prototype of the configured sequencce end notification function is located.
          integer rba_I2c_SeqPrio: 0..3, origin=RB, post-build-variant-value=true, set at pre-compile  # Priority | Priority of the sequence: 0 := lowest to 3 := highest priority. The lowest priority shall be used for most cases.
      container rba_I2c_HwUnitCfg [1..*]: multiplicity set at pre-compile, post-build-variant-multiplicity=true  # HW unit configuration | This container is used to configure an I2C HW unit. The short name of the container rba_I2c_HwUnitCfg is the name of the I2C HW unit. The name shall be compiled of the generic part I2C and the actual HW unit number. E.g. I2C1.
        integer rba_I2c_Baudrate: ..5000, origin=RB, post-build-variant-value=true, set at pre-compile  # Baudrate | Communication baud rate for all external devices connected to the HW unit, specified in kBaud. The register configuration for 100kBaud and 400kBaut is predefined. For other baud rates a manual configuration of the registers must be done within rba_I2c_Cfg_SchM.h.
        string rba_I2c_ExtDev [1..*]: multiplicity set at pre-compile, origin=RB, post-build-variant-multiplicity=true, post-build-variant-value=true, set at pre-compile  # External device | External device connected to the HW unit.
        enumeration rba_I2c_HwUnitMode [0..1]: origin=RB, post-build-variant-value=true, set at pre-compile, default-value=MASTER  # HW unit operation mode | Operation mode of the HW unit - Master or Slave.
          MASTER  # Master
          SLAVE  # Slave
        enumeration rba_I2c_InpSeln [0..1]: multiplicity set at pre-compile, origin=RB, post-build-variant-multiplicity=true, post-build-variant-value=true, set at pre-compile  # Input selection | I2C input selection. This tag defines the used input signal for IFX devices. For more information on how to configure this tag please have a look at the integration manual of I2C. For other devices than IFX this tag is not used.
          INP_A  # Input A
          INP_B  # Input B
          INP_C  # Input C
          INP_D  # Input D
          INP_E  # Input E
          INP_F  # Input F
          INP_G  # Input G
          INP_H  # Input H
    container rba_I2c_General  # General settings | General configuration settings for the I2C handler/driver.
      boolean rba_I2c_DevErrorDetect: origin=RB, set at pre-compile  # Development error detection | Enables/disables the detection and notification of development errors. If this parameter is enabled, then extended error checking is performed during runtime. Any errors detected by these checks are reported to the Det module.
