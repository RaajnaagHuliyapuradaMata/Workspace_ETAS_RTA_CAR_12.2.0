AUTOSAR XML (schema 4-2-2)
package /AUTOSAR_Ifl/EcucModuleDefs
  module definition Ifl [0..1]: category=VENDOR_SPECIFIC_MODULE_DEFINITION, refined-module-def=Ifl, variants pre-compile  # Floating Point Interpolation Library
    container IflGeneral  # General settings for Ifl | General settings for Ifl with selections for used controller and activation of GetVersionInfo interface
      enumeration IflRbMemCopy [0..1]: multiplicity set at pre-compile, origin=RB:10.0.0:2015-07-09, set at pre-compile, default-value=Ifl_MemCopy  # Select whether to use 64-bit memory copy function from rba_BswSrv or Ifl | If IflRbMemCopy is chosen as "BswSrv_MemCopy", then the memory copy function from rba_BswSrv.h will be used which will support for compilers other than Hightec.If IflRbbswsrv is chosen as "Ifl_MemCopy", then the memory copy function from Ifl will be used which will support Hightec compiler only
        Ifl_MemCopy  # Use memcopy function from Ifl for Atomic Read/Write
        BswSrv_MemCopy  # Use memcopy function from rba_bswsrv for Atomic Read/Write
      enumeration IflRbOptimization [0..1]: multiplicity set at pre-compile, origin=RB:1.0.0:2010-12-15, set at pre-compile  # Select for which controller optimized implementations shall be used
        TC17xx  # Tricore TC17xx controller
        TC27xx  # Tricore TC27xx controller
        MPC57xx  # JDP MPC57xx controller
        MPCCut2  # JDP MPC Cut2 controller
        NO_OPTIMIZATION  # No optimization, standard C implementations shall be used
      boolean IflRbOptimizationMcuExtract [0..1]: multiplicity set at pre-compile, origin=RB:10.0.0:2015-06-18, set at pre-compile, default-value=false  # Select whether to fetch machine type from MCU and configure for controller optimized implementation | If IflRbOptimizationMcuExtract is chosen as "True", then the controller information will be extracted from MCU.Based on this, optimized implementations will be selected.Hence the user should not configure "IflRbOptimization".If IflRbOptimizationMcuExtract is chosen as "False", the controller information will not be extracted from MCU and so the user needs to configure "IflRbOptimization" manually.
      enumeration Ifl_ASAM_VersionUsed: origin=RB:4.0.0:2023-01-01, set at pre-compile, default-value=IFL_ASAM_VERSION_1_7  # Configuration parameter for selection of ASAM version used. | If Ifl_ASAM_VersionUsed is set to "IFL_ASAM_VERSION_1_6", Address Recalculation function call for Interpolation Maps/Curves services shall support downscaling/resizing for ASAM 1.6 in the Ifl library. If Ifl_ASAM_VersionUsed is set to "IFL_ASAM_VERSION_1_7", Normal function call for Interpolation Maps/Curves services shall support for ASAM 1.7 in the Ifl library
        IFL_ASAM_VERSION_1_6  # ASAM version 1.6 used.
        IFL_ASAM_VERSION_1_7  # ASAM version 1.7 used.
      enumeration Ifl_VersionInfoAPI: origin=RB:1.0.0:2010-12-15, set at pre-compile  # Configuration parameter for activation of Ifl_GetVersionInfo function. | If IflVersionInfoAPI is set to "ON", the function IflGetVersionInfo shall return the version information of the Ifl library. If IflVersionInfoAPI is set to "OFF", the Ifl library shall not provide the function Ifl_GetVersionInfo
        ON  # Activate IflGetVersionInfo function.
        OFF  # Deactivate IflGetVersionInfo function.
    container IflRbMemoryLocations  # Memory locations | Choose memory location settings for each single service
      enumeration iflRbMemLocDPSearchf32: origin=RB:1.0.0:2010-12-17, set at pre-compile  # Ifl_DPSearch_f32 | Select one of following values: NORMAL for location in normal flash, FAST for location in fast flash, SLOW for location in slow flash
        NORMAL  # Location in normal flash
        FAST  # Location in fast flash
        SLOW  # Location in slow flash
      enumeration iflRbMemLocIntIpoCurf32f32: origin=RB:1.0.0:2010-12-17, set at pre-compile  # Ifl_IntIpoCur_f32_f32 | Select one of following values: NORMAL for location in normal flash, FAST for location in fast flash, SLOW for location in slow flash
        NORMAL  # Location in normal flash
        FAST  # Location in fast flash
        SLOW  # Location in slow flash
      enumeration iflRbMemLocIntIpoMapf32f32f32: origin=RB:1.0.0:2010-12-17, set at pre-compile  # Ifl_IntIpoMap_f32f32_f32 | Select one of following values: NORMAL for location in normal flash, FAST for location in fast flash, SLOW for location in slow flash
        NORMAL  # Location in normal flash
        FAST  # Location in fast flash
        SLOW  # Location in slow flash
      enumeration iflRbMemLocInterpolatef32: origin=RB:2.0.0:2011-06-30, set at pre-compile  # Ifl_Interpolate_f32 | Select one of following values: NORMAL for location in normal flash, FAST for location in fast flash, SLOW for location in slow flash, INLINE for inlining of the service
        NORMAL  # Location in normal flash
        FAST  # Location in fast flash
        SLOW  # Location in slow flash
        INLINE  # Service is inlined
      enumeration iflRbMemLocIpoCurf32: origin=RB:1.0.0:2010-12-17, set at pre-compile  # Ifl_IpoCur_f32 | Select one of following values: NORMAL for location in normal flash, FAST for location in fast flash, SLOW for location in slow flash
        NORMAL  # Location in normal flash
        FAST  # Location in fast flash
        SLOW  # Location in slow flash
      enumeration iflRbMemLocIpoMapf32: origin=RB:1.0.0:2010-12-17, set at pre-compile  # Ifl_IpoMap_f32 | Select one of following values: NORMAL for location in normal flash, FAST for location in fast flash, SLOW for location in slow flash
        NORMAL  # Location in normal flash
        FAST  # Location in fast flash
        SLOW  # Location in slow flash
