AUTOSAR XML (schema 00048)
package /AUTOSAR_NvM/EcucModuleDefs
  module definition NvM: category=VENDOR_SPECIFIC_MODULE_DEFINITION, refined-module-def=NvM, variants pre-compile  # Memory: NVRAM Manager | [ECUC_NVM_00539] Configuration of the NvM (Non volatile RAM Manager) module.
    container NvMBlockCiphering [0..65535]: multiplicity set at pre-compile  # Block ciphering | [ECUC_NvM_00568] Container for a ciphering of the block.
      integer NvMNvBlockNVRAMDataLength [0..1]: 1..65535, multiplicity set at pre-compile, set at pre-compile  # Ciphered data length | [ECUC_NvM_00569] This value specified the block length in case ciphered data is stored in NV RAM - in that case the plain data length may not match the ciphered data length. This value needs be filled out, if the ciphering, encryption and decryption, of the data is enabled for this block. It will be used instead of the NvMNvBlockLength to access the NV RAM. Hint: This value can be equal or bigger than 'NvMNvBlockLength' depending on the characteristics of the referenced CSM Job inside 'NvMNameOfEncryptionJob' (e.g. CSM job adds padding information).
      boolean NvMRbAddAuthentication [0..1]: origin=RB:19.0.0:2022-01-31, default-value=false  # Add block authentication | [BSW_SWCS_AR_NVRAMManager_Ext-3356] Defines whether user data in NVRAM block shall be authenticated in NV memory. The NvM authenticates user data via the Csm job for AEAD encryption. IMPORTANT: If user data authentication is configured then the user has also to define NvMRbTagLength. Parameters NvMRbAssociatedDataLength and NvMRbAssociatedDataPtr shall be defined only if individual associated data is required.
      boolean NvMRbAddEncryption [0..1]: multiplicity set at pre-compile, origin=RB:15.0.0:2020-01-31, set at pre-compile, default-value=false  # Add block encryption | [BSW_SWCS_AR_NVRAMManager_Ext-3249] Defines whether user data in NVRAM block shall be encrypted in NV memory.
      boolean NvMRbAddMac [0..1]: multiplicity set at pre-compile, origin=RB:19.1.0:2022-03-31, set at pre-compile, default-value=false  # Add message authentication code (MAC) | [BSW_SWCS_AR_NVRAMManager_Ext-3415] Defines whether user data in NVRAM block shall be authenticated by a MAC (message authentication code) in NV memory.
      boolean NvMRbAddSignature [0..1]: multiplicity set at pre-compile, origin=RB:15.0.0:2020-01-31, set at pre-compile, default-value=false  # Add signature | [BSW_SWCS_AR_NVRAMManager_Ext-3251] Defines whether user data in NVRAM block shall be signed in NV memory.
      integer NvMRbAssociatedDataLength [0..1]: 0..65535, multiplicity set at pre-compile, origin=RB:15.0.0:2020-01-31, set at pre-compile  # Associated data length | [BSW_SWCS_AR_NVRAMManager_Ext-3267] Defines the length of associated data in bytes used for AEAD encryption. If this parameter is defined then NvM will use Csm job for AEAD encryption.
      string NvMRbAssociatedDataPtr [0..1]: multiplicity set at pre-compile, origin=RB:19.0.0:2022-01-31, set at pre-compile  # Pointer to the associated data | [BSW_SWCS_AR_NVRAMManager_Ext-3268] Defines the pointer to the associated data used for AEAD encryption. You may either give an address in hexadecimal notation here (e.g. 0x1234ABCD) or the name of a linker symbol (e.g. MyAssociatedData) or the address (e.g. &MyAssociatedData). It is also possible to specify no associated data by entering NULL_PTR. If this parameter is defined then NvM will use an AEAD encryption Csm job.
      integer NvMRbInitVectorLength [0..1]: 0..65535, multiplicity set at pre-compile, origin=RB:19.0.0:2022-01-31, set at pre-compile  # Initialization vector length | [BSW_SWCS_AR_NVRAMManager_Ext-3357] Defines the length of the initialization vector in bytes used for user data encryption / authentication.
      integer NvMRbMacLength [0..1]: 0..65535, multiplicity set at pre-compile, origin=RB:19.1.0:2022-03-31, set at pre-compile  # Message authentication code (MAC) length | [BSW_SWCS_AR_NVRAMManager_Ext-3416] Defines the length of the message authentication code (MAC) in bytes used for user data authentication.
      boolean NvMRbSetInitVector [0..1]: multiplicity set at pre-compile, origin=RB:19.0.0:2022-01-31, set at pre-compile, default-value=false  # Set random number as key element InitVector | [BSW_SWCS_AR_NVRAMManager_Ext-3358] Defines whether a random number shall be used as key element InitVector for user data encryption / authentication.
      integer NvMRbSignatureLength [0..1]: 0..65535, multiplicity set at pre-compile, origin=RB:15.0.0:2020-01-31, set at pre-compile  # Signature length | [BSW_SWCS_AR_NVRAMManager_Ext-3254] Defines the length of signature in bytes used to sign user data in NV memory.
      integer NvMRbTagLength [0..1]: 0..65535, multiplicity set at pre-compile, origin=RB:15.0.0:2020-01-31, set at pre-compile  # Tag length | [BSW_SWCS_AR_NVRAMManager_Ext-3269] Defines the length of the tag in bytes used for AEAD encryption. If this parameter is defined then NvM will use Csm job for AEAD encryption.
      boolean NvMRbUseIndividualAssociatedData [0..1]: multiplicity set at pre-compile, origin=RB:19.0.0:2022-01-31, set at pre-compile, default-value=false  # Use individual associated data | [BSW_SWCS_AR_NVRAMManager_Ext-3359] Defines whether individual associated data shall be used to authenticate user data. - true = for user data authetication NvM uses associated data provided via parameters NvMRbAssociatedDataPtr and NvMRbAssociatedDataLength - false = for user data authetication NvM uses the block persistent ID defined in parameter NvMRbBlockPersistentId
      symbolic name reference NvMCsmDecryptionJobReference [0..1]: multiplicity set at pre-compile, set at pre-compile, destination=CsmJob  # Csm job for decryption | [ECUC_NvM_00571] This parameter references a CSM decrypt job used to decrypt ciphered data after reading it from NV RAM. If the Csm job reference uses AEAD algorithm then NvMRbTagLength shall be defined. Parameters NvMRbAssociatedDataLength and NvMRbAssociatedDataPtr shall be defined only if individual associated data is required.
      symbolic name reference NvMCsmEncryptionJobReference [0..1]: multiplicity set at pre-compile, set at pre-compile, destination=CsmJob  # Csm job for encryption | [ECUC_NvM_00570] This parameter references a CSM encrypt job used to encrypt plain data before writing it to the NV RAM. If the Csm job reference uses AEAD algorithm then NvMRbTagLength shall be defined. Parameters NvMRbAssociatedDataLength and NvMRbAssociatedDataPtr shall be defined only if individual associated data is required.
      symbolic name reference NvMRbCsmJobSignatureGenerateRef [0..1]: multiplicity set at pre-compile, origin=RB:15.0.0:2020-01-31, set at pre-compile, destination=CsmJob  # Csm job to generate a signature | [BSW_SWCS_AR_NVRAMManager_Ext-3258] Reference to the Csm job to generate a signature for user data in NV memory.
      symbolic name reference NvMRbCsmJobSignatureVerifyRef [0..1]: multiplicity set at pre-compile, origin=RB:15.0.0:2020-01-31, set at pre-compile, destination=CsmJob  # Csm job to verify a signature | [BSW_SWCS_AR_NVRAMManager_Ext-3259] Reference to the Csm job to verify a signature from NV memory.
      symbolic name reference NvMRbCsmMacGenerateJobReference [0..1]: multiplicity set at pre-compile, origin=RB:19.1.0:2022-03-31, set at pre-compile, destination=CsmJob  # Csm job to generate a message authentication code (MAC) | [BSW_SWCS_AR_NVRAMManager_Ext-3417] Reference to the Csm job to generate a message authentication code (MAC) for user data in NV memory.
      symbolic name reference NvMRbCsmMacVerifyJobReference [0..1]: multiplicity set at pre-compile, origin=RB:19.1.0:2022-03-31, set at pre-compile, destination=CsmJob  # Csm job to verify a message authentication code (MAC) | [BSW_SWCS_AR_NVRAMManager_Ext-3418] Reference to the Csm job to verify a message authentication code (MAC) from NV memory.
    container NvMBlockDescriptor [2..65535]: multiplicity set at pre-compile  # Block descriptor | [ECUC_NVM_00061] Container for all block-specific configuration parameters. For each NvM block, one instance of this container shall be specified.
      enumeration NvMBlockCrcType [0..1]: multiplicity set at pre-compile, set at pre-compile, default-value=NVM_CRC16  # CRC type | [ECUC_NVM_00476] Defines the CRC data width for the NVRAM block. Due to Autosar this parameter shall define the CRC data width for data in NV memory and for data in permanent RAM block. Currently this parameter defines the CRC data width only for data in permanent RAM block (see parameter NvMCalcRamBlockCrc). For data in NV memory the CRC will be always calculated by lower layers independently from this parameter.
        NVM_CRC8  # 8 bit CRC
        NVM_CRC16  # 16 bit CRC
        NVM_CRC32  # 32 bit CRC
      string NvMBlockHeaderInclude [0..1]: multiplicity set at pre-compile, set at pre-compile  # Header file to include | [BSW_SWCS_AR_NVRAMManager_Ext-2997] Defines a header file that shall be included. Only the header file name without the extension has to be entered here. For example Bsw_MemMap instead of Bsw_MemMap.h. If a header file is defined the declarations of the RAM data block (NvMRamBlockDataAddress) and the ROM data block (NvMRomBlockDataAddress) have to be done within this header-file by the user. If a header-file is defined for a specific NvM block a compile time check is carried out to check if the configured NvM block (NvMNvBlockLength) length matches the size of the data given in in the RAM data block (NvMRamBlockDataAddress) and the ROM data block (NvMRomBlockDataAddress). This check is done using the sizeof-operator and causes a compile time error in case of a mismatch. Note that the compile time check just can be carried out if for the NvM block the following two conditions are fulfilled: 1. Runtime RAM block handling is not used by this block (NvMRbRamBlockDataAddressString and NvMRbNvBlockLengthString are empty) 2. The values entered in the RAM data block (NvMRamBlockDataAddress) and the ROM data block (NvMRomBlockDataAddress) are names of a linker symbol, pointers or subelements of data structures declared in the header (e.g. MyVar, MyStruct.MyMember, MyArray[3], &MyVar, ...) but are not addresses in hexadecimal notation (e.g. 0x8000A000).
      integer NvMBlockJobPriority: 0..1, set at pre-compile  # Job priority | [ECUC_NVM_00477] Defines the job priority for a NVRAM block. The current version of NvM supports two job priorities: 0 : Immediate priority, 1 : Standard priority. Immediate priority can be enabled only if priority jobs handling is enabled via the NvMJobPrioritization configuration paramter. Immediate priority blocks shall participate neither in multi-block-read (see also NvMSelectBlockForReadAll) nor in multi-block-write (see also NvMSelectBlockForWriteAll) operations. If an immediate block is selected for ReadAll or WriteAll, then it is not possible to queue an immediate write request for this block while the multiblock operation is being executed (as the state of this block would be PENDING (NVM385)).
      enumeration NvMBlockManagementType: set at pre-compile  # Block management type | [ECUC_NVM_00062] Defines the block management type for the NVRAM block. An NvM block can be a native, a redundant or a dataset block.
        NVM_BLOCK_NATIVE  # Native
        NVM_BLOCK_REDUNDANT  # Redundant
        NVM_BLOCK_DATASET  # Dataset
      boolean NvMBlockUseAutoValidation [0..1]: multiplicity set at pre-compile, set at pre-compile, default-value=false  # Set block to changed during ValidateAll | [ECUC_NvM_00557] Defines whether a NVRAM block shall be processed during NvM_ValidateAll or not. This configuration parameter is only allowed to be set for NVRAM blocks which are configured to have a permanent RAM block or which are configured to use explicit synchronization mechanism.
      boolean NvMBlockUseCRCCompMechanism [0..1]: multiplicity set at pre-compile, set at pre-compile, default-value=false  # CRC compare mechanism | [ECUC_NvM_00556] Defines whether the CRC of the permanent RAM Block shall be compared during a write job with the CRC which was calculated during the last successful read or write job. This parameter can be set to true only if parameter NvMCalcRamBlockCrc is also true.
      boolean NvMBlockUseCompression [0..1]: multiplicity set at pre-compile, set at pre-compile, default-value=false  # Block compression (Block splitting) | [ECUC_NvM_00563] Defines whether the data is compressed before written. RTA-BSW NvM provides currently block split as compression type. The user has also to define the size of block splits if using compression, see also container NvMRbSplitBlock. - true: data compression activated (takes more time to read and write) - false: no compression
      boolean NvMBlockUseCrc: set at pre-compile  # Use CRC | [ECUC_NVM_00036] Enables/disables CRC usage for the NVRAM block in NV memory. If enabled a CRC is calculated before a write operation which is then stored in the NV memory along with the block data. During a read operation this CRC is then checked again to ensure data integrity. Independant of parameter NvMBlockUseCrc the MemStack always uses CRCs to ensure data integrity, but this is done on lower software layers (not NVM level) and it is not possible to deactive it. Due to this reason the parameter NvMBlockUseCrc has to be globally enabled by setting the common parameter NvMRbNvCrcEnable to TRUE if a CRC also should be used at NVM level. Just if both parameters NvMBlockUseCrc and NvMRbNvCrcEnable are set to true the CRC will be used for this block on NVM level. Hint: For the case that the complete MemStack this does not affect any CRC useage on lower layers. Hint: If not the complete MemStack is used then the common parameter NvMRbNvCrcEnable should be set to TRUE to ensure that CRCs are used at NVM level.
      boolean NvMBlockUsePort [0..1]: multiplicity set at pre-compile, set at pre-compile, default-value=false  # Activation of the NvM Port usage | [ECUC_NvM_00559] Defines whether NvMMirror, NvMNotifyInitBlock, NvMNotifyJobFinished, NvMAdmin ports shall be generated for this block. In cases where callbacks have been configured for this block, this configuration parameter also controls the creation of the corresponding R-Ports. For blocks which are accessed via RTE ports this parameter shall be set to true.
      boolean NvMBlockUseSyncMechanism: set at pre-compile, default-value=false  # Explicit synchronization | [ECUC_NVM_00519] Enables/disables the explicit synchronization mechanism with a RAM mirror and callback routines for transferring data to and from NvM module's RAM mirror.
      boolean NvMBlockWriteProt: set at pre-compile  # Initially write protected | [ECUC_NVM_00033] Enables/disables an initial write protection of the NV block.
      boolean NvMCalcRamBlockCrc [0..1]: multiplicity set at pre-compile, set at pre-compile, default-value=false  # CRC (re)calculation | [ECUC_NVM_00119] Enables/disables the CRC (re)calculation for the permanent RAM block or NVRAM blocks which are configured to use explicit synchronization mechanism.
      integer NvMMaxNumOfReadRetries: 0..0, set at pre-compile  # Max. number of read retries | [ECUC_NVM_00533] Defines the maximum number of read retries. The current version of NvM does not support this feature, so this parameter has always to be set to 0.
      integer NvMMaxNumOfWriteRetries: 0..0, set at pre-compile  # Max. number of write retries | [ECUC_NVM_00499] Defines the maximum number of write retries. The current version of NvM does not support this feature, so this parameter has always to be set to 0.
      integer NvMNvBlockBaseNumber [0..0]: 1..65534, set at pre-compile  # Block base number | [ECUC_NVM_00478] According to the NvM specification, this setting shall perform the link to the IDs used in the memory hardware abstraction. Since this NvM implementation uses a different (more efficient) identification scheme towards the memory hardware abstraction, this parameter is and remains superfluous.
      integer NvMNvBlockLength [0..1]: 1..65407, multiplicity set at pre-compile, set at pre-compile  # Block length (fixed number) | [ECUC_NVM_00479] Defines the NV block data length in bytes. (Hint: NvM keeps an internal reserve of 128 bytes, so the maximum block length is 65535-128=65407 bytes.)
      integer NvMNvBlockNum: 1..255, set at pre-compile  # Number of NV blocks | [ECUC_NVM_00480] Defines the number of multiple NV blocks in a contiguous area according to the given block management type. The allowed number of NV blocks is 1 for a native block, 2 for a redundant block and 1..255 for a dataset block. Additionally, the following condition has to be satisfied: NvMNvBlockNum + NvMRomBlockNum <= 255 [NVM444]
      integer NvMNvramBlockIdentifier [0..1]: 2..65534, multiplicity set at pre-compile, set at pre-compile, symbolic-name-value=true  # Block identifier | [ECUC_NVM_00481] Identification of a NVRAM block via a unique block identifier which is used at the NvM API functions (not towards the memory hardware abstraction and also not on the media). The value 0 is reserved for multi block related operations and their results. The value 1 is reserved for the block containing the configuration ID used as part of the dynamic configuration feature. The identifiers of all blocks must be contiguous, i.e. there must not be any gaps in the sequence of block identifiers. All multi block operations operate in an ascending ID sequence, which means that blocks with lower IDs are read and written earlier than blocks with higher IDs. If you don't explicitly specify an identifier for a block, such an identifier is automatically assigned by NvM.
      integer NvMNvramDeviceId: 0..254, set at pre-compile  # Device ID | [ECUC_NVM_00035] Identification of the device where the NVRAM block is located. In contrast to AUTOSAR's NvM specification, this is not a parameter derived from the block configuration on the Ea/Fee module configuration, but the device identifier is directly specified here (and the Ea/Fee block configuration is completely auto-generated). Attention: If the NVRAM block shall be located on a Ea device then user shall use the Ea device ID defined in the container NvMRbEaDevices. If ID used here does not correspond to an ID defined in the container NvMRbEaDevices then the NVRAM block will not be located on a Ea device. Attention: Device ID 0 is fixed to address Fee. If Fee is used then all corresponding blocks shall use device ID 0. If there are more than 1 Fee then first Fee (typically Fee for internal flash) shall use device ID 0 and all other Fees can use other device IDs.
      string NvMRamBlockDataAddress [0..1]: multiplicity set at pre-compile, set at pre-compile, default-value=NULL_PTR  # RAM block data address | [ECUC_NVM_00482] Defines the start address of permanent RAM block data. You may either give an address in hexadecimal notation here (e.g. 0x1234ABCD) or the name of a linker symbol (e.g. MyTestRamBlock) or the address (e.g. &MyTestRamBlock). If you explicitly want to specify that no permanent RAM block shall be used for this block, enter NULL_PTR here. The NvM users shall allocate each NvM RAM block in a RAM section called "saved zone". When using AUTOSAR mechanisms for memory allocation, the memory class _SEC_VAR_SAVED_ZONE_ shall be used. Caution: Configuring the same permanent RAM for more than one NvM block is possible but highly not recommended. In fact, an owner of an NvM block sharing the same permanent RAM block with other NvM blocks has to be aware that the owners of those other blocks could also modify the content of the shared RAM block. Hence, a certain synchronization on read/write accesses, to the common RAM block, needs to be established between different NvM blocks' owners sharing a common permanent RAM block.
      boolean NvMRbBackupBlock [0..1]: multiplicity set at pre-compile, origin=RB:18.1.0:2021-10-31, set at pre-compile, default-value=false  # Include block in Mem backup | Defines that the block should be included in the block backup using rba_MemBckp component. Note: Feature is only available for Fee blocks and is not supporting the combination with variable length blocks (NvMNvBlockLength = 0). TRUE: Block is included in the backup. FALSE: Block is not included in the backup.
      integer NvMRbBlockPersistentId [0..1]: 1..65534, multiplicity set at pre-compile, origin=RB:0.2.0:2012-03-01, set at pre-compile  # Persistent ID | [BSW_SWCS_AR_NVRAMManager_Ext-2749] Defines a unique ID for this block representing its block-specific properties. It shall be changed if and only if these block-specific properties are modified in a non-compatible way. This ID is stored on the memory media and is the basis for block identification in the memory drivers (Fee, Eep). In contrast to the IDs which are taken for block identification at the C API, this ID is (for a given block) identical in all modules of the memory stack. Its value typically remains the same even if other blocks are added to or removed from the block layout. It is not allowed that any two blocks have the same persistent ID. Additionally, the persistent IDs 0 and 65535 are reserved for internal use. If you don't explicitly specify a persistent ID for a block, such an identifier is automatically assigned by NvM based on the block name and block length.
      integer NvMRbBlockVersion [0..1]: 0..255, multiplicity set at pre-compile, origin=RB:19.0.0:2022-01-31, set at pre-compile  # Block version | [BSW_SWCS_AR_NVRAMManager_Ext-3343] Defines the block version. If the version is configured for this block, it will be stored into the non-volatile memory with the user data. The user can enable this feature by setting this parameter to a non zero value, the value zero means the block has no block version. If the user did a major change in the internal structure of the block then the block version should be updated. If the version is configured for a block, during a read block request, if the configured version matches the read version then the read request is executed normally if not the default values will be used and if no default values are available then NvM provides no values.
      boolean NvMRbFirstReadDataMigration [0..1]: multiplicity set at pre-compile, origin=RB:9.0.0:2016-11-04, set at pre-compile, default-value=false  # First Read Data Migration | [BSW_SWCS_AR_NVRAMManager_Ext-3027] Enables/disables First Read Data Migration feature for this block. When First Read Data Migration is enabled a read job is also performed when a missmatch between the configured NV block length and the block length on medium (EEPROM) occurs. In case the NV block length is smaller then the block on medium the remaining data are discarded. In case the NV block length is bigger then the block on medium the remaining data are filled with zero. If the feature is disabled and a length missmatch occurs the read job is not performed.
      boolean NvMRbInitBlockAtLayoutChange [0..1]: multiplicity set at pre-compile, origin=RB:6.0.0:2015-07-31, set at pre-compile, default-value=false  # Initialize block in case of a layout change | [BSW_SWCS_AR_NVRAMManager_Ext-2881] Defines whether the NvM block shall be initialized if a block layout change is detected. In such case, the block is firstly read during ReadAll. If the block couldn't be retrieved from the medium, initialization data (from the ROM block or via the initialization callback) is written to the medium after the execution of ReadAll. This configuration parameter is allowed to be set to "true" under the following conditions: (1) The common configuration parameter NvMRbInitAtLayoutChange is set to "true". (2) The block is native or redundant (3) The block has a standard priority (4) The block has a ROM block or an initialization callback (5) The block has a RAM block or is configured with explicit synchronization (6) The block is configured for ReadAll (7) Additionally, if dynamic configuration is enabled, then this block has to be resistant to sw change. Hint: The block is initialized (i.e. written to the medium after ReadAll) if a configuration ID mismatch is detected. Therefore, when configuring a block with this feature, a new compiled configuration ID should be configured via the NvMCompiledConfigId parameter (otherwise the block wouldn't be initialized).
      boolean NvMRbNoFallback [0..1]: multiplicity set at pre-compile, origin=RB:6.1.0:2015-10-30, set at pre-compile, default-value=false  # No fallback to the old value | [BSW_SWCS_AR_NVRAMManager_Ext-2925] This tag activates or deactivates a fallback mechanism to older copies of the same block. It is only evaluated for blocks located on Fee and ignored for blocks located on Ea. By default, this feature is set to false which is the standard behavior for Fee blocks (i.e. older values of the same block are preferred over delivering no block data at all). In Ea, older values are never available by principle and therefore blocks located on Ea will behave as if this tag had been set to true, regardless of its actual setting. If this tag is set to true and the corresponding block is located on Fee, older values will not be returned if the latest block instance is completely corrupted. In this case, inconsistent state is reported instead. Caution: When enabling this feature for the first time, already existing instances of the corresponding block on the media might not be readable anymore. Additionally, some Fee configurations might not support this feature at all. Please refer to the Fee documentation for details.
      string NvMRbNvBlockLengthString [0..1]: multiplicity set at pre-compile, origin=RB:9.0.0:2016-11-04, set at pre-compile  # Block length (C expression) | [BSW_SWCS_AR_NVRAMManager_Ext-2996] Defines the NV block data length in bytes. All possible R-VALUES in C programming language except stand alone numerical literals are supported. A semicolon at the end of the C expression is not necessary. For numerical literals use NvMNvBlockLength or a define directive instead. For example if the block length Null shall be configured use a define directive like NV_BLOCK_LENGTH_NULL. All R-Values used here have to be declared by the user. Furthermore the user has to make it known to NvM_Cfg.c. Therefore the configuration parameter NvMBlockHeaderInclude has to be used.
      string NvMRbRamBlockDataAddressString [0..1]: multiplicity set at pre-compile, origin=RB:9.0.0:2016-11-04, set at pre-compile, default-value=NULL_PTR  # RAM block data address (C expression) | [BSW_SWCS_AR_NVRAMManager_Ext-] Defines the RAM block data length as C expression. All possible R-VALUES in C programming language are supported. A semicolon at the end of the C expression is not necessary. All R-Values used here have to be declared by the user. Furthermore the user has to make it known to NvM_Cfg.c. Therefore the configuration parameter NvMBlockHeaderInclude has to be used.
      boolean NvMRbRamInitUnconditional [0..1]: multiplicity set at pre-compile, origin=RB:11.1.0:2018-04-31, set at pre-compile, default-value=false  # RAM init unconditional | [BSW_SWCS_AR_NVRAMManager_Ext-3175] This parameter defines whether a permanent RAM block will be initialized unconditionally. - true: permanent RAM block will be initialized even if it has remained unchanged after last reset (common parameter NvMRbRamInitCheck = NVM_RAM_INIT_CHECK_QUICK) - false: permanent RAM block will be initialized dependent on the state of the parameter NvMRbRamInitCheck
      boolean NvMRbResistantToLayoutRemoval [0..1]: multiplicity set at pre-compile, origin=RB:2.1.0:2013-10-28, set at pre-compile, default-value=false  # Resistant to layout removal | [BSW_SWCS_AR_NVRAMManager_Ext-2783] Defines whether the NvM block is resistant to layout removal. Once configured and written, lower layers keep this block saved on the persistent media even when this block is not part of the layout anymore (i.e. when the configuration changes and this block is removed from the layout). In this case, this block is not accessible from NvM. If the configuration changes again and this block is reconfigured, access to this block is reenabled again. If dynamic configuration is active (via NvMDynamicConfiguration), then resistant-to-layout-removal blocks must be resistant-to-changed-SW (configurable via NvMResistantToChangedSw parameter).
      boolean NvMRbSelectBlockForFirstInitAll [0..1]: multiplicity set at pre-compile, origin=RB:3.1.0:2014-04-25, set at pre-compile, default-value=false  # Initialize block during FirstInitAll | [BSW_SWCS_AR_NVRAMManager_Ext-2828] Defines whether a NvM block shall be processed during NvM_Rb_FirstInitAll or not. This configuration parameter is allowed to be set in the following cases: (i) The NvM block (is native or redundant) and (has a ROM block or an InitblockCallback) and (has a permanent RAM block or is configured to use explicit synchronization mechanism) (ii) The NvM block (is native or redundant) and (has no ROM block and no InitBlockCallback). In this case the NvM block is simply invalidated by the NvM_Rb_FirstInitAll job. (iii) The NvM block is of type NVM_BLOCK_DATASET. In this case, all the NV blocks of the NvM block are invalidated by the NvM_Rb_FirstInitAll job.
      function name NvMRbSingleBlockStartCallback [0..1]: multiplicity set at pre-compile, origin=RB:9.0.0:2016-11-04, set at pre-compile, default-value=NULL_PTR  # Single block start callback (Rb) | [BSW_SWCS_AR_NVRAMManager_Ext_3062] Name of the block-specific callback routine which shall be invoked on start of each access to the actual memory media. If you explicitly want to specify that no such callback routine shall be called, enter NULL_PTR here. The signature of the callback-function has to be: For NvMRbCallbackSignatureAR45=false: Std_ReturnType CallbackName(uint8 ServiceId); For NvMRbCallbackSignatureAR45=true: Std_ReturnType CallbackName(NvM_BlockRequestType BlockRequest). It is not allowed to call any NvM or DEM functions from within this callback function!
      boolean NvMRbWriteCounter [0..1]: multiplicity set at pre-compile, origin=RB:17.0.0:2021-01-31, set at pre-compile, default-value=false  # Write Counter | [BSW_SWCS_AR_NVRAMManager_Ext-3296] This parameter defines whether the write counter is enabled/disabled for a NVRAM block. Attention: When write counter is enabled the size of data stored in non-volatile memory changes (block-size = user-data-size + write-counter-size) with all its implications on backwards-compatibility!
      function name NvMReadRamBlockFromNvCallback [0..1]: multiplicity set at pre-compile, set at pre-compile, default-value=NULL_PTR  # Read RAM copy callback | [ECUC_NVM_00521] Name of the block-specific callback routine which shall be invoked in order to let the application copy data from the NvM module's mirror to RAM block (see also the NvMBlockUseSyncMechanism parameter). If you explicitly want to specify that no such callback routine shall be called, enter NULL_PTR here. For a user located above RTE and if NvMRbGenRteServicePort is set to TRUE, this callback has to be left empty in order to generate the callback automatically. The signature of the callback-function has to be: Std_ReturnType CallbackName(void* NvMBuffer). It is not allowed to call any NvM or DEM functions from within this callback function!
      boolean NvMResistantToChangedSw: set at pre-compile  # Resistant to changed SW | [ECUC_NVM_00483] Defines whether a NVRAM block shall be treated as resistant to configuration changes or not (see also the NvMCompiledConfigId and NvMDynamicConfiguration parameters for a description of this mechanism).
      string NvMRomBlockDataAddress [0..1]: multiplicity set at pre-compile, set at pre-compile, default-value=NULL_PTR  # ROM block data address | [ECUC_NVM_00484] Defines the start address of ROM block data. You may either give an address in hexadecimal notation here (e.g. 0x2345BCDE) or the name of a linker symbol (e.g. MyTestRomBlock) or the address (e.g. &MyTestRomBlock). If you explicitly want to specify that no ROM block shall be available for this block, enter NULL_PTR here. The NvM users shall allocate each NvM ROM block in the so called "saved recovery zone". When using AUTOSAR mechanisms for memory allocation, the memory class <MODULE>_SEC_CONST_SAVED_RECOVERY_ZONE_<SIZE> shall be used.
      integer NvMRomBlockNum: 0..254, set at pre-compile  # Number of ROM blocks | [ECUC_NVM_00485] Defines the number of multiple ROM blocks in a contiguous area according to the given block management type. The allowed number of ROM blocks is 0..1 for a native or a redundant block and 0..254 for a dataset block. Additionally, the following condition has to be satisfied: NvMNvBlockNum + NvMRomBlockNum <= 255 [NVM444]
      boolean NvMSelectBlockForReadAll [0..1]: multiplicity set at pre-compile, set at pre-compile, default-value=false  # Read block during ReadAll | [ECUC_NVM_00117] Defines whether a NVRAM block shall be processed during NvM_ReadAll or not. This configuration parameter is only allowed to be set for NVRAM blocks which are configured to have a permanent RAM block or which are configured to use explicit synchronization mechanism. Additionally, dataset blocks (configurable via NvMBlockManagementType parameter) as well as immediate priority blocks (configurable via NvMBlockJobPriority parameter) are not allowed to be selected for NvM_ReadAll.
      boolean NvMSelectBlockForWriteAll [0..1]: multiplicity set at pre-compile, set at pre-compile, default-value=false  # Write block during WriteAll | [ECUC_NVM_00549] Defines whether a NVRAM block shall be processed during NvM_WriteAll or not. This configuration parameter is only allowed to be set for NVRAM blocks which are configured to have a permanent RAM block or which are configured to use explicit synchronization mechanism.
      boolean NvMStaticBlockIDCheck: set at pre-compile  # Static block ID check | [ECUC_NVM_00532] Enables/disables the static block ID check for this block. The current version of NvM does not support this feature, so this parameter has currently always to be set to false.
      boolean NvMWriteBlockOnce: set at pre-compile  # Write block once | [ECUC_NVM_00072] Enables/disables automatic write protection of this block once it has been successfully read from or written to the memory media. This protects the block data to be overwritten once it has been successfully written. Please note that the fact that the block data has been successfully written is lost after NvM_Init; you typically recover this information by trying to read the block via NvM_ReadAll or NvM_ReadBlock before attempting any write/invalidate/erase operation on blocks configured to be written only once. An NvM block configured with the "Write Once" is allowed to be initialized at layout change (please see NvMRbInitBlockAtLayoutChange configuration parameter). If the block is initialized (i.e. its recovery data is written to the medium after ReadAll), attempting any write/invalidate/erase operation on this block will fail.
      function name NvMWriteRamBlockToNvCallback [0..1]: multiplicity set at pre-compile, set at pre-compile, default-value=NULL_PTR  # Write RAM copy callback | [ECUC_NVM_00520] Name of the block-specific callback routine which shall be invoked in order to let the application copy data from RAM block to the NvM module's mirror (see also the NvMBlockUseSyncMechanism parameter). If you explicitly want to specify that no such callback routine shall be called, enter NULL_PTR here. For a user located above RTE and if NvMRbGenRteServicePort is set to TRUE, this callback has to be left empty in order to generate the callback automatically. The signature of the callback-function has to be: Std_ReturnType CallbackName(void* NvMBuffer). It is not allowed to call any NvM or DEM functions from within this callback function!
      boolean NvMWriteVerification: set at pre-compile  # Write verification | [ECUC_NVM_00534] Enables/disables write verification. The current version of NvM does not support this feature, so this parameter has currently always to be set to false.
      integer NvMWriteVerificationDataSize: 0..65535, set at pre-compile  # Write verification data size | [ECUC_NVM_00538] Defines the number of bytes to compare in each step when comparing the content of a RAM Block and a block read back during write verification. This parameter is ignored if the write verification feature is disabled for this block.
      symbolic name reference NvMBlockCipheringRef [0..1]: multiplicity set at pre-compile, set at pre-compile, destination=NvMBlockCiphering  # Block security services | [ECUC_NvM_00567] Reference to ciphering container. If configured, NvM encrypt the data before storage and decrypt the data after restoring. If empty, the NvM stores and restore the original user data.
      symbolic name reference NvMBlockEcucPartitionRef [0..1]: multiplicity set at pre-compile, set at pre-compile, destination=EcucPartition  # Reference to the EcucPartition, where this NvM Block is mapped to | [ECUC_NvM_00564] Maps the NV block to zero or one ECUC partition to limit the access to this NV block. The ECUC partition referenced is within the subset of the ECUC partitions where the NvM is mapped to.
      symbolic name reference NvMRbRamInitAddSavedZoneNameRef [0..1]: multiplicity set at pre-compile, origin=RB:20.1.0:2022-07-12, set at pre-compile, destination=NvMRbRamInitAddSavedZone  # RAM Init - select additional savedzone name extension | [BSW_SWCS_AR_NVRAMManager_Ext-3440] Only used if NvMRbRamInitCheck = TRUE and NvMRbRamInitUnconditional = FALSE and a PRAM Block is configured. If empty the standard SAVEDZONE pragma section is used for the reset marker, so that the block data has the init behaviour of the normal SAVEDZONE RAM. If the PRAM is located in RAM area with a different reset behaviour, the NvM init behaviour need to be in sync with it. Thatfore an additional reset marker must be placed in the same section as the PRAM is located. For the additional reset marker the pragma NVM_{START/STOP}_SEC_VAR_SAVED_ZONE_<NvMRbRamInitAddSavedZoneName>_32 is used. (This parameter NvMRbRamInitAddSavedZoneName is the {refinement} as defined for the SEC_VAR_SAVED_ZONE in the AUTOSAR_SWS_MemoryMapping) INTEGRATION hint: This section must be added in the NvM_MemMap.h (without MemMapGen) or in the MemMap-Pragma-configuration xpt file (if MemMapGen is used).
      container NvMInitBlockCallback [0..1]: multiplicity set at pre-compile  # Initialization callback container | [ECUC_NvM_00556] Container for callback function
        function name NvMInitBlockCallbackFnc [0..1]: multiplicity set at pre-compile, set at pre-compile, default-value=NULL_PTR  # Initialization callback function | [ECUC_NVM_00116] Name of the block-specific callback routine which shall be invoked if no ROM data is available for initialization of the NVRAM block. If you explicitly want to specify that no such callback routine shall be called, enter NULL_PTR here.&lt;BR&gt; For a user located above RTE and if NvMRbGenRteServicePort is set to TRUE, this callback has to be left empty in order to generate the callback automatically. The signature of the callback-function has to be: For NvMRbCallbackSignatureAR45=false: Std_ReturnType CallbackName(void) For NvMRbCallbackSignatureAR45=true: Std_ReturnType CallbackName( NvM_InitBlockRequestType InitBlockRequest ). It is not allowed to call any NvM or DEM functions from within this callback function!
      container NvMRbSplitBlock [0..1]: multiplicity set at pre-compile  # Block split container | [BSW_SWCS_AR_NVRAMManager_Ext-3445] Container for definition of split block
        container NvMRbSubBlock [1..127]: multiplicity set at pre-compile  # Sub-block container | [BSW_SWCS_AR_NVRAMManager_Ext-3449] Container for definition of sub-blocks within a split block
          integer NvMRbSubBlockLength: 1..65407, multiplicity set at pre-compile, origin=RB:21.0.0:2023-01-31, set at pre-compile  # Sub-Block length | [BSW_SWCS_AR_NVRAMManager_Ext-3450] Defines the sub-block length in bytes.
          integer NvMRbSubBlockNum: 1..127, multiplicity set at pre-compile, origin=RB:21.0.0:2023-01-31, set at pre-compile  # Number of sub-blocks | [BSW_SWCS_AR_NVRAMManager_Ext-3451] Defines number of contiguous sub-blocks with same length within a split block.
      container NvMSingleBlockCallback [0..1]: multiplicity set at pre-compile  # Single Block callback container | [ECUC_NvM_00562] Container for callback function
        function name NvMSingleBlockCallbackFnc [0..1]: multiplicity set at pre-compile, set at pre-compile, default-value=NULL_PTR  # Single block callback function | [ECUC_NvM_00506] Name of the block-specific callback routine which shall be invoked on termination of each access to the actual memory media. If you explicitly want to specify that no such callback routine shall be called, enter NULL_PTR here.&lt;BR&gt; For a user located above RTE and if NvMRbGenRteServicePort is set to TRUE, this callback has to be left empty in order to generate the callback automatically. The signature of the callback-function has to be: For NvMRbCallbackSignatureAR45=false: Std_ReturnType CallbackName(uint8 ServiceId, NvM_RequestResultType JobResult). For NvMRbCallbackSignatureAR45=true: Std_ReturnType CallbackName(NvM_BlockRequestType BlockRequest, NvM_RequestResultType JobResult). It is not allowed to call any NvM or DEM functions from within this callback function!
      choice container NvMTargetBlockReference [0..0]  # Reference to block in media | [ECUC_NvM_00486] According to the NvM specification, this container shall collect all references to the related block configuration in Ea resp. Fee. Since this NvM implementation entirely generates this related block configuration, this container together with its contained reference parameters is and remains superfluous.
        container NvMEaRef [0..1]: multiplicity set at pre-compile  # Reference to block in serial EEPROM | [ECUC_NvM_00487] Container for block-specific Ea parameters/references. Not used in this NvM implementation.
          symbolic name reference NvMNameOfEaBlock [0..0]: set at pre-compile, destination=EaBlockConfiguration  # Reference to block in serial EEPROM | [ECUC_NvM_00488] Reference to block configuration in Ea module. Not used in this NvM implementation.
        container NvMFeeRef [0..1]: multiplicity set at pre-compile  # Reference to block in flash EEPROM emulation | [ECUC_NvM_00489] Container for block-specific Fee parameters/references. Not used in this NvM implementation.
          symbolic name reference NvMNameOfFeeBlock [0..0]: set at pre-compile, destination=FeeBlockConfiguration  # Reference to block in flash EEPROM emulation | [ECUC_NvM_00490] Reference to block configuration in Fee module. Not used in this NvM implementation.
    container NvMCommon  # Common options | [ECUC_NvM_00028] Container for common (i.e. not block-specific) configuration options.
      enumeration NvMApiConfigClass: set at pre-compile  # API class | [ECUC_NvM_00491] Allows to configure the feature set supported by the NvM service. Higher API classes mean more features at the expense of higher resource usage. Lower API classes mean less features but a smaller memory footprint. Please relate to the NvM documentation for a detailed description of which API class contains which set of features.
        NVM_API_CONFIG_CLASS_3  # API Class 3
      boolean NvMBswMMultiBlockJobStatusInformation [0..1]: multiplicity set at pre-compile, set at pre-compile, default-value=false  # Inform BswM about the multiblock job status | [BSW_SWCS_AR_NVRAMManager_Ext-2803] Enables/disables the notification of BswM about the current status of the multiblock job. The notification is made by invoking the function BswM_NvM_CurrentJobMode when multiblock operations are started, finished or canceled. If this notification is enabled, then a configured multiblock callback (configurable via NvMMultiBlockCallback) is not fired (BSW_SWCS_AR_NVRAMManager_Ext-2804).
      integer NvMBufferAlignmentValue [0..0]: 0..0, set at pre-compile  # Buffer Alignment Value | [ECUC_NvM_00573] Parameter determines the alignment of the start address that NvM buffers need to have. Value shall be inherited from EaBufferAlignmentValue or FeeBufferAlignmentValue. This parameter is not supported by the NvM. Instead the MemMap section NVM_START_SEC_VAR_SECURED_CACHED_RAM_ALIGNED_CLEARED_UNSPECIFIED can be used to specifically align NvM buffers containing data which is forward to MemIf.
      integer NvMCompiledConfigId: 0..65535, set at pre-compile  # Compiled configuration ID | [ECUC_NvM_00492] Configuration ID uniquely identifying the NV memory layout version. This ID is used for compatibility decisions during NvM_ReadAll if dynamic configuration feature of NvM is enabled (see also the NvMDynamicConfiguration parameter) or if the initialization of blocks at a layout change is enabled (see also the NvMRbInitAtLayoutChange parameter). This parameter is also used for the "initialization at layout change feature" (see also NvMRbInitBlockAtLayoutChange parameter). The configuration of the compiled ID is currently mandatory.
      integer NvMCrcNumOfBytes: 1..65535, set at pre-compile  # Number of CRC bytes | [ECUC_NvM_00493] If CRC (re-) calculation is configured for at least one permanent RAM block, this parameter defines the maximum number of bytes which shall be processed within one cycle of job processing.
      integer NvMCsmRetryCounter [0..1]: 0..255, set at pre-compile, default-value=0  # Number of Csm job retries | [ECUC_NvM_00572] This value specifies the number of CSM encryption/decryption job retry attempts. CSM jobs for block reading and writing may fail (e.g. module busy, queue full, ...). To not directly abort the read/write with an error status, the NvM will retry the CSM job for the configured NvMCsmRetryCounter times. Configuring 0 means: no retry behavior; job will be aborted directly.
      integer NvMDatasetSelectionBits [0..0]: 0..8, set at pre-compile  # Number of data selection bits | [ECUC_NvM_00494] According to the NvM specification, this setting defines the number of least significant bits which shall be used to address a certain dataset of a NVRAM block within the interface to the memory hardware abstraction. Since this NvM implementation uses a different (more efficient) identification scheme towards the memory hardware abstraction, this parameter is and remains superfluous.
      boolean NvMDevErrorDetect: set at pre-compile  # Development error detection | [ECUC_NvM_00495] Enables/disables the detection and notification of development errors. If this parameter is enabled, then extended error checking is performed during runtime; any errors detected by these checks are reported to the Det module. This feature should be switched off in series software.
      boolean NvMDrvModeSwitch: set at pre-compile  # Driver mode switch | [ECUC_NvM_00496] Enables/disables switching memory drivers to fast mode during performing NvM_ReadAll and NvM_WriteAll. Fast node is not and will not be supported by layers underneath NvM. Therefore, NvM does not support this feature, so this parameter has currently always to be set to false.
      boolean NvMDynamicConfiguration: set at pre-compile  # Dynamic configuration | [ECUC_NvM_00497] Enables/disables the dynamic configuration management feature. If enabled, the currently configured compiled configuration ID (see NvMCompiledConfigId parameter) is compared against the configuration ID stored on the memory media during NvM_ReadAll. If these ID's don't match, only the blocks marked as being resistant to SW changes (see also the NvMResistantToChangedSw parameter) are read from the memory media. If this parameter is disabled, NvM_ReadAll is processed without taking care of any possibly stored configuration ID.
      boolean NvMJobPrioritization: set at pre-compile  # Job prioritization | [ECUC_NvM_00498] Enables/disables job prioritization handling.
      float NvMMainFunctionPeriod: 0.., set at pre-compile  # Main function period | [ECUC_NvM_00555] Defines the period between successive calls to the NvM main function in seconds. In case NvM main function is scheduled via RTE in a timed task the minimum value is 1.0e-7 [s].
      function name NvMMultiBlockCallback [0..1]: multiplicity set at pre-compile, set at pre-compile  # Multiblock callback | [ECUC_NvM_00500] Name of the common callback routine which shall be invoked on termination of each asynchronous multi block request (NvM_Rb_FirstInitAll, NvM_ReadAll, removing of non-resistant to changed SW blocks or NvM_WriteAll). If you explicitly want to specify that no such callback routine shall be called, enter NULL_PTR here. The signature of the callback-function has to be: For NvMRbCallbackSignatureAR45=false: Std_ReturnType CallbackName(uint8 ServiceId, NvM_RequestResultType JobResult ) For NvMRbCallbackSignatureAR45=true: Std_ReturnType CallbackName(NvM_MultiBlockRequestType MultiBlockRequest, NvM_RequestResultType JobResult ). It is not allowed to call any NvM or DEM functions from within this callback function!
      boolean NvMPollingMode: set at pre-compile  # Polling mode | [ECUC_NvM_00501] Defines the way how NvM communicates to the memory media drivers. If set to true, the NvM_MainFunction polls the status from these drivers if some operation is ongoing. If set to false, the media drivers asynchronously report any changes in the operation status via dedicated callback functions provided by NvM. NvM does not support asynchronous notifications from the memory media drivers, so this parameter has currently always to be set to true.
      boolean NvMRbAuxInterface [0..1]: multiplicity set at pre-compile, origin=RB:7.0.0:2016-01-31, set at pre-compile, default-value=false  # Auxiliary interface | [BSW_SWCS_AR_NVRAMManager_Ext-2945] Enables/disables the auxiliary service interface. This interface allows a special "auxiliary" user to trigger NvM single-block jobs for arbitrary blocks which do not interfere with jobs or states of "regular" users.
      integer NvMRbBlockHeader [0..1]: 0..2, multiplicity set at pre-compile, origin=RB:19.0.0:2022-01-31, set at pre-compile, default-value=0  # Block header | [BSW_SWCS_AR_NVRAMManager_Ext-3406] Defines the storage of the block header in non-volatile memory together with user data. Block header is always stored before user data, i.e block data in non-volatile memory starts with block header. Possible values: - 0 = block header disabled - 1 = block header with layout version 1 stored: Byte | Name | Usage 0-1 | CrcHdr | CRC16 over header bytes 2-14, LSB first 2 | LngHdr | Header length in bytes [1 .. 255] 3 | VerHdr | Header Version [1 .. 255] 4-5 | LngPlainData | Length of plain user data in bytes [1 .. 65407], LSB first 6-7 | LngEncryptData | Length of encrypted user data in bytes [0, 1 .. 65407], LSB first, 0 = user data not encrypted 8 | CrcPlainData | Length of the CRC over plain user data stored with encrypted user data [0, 1, 2, 4], 0 = no CRC, 1 = CRC8, 2 = CRC16, 4 = CRC32 9 | LngIV | Length of the Init Vector used for encryption in multiples of 4 bytes [0, 1 .. 255], 0 = no Init Vector, 1 = 4 bytes, 2 = 8 bytes, 3 = 12 bytes, etc. 10 | LngTag | Length of the tag stored in case of AEAD encryption in multiples of 4 bytes [0, 1 .. 255], 0 = no tag, 1 = 4 bytes, 2 = 8 bytes, 3 = 12 bytes, etc. 11 | LngSgn | Length of the signature in multiples of 4 bytes [0, 1 .. 255], 0 = no signature, 1 = 4 bytes, 2 = 8 bytes, 3 = 12 bytes, etc. 12 | LngWrtCntr | Length of the block write counter [0, 4], 0 = no write counter used, 4 = 4 bytes stored 13 | LngBlkVer | Length of the block version [0, 1], 0 = no block version used, 1 = byte stored 14 | LngCrcStoredData | Length of the CRC over all data stored in non-volatile memory [0, 1, 2, 4], 0 = no CRC stored, 1 = CRC8 stored, 2 = CRC16 stored, 4 = CRC32 stored - 2 = block header with layout version 2 stored: Byte | Name | Usage 0-1 | CrcHdr | CRC16 over header bytes 2-14, LSB first 2 | LngHdr | Header length in bytes [1 .. 255] 3 | VerHdr | Header Version [1 .. 255] 4-5 | LngPlainData | Length of plain user data in bytes [1 .. 65407], LSB first 6-7 | LngEncryptData | Length of encrypted user data in bytes [0, 1 .. 65407], LSB first, 0 = user data not encrypted 8 | CrcPlainData | Length of the CRC over plain user data stored with encrypted user data [0, 1, 2, 4], 0 = no CRC, 1 = CRC8, 2 = CRC16, 4 = CRC32 9 | LngIV | Length of the Init Vector used for encryption in multiples of 4 bytes [0, 1 .. 255], 0 = no Init Vector, 1 = 4 bytes, 2 = 8 bytes, 3 = 12 bytes, etc. 10 | LngTag | Length of the tag stored in case of AEAD encryption in multiples of 4 bytes [0, 1 .. 255], 0 = no tag, 1 = 4 bytes, 2 = 8 bytes, 3 = 12 bytes, etc. 11 | LngSgn | Length of the signature in multiples of 4 bytes [0, 1 .. 255], 0 = no signature, 1 = 4 bytes, 2 = 8 bytes, 3 = 12 bytes, etc. 12 | LngMac | Length of the message authentication code (MAC) in multiples of 4 bytes [0, 1 .. 255], 0 = no signature, 1 = 4 bytes, 2 = 8 bytes, 3 = 12 bytes, etc. 13 | LngWrtCntr | Length of the block write counter [0, 4], 0 = no write counter used, 4 = 4 bytes stored 14 | LngBlkVer | Length of the block version [0, 1], 0 = no block version used, 1 = byte stored 15 | LngCrcStoredData | Length of the CRC over all data stored in non-volatile memory [0, 1, 2, 4], 0 = no CRC stored, 1 = CRC8 stored, 2 = CRC16 stored, 4 = CRC32 stored
      boolean NvMRbCallbackSignatureAR45 [0..1]: multiplicity set at pre-compile, origin=RB:19.1.0:2022-03-15, set at pre-compile, default-value=false  # Callback function parameter type according to AR45 | [BSW_SWCS_AR_NVRAMManager_Ext-3436] Changes the parameter type of the callback functions. TRUE: NvM_<Multi;Init>BlockRequestType according to AR44 and after ; FALSE: ServiceId according to AR43 and before; Details of the parameter of the function calls see the callback parameters. If NvMRbCallbackSignatureAR45 = TRUE the function NvM_Rb_GetActiveService is not available, because it is not needed anymore and it has disadvantages when usedwith the MultiFee and/or crytographic service feature. See NvM Doku NvM_EN_detailed_CDG.pdf
      boolean NvMRbCommonCalcRamBlockCrc [0..1]: multiplicity set at pre-compile, origin=RB:13.1.0:2019-03-31, set at pre-compile, default-value=false  # Common CRC (re)calculation | [BSW_SWCS_AR_NVRAMManager_Ext-3186] Defines the default value for parameters NvMCalcRamBlockCrc and NvMBlockUseCRCCompMechanism. If this parameter is set to true then default value of parameters NvMCalcRamBlockCrc and NvMBlockUseCRCCompMechanism is true for all NVRAM blocks for which these parameters can be true. I.e. for all NVRAM blocks with permanent RAM blocks or which are configured to use explicit synchronization mechanism. For NVRAM blocks which have not configured a CRC type the NvM will use the default CRC type of 16 bit (NVM_CRC16).
      boolean NvMRbCommonWriteCounter [0..1]: multiplicity set at pre-compile, origin=RB:17.0.0:2021-01-31, set at pre-compile, default-value=false  # Common write counter | [BSW_SWCS_AR_NVRAMManager_Ext-3295] Defines the default value for the block specific parameter NvMRbWriteCounter. - true: default value of the parameter NvMRbWriteCounter is true for all NVRAM blocks. I.e. the write counter is enabled for all NVRAM blocks and disabled only for NVRAM blocks where the parameter NvMRbWriteCounter is explicitely set to false. - false: default value of the parameter NvMRbWriteCounter is false for all NVRAM blocks. I.e. the write counter is disabled for all NVRAM blocks and enabled only for NVRAM blocks where the parameter NvMRbWriteCounter is explicitely set to true.
      boolean NvMRbDynConfigLoadDefaultsForNonResistant [0..1]: multiplicity set at pre-compile, origin=RB:17.1.0:2021-03-31, set at pre-compile, default-value=false  # Load defaults for non-resistant blocks | [BSW_SWCS_AR_NVRAMManager_Ext-3307] Defines whether NvM loads default values or skips reading for non-resistant blocks in case of layout change for dynamic configuration defined by Autosar (extended run-time preparation) TRUE = NvM loads default values for non-resistant blocks in case of layout change FALSE = NvM skips reading of non-resistant blocks in case of layout change ATTENTION: this parameter affects only dynamic configuration as defined by AUTOSAR. If enhanced dynamic configuration is enabled (NvMRbRemoveNonResistantBlocks = TRUE) then this parameter has no effect.
      boolean NvMRbErrorInfoDetail [0..1]: multiplicity set at pre-compile, origin=RB:19.0.0:2021-01-31, set at pre-compile, default-value=false  # Error Info Detail | [BSW_SWCS_AR_NVRAMManager_Ext-3405] Defines whether the API NvM_Rb_GetErrorInfoDetail is available. It can be called after each block oriented job to fetch additional error details. - true: NvM_Rb_GetErrorInfoDetail function is available. - false: NvM_Rb_GetErrorInfoDetail function is not available.
      boolean NvMRbExplcitSyncReadWithConst [0..1]: multiplicity set at pre-compile, origin=RB:18.1.0:2021-09-20, set at pre-compile, default-value=false  # Enable const qualifier for read callback | [BSW_SWCS_AR_NVRAMManager_Ext-3333] Enables const qualifier in signature of the read callback parameter NvMBuffer. Read callback can be defined using block parameter NvMReadRamBlockFromNvCallback. TRUE = Read callback parameter has a const qualifier. FALSE = Read callback parameter has no const qualifier.
      enumeration NvMRbGenArxmlVersion [0..1]: multiplicity set at pre-compile, origin=RB:0.2.0:2012-03-01, set at pre-compile, default-value=NVM_GEN_ARXML_VERSION_402  # Version of generated ARXML | [BSW_SWCS_AR_NVRAMManager_Ext-2746] Version of the generated ARXML file(s).
        NVM_GEN_ARXML_VERSION_402  # 4.0R2
      boolean NvMRbInitAtLayoutChange [0..1]: multiplicity set at pre-compile, origin=RB:6.0.0:2015-07-31, set at pre-compile, default-value=false  # Initialize blocks at a layout change | [BSW_SWCS_AR_NVRAMManager_Ext-2893] Enables/disables the initialization of NvM blocks having the configuration parameter NvMRbInitBlockAtLayoutChange set to "true". This initialization is perfomed in case a layout change is detected.
      boolean NvMRbInitBufferBeforeSyncWrite [0..1]: multiplicity set at pre-compile, origin=RB:17.1.0:2021-03-31, set at pre-compile, default-value=false  # Initialize buffer before sync write callback | [BSW_SWCS_AR_NVRAMManager_Ext-3298] Enables/disables the initialization of the NvM internal buffer before invoking the write callback with explicit synchronization.
      enumeration NvMRbMainFunctionScheduling [0..1]: multiplicity set at pre-compile, origin=RB:13.0.0:2019-01-31, set at pre-compile, default-value=NVM_RB_MAINFUNC_SCHEDULING_RTE_TIMED  # Scheduling for NvM_MainFunction | [BSW_SWCS_AR_NVRAMManager_Ext-3183] Defines if NvM_MainFunction() is beeing called in the background-task via RTE, in a scheduled task via RTE or if it is not called via RTE and therefore has to be scheduled manually. In case it is scheduled manually no RTE events or entities are generated.
        NVM_RB_MAINFUNC_SCHEDULING_RTE_BACKGROUND  # RTE background task
        NVM_RB_MAINFUNC_SCHEDULING_RTE_TIMED  # RTE timed task
        NVM_RB_MAINFUNC_SCHEDULING_MANUAL  # Manual scheduling
      function name NvMRbMultiBlockStartCallback [0..1]: multiplicity set at pre-compile, origin=RB:7.1.0:2016-04-30, set at pre-compile  # Multiblock start callback | [BSW_SWCS_AR_NVRAMManager_Ext-2762] Entry address of the common callback routine which shall be invoked whenever an asynchronous multi block request is about to start. If you explicitly want to specify that no such callback routine shall be called, enter NULL_PTR here. The signature of the callback-function has to be: For NvMRbCallbackSignatureAR45=false: Std_ReturnType CallbackName(uint8 ServiceId) For NvMRbCallbackSignatureAR45=true: Std_ReturnType CallbackName( NvM_MultiBlockRequestType MultiBlockRequest ). It is not allowed to call any NvM or DEM functions from within this callback function!
      boolean NvMRbNoInitCallbackRomBlockConfigured [0..1]: multiplicity set at pre-compile, origin=RB:19.1.0:2022-03-03, set at pre-compile, default-value=false  # No Initialization callback if a ROM block is configured | [BSW_SWCS_AR_NVRAMManager_Ext-3414] Enables/disables no initialization callback is called if a block has ROM block configured feature, if the parameter NvMRbNoInitCallbackRomBlockConfigured is set to "true", the initialization callback shall be called only if a ROM block is not configured. For AR46 and higher, this feature shall be enabled.
      boolean NvMRbNoSingleBlockBeforeReadAll [0..1]: multiplicity set at pre-compile, origin=RB:18.0.0:2021-06-30, set at pre-compile, default-value=false  # No single block request before ReadAll | [BSW_SWCS_AR_NVRAMManager_Ext-3330] Enables/disables no single block request before ReadAll feature, if the parameter NvMRbNoSingleBlockBeforeReadAll is set to "true", any single block access shall not be processed before completion of "ReadAll" service - instead they shall be rejected with E_NOT_OK.
      boolean NvMRbNvCrcEnable [0..1]: multiplicity set at pre-compile, origin=RB:14.0.0:2019-06-05, set at pre-compile, default-value=false  # Enable CRC useage in NV memory | [BSW_SWCS_AR_NVRAMManager_Ext-3187] Globally enables/disables CRC useage in NV memory for NVRAM blocks which have the block-specific parameter NvMBlockUseCrc set to TRUE. If NvMRbNvCrcEnable is TRUE the block-specific parameter NvMBlockUseCrc defines if a CRC on NVM level is used for the block. If NvMRbNvCrcEnable is set to FALSE no CRCs on NVM level will be used (even though the block-specific parameter NvMBlockUseCrc might be set to TRUE). Hint: For projects which do not use the complete MemStack, the parameter NvMRbNvCrcEnable should be set to TRUE to enable CRC useage. For projects which use the complete Memstack it is adviced to keep the Nv CRC on NvM level turned off (NvMRbNvCrcEnable=FALSE) because the lower software layers already apply CRC integrity checks. Attention: When CRC useage is activated the block-size of the NVM block changes compared to the case that CRC is deactivated (block-size = user-data-size + crc-size) with all its implications on backwards-compatibility!
      function name NvMRbObserverCallback [0..1]: multiplicity set at pre-compile, origin=RB:3.1.0:2014-04-25, set at pre-compile  # Observer callback | [BSW_SWCS_AR_NVRAMManager_Ext-2843] Name of the callback routine which is invoked on the termination of the processing of a job for a block within an asynchronous request. Unlike multiblock callback, if configured, this callback is invoked for any configured block including the configuration ID block (when dynamic configuration is enabled) and excluding block #0. Similar to the single block request, it provides the block specific request result when the processing of the block finishes. If you explicitly want to specify that no such callback routine shall be called, enter NULL_PTR here. It is not allowed to call any NvM or DEM functions from within this callback function!
      enumeration NvMRbRamInitCheck [0..1]: multiplicity set at pre-compile, origin=RB:2.1.0:2013-10-28, set at pre-compile, default-value=NVM_RB_RAM_INIT_CHECK_NONE  # RAM init check | [BSW_SWCS_AR_NVRAMManager_Ext-2786] This parameter allows to choose the behavior of the NvM module when a reset occurs. NVM_RB_RAM_INIT_CHECK_NONE: After a reset, NvM_ReadAll() reads all blocks suitable for ReadAll. NVM_RB_RAM_INIT_CHECK_QUICK: After a reset, it is checked whether the saved zone is lost. If not lost, only blocks whose RAM status bits are INVALID are filled with data from Nv blocks during NvM_ReadAll(). If the RAM status bit of a block is found VALID, then the block is skipped by NvM_ReadAll().
        NVM_RB_RAM_INIT_CHECK_NONE  # None
        NVM_RB_RAM_INIT_CHECK_QUICK  # Quick
      integer NvMRbRandomNrLength [0..1]: 0..65535, multiplicity set at pre-compile, origin=RB:19.0.0:2022-01-31, set at pre-compile, default-value=16  # Random number length | [BSW_SWCS_AR_NVRAMManager_Ext-3253] Defines the length of random number in bytes used for user data encryption / authentication.
      boolean NvMRbRemoveNonResistantBlocks [0..1]: multiplicity set at pre-compile, origin=RB:2.1.0:2013-10-28, set at pre-compile, default-value=false  # Remove non-resistant blocks | [BSW_SWCS_AR_NVRAMManager_Ext-2787] Enables/disables enhanced dynamic configuration. If enabled and if the configured configuration ID is different from the configuration ID stored on the memory media, NV blocks which are configured to be non-resistant against SW changes (parameter NvMResistantToChangedSw set to false) are removed from the media directly after NvM_ReadAll has finished. Afterwards, the changed configuration ID is immediately written to the memory media before serving any other NvM request. This feature is only available if dynamic configuration is enabled (see parameter NvMDynamicConfiguration). Caution: if the enhanced dynamic configuration is enabled, all of the single block operations will be neither accepted nor executed before the ReadAll is called, if the block is as ReadAll block configured and is not resistant to changed software.
      integer NvMRbReqMonDevId [0..1]: 0..254, multiplicity set at pre-compile, origin=RB:10.0.0:2017-07-31, set at pre-compile  # Device ID for request monitoring | [BSW_SWCS_AR_NVRAMManager_Ext-3141] This parameter defines the device where the NVRAM block for request monitoring will be located.
      enumeration NvMRbReqMonitor [0..1]: multiplicity set at pre-compile, origin=RB:10.0.0:2017-07-31, set at pre-compile, default-value=NVM_RB_REQ_MON_DISABLED  # Request monitoring | [BSW_SWCS_AR_NVRAMManager_Ext-3124] This parameter defines the request monitoring function for the NvM. NVM_RB_REQ_MON_DISABLED [Default]: Request monitoring disabled. NVM_RB_REQ_MON_WRITE: Monitoring of write requests enabled. In this case following counters are available: - NvM_Rb_cntrWrites_u16 = Number of write requests since last power-on, - NvM_Rb_nrBytesWritten_u32 = Number of bytes written since last power-on, - NvM_Rb_idLastWrittenBlock_uo = ID of the last written block, - NvM_Rb_WriteMon_st.nrBytesWrittenMax_u32 = maximum number of bytes written since last power-on, - NvM_Rb_WriteMon_st.cntrWritesAbs_u32 = accumulated number of all write requests, - NvM_Rb_WriteMon_st.cntrWritesMax_u16 = maximum number of write requests since last power-on
        NVM_RB_REQ_MON_DISABLED  # Disabled
        NVM_RB_REQ_MON_WRITE  # Write requests
      boolean NvMRbRuntimeRamBlockConfiguration [0..1]: multiplicity set at pre-compile, origin=RB:9.0.0:2016-11-04, set at pre-compile, default-value=false  # Runtime RAM Block Configuration | [BSW_SWCS_AR_NVRAMManager_Ext-3028] Enables/disables the runtime calculation of the NV block lengths and RAM block data addresses. When this feature is enabled the NV block length and the RAM block data address can be defined as C expression in NvMRbNvBlockLengthString and NvMRamBlockDataAddress. If this feature is enabled and explicit synchronization is used for a block the explicit synchronization buffer has to be defined by the user. Therefore the configuration parameters NvMRbRuntimeRamBufferAddressStart and NvMRbRuntimeRamBufferAddressEnd have to be used.
      string NvMRbRuntimeRamBufferAddressEnd [0..1]: multiplicity set at pre-compile, origin=RB:9.0.0:2016-11-04, set at pre-compile, default-value=NULL_PTR  # Explicit Sync RAM End Address | [BSW_SWCS_AR_NVRAMManager_Ext-3030] Defines the end address of the RAM buffer used for explicit synchronisation when NV block lengths are calculated on runtime (NvMRbRuntimeRamBlockConfiguration is enabled).
      string NvMRbRuntimeRamBufferAddressStart [0..1]: multiplicity set at pre-compile, origin=RB:9.0.0:2016-11-04, set at pre-compile, default-value=NULL_PTR  # Explicit Sync RAM Start Address | [BSW_SWCS_AR_NVRAMManager_Ext-3029] Defines the start address of the RAM buffer used for explicit synchronisation when NV block lengths are calculated on runtime (NvMRbRuntimeRamBlockConfiguration is enabled).
      boolean NvMRbSetWriteAllTriggerApi [0..1]: multiplicity set at pre-compile, origin=RB:8.0.0:2016-07-31, set at pre-compile, default-value=false  # SetWriteAllTrigger API | [BSW_SWCS_AR_NVRAMManager_Ext-2982] Enables/disables NvM_Rb_SetWriteAllTrigger API. This API allows to trigger WriteAll participation independent of RAM block states or whether a block is currently busy or not. If Dem is used, "NvMRbSetWriteAllTriggerApi" must be set to TRUE.
      boolean NvMRbSwcdToEcucValuesEnable [0..1]: multiplicity set at pre-compile, origin=RB:17.0.0:2020-12-04, set at pre-compile, default-value=false  # Enable SWCD to EcucValues translation | On SWCD level it is possible to configure NvBlockNeeds. For such NvBlockNeeds it is required to configure a corresponding NvM block on EcucValues side. On enabling this switch the available information in SWCD is automatically translated to EcucValues. SWCD does support only a subset of pure AUTOSAR parameters. Additional information has to be provided on EcucValues level. Currently it is not possible to automatically calculate the mandatory parameters block length and the device ID from the SWCD configuration. The 2 parameters NvMNvBlockLength and NvMNvramDeviceId have to be provided additionally on EcucValues level.
      integer NvMRepeatMirrorOperations [0..1]: 0..7, multiplicity set at pre-compile, set at pre-compile, default-value=0  # Max. number of mirror operation retries | [ECUC_NvM_00518] Defines the number of retries to let the application copy data to or from the NvM module's mirror before postponing the current job. The lower multiplicity is set to 0 in contrast to NVM518_Conf. In fact, this parameter doesn't have to be configured if none of the blocks is configured to use explicit synchronization. See also the NvMBlockUseSyncMechanism parameter in the block configuration.
      boolean NvMSetRamBlockStatusApi: set at pre-compile  # SetRamBlockStatus API | [ECUC_NvM_00502] Enables/disables the NvM_SetRamBlockStatus API. If enabled, NvM_WriteAll only writes blocks to memory which have been explicitly marked as changed by using this API. If disabled, this API is not available and NvM_WriteAll writes blocks to memory regardless of whether they have changed or not. The current version of NvM does not support disabling the NvM_SetRamBlockStatus API, so this parameter must always be set to true.
      integer NvMSizeImmediateJobQueue [0..1]: 1..255, multiplicity set at pre-compile, set at pre-compile, default-value=1  # Size of immediate job queue | [ECUC_NvM_00503] Defines the number of queue entries for the immediate priority job queue. This parameter is only applicable if the NvMJobPrioritization parameter is set to true.
      integer NvMSizeStandardJobQueue: 1..255, set at pre-compile  # Size of standard job queue | [ECUC_NvM_00504] Defines the number of queue entries for the standard job queue.
      boolean NvMVersionInfoApi: set at pre-compile  # GetVersionInfo API | [ECUC_NvM_00505] Enables/disables the NvM_GetVersionInfo API.
      symbolic name reference NvMEcucPartitionRef [0..65535]: multiplicity set at pre-compile, set at pre-compile, destination=EcucPartition  # Reference to the EcucPartition, where NvM API is available | [ECUC_NvM_00565] Maps the NvM to one or multiple ECUC partitions to make its C-APIs available in the according partition.
      symbolic name reference NvMMasterEcucPartitionRef [0..1]: multiplicity set at pre-compile, set at pre-compile, destination=EcucPartition  # Reference to the EcucPartition, where the NvM Master is located | [ECUC_NvM_00566] Maps the NvM master to zero or one ECUC partition to assign the master functionality to a certain core. The ECUC partition referenced is a subset of the ECUC partitions where the NvM is mapped to.
      symbolic name reference NvMRbCsmJobRandomNrRef [0..1]: multiplicity set at pre-compile, origin=RB:19.0.0:2022-01-31, set at pre-compile, destination=CsmJob  # Csm job to get a random number used for encryption | [BSW_SWCS_AR_NVRAMManager_Ext-3257] Reference to the Csm job to get a random number used for cryptographic services.
      container NvMRbApiOverloading [0..1]: multiplicity set at pre-compile  # API overloading | [BSW_SWCS_AR_NVRAMManager_Ext-2914] Container for API overloading options. The parameters within this container should only be used with extreme care after thoroughly consulting the NvM documentation. Using the API overloading feature the wrong way can corrupt the entire Mem stack's functionality.
        function name NvMRbAuxGetErrorStatus [0..1]: multiplicity set at pre-compile, origin=RB:19.1.0:2022-02-10, set at pre-compile  # Rb_AuxGetErrorStatus function name | [BSW_SWS_AR_NVRAMManager_Ext-2914] Name of the function to be called in the body of NvM_Rb_AuxGetErrorStatus instead of NvM's own implementation (which is available as NvM_Rb_AuxGetErrorStatusBase if this parameter is set).
        function name NvMRbAuxInvalidateNvBlock [0..1]: multiplicity set at pre-compile, origin=RB:15.1.0:2020-04-30, set at pre-compile  # Rb_AuxInvalidateNvBlock function name | [BSW_SWCS_AR_NVRAMManager_Ext-2914] Name of the function to be called in the body of NvM_Rb_AuxInvalidateNvBlock instead of NvM's own implementation (which is available as NvM_Rb_AuxInvalidateNvBlockBase if this parameter is set).
        function name NvMRbAuxReadBlock [0..1]: multiplicity set at pre-compile, origin=RB:15.1.0:2020-04-30, set at pre-compile  # Rb_AuxReadBlock function name | [BSW_SWCS_AR_NVRAMManager_Ext-2914] Name of the function to be called in the body of NvM_Rb_AuxReadBlock instead of NvM's own implementation (which is available as NvM_Rb_AuxReadBlockBase if this parameter is set).
        function name NvMRbAuxSetDataIndex [0..1]: multiplicity set at pre-compile, origin=RB:18.0.0:2021-07-31, set at pre-compile  # Rb_AuxSetDataIndex function name | [BSW_SWCS_AR_NVRAMManager_Ext-2914] Name of the function to be called in the body of NvM_Rb_AuxSetDataIndex instead of NvM's own implementation (which is available as NvM_Rb_AuxSetDataIndexBase if this parameter is set).
        function name NvMRbAuxWriteBlock [0..1]: multiplicity set at pre-compile, origin=RB:15.1.0:2020-04-30, set at pre-compile  # Rb_AuxWriteBlock function name | [BSW_SWCS_AR_NVRAMManager_Ext-2914] Name of the function to be called in the body of NvM_Rb_AuxWriteBlock instead of NvM's own implementation (which is available as NvM_Rb_AuxWriteBlockBase if this parameter is set).
        function name NvMRbCancelWriteAll [0..1]: multiplicity set at pre-compile, origin=RB:15.1.0:2020-04-30, set at pre-compile  # CancelWriteAll function name | [BSW_SWCS_AR_NVRAMManager_Ext-2914] Name of the function to be called in the body of NvM_CancelWriteAll instead of NvM's own implementation (which is available as NvM_Rb_CancelWriteAllBase if this parameter is set).
        function name NvMRbEraseNvBlock [0..1]: multiplicity set at pre-compile, origin=RB:6.1.0:2015-10-31, set at pre-compile  # EraseNvBlock function name | [BSW_SWCS_AR_NVRAMManager_Ext-2914] Name of the function to be called in the body of NvM_EraseNvBlock instead of NvM's own implementation (which is available as NvM_Rb_EraseNvBlockBase if this parameter is set).
        function name NvMRbFirstInitAll [0..1]: multiplicity set at pre-compile, origin=RB:15.1.0:2020-04-30, set at pre-compile  # Rb_FirstInitAll function name | [BSW_SWCS_AR_NVRAMManager_Ext-2914] Name of the function to be called in the body of NvM_Rb_FirstInitAll instead of NvM's own implementation (which is available as NvM_Rb_FirstInitAllBase if this parameter is set).
        function name NvMRbGetErrorStatus [0..1]: multiplicity set at pre-compile, origin=RB:19.1.0:2022-02-10, set at pre-compile  # GetErrorStatus function name | [BSW_SWS_AR_NVRAMManager_Ext-2914] Name of the function to be called in the body of NvM_GetErrorStatus instead of NvM's own implementation (which is available as NvM_Rb_GetErrorStatusBase if this parameter is set).
        function name NvMRbInvalidateNvBlock [0..1]: multiplicity set at pre-compile, origin=RB:6.1.0:2015-10-31, set at pre-compile  # InvalidateNvBlock function name | [BSW_SWCS_AR_NVRAMManager_Ext-2914] Name of the function to be called in the body of NvM_InvalidateNvBlock instead of NvM's own implementation (which is available as NvM_Rb_InvalidateNvBlockBase if this parameter is set).
        function name NvMRbReadAll [0..1]: multiplicity set at pre-compile, origin=RB:6.1.0:2015-10-31, set at pre-compile  # ReadAll function name | [BSW_SWCS_AR_NVRAMManager_Ext-2914] Name of the function to be called in the body of NvM_ReadAll instead of NvM's own implementation (which is available as NvM_Rb_ReadAllBase if this parameter is set).
        function name NvMRbReadBlock [0..1]: multiplicity set at pre-compile, origin=RB:6.1.0:2015-10-31, set at pre-compile  # ReadBlock function name | [BSW_SWCS_AR_NVRAMManager_Ext-2914] Name of the function to be called in the body of NvM_ReadBlock instead of NvM's own implementation (which is available as NvM_Rb_ReadBlockBase if this parameter is set).
        function name NvMRbReadPRamBlock [0..1]: multiplicity set at pre-compile, origin=RB:16.0.0:2020-07-31, set at pre-compile  # ReadPRamBlock function name | [BSW_SWCS_AR_NVRAMManager_Ext-2914] Name of the function to be called in the body of NvM_ReadPRAMBlock instead of NvM's own implementation (which is available as NvM_Rb_ReadPRAMBlockBase if this parameter is set).
        function name NvMRbRestoreBlockDefaults [0..1]: multiplicity set at pre-compile, origin=RB:6.1.0:2015-10-31, set at pre-compile  # RestoreBlockDefaults function name | [BSW_SWCS_AR_NVRAMManager_Ext-2914] Name of the function to be called in the body of NvM_RestoreBlockDefaults instead of NvM's own implementation (which is available as NvM_Rb_RestoreBlockDefaultsBase if this parameter is set).
        function name NvMRbRestorePRamBlockDefaults [0..1]: multiplicity set at pre-compile, origin=RB:16.0.0:2020-07-31, set at pre-compile  # RestorePRamBlockDefaults function name | [BSW_SWCS_AR_NVRAMManager_Ext-2914] Name of the function to be called in the body of NvM_RestorePRAMBlockDefaults instead of NvM's own implementation (which is available as NvM_Rb_RestorePRAMBlockDefaultsBase if this parameter is set).
        function name NvMRbSetBlockLockStatus [0..1]: multiplicity set at pre-compile, origin=RB:18.0.0:2021-07-31, set at pre-compile  # SetBlockLockStatus function name | [BSW_SWCS_AR_NVRAMManager_Ext-2914] Name of the function to be called in the body of NvM_SetBlockLockStatus instead of NvM's own implementation (which is available as NvM_Rb_SetBlockLockStatusBase if this parameter is set).
        function name NvMRbSetBlockProtection [0..1]: multiplicity set at pre-compile, origin=RB:18.0.0:2021-07-31, set at pre-compile  # SetBlockProtection function name | [BSW_SWCS_AR_NVRAMManager_Ext-2914] Name of the function to be called in the body of NvM_SetBlockProtection instead of NvM's own implementation (which is available as NvM_Rb_SetBlockProtectionBase if this parameter is set).
        function name NvMRbSetDataIndex [0..1]: multiplicity set at pre-compile, origin=RB:18.0.0:2021-07-31, set at pre-compile  # SetDataIndex function name | [BSW_SWCS_AR_NVRAMManager_Ext-2914] Name of the function to be called in the body of NvM_SetDataIndex instead of NvM's own implementation (which is available as NvM_Rb_SetDataIndexBase if this parameter is set).
        function name NvMRbSetRamBlockStatus [0..1]: multiplicity set at pre-compile, origin=RB:18.0.0:2021-07-31, set at pre-compile  # SetRamBlockStatus function name | [BSW_SWCS_AR_NVRAMManager_Ext-2914] Name of the function to be called in the body of NvM_SetRamBlockStatus instead of NvM's own implementation (which is available as NvM_Rb_SetRamBlockStatusBase if this parameter is set).
        function name NvMRbSetWriteAllTrigger [0..1]: multiplicity set at pre-compile, origin=RB:18.0.0:2021-07-31, set at pre-compile  # Rb_SetWriteAllTrigger function name | [BSW_SWCS_AR_NVRAMManager_Ext-2914] Name of the function to be called in the body of NvM_Rb_SetWriteAllTrigger instead of NvM's own implementation (which is available as NvM_Rb_SetWriteAllTriggerBase if this parameter is set).
        function name NvMRbValidateAll [0..1]: multiplicity set at pre-compile, origin=RB:15.1.0:2020-04-30, set at pre-compile  # ValidateAll function name | [BSW_SWCS_AR_NVRAMManager_Ext-2914] Name of the function to be called in the body of NvM_Rb_ValidateAll instead of NvM's own implementation (which is available as NvM_Rb_ValidateAllBase if this parameter is set).
        function name NvMRbWriteAll [0..1]: multiplicity set at pre-compile, origin=RB:6.1.0:2015-10-31, set at pre-compile  # WriteAll function name | [BSW_SWCS_AR_NVRAMManager_Ext-2914] Name of the function to be called in the body of NvM_WriteAll instead of NvM's own implementation (which is available as NvM_Rb_WriteAllBase if this parameter is set).
        function name NvMRbWriteBlock [0..1]: multiplicity set at pre-compile, origin=RB:6.1.0:2015-10-31, set at pre-compile  # WriteBlock function name | [BSW_SWCS_AR_NVRAMManager_Ext-2914] Name of the function to be called in the body of NvM_WriteBlock instead of NvM's own implementation (which is available as NvM_Rb_WriteBlockBase if this parameter is set).
        function name NvMRbWritePRamBlock [0..1]: multiplicity set at pre-compile, origin=RB:16.0.0:2020-07-31, set at pre-compile  # WritePRamBlock function name | [BSW_SWCS_AR_NVRAMManager_Ext-2914] Name of the function to be called in the body of NvM_WritePRAMBlock instead of NvM's own implementation (which is available as NvM_Rb_WritePRAMBlockBase if this parameter is set).
      container NvMRbDeviceProperty [0..254]: multiplicity set at pre-compile  # Memory devices | [BSW_SWCS_AR_NVRAMManager_Ext-3463] Container for a management structure to configure a memory device.
        boolean NvMRbEnableHighSpeedMode: multiplicity set at pre-compile, origin=RB:22.0.0:2023-07-31, set at pre-compile  # High-speed-mode | [BSW_SWCS_AR_NVRAMManager_Ext-3464] Defines whether the corresponding NVRAM device shall store NVRAM blocks with immediate priority in high-speed-mode.
        integer NvMRbNvramDeviceId: 0..254, multiplicity set at pre-compile, origin=RB:22.0.0:2023-07-31, set at pre-compile  # Memory device ID | [BSW_SWCS_AR_NVRAMManager_Ext-3465] Defines the NVRAM device ID for which properties in this container are defined.
      container NvMRbEaDevices [0..1]: multiplicity set at pre-compile  # Ea Devices | [BSW_SWCS_AR_NVRAMManager_Ext-3316] Container for device IDs to address Ea devices.
        integer NvMRbEaDeviceId [0..1]: 1..254, multiplicity set at pre-compile, origin=RB:17.1.0:2021-03-31, set at pre-compile  # Device ID to address Ea device | [BSW_SWCS_AR_NVRAMManager_Ext-3314] Identification of the device to address Ea. Attention: If a NVRAM block shall be located on the Ea device identified by this parameter then the parameter NvMNvramDeviceId of this NVRAM block shall be equal to the value defined here. Attention: Device ID 0 is fixed to address Fee. So device ID 0 cannot be used for Ea devices.
    container NvMRbRamInitAddSavedZone [0..65535]: multiplicity set at pre-compile  # RAM Init - Additional SavedZone Names | [BSW_SWCS_AR_NVRAMManager_Ext-3441] Container for the reference from NvMRbRamInitAddSavedZoneNameRef. For each additional SAVEDZONE a container can be added. (see also NvMRbRamInitAddSavedZoneNameRef)
      string NvMRbRamInitAddSavedZoneName: multiplicity set at pre-compile, origin=RB:20.1.0:2022-07-12, set at pre-compile  # RAM Init - additional savedzone name extension | [BSW_SWCS_AR_NVRAMManager_Ext-3443] For the additional reset marker the pragma NVM_{START/STOP}_SEC_VAR_SAVED_ZONE_<NvMRbRamInitAddSavedZoneName>_32 is used. This parameter NvMRbRamInitAddSavedZoneName is used as {refinement} as defined for the SEC_VAR_SAVED_ZONE in the AUTOSAR_SWS_MemoryMapping. (see also NvMRbRamInitAddSavedZoneNameRef)
    container NvmDemEventParameterRefs [0..0]  # Dem event parameter references | [ECUC_NvM_00541] Container for the references to DemEventParameter elements which are invoked using the Dem_ReportErrorStatus API in case the corresponding error occurs. Dem events are not supported by NvM. So, this entire container shall not be provided.
      symbolic name reference NVM_E_INTEGRITY_FAILED [0..0]: set at pre-compile, destination=DemEventParameter  # Dem event "integrity failed" | [ECUC_NvM_00542] Reference to the DemEventParameter which is invoked using the Dem_ReportErrorStatus API in case an inconsistent block is encountered on the memory media. Dem events are not supported by NvM. So, this reference shall not be provided.
      symbolic name reference NVM_E_LOSS_OF_REDUNDANCY [0..0]: set at pre-compile, destination=DemEventParameter  # Dem event "loss of redundancy" | [ECUC_NvM_00546] Reference to the DemEventParameter which is invoked using the Dem_ReportErrorStatus API in case a loss of redundancy is detected. Dem events are not supported by NvM. So, this reference shall not be provided.
      symbolic name reference NVM_E_QUEUE_OVERFLOW [0..0]: set at pre-compile, destination=DemEventParameter  # Dem event "queue overflow" | [ECUC_NvM_00547] Reference to the DemEventParameter which is invoked using the Dem_ReportErrorStatus API in case a queue overflow occurs. Dem events are not supported by NvM. So, this reference shall not be provided.
      symbolic name reference NVM_E_REQ_FAILED [0..0]: set at pre-compile, destination=DemEventParameter  # Dem event "request failed" | [ECUC_NvM_00543] Reference to the DemEventParameter which is invoked using the Dem_ReportErrorStatus API in case a request fails. Dem events are not supported by NvM. So, this reference shall not be provided.
      symbolic name reference NVM_E_VERIFY_FAILED [0..0]: set at pre-compile, destination=DemEventParameter  # Dem event "verify failed" | [ECUC_NvM_00545] Reference to the DemEventParameter which is invoked using the Dem_ReportErrorStatus API in case a verify operation fails. Dem events are not supported by NvM. So, this reference shall not be provided.
      symbolic name reference NVM_E_WRITE_PROTECTED [0..0]: set at pre-compile, destination=DemEventParameter  # Dem event "write protected" | [ECUC_NvM_00548] Reference to the DemEventParameter which is invoked using the Dem_ReportErrorStatus API in case a write operation to a write protected block is encountered. Dem events are not supported by NvM. So, this reference shall not be provided.
      symbolic name reference NVM_E_WRONG_BLOCK_ID [0..0]: set at pre-compile, destination=DemEventParameter  # Dem event "wrong block ID" | [ECUC_NvM_00544] Reference to the DemEventParameter which is invoked using the Dem_ReportErrorStatus API in case a static block ID check fails. Dem events are not supported by NvM. So, this reference shall not be provided.
