AUTOSAR XML (schema 00048)
package /AUTOSAR_LinSM/EcucModuleDefs
  module definition LinSM [0..1]: category=VENDOR_SPECIFIC_MODULE_DEFINITION, post-build-variant-support=true, refined-module-def=LinSM, variants pre-compile  # Configuration of the Lin State Manager module(with vendor specific enhancements of RB).
    container LinSMConfigSet  # This container contains the configuration parameters and sub containers of the AUTOSAR LinSm module.
      integer LinSMModeRequestRepetitionMax: 0..255, origin=RB:2019-09-09, post-build-variant-value=true, set at pre-compile  # Specifies the maximal amount of mode request repetitions without a respective mode indication from the LinIf module until the LinSM module reports a Runtime Error to the Det and tries to go back to no communication.
      container LinSMChannel [1..*]: multiplicity set at pre-compile  # Describes each LIN channel the LinSM is connected to.
        float LinSMConfirmationTimeout: 0..INF, set at pre-compile  # Timeout in seconds for the goto sleep, wakeup and schedule request calls to LinIf. The timeout must be longer than a goto-sleep command on the bus (i.e. it is bit rate dependent).
        boolean LinSMEnableScheduleTableQueue [0..1]: multiplicity set at pre-compile, origin=RB:2016-03-15, set at pre-compile, default-value=false  # This parameter enables or disables of queue Handling for Run Once Schedule table per channel.
        integer LinSMMaxQUEUESize [0..1]: 1..255, multiplicity set at pre-compile, origin=RB:2016-03-16, set at pre-compile  # This parameter holds the Maximum queue size
        enumeration LinSMNodeType: {MASTER, SLAVE}, set at pre-compile  # Specifies the LIN node type of this channel.
        float LinSMSilenceAfterWakeupTimeout [0..1]: 0..INF, set at link in variant link-time+post-build / pre-compile in variant pre-compile  # Timeout in seconds after a failed wakeup sequence until a new wakeup process is started
        boolean LinSMTransceiverPassiveMode [0..1]: multiplicity set at pre-compile, set at pre-compile  # Selects STANDBY (true) or SLEEP (false) transceiver mode when entering LINSM_NO_COM.
        integer LinSmNetworkIndex: 0..255, origin=RB:2016-09-21, set at pre-compile, symbolic-name-value=true, with-auto=true  # This parameter holds the unique channel index value. The value shall be the same as the ComMChannelId of the ComMChannel referenced by LinSMComMNetworkHandleRef. Implementation Type: NetworkHandleType
        reference LinSMChannelIndex: origin=RB:2016-09-23, set at pre-compile, requires-symbolic-name-value=true, destination=LinIfChannel  # Index of the controller. To be able to interface to the correct hw.
        reference LinSMComMNetworkHandleRef: set at pre-compile, requires-symbolic-name-value=true, destination=ComMChannel  # Unique handle to identify one certain LIN network. Reference to one of the network handles configured in the ComM.
        container LinSMSchedule [1..*]: multiplicity set at pre-compile  # The schedule references to a schedule that is located in the LinIf configuration. Moreover, the PDU groups are located in the COM configuration. Note that there are two references to PDU groups. The simple reason is that a PDU group is only allowed to contain one direction (TX or RX). | Only applicable to LIN master nodes.As slave node is not yet supported, atleast one schedule should be configured in all nodes.
          integer LinSMScheduleIndex: 0..255, set at pre-compile, symbolic-name-value=true  # This index parameter can be used by the BswM as a SymbolicNameReference target. The LinSM just forwards the request from the BswM to LinIf. Note that the value of the LinSMScheduleIndex shall be the same as the value from the LinIf.
          integer LinSMScheduleTablePriority [0..1]: 1..255, multiplicity set at pre-compile, origin=RB:2016-03-15, set at pre-compile  # This parameter holds the priority of each schedule table
          reference LinSMScheduleIndexRef: post-build-variant-value=true, set at link in variant link-time / post-build in variant post-build / pre-compile in variant pre-compile, requires-symbolic-name-value=true, destination=LinIfScheduleTable  # Reference to a schedule table in the LinIf configuration
    container LinSMGeneral  # This container contains general parameters of LIN State Manager module.
      boolean LinSMDevErrorDetect: set at pre-compile, default-value=false  # Switches the development error detection and notification on or off. | * true: detection and notification is enabled. * false: detection and notification is disabled.
      float LinSMMainProcessingPeriod: 0..INF, set at pre-compile  # Fixed period that the MainFunction shall be called.
      boolean LinSMVersionInfoApi: set at pre-compile, default-value=false  # Switches the LinSM_GetVersionInfo function ON or OFF.
