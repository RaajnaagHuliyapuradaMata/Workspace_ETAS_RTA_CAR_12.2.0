AUTOSAR XML (schema 00051)
package /RTE
  module config Rte
    RteBswGeneral: RteSchMVersionInfoApi=0, RteUseComShadowSignalApi=0
    RteGeneration:
      RteBypassSupport = NONE
      RteCalibrationSupport = NONE
      RteCodeVendorId = 11
      RteDevErrorDetect = 0
      RteDevErrorDetectUninit = 0
      RteGenerationMode = COMPATIBILITY_MODE
      RteInExclusiveAreaCheckEnabled = 1
      RteMeasurementSupport = 0
      RteOptimizationMode = RUNTIME
      RteValueRangeCheckEnabled = 0
      RteVfbTraceAnonymousClientEnabled = 0
      RteVfbTraceEnabled = 0
    NoneSectionPolicies (RteInitializationBehavior): RteInitializationStrategy=RTE_INITIALIZATION_STRATEGY_NONE, RteSectionInitializationPolicy=NO-INIT
    RteOsInteraction
    DataDeclarationSectionPolicies (RteInitializationBehavior):
      RteInitializationStrategy = RTE_INITIALIZATION_STRATEGY_AT_DATA_DECLARATION
      RteSectionInitializationPolicy = INIT
      RteSectionInitializationPolicy = CLEARED
    RteStartSectionPolicies (RteInitializationBehavior):
      RteInitializationStrategy = RTE_INITIALIZATION_STRATEGY_AT_RTE_START_AND_PARTITION_RESTART
      RteSectionInitializationPolicy = POWER-ON-INIT
      RteSectionInitializationPolicy = POWER-ON-CLEARED
    CPT_MyReceivingSWC_ApplicationEcu (RteSwComponentInstance): RteSoftwareComponentInstanceRef=CPT_MyReceivingSWC_ApplicationEcu
      TE_RX (RteEventToTaskMapping): RtePositionInTask=1, RteImmediateRestart=0, RteActivationOffset=0.0, RteMappedToTaskRef=OsTask_ASW, RteEventRef=TE_RX
    CPT_MyTransmittingSWC_ApplicationEcu (RteSwComponentInstance): RteSoftwareComponentInstanceRef=CPT_MyTransmittingSWC_ApplicationEcu
      TE_TX (RteEventToTaskMapping): RtePositionInTask=2, RteImmediateRestart=0, RteActivationOffset=0.0, RteMappedToTaskRef=OsTask_ASW, RteEventRef=TE_TX
    6 x RteBswModuleInstance:
      ComM: RteBswImplementationRef=ComM
        EV_SE_MainFunction_Can_Network_Channel_Can_Network (RteBswEventToTaskMapping):
          RteBswPositionInTask = 7
          RteImmediateRestart = 0
          RteBswActivationOffset = 0.0
          RteBswMappedToTaskRef = OsTask_BSW
          RteBswEventRef = EV_SE_MainFunction_Can_Network_Channel_Can_Network
      BSWIMPL_Can: RteBswImplementationRef=BSWIMPL_Can
        4 x RteBswEventToTaskMapping, all with RteImmediateRestart=0, RteBswActivationOffset=0.0, RteBswMappedToTaskRef=OsTask_BSW:
          BSWTE_MainFunction_Mode: RteBswPositionInTask=6, RteBswEventRef=BSWTE_MainFunction_Mode
          BSWTE_MainFunction_BusOff: RteBswPositionInTask=12, RteBswEventRef=BSWTE_MainFunction_BusOff
          BSWTE_MainFunction_Read: RteBswPositionInTask=5, RteBswEventRef=BSWTE_MainFunction_Read
          BSWTE_MainFunction_Write: RteBswPositionInTask=8, RteBswEventRef=BSWTE_MainFunction_Write
      CanSM: RteBswImplementationRef=CanSM
        EV_SE_MainFunction (RteBswEventToTaskMapping): RteBswPositionInTask=9, RteImmediateRestart=0, RteBswActivationOffset=0.0, RteBswMappedToTaskRef=OsTask_BSW, RteBswEventRef=EV_SE_MainFunction
      BSWIMPL_BswM: RteBswImplementationRef=BSWIMPL_BswM
        7 x RteBswEventToTaskMapping:
          TE_BswM_MainFunction: RteBswPositionInTask=11, RteImmediateRestart=0, RteBswActivationOffset=0.0, RteBswMappedToTaskRef=OsTask_BSW, RteBswEventRef=TE_BswM_MainFunction
          MSE_BswM_Cfg_ImdtBswNotification_BswM_MRP_BswM_MDG_ECUM_STATE_APP_POST_RUN: RteBswEventRef=MSE_BswM_Cfg_ImdtBswNotification_BswM_MRP_BswM_MDG_ECUM_STATE_APP_POST_RUN
          MSE_BswM_Cfg_ImdtBswNotification_BswM_MRP_BswM_MDG_ECUM_STATE_APP_RUN: RteBswEventRef=MSE_BswM_Cfg_ImdtBswNotification_BswM_MRP_BswM_MDG_ECUM_STATE_APP_RUN
          MSE_BswM_Cfg_ImdtBswNotification_BswM_MRP_BswM_MDG_ECUM_STATE_PREP_SHUTDOWN: RteBswEventRef=MSE_BswM_Cfg_ImdtBswNotification_BswM_MRP_BswM_MDG_ECUM_STATE_PREP_SHUTDOWN
          MSE_BswM_Cfg_ImdtBswNotification_BswM_MRP_BswM_MDG_ECUM_STATE_RUN: RteBswEventRef=MSE_BswM_Cfg_ImdtBswNotification_BswM_MRP_BswM_MDG_ECUM_STATE_RUN
          MSE_BswM_Cfg_ImdtBswNotification_BswM_MRP_BswM_MDG_ECUM_STATE_STARTUP_ONE: RteBswEventRef=MSE_BswM_Cfg_ImdtBswNotification_BswM_MRP_BswM_MDG_ECUM_STATE_STARTUP_ONE
          MSE_BswM_Cfg_ImdtBswNotification_BswM_MRP_BswM_MDG_ECUM_STATE_STARTUP_TWO: RteBswEventRef=MSE_BswM_Cfg_ImdtBswNotification_BswM_MRP_BswM_MDG_ECUM_STATE_STARTUP_TWO
      EcuM: RteBswImplementationRef=EcuM
        TE_EcuM_MainFunction (RteBswEventToTaskMapping): RteBswPositionInTask=10, RteImmediateRestart=0, RteBswActivationOffset=0.0, RteBswMappedToTaskRef=OsTask_BSW, RteBswEventRef=TE_EcuM_MainFunction
      Com: RteBswImplementationRef=Com
        EV_SE_MainFunctionTx_ComMainFunctionTx (RteBswEventToTaskMapping):
          RteBswPositionInTask = 3
          RteImmediateRestart = 0
          RteBswActivationOffset = 0.0
          RteBswMappedToTaskRef = OsTask_BSW
          RteBswEventRef = EV_SE_MainFunctionTx_ComMainFunctionTx
        EV_SE_MainFunctionRx_ComMainFunctionRx (RteBswEventToTaskMapping):
          RteBswPositionInTask = 4
          RteImmediateRestart = 0
          RteBswActivationOffset = 0.0
          RteBswMappedToTaskRef = OsTask_BSW
          RteBswEventRef = EV_SE_MainFunctionRx_ComMainFunctionRx
    CPT_BswM (RteSwComponentInstance): RteSoftwareComponentInstanceRef=CPT_BswM
      MSE_BswM_Cfg_DfrdSwcNotification_BswM_MRP_SwcModeRequest_SHUT_DOWN (RteEventToTaskMapping): RteEventRef=MSE_BswM_Cfg_DfrdSwcNotification_BswM_MRP_SwcModeRequest_SHUT_DOWN
      OPIE_BswMSwcGenericRequest_Server (RteEventToTaskMapping): RteEventRef=OPIE_BswMSwcGenericRequest_Server
    CPT_EcuM (RteSwComponentInstance): RteSoftwareComponentInstanceRef=CPT_EcuM
      7 x RteEventToTaskMapping:
        OIE_GetBootTarget: RteEventRef=OIE_GetBootTarget
        OIE_GetLastShutdownTarget: RteEventRef=OIE_GetLastShutdownTarget
        OIE_GetShutdownCause: RteEventRef=OIE_GetShutdownCause
        OIE_GetShutdownTarget: RteEventRef=OIE_GetShutdownTarget
        OIE_SelectBootTarget: RteEventRef=OIE_SelectBootTarget
        OIE_SelectShutdownCause: RteEventRef=OIE_SelectShutdownCause
        OIE_SelectShutdownTarget: RteEventRef=OIE_SelectShutdownTarget
    NvM (RteBswModuleInstance): RteBswImplementationRef=NvM
      EV_SE_MainFunction (RteBswEventToTaskMapping): RteBswPositionInTask=1, RteImmediateRestart=0, RteBswActivationOffset=0.0, RteBswMappedToTaskRef=OsTask_BSW, RteBswEventRef=EV_SE_MainFunction
    MemIf (RteBswModuleInstance): RteBswImplementationRef=MemIf
      EV_MemIf_Rb_MainFunction (RteBswEventToTaskMapping): RteBswPositionInTask=2, RteImmediateRestart=0, RteBswActivationOffset=0.0, RteBswMappedToTaskRef=OsTask_BSW, RteBswEventRef=EV_MemIf_Rb_MainFunction
