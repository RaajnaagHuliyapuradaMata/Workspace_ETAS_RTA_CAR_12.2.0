AUTOSAR XML (schema 00048)
package /AUTOSAR_Dem/EcucModuleDefs
  module definition Dem: category=VENDOR_SPECIFIC_MODULE_DEFINITION, refined-module-def=Dem  # Configuration of the Dem (Diagnostic Event Manager) module.
    container DemConfigSet  # This container contains the configuration parameters and sub containers of the Dem module supporting multiple configuration sets.
      container DemComponent  # This container configures the monitored components and system dependencies.
        integer DemRbComponentAllowedRecoveries [0..1]: 0..255, multiplicity set at pre-compile, origin=RB:AR40.4.0.0:2012-06-01, set at pre-compile, default-value=255  # Number of allowed recoveries at a component during one ignition cycle. To limit system toggeling for unrobust monitorings.
        boolean DemRbResetPerformedRecoveriesValue [0..1]: multiplicity set at pre-compile, origin=RB:45.2.0.0:2021-12-07, set at pre-compile, default-value=false  # Performed recoveries counter of a DemComponent will be reset on the operation cycle change. Hint: "DemRbComponentAllowedRecoveries" controls whether a component might be recovered (event reports PASSED). Related config parameter "DemRbSupportRecoveryLimitation" must be turned on.
      container DemDTC  # This container contains the configuration (parameters) for DemUdsDTC.
        integer DemRbAlternativeDTC [0..1]: 1..16777214, multiplicity set at pre-compile, origin=RB:AR40.8.0.0:2014-01-27, set at pre-compile  # Alternative Diagnostic Trouble Code value | (Range: 0x000000 and 0xFFFFFF are reserved for DTC groups by ISO 14229-1)
      container DemDebounceCounterBasedClass  # This container contains the configuration of Debounce Counter Based Class
        integer DemRbDebounceCounterDecrementStepSizeAlternative [0..1]: 1..32768, multiplicity set at pre-compile, origin=RB:AR40.6.0.0:2013-06-01, set at pre-compile  # Defines alternative step size for decrementation of the internal fault detection counter (PREPASSED) (e.g. for plant mode software). If the parameter is not configured, the value of "DemDebounceCounterDecrementStepSize" shall be considered.
        integer DemRbDebounceCounterFdcThresholdStorageValue [0..1]: 1..32767, multiplicity set at pre-compile, origin=RB:AR40.11.0.0:2015-11-20, set at pre-compile  # Threshold to allocate an event memory entry and to capture the FreezeFrame.
        integer DemRbDebounceCounterIncrementStepSizeAlternative [0..1]: 1..32767, multiplicity set at pre-compile, origin=RB:AR40.6.0.0:2013-06-01, set at pre-compile  # Defines alternative step size for incrementation of the internal fault detection counter (PREFAILED) (e.g. for plant mode software). If the parameter is not configured, the value of "DemDebounceCounterIncrementStepSize" shall be considered.
        boolean DemRbDebounceCounterJumpDownAlternative [0..1]: multiplicity set at pre-compile, origin=RB:AR40.6.0.0:2013-06-01, set at pre-compile  # Switch for the activation of Jump-Down. true: Jump-Down activated false: Jump-Down deactivated If the parameter is not configured, the value of DemDebounceCounterJumpDown shall be considered.
        integer DemRbDebounceCounterJumpDownValueAlternative [0..1]: -32768..32767, multiplicity set at pre-compile, origin=RB:AR40.6.0.0:2013-06-01, set at pre-compile  # Defines Alternative Jump down value of the internal fault detection counter. If the parameter is not configured, the value of "DemDebounceCounterJumpDownValue" shall be considered.
        boolean DemRbDebounceCounterJumpUpAlternative [0..1]: multiplicity set at pre-compile, origin=RB:AR40.6.0.0:2013-06-01, set at pre-compile  # Switch for the activation of Jump-Up. true: Jump-Up activated false: Jump-Up deactivated If the parameter is not configured, the value of "DemDebounceCounterJumpUp" shall be considered
        integer DemRbDebounceCounterJumpUpValueAlternative [0..1]: -32768..32767, multiplicity set at pre-compile, origin=RB:AR40.6.0.0:2013-06-01, set at pre-compile  # Defines Alternative Jump Up value of the internal fault detection counter. If the parameter is not configured, the value of DemDebounceCounterJumpUpValue shall be considered.
        integer DemRbDebounceCounterSuspiciousThreshold [0..1]: 1..32767, multiplicity set at pre-compile, origin=RB:AR40.11.0.0:2015-10-19, set at pre-compile  # Threshold to indicate the event is suspicious.
        string DemRbShiftView [0..1]: multiplicity set at pre-compile, origin=RB:AR40.6.0.0:2013-07-26, set at pre-compile, regular-expression=[a-zA-Z0-9_]([a-zA-Z0-9\._])*  # This parameter is added for DGS Dem. It specifies where to arrange calibration parameters of the ratioId in asap file (shiftview). DGS DSM creates diagnostic calibration parameters for ratios. If your module has own calibration parameters then give your assigned function name in a2l-file and DGS-DSM will shift the diagnostic calibration parameters to this a2l function. Otherwise define a function name for the diagnostic calibration, only.
      container DemDebounceTimeBaseClass  # This container contains the configuration of Debounce Time Based Class.
        float DemRbDebounceTimeSuspiciousThreshold [0..1]: 0.001..3600, multiplicity set at pre-compile, origin=RB:AR40.11.0.0:2015-10-19, set at pre-compile  # Threshold to indicate the event is suspicious.
        string DemRbShiftView [0..1]: multiplicity set at pre-compile, origin=RB:AR40.6.0.0:2013-07-26, set at pre-compile, regular-expression=[a-zA-Z0-9_]([a-zA-Z0-9\._])*  # This parameter is added for DGS Dem. It specifies where to arrange calibration parameters of the ratioId in asap file (shiftview). DGS DSM creates diagnostic calibration parameters for ratios. If your module has own calibration parameters then give your assigned function name in a2l-file and DGS-DSM will shift the diagnostic calibration parameters to this a2l function. Otherwise define a function name for the diagnostic calibration, only.
      container DemEventParameter  # This container contains the configuration (parameters) for events.
        string DemRbEventDescription [0..1]: multiplicity set at pre-compile, origin=RB:AR40.4.0.0:2012-06-01, set at pre-compile  # The purpose of the specified event shall be described.
        choice container DemDebounceAlgorithmClass  # Debounce algorithm class: counter based, time based, or monitor internal.
          container DemDebounceMonitorInternal  # This container contains the configuration (parameters) for monitor internal debouncing.
            container DemCallbackGetFDC  # DemCallbackGetFDC specifies the callback (parameter DemCallbackGetFDCFnc is present) or R-Port (no parameter DemCallbackGetFDCFnc is present) to retrieve the fault detection counter value. | In case no container is configured, no fault detection counter will be available.
              boolean DemRbGeneralCallbackGetFDCFncUsed [0..1]: multiplicity set at pre-compile, origin=RB:AR40.7.0.0:2013-07-24, set at pre-compile, default-value=false  # If configured to TRUE, the global callback has to be configured under DemGeneral/demRbGeneral/demRbGlobalCallbackGetFaultDetectionCounter. General function name used for "GetFaultDetectionCounter".
        container DemIndicatorAttribute  # This container contains the event specific configuration of Indicators.
          boolean DemRbIndicatorApiControl [0..1]: multiplicity set at pre-compile, origin=RB:AR40.4.8.0:2014-07-31, set at pre-compile, default-value=false  # This configuration switch defines whether the indicator state is controlled using the API Dem_SetIndicatorStatusForEvent, according to DemIndicatorBehaviour
        container DemRbDoc [0..1]: multiplicity set at pre-compile  # Documentation | This container contains the documentation for the Event.
          add info DemRbDocFailedCriteria: origin=RB:AR40.8.0.0:2014-06-10, set at pre-compile  # Failure detection criteria | Verbal description of the recognition method for the FAILED/PREFAILED status, i.e. how it is detected that a failure is present. If applicable, describe what limit values or thresholds are used. If several alternative strategies are implemented, all of them shall be described.
          add info DemRbDocFailedDebouncing: origin=RB:AR40.8.0.0:2014-06-10, set at pre-compile  # Monitoring-internal failure debouncing | This shall describe how long or how often the failure detection criteria has to be detected before the FAILED/PREFAILED status is reported to the Dem. Note: Describe monitoring-internal debouncing only. If no monitoring-internal debouncing is implemented, then enter an empty paragraph.
          add info DemRbDocFaultReaction: origin=RB:AR40.8.0.0:2014-06-10, set at pre-compile  # Monitoring-internal fault reaction | Describe what further actions are triggered in case of a failure besides the reporting to the Dem. Note: Do not describe FiM-related failure reactions. If no failure reactions are triggered, enter an empty paragraph.
          add info DemRbDocPassedCriteria: origin=RB:AR40.8.0.0:2014-06-10, set at pre-compile  # Passed detection criteria | Verbal description of the recognition method for the PASSED/PREPASSED status, i.e. how it is detected that no failure is present. If applicable, describe what limit values or thresholds are used. If several alternative strategies are implemented, all of them shall be described.
          add info DemRbDocPassedDebouncing: origin=RB:AR40.8.0.0:2014-06-10, set at pre-compile  # Monitoring-internal passed debouncing | This shall describe how long or how often the passed detection criteria has to be detected before the PASSED/PREPASSED status is reported to the Dem. Note: Describe monitoring-internal debouncing only. If no monitoring-internal debouncing is implemented, then enter an empty paragraph.
          add info DemRbDocTestPrecondition: origin=RB:AR40.8.0.0:2014-06-10, set at pre-compile  # Monitoring-internal enable condition | Under which preconditions does a test take place? Note: Describe monitoring-internal preconditions only (not Dem-configured enable conditions). If no monitoring-internal precondition is implemented, then enter an empty paragraph.
          container DemRbFDoc [0..*]: multiplicity set at pre-compile  # Formalized description | This container contains the formalized documentation of the monitoring reporting this Dem event. If a (PRE)PASSED/(PRE)FAILED status can be detected in multiple ways, create one container instance for each way.
            enumeration DemRbFDocApplObdLaw: origin=RB:AR40.8.0.0:2014-06-10, set at pre-compile  # OBD law reference | Filling out this element is needed for legally required events. If the event is not legally required, please select "none". For further information contact your local legislation expert.
              none
              e13_CCR_P_1968_2  # 13 CCR ÃÂ§ 1968.2
              e13_CCR_P_1971_1  # 13 CCR ÃÂ§ 1971.1
              e70_220_EEC_ECE_R83  # EU 70/220/EEC, ECE R83
              EU_595_2009_EC_ECE_R49  # EU 595/2009/EC, ECE R49
              other
            string DemRbFDocApplObdLawOther [0..1]: multiplicity set at pre-compile, origin=RB:AR40.8.0.0:2014-06-10, set at pre-compile, regular-expression=[a-zA-Z0-9_]([a-zA-Z0-9\._])*  # OBD law reference other | This element has to be filled out, if 'other' is selected for OBD law reference. For further information contact your local legislation expert.
            string DemRbFDocApplObdLawSection [0..1]: multiplicity set at pre-compile, origin=RB:AR40.8.0.0:2014-06-10, set at pre-compile  # OBD law section | Filling out this element is needed for legally required events. For further information contact your local legislation expert.
            add info DemRbFDocFailedCriterion: origin=RB:AR40.8.0.0:2014-06-10, set at pre-compile  # Failure detection criterion | Formal description of the recognition method for the FAILED/PREFAILED status, i.e. how it is detected that a failure is present. This shall be formulated as an expression based on measurement variables and calibration parameters. If applicable measurement variables and calibration parameters are not available and there is exactly one instance of the formalized description container, then enter an empty paragraph. If applicable measurement variables and calibration parameters are not available and there is more than one instance of the formalized description container, then enter an textual description.
            add info DemRbFDocFailedDebouncing: origin=RB:AR40.8.0.0:2014-06-10, set at pre-compile  # Monitoring-internal failure debouncing | This shall describe how long or how often the failure detection criteria has to be detected before the FAILED/PREFAILED status is reported to the Dem. This shall be formulated as an expression based on measurement variables and calibration parameters. Note: Describe monitoring-internal debouncing only. If no monitoring-internal debouncing is implemented, then enter an empty paragraph.
            string DemRbFDocMonitoredComponentOther [0..1]: multiplicity set at pre-compile, origin=RB:AR40.8.0.0:2014-06-10, set at pre-compile  # Monitored component other | Specification of the monitored component or monitored system, if not included in the list (DemFDocMonitoredComponent).
            add info DemRbFDocMonitoringDeactivation: origin=RB:AR40.8.0.0:2014-06-10, set at pre-compile  # Monitoring deactivation | Typically a simple condition which deactivates the monitoring (at least report to DEM will be suppressed/deactivated). This might e.g. be a monitor-internal, calibratable parameter to deactivate the calculation of the fault detection criterion. The condition does not represent a physical necessity. Also it does not change during ECU runtime. Therefore it is not an enable condition. If no deactivation condition is implemented, then enter an empty paragraph.
            enumeration DemRbFDocMonitoringFrequency: origin=RB:AR40.8.0.0:2014-06-10, set at pre-compile  # Monitoring frequency | Describes how often the monitoring algorithm is calculated. "continuous": does not have a precondition or may only depend on the following preconditions: battery voltage, ignition, altitude, ambient temperature, barometric pressure, can initialization "multiple": uses additional preconditions (besides the ones listed above) but runs always if preconditions are fulfilled. "once per driving cycle": only runs once per driving cycle "once per driving cycle keep alive": only runs during postrun "once per lifetime": only runs once per ecu lifetime
              continuous
              multiple
              once_per_driving_cycle  # once per driving cycle
              once_per_driving_cycle_keep_alive  # once per driving cycle keep alive
              once_per_lifetime  # once per lifetime
            enumeration DemRbFDocMonitoringStrategyComprehensiveComp: origin=RB:AR40.8.0.0:2014-06-10, set at pre-compile  # General monitoring strategy for comprehensive component | General classification of the monitoring strategy for Comprehensive Components according to the definitions of the California Air Ressources Board CARB. In case a "Comprehensive Component" monitoring strategy is selected above please enter here the general monitoring strategy according to CARBs definition. For monitored components other than comprehensive components select "none".
              none
              Input_Open_Circuit  # input open circuit
              Input_Out_of_Range_Low  # input out of range low
              Input_Out_of_Range_High  # input out of range high
              Input_Rationality_Low  # input rationality low
              Input_Rationality_High  # input rationality high
              Input_Other_Rationality  # input other rationality
              Output_Open_Circuit  # output open circuit
              Output_Shorted_Low  # output shorted low
              Output_Shorted_High  # output shorted high
              Output_Functional  # output functional
            string DemRbFDocMonitoringStrategyOther [0..1]: multiplicity set at pre-compile, origin=RB:AR40.8.0.0:2014-06-10, set at pre-compile  # Other Monitoring strategy | Brief description of the basic idea for the fault detection criterion of the monitoring. Only needed if "Monitoring strategy" "other" is selected.
            add info DemRbFDocPassedCriterion: origin=RB:AR40.8.0.0:2014-06-10, set at pre-compile  # Passed detection criterion | Formal description of the recognition method for the PASSED/PREPASSED status, i.e. how it is detected that no failure is present. This shall be formulated as an expression based on measurement variables and calibration parameters. If applicable measurement variables and calibration parameters are not available and there is exactly one instance of the formalized description container, then enter an empty paragraph. If applicable measurement variables and calibration parameters are not available and there is more than one instance of the formalized description container, then enter an textual description.
            add info DemRbFDocPassedDebouncing: origin=RB:AR40.8.0.0:2014-06-10, set at pre-compile  # Monitoring-internal passed debouncing | This shall describe how long or how often the passed detection criteria has to be detected before the PASSED/PREPASSED status is reported to the Dem. This shall be formulated as an expression based on measurement variables and calibration parameters. Note: Describe monitoring-internal debouncing only. If no monitoring-internal debouncing is implemented, then enter an empty paragraph.
            add info DemRbFDocTestPrecondition: origin=RB:AR40.8.0.0:2014-06-10, set at pre-compile  # Test precondition | Describe all atomic conditions which must be fulfilled so that the fault detection criterion can be calculated with a meaningful result. Atomic condition means a single condition such as "battery voltage above minimum". Describe in formal syntax if feasible - otherwise use text. Note: The fault detection criterion shall not be repeated here, neither partly nor completely. Note: Do not repeat a fault detection inactive condition "Monitoring deactivation".
            reference DemRbFDocMonitoredComponent: origin=RB:AR40.8.0.0:2014-06-10, set at pre-compile, destination=DemRbGDocMonitoredComponent  # Monitored component | What is monitored? Select the monitored component or monitored system from the list.
            reference DemRbFDocMonitoringStrategy: origin=RB:AR40.8.0.0:2014-06-10, set at pre-compile, destination=DemRbGDocMonitoringStrategy  # Monitoring strategy | Brief description of the basic idea for the fault detection criterion of the monitoring. Select appropriate value of the monitoring strategy from the list. If none of the values fits, choose "other" and enter description in "Other Monitoring strategy".
        container DemRbEventClass  # This container contains the configuaration (parameters) for EventClass
          string DemRbDgsDfcName [0..1]: multiplicity set at pre-compile, origin=RB:AR40.4.0.0:2012-06-01, set at pre-compile, regular-expression=[a-zA-Z0-9_]([a-zA-Z0-9\._])*  # This parameter is added for DGS Dem. It specifies the legacy DFC (Diagnostic Fault Code) name used in DGS systems.
          boolean DemRbEventStatusBitStorageTestFailed [0..1]: multiplicity set at pre-compile, origin=RB:AR40.4.0.0:2012-06-01, set at pre-compile, default-value=false  # This parameter specifies if the failure of this event (UDS status bit 0 of DTC mapped to the event) is stored to the non-volatile memory over power cycles or not. This setting is only relevant if the global setting DemStatusBitStorageTestFailed is set to FALSE. [NON-AUTOSAR EXTENSION]
          integer DemRbEventUniqueId [0..1]: 0..0xFFFFFFFF, multiplicity set at pre-compile, origin=RB:AR40.7.0.0:2013-11-11, set at pre-compile, symbolic-name-value=true  # This contains a free definable unique id. It is used with the BFM.
          string DemRbShiftView [0..1]: multiplicity set at pre-compile, origin=RB:AR40.6.0.0:2013-07-26, set at pre-compile, regular-expression=[a-zA-Z0-9_]([a-zA-Z0-9\._])*  # Mapping for documentation | Reference to the name of the SW-component calculating the DemEvent. This parameter is added for DGS Dem. It is used in further processing to assign calibration parameters of the considered event, generated during software build in asap file to the calculating SW-component("shiftview"). DGS DSM creates diagnostic calibration parameters for events(= DGS DFCs). If your module has own calibration parameters then give your assigned function name in a2l-file and DGS-DSM will shift the diagnostic calibration parameters to this a2l function. Otherwise define a function name for the diagnostic calibration, only.
          reference DemRbEventCategoryRef [0..1]: multiplicity set at pre-compile, origin=RB:AR40.4.0.0:2012-06-01, set at pre-compile, destination=DemRbEventCategory  # Reference to category of the event [NON-AUTOSAR EXTENSION]
          container DemRbEventCustAttribute [0..*]: multiplicity set at pre-compile  # This container contains the configuration(parameters) for event customer attribute values and reference.
            string DemRbCustAttributeValue: origin=TO_BE_UPDATED, set at pre-compile  # The configuration of the event attributes done by assigning a value
            reference DemRbCustAttributeRef: origin=TO_BE_UPDATED, set at pre-compile, destination=DemRbDefaultEventCustAttribute  # The configuration of the event attribute done by creating a reference
    container DemGeneral  # This container contains the configuration (parameters) of the BSW Dem
      string DemRbHeaderFileInclusion [0..*]: scope=ECU, multiplicity set at pre-compile, set at pre-compile, regular-expression=[a-zA-Z0-9_]([a-zA-Z0-9\._])*  # Name of the header file(s) to be included by the Dem module containing the used C-callback declarations.
      container DemClient: multiplicity set at pre-compile  # This container contains possible clients that are using the Dem APIs.
        integer DemRbClientPriority: 1..255, multiplicity set at pre-compile, origin=RB:AR42.5.0.0:2018-08-29, set at pre-compile  # This parameter defines a unique priority value that a DemClient can have. Lower the value higher the priority.
      choice container DemDataElementClass  # This container contains the configuration (parameters) for an internal/external data element class.
        container DemInternalDataElementClass  # This container contains the configuration (parameters) for an internal data element class.
          function name DemRbDataElementReadFnc [0..1]: multiplicity set at pre-compile, origin=RB:AR40.10.0.0:2015-06-25, set at pre-compile  # Defines the name of the project specific C function "ReadDataElement" which will provide the desired internal data. Please refer to Dem_PrjSpecificInternalData.c_tpl. This parameter must be configured if DemInternalDataElement is configured as DEM_PRJ_SPECIFIC_DATA_ON_RETRIEVE or DEM_PRJ_SPECIFIC_DATA_ON_REPORT. Otherwise it must not be configured.
      container DemEventMemorySet  # This container is a collection of referenced event memories and related information for a Dem client.
        container DemPrimaryMemory  # This container contains the primary event memory specific parameters of the Dem module.
          enumeration DemEventDisplacementStrategy: {DEM_DISPLACEMENT_RBA_FIFO, DEM_DISPLACEMENT_RBA_CUST}  # This configuration switch defines, whether support for event displacement is enabled or not, and which displacement strategy is followed.
        container DemUserDefinedMemory  # This container contains the user defined event memory specific parameters of the Dem module.
          enumeration DemEventDisplacementStrategy: {DEM_DISPLACEMENT_RBA_FIFO, DEM_DISPLACEMENT_RBA_CUST}  # This configuration switch defines, whether support for event displacement is enabled or not, and which displacement strategy is followed.
      container DemGeneralOBD  # This container contains the general OBD-specific configuration (parameters) of the Dem module.
        container DemRbGeneralOBD [0..1]  # This container contains the configuration (parameters) of the BSW Dem. Delete container if OBD is not required.
      container DemNvRamBlockId  # This container contains the configuration (parameters) for a non-volatile memory block, which is used from the Dem. If no permanent storage of event memory entries is required, no block needs to be configured. | The number of blocks which are necessary depends on the implementation and configuration (e.g. number of used event memories) of the Dem module.
        integer DemRbNvRamImmediateStoragePriority [0..1]: -10000..10000, multiplicity set at pre-compile, origin=RB:AR40.14.0.0:2017-02-16, set at pre-compile, default-value=0  # If an immediate storage is triggered (e.g. via Dem_TriggerStorageToNvm()) then the blocks are stored to NvM in the order of decreasing priority. Some blocks must be configured to the highest priority (see documentation). The order between blocks which have the same priority is undefined.
      container DemOperationCycle  # This container holds all parameters that are relevant to configure an operation cycle.
        boolean DemRbIsStartViaApiAllowed [0..1]: scope=ECU, origin=RB:AR42.4.0.0:2018-03-23, set at pre-compile, default-value=false  # DemRbIsAllowedToBeStartedDirectly | Is dependent cycle allowed to be started with Dem_RestartOperationCycle as well. (Only relevant if DemLeadingCycleRef is set)
      container DemRatio  # This container contains the OBD-specific in-use-monitor performance ratio configuration.
        integer DemRbSPNNumber [0..1]: 0..524287, multiplicity set at pre-compile, origin=RB:AR45.4.0.0:2022-12, set at pre-compile  # This parameter defines customer specific SPN number for individual Ratio group.
      container DemRbGDoc [0..1]: multiplicity set at pre-compile  # This container contains the configuration (parameters) of the BSW Dem
        container DemRbGDocMonitoredComponent [1..*]: multiplicity set at pre-compile  # Specify a monitored component or system.
        container DemRbGDocMonitoringStrategy [1..*]: multiplicity set at pre-compile  # Specify a monitoring strategy.
      container DemRbGeneral  # This container contains the configuration (parameters) of the BSW Dem
        function name DemRbAllowDisableDTCSettingCallback [0..1]: multiplicity set at pre-compile, origin=RB:AR40.7.0.0:2014-01-31, set at pre-compile  # Enter the name of a function which indicates whether disabling the DTCSetting for that particular event is allowed or not.If the function returns TRUE the event shall be ignored and if it returns FALSE the function shall be processed.
        boolean DemRbCheckApiConsistency [0..1]: multiplicity set at pre-compile, origin=RB:AR40.11.0.0:2015-12-23, set at pre-compile, default-value=false  # This parameter controls the check done for the consistency of DEM C and RTE APIs [Redundant declaration warnings are expected if the APIs are consistent]. Configured as True -> Consistency of APIs are checked Configured as False -> Consistency of APIs are not checked
        boolean DemRbClearDtcClearsAllBits [0..1]: multiplicity set at pre-compile, origin=RB:AR40.9.0.0:2014-08-20, set at pre-compile, default-value=true  # Control whether clear DTC will clear all the bits of the isobyte. If true is selected behavior is like AR4.0.*, AR4.1.*, AR4.2.1). In case of false the testfailed flag and warning indicator flag won't be cleared.
        boolean DemRbClearProjectExtensionIsClearPendingNotification [0..1]: multiplicity set at pre-compile, origin=RB:AR40.7.0.0:2013-12-01, set at pre-compile, default-value=false  # This configuration switch defines, project specific callback to get the feedback from project if the clear triggered via this API is pending or not, before finish the ClearDTC action
        boolean DemRbCustomizableDTCStatusByte [0..1]: multiplicity set at pre-compile, origin=RB:AR40.9.0.0:2014-08-20, set at pre-compile, default-value=false  # Activate separate calculation of a dtc statusbyte. This allows project specific extensions of the behavior of the dtc statusbyte, without influencing the "failsafe" behavior (e.g. testfailed flag of an event). Costs an additional statusbyte per event. If enabled use template file Dem_CustomStatusByte.h_tpl for projct specific implemenation.
        boolean DemRbDTCSettingBlocksReporting [0..1]: multiplicity set at pre-compile, origin=RB:AR40.9.0.0:2014-08-20, set at pre-compile, default-value=true  # Control whether DTC Setting will block the reporting of eventstatus like enableconditions (AR4.0.*, AR4.1.*, ...) or whether the DTC Setting does not block the reports allowing a system behavior (ISO14229-2013).
        boolean DemRbDataElementLastFailedSinceLastFailedExcludingTNCIncludesFailedCycle [0..1]: multiplicity set at pre-compile, origin=RB:AR40.7.0.0:2013-12-01, set at pre-compile, default-value=true  # Enables/Disables if the counter for the internal data element class DEM_CYCLES_SINCE_LAST_FAILED_EXCLUDING_TNC includes the cycle in which the failed occurred.
        boolean DemRbDebLimitRelevantForJumping [0..1]: multiplicity set at pre-compile, origin=RB:AR40.6.0.0:2013-06-01, set at pre-compile, default-value=false  # If configured to false, the debouncer jump behavior is performed on change of counter direction (as defined by Autosar). If set to true, the debouncer jump behavior is only done when the counter additionally equals the passed/failed limit.
        float DemRbDebounceTimeBasedTaskTime [0..1]: 0..0.1, multiplicity set at pre-compile, origin=RB:AR40.13.0.0:2016-07-25, set at pre-compile  # This parameter allows to configure a different cyclic task time as the base for Timebase Debounce method.If this is configured then Dem_TimeBasedDebounceMainFunction must be scheduled in appropriate cycle task. Please note: This configuration value shall be equal to the value in the Basic Software Scheduler configuration of the RTE module. [RB-Comment] The timebase for this parameter is seconds. | The AUTOSAR configuration standard is to use SI units, so this parameter is defined as float value in seconds. Dem configuration tools must convert this float value to the appropriate value format for the use in the software implementation of Dem. min: A negative value is not allowed. max: After event status was reported, processing shall be completed within 100ms in order to have the fault entry status information updated as soon as possible (e.g. for PID $01). upperMultiplicity: Exactly one TaskTime must be specified per configuration. lowerMultiplicity: Exactly one TaskTime must be specified per configuration.
        boolean DemRbDisableAutomaticEventIds [0..1]: multiplicity set at pre-compile, origin=RB:AR40.10.20.0:2016-10-28, set at pre-compile, default-value=false  # Enables/ Disables the automatic assignement of EventIds. Hint: If automatic eventId assignement is disabled, the user has to manually assign the IDs and has to ensure a consecutive numbering from 1..numberofEventIds. Automatic number assignement is recommended.
        boolean DemRbDisturbanceMemoryCallbackOnDisturbance [0..1]: multiplicity set at pre-compile, origin=RB:AR40.10.20.0:2016-10-28, set at pre-compile, default-value=false  # Enables/ Disables project specific callback at the time of disturbance for Disturbance memory
        integer DemRbDisturbanceMemorySize [0..1]: 1..15, multiplicity set at pre-compile, origin=RB:AR40.4.0.0:2012-06-01, set at pre-compile, default-value=15  # number of elements stored in the dirsturbance memory.
        boolean DemRbDisturbanceMemorySupported [0..1]: multiplicity set at pre-compile, origin=RB:AR40.4.0.0:2012-06-01, set at pre-compile, default-value=false  # Disturbance memory is supported or not
        boolean DemRbEnableDemNvmBlocksAutoConfiguration [0..1]: multiplicity set at pre-compile, origin=RB:AR42.5.0.0:2018-08-31, set at pre-compile, default-value=false  # This configuration switch defines, whether the needed Dem Blocks shall be added automatically in NVM or not. If it is enabled then the expected NvM Blocks should be configured in the NVRAM Manager and respectively referenced in Dem. In that case the block length shall be provided as C expression in NvMRbNvBlockLengthString.
        boolean DemRbEnableNvmBlockLengthChecks [0..1]: multiplicity set at pre-compile, origin=RB:AR40.9.0.0:2014-11-18, set at pre-compile, default-value=false  # This configuration switch defines, whether the static assertion check for the NVM Block length is enabled or not.
        boolean DemRbEnableReportingChronologicalOrderHooks [0..1]: multiplicity set at pre-compile, origin=RB:AR40.12.0.0:2016-05-05, set at pre-compile, default-value=false  # This switch controls the availability of hooks for implementing Project specific DTC filter and reporting.(like report DTCs in Chronological order ). The declarations are available in Dem_ChronoSort.h file. Project has to provide their implementation in template file Dem_PrjChronoSorting.c_tpl.
        boolean DemRbEvMemProjectExtension [0..1]: multiplicity set at pre-compile, origin=RB:AR40.10.0.0:2015-07-07, set at pre-compile, default-value=false  # Activate project specific implementation and calculation in evmem (e.g. cycle counters for environmental data). On activating the feature, the struct 'Dem_EvMemProjectExtension' is included in each EvMem location and the project specific calculations 'Dem_EvMemProjectExtension(Init|Main|UnRobust|Failed|StartOpCycle)' are triggered. The struct and the functions have to be implemented in the project based on the available templates 'Dem_PrjEvmemProjectExtension.*_tpl'. Additionally data items can be defined in the environmental data by specifying appropriate dataelement (refer to DemInternalDataElement: DEM_PRJ_SPECIFIC_DATA_ON_RETRIEVE or DEM_PRJ_SPECIFIC_DATA_ON_REPORT).
        boolean DemRbEventCombinationOnlyAllEventsPassed [0..1]: multiplicity set at pre-compile, origin=RB:AR45.4.0.0:2023-01-02, set at pre-compile, default-value=false  # Changes the processing of passed for combined DTCs. If set to "true": On OperationCycle change a DTC will be processed as PASSED only if all combined Events of this DTC have reported PASSED (and never FAILED) in this operation cycle If ser to "false": On OperationCycle change the passed for the DTC will be processed if one of the combined events reported passed Default: "false" (old behavior)
        boolean DemRbEventMemoryGenericSupported [0..1]: multiplicity set at pre-compile, origin=RB:AR40.6.0.0:2013-04-01, set at pre-compile, default-value=true  # Enables/Disables support for the generic event memory services Dem_GetDTCByOccurrenceTime and Dem_GetEventMemoryOverflow
        boolean DemRbEvtProjectExtension [0..1]: multiplicity set at pre-compile, origin=RB:AR40.10.0.0:2015-08-01, set at pre-compile, default-value=false  # Enables a project specific callback on each setEventStatus. May be used to calculate project specific status information (and e.g. store it as customer specific attributes; see DemRbDefaultEventCustAttribute).
        integer DemRbFailureDependencyRecheckLimit [0..1]: 1..65535, multiplicity set at pre-compile, origin=RB:AR40.12.0.0:2016-06-30, set at pre-compile, default-value=80  # Also known as "Recheck Causality": With failure dependency structure enabled, this parameter configures the number of events which are checked per main-cycle. The check addresses the situation, where an event is TestFailed, but not yet considered as beeing causal. This might happen for example, if an event is reported as FAILED while the storagecondition is not fulfilled or a higher priority fault is already reported and later on, the storagecondition is fulfilled again or the other failure disappears.
        enumeration DemRbGetEventAvailableBehaviour: {AUTOSAR_COMPLIANT, LEGACY}, multiplicity set at pre-compile, origin=RB:AR45.5.0.0:2023-06-23, set at pre-compile  # This parameter defines how Dem_GetEventAvailable() API assigns value to the out parameter "AvailableStatus". (1) AUTOSAR_COMPLIANT: If chosen, TRUE is assigned to the out parameter if event is available (Not suppressed) and FALSE is assigned to the out parameter if event is not available (suppressed) (2) LEGACY: If chosen, FALSE is assigned to the out parameter if event is available (Not suppressed) and TRUE is assigned to the out parameter if event is not available (suppressed) Note: It is the responsibility of the user that all callers of the Dem_GetEventAvailable() API in the project rely on the same type of behaviour and that specific behaviour is configured here.
        function name DemRbGlobalCallbackClearEventAllowedFnc [0..1]: multiplicity set at pre-compile, origin=RB:AR40.6.0.0:2013-07-26, set at pre-compile  # This parameter specifies a global callback, which is called as a "permission gate" before deleting an event. The behavior is identical to DemCallbackClearEventAllowed which is configured within DemEventParameter. In cases when DemGlobalCallbackClearEventAllowedFnc is configured, for the events which have DemCallbackClearEventAllowedFnc configured, the configured callback per Event shall have the precidence and thus the global callback shall not be invoked. Thus, the global callback is restricted to be invoked for all the Events which does not have container DemCallbackClearEventAllowed configured with DemEventParameter.
        function name DemRbGlobalCallbackGetFaultDetectionCounter [0..1]: multiplicity set at pre-compile, origin=RB:AR40.6.0.0:2013-07-26, set at pre-compile  # This parameter specifies a global callback for getting the fault detection counter. The function returns 127 if the event is failed and -128 if it is passed . In all other cases it returns 0.
        boolean DemRbClearDTCHandleEventMemoryOverflow [0..1]: multiplicity set at pre-compile, origin=RB:AR45.5.0.0:2023-06-16, set at pre-compile, default-value=true  # [NON-AUTOSAR] This parameter shall be activated for handling the buffer overflow situation for cyclic events reported during clear. If TRUE,Re-Reporting Cyclic events shall make an entry into event memory after clearDTC is complete,if there is a buffer overflow. If FALSE, Re-Reporting Cyclic events shall not make an entry into event memory after clearDTC is complete,if there is a buffer overflow.
        boolean DemRbHistoryStatusSupported [0..1]: multiplicity set at pre-compile, origin=RB:AR40.8.0.0:2014-02-25, set at pre-compile, default-value=false  # AllowHistoryStatus is triggered or not
        boolean DemRbLockAllFailureInfoSupported [0..1]: multiplicity set at pre-compile, origin=RB:AR40.8.0.0:2014-03-28, set at pre-compile, default-value=false  # LockAllFailureInformation is supported or not
        enumeration DemRbMirrorMemoryDisplacmentStrategyType [0..1]: {DEM_DISPLACEMENT_FULL, DEM_DISPLACEMENT_RBA_CUST, DEM_DISPLACEMENT_RBA_FIFO}, multiplicity set at pre-compile, origin=RB:AR40.8.0.0:2014-03-03, set at pre-compile, default-value=DEM_DISPLACEMENT_FULL  # This parameter defines the type of Displacement Strategy used for the Mirror Memory (1) DEM_DISPLACEMENT_FULL (priority based) (2) DEM_DISPLACEMENT_RBA_FIFO (3) DEM_DISPLACEMENT_RBA_CUST
        boolean DemRbMirrorMemoryDtcStatusStored [0..1]: multiplicity set at pre-compile, origin=RB:AR40.8.0.0:2014-05-05, set at pre-compile, default-value=false  # [NON-AUTOSAR] This parameter defines that the DTC Status is additionally stored in Mirror Memory when a Mirror Memory location is written. If a DTC Status (with parameter Origin = MIRROR) is requested the stored DTC status is reported instead of the current DTC Status
        enumeration DemRbMirrorMemoryType [0..1]: {MIRROR_ON_CLEAR, MIRROR_ON_FAILED}, multiplicity set at pre-compile, origin=RB:AR40.4.0.0:2012-06-01, set at pre-compile, default-value=MIRROR_ON_CLEAR  # [NON-AUTOSAR] This parameter defines the type of Mirror Memory: (1) Store in Mirror Memory (On Failed) (2) Store in Mirror Memory (On Clear)
        boolean DemRbMonitorDataBeforeInit [0..1]: multiplicity set at pre-compile, origin=RB:AR45.0.4.0:2020-09-02, set at pre-compile, default-value=true  # DemRbMonitorDataBeforeInit (i.e monitor data data support between Preinit and Init) is supported or not
        boolean DemRbMonitorDataForTimeBasedDebouncing [0..1]: multiplicity set at pre-compile, origin=RB:AR42.9.0.0:2020-10-14, set at pre-compile, default-value=false  # With this it is possible to store the monitordata reported with the prepassed/-failed and process it after the timebaseddebouncing qualified the report. CAREFULL: this leads to additional memory consumption (MonitorDataSize * 2 * countOfTimeBasedDebouncedEvents)
        boolean DemRbNvMBlockValidationAsError [0..1]: multiplicity set at pre-compile, origin=RB:AR47.1.0.0:2022-02-28, set at pre-compile, default-value=true  # With this switch the validation error for missing NvM blocks can be turned into a warning instead of error. This is to support the usecase of not using the NvM together with the Dem.
        integer DemRbClearDTCUpdateRelevantFlagNumberOfEventsPerCycle [0..1]: 1..65535, multiplicity set at pre-compile, origin=RB:AR45.5.0.0:2023-06-27, set at pre-compile, default-value=400  # Configures the number of events to be processed per DemMainCycle for updating the next report relevant for Memories flag. ->If this parameter is not configured, By default 400 events shall be selected for updating the next report relevant for Memories flag per main function call. This parameter is considered only if DemRbClearDTCHandleEventMemoryOverflow = TRUE
        integer DemRbNvMNumberOfStorageBuffer [0..1]: 1..255, multiplicity set at pre-compile, origin=RB:AR40.12.0.0:2016-03-21, set at pre-compile, default-value=2  # This parameter defines how many storagebuffer are available for copying to NVRAM. Storagebuffer are needed for all DemNvMBlocks which don't support callbacks and therefore need to store the content in a sperate buffer for data consistency. A higher number of storagebuffer means faster copying of multiple blocks but also more RAM consumption.
        enumeration DemRbOccurrenceCounterType [0..1]: {AUTOSAR, NONE}, multiplicity set at pre-compile, origin=RB:AR40.4.0.0:2012-06-01, set at pre-compile, default-value=AUTOSAR  # [NON-AUTOSAR] This parameter defines the Type of Occurrence Counter. (1) Not Supported (2) AUTOSAR
        boolean DemRbOperationCycleStatusStorage: scope=ECU, set at pre-compile  # Defines if the operation cycle state is available over the power cycle (stored non-volatile) or not. | true: the operation cycle state is stored non-volatile false: the operation cycle state is only stored volatile
        boolean DemRbPrestoreFreezeFrameNonVolatile [0..1]: multiplicity set at pre-compile, origin=RB:AR40.9.0.0:2014-10-01, set at pre-compile, default-value=false  # [NON-AUTOSAR] If enabled, prestored freeze frame will be stored non volatile and will be still available after restarting the ECU.
        boolean DemRbProjectSpecificDebOptimization [0..1]: multiplicity set at pre-compile, origin=RB:AR42.06.1.0:2019-9-15, set at pre-compile, default-value=false  # Controls call-out point for optimising debouncing of events. If enabled (TRUE), a call-out point will be available in which the run-time optimzation logic needs to be implemented as per the template file Dem_PrjSpecificDebOptimization.h_tpl.
        boolean DemRbProjectSpecificEventStatusHandling [0..1]: multiplicity set at pre-compile, origin=RB:AR40.10.0.0:2015-06-26, set at pre-compile, default-value=false  # Controls project-specific handling of EventStatus. If enabled (TRUE), the event handling functions have to be implemented in the project based on the template file Dem_PrjEventStatus.h_tpl.
        boolean DemRbProjectSpecificWarningIndicatorHandling [0..1]: multiplicity set at pre-compile, origin=RB:AR40.10.9.0:2015-11-29, set at pre-compile, default-value=false  # Enable for project specific implementation of WIR bit handling. This parameter has to be enabled to use the IndicatorLiteforCCPS sub-module. Along with this parameter, DemEventParameter/DemRbEventClass/DemRbCustEventAtrributes has to be Configured with short name "DeActTrigger".
        boolean DemRbReadEventRelatedDataFromDifferentOsTask [0..1]: multiplicity set at pre-compile, origin=RB:AR40.13.0.0:2016-12-13, set at pre-compile, default-value=false  # Needs to be enabled if event-related data (extended data or freeze frames) is read synchronously from a task different than the one running the Dem_MainFunction() (e.g. via the Dem_GetEventExtendedDataRecord*, Dem_GetEventFreezeFrameData*, Dem_DltGetAllExtendedDataRecords or Dem_DltGetMostRecentFreezeFrameRecordData functions). The asynchronous Dcm interfaces Dem_GetNextExtendedDataRecord() and Dem_GetNextFreezeFrameData() are not affected. Enables additional synchronisation mechanisms which may incur some overhead (memory and runtime). In particular it needs to be enabled in OBD-relevant systems where the Dcm_MainFunction() runs in a different task than the Dem_MainFunction(). Non-OBD-relevant systems generally do not need to enable it unless the event-related data is accessed from outside the Dcm.
        boolean DemRbRuntimeErrorDetect [0..1]: set at pre-compile, with-auto=true, default-value=false  # Deprecated: Switches the Runtime error detection and notification on or off. Runtime errors always are on. | * true: detection and notification is enabled. * false: detection and notification is disabled.
        boolean DemRbShadowEntriesVisible [0..1]: multiplicity set at pre-compile, origin=RB:AR40.8.0.0:2014-01-16, set at pre-compile, default-value=false  # This switch enables the visibility of deleted event memory entries (cleared or aged) in API services reporting extended data records and freeze frame data records to DCM.
        boolean DemRbShadowMemory [0..1]: multiplicity set at pre-compile, origin=RB:AR40.4.0.0:2012-06-01, set at pre-compile, default-value=false  # [NON-AUTOSAR] This parameter defines if the virtual deleted entries (Shadow memory) in the primary memory shall be mapped to the MIRROR Memory. This setting requires that Mirror Memory is not configured!
        enumeration DemRbStatusByteConsistencyPreference [0..1]: multiplicity set at pre-compile, origin=RB:AR40.13.0.0:2016-10-24, set at pre-compile, default-value=STATUS_BYTE_BLOCK  # Select which source to prefer if the event status bits stored in the event status byte Nvm block and the event memory Nvm block are inconsistent. Currently this only affects the TestFailed status bit. Options: STATUS_BYTE_BLOCK: Prefer the status bits restored from the status byte block. EVENT_MEMORY: Prefer the status bits restored from the event memory.
          EVENT_MEMORY  # Prefer the status bits restored from the event memory.
          STATUS_BYTE_BLOCK  # Prefer the status bits restored from the status byte block.
        boolean DemRbStorageConditionBlocksPassedReports [0..1]: multiplicity set at pre-compile, origin=RB:AR42.8.0.0:2020-03-20, set at pre-compile, default-value=false  # Control whether StorageCondition will block the storage of Passed reports. TRUE : Storage Condition blocks storage on both Passed and Failed reports. FALSE : Storage Condition blocks only storage on Failed reports and allows storage on Passed reports.
        integer DemRbStoreWaitingForMonBufferDelayTime [0..1]: 0..255, multiplicity set at pre-compile, origin=RB:AR42.5.0.0:2018-09-20, default-value=255  # This Configuration is needed only if DemRbSupportFailureDependency is TRUE. This parameter defines the number of Dem main function cycles for which the storing of an event is delayed. During that time the event is kept in the event buffer and not written to the storage. If demRbStoreWaitingForMonitoringEvent is set to FALSE: If the event reports FAILED within this time then it will be moved to the Dem event memory and BFM as a FAILED event. If it reports PASSED within this time it will be discarded from buffer i.e. no storage. If demRbStoreWaitingForMonitoringEvent is set to TRUE: Even if there is no report within this time (either PASSED or FAILED) the event will be stored in the Dem event memory and BFM as a FAILED event after this time. Please refer demRbStoreWaitingForMonitoringEvent for further details. Note: If configured as 0, the event will be directly written to storage as soon as it enters the event buffer via recheck logic.[NON-AUTOSAR EXTENSION]
        boolean DemRbStoreWaitingForMonitoringEvent [0..1]: multiplicity set at pre-compile, origin=RB:AR40.14.0.0:2017-06-14, default-value=false  # This configuration is needed only if DemRbSupportFailureDependency is TRUE. This switch controls whether the event in WAITING_FOR_MONITORING state to be stored as FAILED event in Event memory and BFM, even though no report until waiting time. Consider the situation, an event was affected by Storage condition (Storage filtered) or sequential fault (Parent or higher prio event is FAILED) and now it becomes causal due to storage condition removed or parent/high prio fault healed. Then the event will be in WAITING_FOR_MONITORING state i.e. it will be in the event buffer for a definite time (DemTaskTime * DemRbStoreWaitingForMonBufferDelayTime) expecting for a new report again either PASSED or FAILED. If it reports FAILED then it will be stored in Event memory and BFM. If PASSED then it will be discarded from buffer itself. If there is no report after time elapsed, then the event storage is dependant on this switch. TRUE: Event will be stored as FAILED in Event memory and BFM even though no report after time elapsed. FALSE: Event will be discarded and no storage in Event memory and BFM as there is no report after time elapsed.
        boolean DemRbSupportAgingCounterOnlyWhenAgingAllowed [0..1]: multiplicity set at pre-compile, origin=RB:AR42.4.0.0:2018-07-31, set at pre-compile, default-value=false  # This configuration switch defines whether Aging counter has to be supported for all DTCs or only for DTCs which have DemAgingAllowed configured as TRUE | TRUE: DTCs which have DemAgingAllowed configured as TRUE - will have an Aging counter, and for DTCs with DemAgingAllowed configured as FALSE - the corresponding aging counter will be set to a Default value 255. ; FALSE : All DTCs will have aging counters independent of the configuration value of DemAgingAllowed. ; Note : If this parameter is configured as TRUE, the Aging counter behaviour will be compliant to AUTOSAR 42.3. If this parameter is not configured or if it is configured as FALSE, then the behaviour will be not as per AUTOSAR(it will be compliant to previous versions of DEM) - If additionally DemAgingCycleCounterThreshold is not configured, the default value generated will be '1' and Aging counter will be updated independent of the configuration value of DemAgingAllowed.
        enumeration DemRbSupportDebouncerResetAfterStorageCondition [0..1]: {ACCORDING_DEBOUNCEBEHAVIOR, OFF}, multiplicity set at pre-compile, origin=RB:AR40.12.0.0:2016-01-22, set at pre-compile, default-value=OFF  # [NON-AUTOSAR] This Parameter Enables or Disables the resetting of the debouncer after storagecondition. (1) OFF : do not reset the debouncer after StorageCondition (2) ACCORDING_DEBOUNCEBEHAVIOR : resetting after StorageCondition is re-enebled based on the debounce behavior
        enumeration DemRbSupportEraseAllNvMData [0..1]: {ERASE_ALL_OFF, ERASE_ALL_WITH_HASHID_CHECK, ERASE_ALL_WITHOUT_HASHID_CHECK}, multiplicity set at pre-compile, origin=RB:AR40.13.0.0:2016-08-10, set at pre-compile, default-value=ERASE_ALL_OFF  # Allows the project to erase all nvm data, e.g. in case of flashing. (Templatefile Dem_PrjEraseAllNvMDataHandling.c needs to be used, project specific callback "Dem_PrjEraseAllNvMDataHandling" to be implemented to trigger erase all.) 1.) ERASE_ALL_OFF - Erase all Nvm data functionality disabled. 2.) ERASE_ALL_WITHOUT_HASHID_CHECK - Erase all is enabled without having hash id check. 3.) ERASE_ALL_WITH_HASHID_CHECK - Erase all is enabled with hash id check, i.e result of HashId check to detect any change in Order of Events or Number of Events or Event ID or Event Shortname is provided as argument in callback. (Refer section 12.13 in Dem_BswDoc for more details)
        boolean DemRbSupportEventCategory [0..1]: multiplicity set at pre-compile, origin=RB:AR40.4.0.0:2012-06-01, set at pre-compile, default-value=false  # This is used e.g. for prioritization of monitoring in the RB Failure Memory
        boolean DemRbSupportEventFDCThresholdReached [0..1]: multiplicity set at pre-compile, origin=RB:AR40.11.0.0:2015-11-07, set at pre-compile, default-value=false  # [NON-AUTOSAR] Switch to enable or disable the availability to querry whether the Event FDC value has reached FDC threshold configured or not. The querying can be done through the interface "Dem_GetEventFdcThresholdReached( )".
        boolean DemRbSupportEventMemoryEntryOnFDCThreshold [0..1]: multiplicity set at pre-compile, origin=RB:AR40.8.0.0:2014-07-07, set at pre-compile, default-value=false  # [NON-AUTOSAR] Switch to enable or disable the Robustness feature
        boolean DemRbSupportFailureDependency [0..1]: multiplicity set at pre-compile, origin=RB:AR40.4.0.0:2012-06-01, set at pre-compile, default-value=false  # This switch controls the availability of the feature failure dependency structure. The feature provides the possibility to define hierarchical failure dependencies through a graph structure that has to be defined in DIAMANT
        enumeration DemRbSupportProjectSpecificConsistencyCheck [0..1]: {CONSISTENCY_CHECK_OFF, CONSISTENCY_CHECK_ON}, multiplicity set at pre-compile, origin=RB:AR42.02:2017-06-09, set at pre-compile, default-value=CONSISTENCY_CHECK_OFF  # Enables or Disables Project Specific Consistency Checks.The Project specific function have to be implemented based on the project specific templates available in Dem_PrjSpecificConsistencyCheck*.tpl.
        boolean DemRbSupportProjectSpecificFailureMemory [0..1]: multiplicity set at pre-compile, origin=RB:AR40.12.0.0:2016-07-30, set at pre-compile, default-value=false  # Activates Project Specific Failure Memory Data handling. On activation, a new variable DemRbProjectSpecificFailureMemoryType DemRbProjectSpecificFailureMemoryData will be available in Dem_EvBuffEvent structure. The Project specific data type DemRbProjectSpecificFailureMemoryType and functions have to be implemented based on the project specific templates available in Dem_PrjSpecificFailureMemory*.tpl.
        boolean DemRbSupportQueueingUnrobustEvent [0..1]: multiplicity set at pre-compile, origin=RB:AR42.7.0.0:2019-11-06, set at pre-compile, default-value=false  # [NON-AUTOSAR] Switch to enable or disable the queueing of events reporting unrobust before the Dem has been initialized.
        boolean DemRbSupportRecoveryLimitation [0..1]: multiplicity set at pre-compile, origin=RB:AR40.4.0.0:2012-06-01, set at pre-compile, default-value=false  # The number of possible recoveries of failure words may be limited. This function switch configures the availability of a feature to configure a failure recovery limit for each node in the failure graph
        boolean DemRbSupportSuspicious [0..1]: multiplicity set at pre-compile, origin=RB:AR40.11.0.0:2015-10-19, set at pre-compile, default-value=false  # This configuration switch defines, event and component suspicious feature support is enabled or not. | true: event and component suspicious feature support is enabled false: event and component suspicious feature support is disabled
        boolean DemRbTestModeSupported [0..1]: multiplicity set at pre-compile, origin=RB:AR40.8.0.0:2014-02-14, set at pre-compile, default-value=false  # This configuration switch defines, whether Test Mode reporting is supported for events or not. If Test mode is enabled only test reporting is accepted (through Dem_SetEventStatus_TestMode, DemSetEventStatusWithMonitorData_TestMode, DemReportErrorStatusWithEnvData_TestMode). Normal reporting is deactivated | true: Test Mode Reporting for event is enabled; false: Test Mode Reporting for event is disabled
        boolean DemRbTriggerToStoreNvMSupported [0..1]: multiplicity set at pre-compile, origin=RB:AR40.8.0.0:2014-06-01, set at pre-compile, default-value=false  # This configuration switch defines, whether the API to trigger immediate storage to NVM (API : Dem_TriggerStorageToNvm) is available.
        boolean DemRbUserDefinedAgingCounter [0..1]: multiplicity set at pre-compile, origin=RB:AR40.4.0.0:2012-06-01, set at pre-compile, default-value=false  # [NON-AUTOSAR] This parameter defines the custamizable Aging Counter. (1) true (2) false | If this parameter is True, then the Aging counter value can be obtained from the Data-element DEM_AGINGCTR_UPCNT, but it will not be ensured that the data-element DEM_AGINGCTR_DOWNCNT gives correct value of Aging counter. False: No effect.
        boolean DemRbUserDefinedEventMemoryStorageStrategyEnabled [0..1]: multiplicity set at pre-compile, origin=RB:AR40.7.0.0:2013-12-01, set at pre-compile, default-value=false  # Enables/Disables support for a user defined storage and displacement strategy in primary and secondary event memory. This strategy replaces the AUTOSAR defined methods. When user-defined storage strategy is enabled the user needs to implement the function Dem_EvMemGetEventMemoryStorageLocation. The header file Dem.h is used to include the function prototyp
        boolean DemRbUserDefinedMirrorMemoryStorageStrategyEnabled [0..1]: multiplicity set at pre-compile, origin=RB:AR40.7.0.0:2013-12-01, set at pre-compile, default-value=false  # Enables/Disables support for a user defined function to implement storage and displacement strategy in mirror memory. If default behavior is not overwritten here, the mirror memory is using the same strategy as the primary and secondary memory. When user-defined storage strategy is enabled the user needs to implement the function Dem_EvMemGetMirrorMemoryStorageLocation. The header file Dem.h is used to include the function prototyp
        enumeration DemRbValidationMode [0..1]: {Dem_ValidationMode_ExtendedEventChecks, Dem_ValidationMode_Standard}, multiplicity set at pre-compile, origin=RB:AR40.8.0.0:2014-05-28, set at pre-compile, default-value=Dem_ValidationMode_Standard  # This configuration switch defines,whether the executed validations shall be specially enhanced for RTA-BSW Events or whether - in standard mode - the standard project validations shall be used.
        reference DemRbDisturbanceMemoryExtendedDataClassRef [0..1]: multiplicity set at pre-compile, origin=RB:AR40.4.0.0:2012-06-01, set at pre-compile, destination=DemExtendedDataClass  # This reference defines the link to an extended data class sampler.
        container DemRbBfm [0..1]: multiplicity set at pre-compile  # This container contains the configuration (parameters) of the BSW Dem. Delete container if BFM is not required.
        container DemRbCalibParameters [0..1]  # DemRbCalibtParameters | This container contains the configuration (parameters) to calibrate data into separate structure.
          boolean DemRbCalibAgingCycleCounterThreshold [0..1]: multiplicity set at pre-compile, origin=RB:AR45.3.1.0:2022-08-29, set at pre-compile, default-value=false  # This parameter calibrates Aging Threshold. True: Calibrate data into separate structure. False: no effect.
          boolean DemRbCalibEventConfirmationThreshold [0..1]: multiplicity set at pre-compile, origin=RB:AR45.3.1.0:2022-08-29, set at pre-compile, default-value=false  # This parameter calibrates failure confirmation Threshold. True: Calibrate data into separate structure. False: no effect.
          boolean DemRbCalibEventPriority [0..1]: multiplicity set at pre-compile, origin=RB:AR45.3.1.0:2022-08-29, set at pre-compile, default-value=false  # This parameter calibrates Event Priority. True: Calibrate data into separate structure. False: no effect.
          boolean DemRbCalibMaxNumberFreezeFrameRecords [0..1]: multiplicity set at pre-compile, origin=RB:AR45.3.1.0:2022-08-29, set at pre-compile, default-value=false  # This parameter calibrates Maximum freez frame records value. True: Calibrate data into separate structure. False: no effect.
          boolean DemRbCalibSeverity [0..1]: multiplicity set at pre-compile, origin=RB:AR45.3.1.0:2022-08-29, set at pre-compile, default-value=false  # This parameter calibrates severity value. True: Calibrate data into separate structure. False: no effect.
          boolean DemRbCalibDTCKind [0..1]: multiplicity set at pre-compile, origin=RB:AR45.3.1.0:2022-08-29, set at pre-compile, default-value=false  # This parameter calibrates DTC kind value. True: Calibrate data into separate structure. False: no effect.
          boolean DemRbCalibEventAvailability [0..1]: multiplicity set at pre-compile, origin=RB:AR45.3.1.0:2022-08-29, set at pre-compile, default-value=false  # This parameter calibrates event availability value. True: Calibrate data into separate structure. False: no effect.
          boolean DemRbCalibAgingAllowed [0..1]: multiplicity set at pre-compile, origin=RB:AR45.3.1.0:2022-08-29, set at pre-compile, default-value=false  # This parameter calibrates aging allowed value. True: Calibrate data into separate structure. False: no effect.
          boolean DemRbCalibSignificance [0..1]: multiplicity set at pre-compile, origin=RB:AR45.3.1.0:2022-08-29, set at pre-compile, default-value=false  # This parameter calibrates significance value. True: Calibrate data into separate structure. False: no effect.
          boolean DemRbCalibOBDReadiness [0..1]: multiplicity set at pre-compile, origin=RB:AR45.3.1.0:2022-08-29, set at pre-compile, default-value=false  # This parameter calibrates OBD readiness value. True: Calibrate data into separate structure. False: no effect.
        container DemRbDebounceCounterSet [0..255]: multiplicity set at pre-compile  # Defines debounce counter alternative's name
        container DemRbDefaultEventCustAttribute [0..*]: multiplicity set at pre-compile  # Definition of available Customer Specific Attributes, which may be set per Event. Handling to be done in template file Dem_EventAttribute.h_tpl.
          string DemRbCustAttributeDefaultValue: origin=TO_BE_UPDATED, set at pre-compile  # DefaultValue if this parameter is not referred in an Event
        container DemRbDocumentation [0..1]: multiplicity set at pre-compile  # This container contains the configuration (parameters) of the BSW Dem
          container DemRbDDL_CSV [0..1]: multiplicity set at pre-compile  # Specify a DDL parameters
            boolean DemRbIncludeAgingCycleInDDLExport [0..1]: scope=ECU, multiplicity set at pre-compile, set at pre-compile, default-value=true  # Configurable DDL parameters | true: Provide AgingCycle value in Dem_DDL.csv file false: Not Provide AgingCycle value in Dem_DDL.csv file
            boolean DemRbIncludeCallbackClearEventAllowedInDDLExport [0..1]: scope=ECU, multiplicity set at pre-compile, set at pre-compile, default-value=true  # Configurable DDL parameters | true: Provide CallbackClearEventAllowed value in Dem_DDL.csv file false: Not Provide CallbackClearEventAllowed value in Dem_DDL.csv file
            boolean DemRbIncludeCallbackEventDataChangedInDDLExport [0..1]: scope=ECU, multiplicity set at pre-compile, set at pre-compile, default-value=true  # Configurable DDL parameters | true: Provide CallbackEventDataChanged value in Dem_DDL.csv file false: Not Provide CallbackEventDataChanged value in Dem_DDL.csv file
            boolean DemRbIncludeCallbackEventStatusChangedInDDLExport [0..1]: scope=ECU, multiplicity set at pre-compile, set at pre-compile, default-value=true  # Configurable DDL parameters | true: Provide CallbackEventStatusChanged value in Dem_DDL.csv file false: Not Provide CallbackEventStatusChanged value in Dem_DDL.csv file
            boolean DemRbIncludeCallbackInitMForEInDDLExport [0..1]: scope=ECU, multiplicity set at pre-compile, set at pre-compile, default-value=true  # Configurable DDL parameters | true: Provide CallbackInitMForE value in Dem_DDL.csv file false: Not Provide CallbackInitMForE value in Dem_DDL.csv file
            boolean DemRbIncludeCausalityDelayTimeInDDLExport [0..1]: scope=ECU, multiplicity set at pre-compile, set at pre-compile, default-value=true  # Configurable DDL parameters | true: Provide EvBufferTime value in Dem_DDL.csv file false: Not Provide EvBufferTime value in Dem_DDL.csv file
            boolean DemRbIncludeDTCClassRefInDDLExport [0..1]: scope=ECU, multiplicity set at pre-compile, set at pre-compile, default-value=true  # Configurable DDL parameters | true: Provide DTCClassRef value in Dem_DDL.csv file false: Not Provide DTCClassRef value in Dem_DDL.csv file
            boolean DemRbIncludeDTCValueInDDLExport [0..1]: scope=ECU, multiplicity set at pre-compile, set at pre-compile, default-value=false  # Configurable DDL parameters | true: Provide DTC Value in Dem_DDL.csv file false: Not Provide DTC Value in Dem_DDL.csv file
            boolean DemRbIncludeDebounceAlgorithmClassInDDLExport [0..1]: scope=ECU, multiplicity set at pre-compile, set at pre-compile, default-value=true  # Configurable DDL parameters | true: Provide DebounceAlgorithmClass value in Dem_DDL.csv file false: Not Provide DebounceAlgorithmClass value in Dem_DDL.csv file
            boolean DemRbIncludeDgsDfcNameInDDLExport [0..1]: scope=ECU, multiplicity set at pre-compile, set at pre-compile, default-value=true  # Configurable DDL parameters | true: Provide DemRbDgsDfcName value in Dem_DDL.csv file false: Not Provide DemRbDgsDfcName value in Dem_DDL.csv file
            boolean DemRbIncludeEnableConditionsInDDLExport [0..1]: scope=ECU, multiplicity set at pre-compile, set at pre-compile, default-value=true  # Configurable DDL parameters | true: Provide EnableConditions value in Dem_DDL.csv file false: Not Provide EnableConditions value in Dem_DDL.csv file
            boolean DemRbIncludeEventConfirmationThresholdInDDLExport [0..1]: scope=ECU, multiplicity set at pre-compile, set at pre-compile, default-value=true  # Configurable DDL parameters | true: Provide EventConfirmationThreshold value in Dem_DDL.csv file false: Not Provide EventConfirmationThreshold value in Dem_DDL.csv file
            boolean DemRbIncludeEventIdInDDLExport [0..1]: scope=ECU, multiplicity set at pre-compile, set at pre-compile, default-value=true  # Configurable DDL parameters | true: Provide EventId value in Dem_DDL.csv file false: Not Provide EventId value in Dem_DDL.csv file
            boolean DemRbIncludeEventKindInDDLExport [0..1]: scope=ECU, multiplicity set at pre-compile, set at pre-compile, default-value=true  # Configurable DDL parameters | true: Provide EventKind value in Dem_DDL.csv file false: Not Provide EventKind Parameter value in Dem_DDL.csv file
            boolean DemRbIncludeEventParameterInDDLExport [0..1]: scope=ECU, multiplicity set at pre-compile, set at pre-compile, default-value=true  # Configurable DDL parameters | true: Provide EventParameter value in Dem_DDL.csv file false: Not Provide EventParameter value in Dem_DDL.csv file
            boolean DemRbIncludeExtendedDataClassRefInDDLExport [0..1]: scope=ECU, multiplicity set at pre-compile, set at pre-compile, default-value=true  # Configurable DDL parameters | true: Provide ExtendedDataClassRef value in Dem_DDL.csv file false: Not Provide ExtendedDataClassRef value in Dem_DDL.csv file
            boolean DemRbIncludeFreezeFrameClassRefInDDLExport [0..1]: scope=ECU, multiplicity set at pre-compile, set at pre-compile, default-value=true  # Configurable DDL parameters | true: Provide FreezeFrameClassRef value in Dem_DDL.csv file false: Not Provide FreezeFrameClassRef value in Dem_DDL.csv file
            boolean DemRbIncludeIsReplacementEventOfStocoInDDLExport [0..1]: scope=ECU, multiplicity set at pre-compile, set at pre-compile, default-value=true  # Configurable DDL parameters | true: Provide IsReplacementEventOfStoco value in Dem_DDL.csv file false: Not Provide IsReplacementEventOfStoco value in Dem_DDL.csv file
            boolean DemRbIncludeNodeRefInDDLExport [0..1]: scope=ECU, multiplicity set at pre-compile, set at pre-compile, default-value=true  # Configurable DDL parameters | true: Provide NodeRef value in Dem_DDL.csv file false: Not Provide NodeRef value in Dem_DDL.csv file
            boolean DemRbIncludeOperationCycleInDDLExport [0..1]: scope=ECU, multiplicity set at pre-compile, set at pre-compile, default-value=true  # Configurable DDL parameters | true: Provide OperationCycle value in Dem_DDL.csv file false: Not Provide OperationCycle value in Dem_DDL.csv file
            boolean DemRbIncludeRecoverableInDDLExport [0..1]: scope=ECU, multiplicity set at pre-compile, set at pre-compile, default-value=true  # Configurable DDL parameters | true: Provide Recoverable value in Dem_DDL.csv file false: Not Provide Recoverable value in Dem_DDL.csv file
            boolean DemRbIncludeShiftViewInDDLExport [0..1]: scope=ECU, multiplicity set at pre-compile, set at pre-compile, default-value=true  # Configurable DDL parameters | true: Provide DemRbShiftView value in Dem_DDL.csv file false: Not Provide DemRbShiftView value in Dem_DDL.csv file
            boolean DemRbIncludeStorageConditionsInDDLExport [0..1]: scope=ECU, multiplicity set at pre-compile, set at pre-compile, default-value=true  # Configurable DDL parameters | true: Provide StorageConditions value in Dem_DDL.csv file false: Not Provide StorageConditions value in Dem_DDL.csv file
        container DemRbEventCategory [0..255]: multiplicity set at pre-compile  # Specification of the event categories known in ESP-Systems; used to categorize failure for analysis in RB plants. This parameter is also used as the priority of RB failure memory records.
          integer DemRbEventCategoryId: 1..254, origin=RB:AR40.4.0.0:2012-06-01, set at pre-compile, symbolic-name-value=true, default-value=254  # This contains unique event category id. The values "0" and "255" are reserved for internal use. In the RB failure memory "0" is the highest priority and "255" is the lowest one.
          integer DemRbEventCategoryPriorityId [0..1]: 1..254, multiplicity set at pre-compile, origin=RB:AR40.12.0.0:2016-04-18, set at pre-compile, symbolic-name-value=true, default-value=254  # The parameter is used to configure event category priority. Least the value higher the priority.
        container DemRbExternalProcessing [0..1]: multiplicity set at pre-compile  # This container contains the configuration (parameter) for processing the function externally.
          boolean DemRbDtcFilter [0..1]: multiplicity set at pre-compile, origin=RB:AR40.8.0.0:2014-07-24, set at pre-compile, default-value=false  # This configuration switch defines whether the DTC filter function shall be processed inside Dem_Mainfunction or it shall be processed when it is called from the external function | true: External processing is enabled false: External Processing is disabled
        container DemRbGlobalCallbackEventStatusChanged [0..255]: multiplicity set at pre-compile  # The presence of this container indicates, that the Dem has access to a "DemRbGlobalCallbackEventStatusChangedFnc" callback, which the Dem will call for every event status changed to notify other components about the change in the status of a event. Note: All callbacks configured in this container shall be called in a single function. | if DemRbGlobalCallbackEventStatusChangedFnc is configured, this parameter defines the name of the function that the Dem will call.
          function name DemRbGlobalCallbackEventStatusChangedFnc: scope=ECU, multiplicity set at pre-compile, origin=RB:AR42.7.0.0:2019-07-12, set at pre-compile  # Function name of prototype "GlobalEventStatusChanged".
        container DemRbGlobalCallbackInitMForE [0..1]  # The presence of this container indicates, that the Dem has access to an "DemRbGlobalInitMonitorForEvent" callback, which the Dem will call to initialize all monitors. | In case the container has a DemRbGlobalCallbackInitMForEFnc, this parameter defines the name of the function that the Dem will call. In case there is no DemRbGlobalCallbackInitMForEFnc, the Dem will not call the GLobal Callback to notify the reset monitor reasons to the application.
          function name DemRbGlobalCallbackInitMForEFnc [0..1]: multiplicity set at pre-compile, origin=RB:AR42.X.0.0:2020-01-22, set at pre-compile  # Function name of prototype "GlobalInitMonitorForEvent".
        container DemRbOptimization  # This container contains the configuration (parameters) introduced for the optimization purpose.
          integer DemRbAdvanceOperationCycleEventsPerLock [0..1]: 1..65535, multiplicity set at pre-compile, origin=RB:AR42.1.0.0:2016-12-01, set at pre-compile, default-value=16  # On change of an operationcycle, all affected events are processed concerning their eventstatus. This parameter configures the number of events beeing processed at once inside a lock in DemMainCycle.
          integer DemRbClearDTCNumberOfEventsPerCycle [0..1]: 1..65535, multiplicity set at pre-compile, origin=RB:AR40.10.0.0:2015-05-06, set at pre-compile  # Configures the number of events to be processed per DemMainCycle when processing a clear command. Be aware, the time to clear an individual event is highly dependent on ecu speed, task timing, and configuration like clearEventAllowed callbacks and eventStatusChange callbacks. ->If this parameter is not configured, all events are processed in one call.
          integer DemRbDtcFilterNumberOfEventsPerCycle [0..1]: 1..65535, multiplicity set at pre-compile, origin=RB:AR40.7.0.0:2013-10-01, set at pre-compile, default-value=25  # Defines how many events are considered in processing of a DTCFilter function in the Dem task cycle. If a DTC has more events than this parameter it will be processed anyway if it is the first DTC of this Dem task cycle (so that at least one dtc will be processed per cycle).
          integer DemRbDtcFilterRetrieveNumberOfDTCsPerCycle [0..1]: 1..255, multiplicity set at pre-compile, origin=RB:AR42.4.0.0:2018-04-10, set at pre-compile, default-value=50  # This parameter defines how many DTC's are considered to search matching DTC while retrieval in processing of one GetNextFilteredDTC call. Increasing this value will increase runtime marginally as we look for more DTC’s if matching DTC’s are not present. Refer BSWDOC for further details.
          integer DemRbDtcStateManagerNumberOfDTCsPerCycle [0..1]: 1..65535, multiplicity set at pre-compile, origin=RB:AR42.3.0.0:2017-09-04, set at pre-compile, default-value=10  # Defines the namuber of DTCs to be processed in DTCStateManager function per cycle
          integer DemRbNumberOfDTCsToProcessPerLOCK [0..1]: 1..65535, multiplicity set at pre-compile, origin=RB:AR42.4.0.0:2018-06-18, set at pre-compile, default-value=1  # The number of DTCs to be allowed for processing per LOCK while Control DTC Setting Service is called. Projects should take care that LOCK might take more time in two cases, (i) when DEM_CFG_CUSTOMIZABLEDTCSTATUSBYTE is switched ON(and some project specific functionlaity is done inside the Customer Status Byte Function), (ii) When Event combination is used. -> If this parameter is not configured, by default, it takes the value 1 such that it is safe to have LOCK per DTC irrespective of Project configuration.
          integer DemRbNumberOfEventsToProcessPerLOCK [0..1]: 1..65535, multiplicity set at pre-compile, origin=RB:AR42.4.0.0:2018-06-18, set at pre-compile, default-value=1  # The number of Events to be allowed for processing per LOCK . Projects should take care that LOCK might take more time in two cases, (i) when DEM_CFG_CUSTOMIZABLEDTCSTATUSBYTE is switched ON(and some project specific functionlaity is done inside the Customer Status Byte Function), (ii) When Event combination is used. -> If this parameter is not configured, by default, it takes the value 1 such that it is safe to have LOCK per DTC irrespective of Project configuration.
