[part 1 of 2: package /AUTOSAR_TcpIp/EcucModuleDefs]
AUTOSAR XML (schema 00048)
package /AUTOSAR_TcpIp/EcucModuleDefs
  module definition TcpIp [0..1]: category=VENDOR_SPECIFIC_MODULE_DEFINITION, post-build-variant-support=true, refined-module-def=TcpIp, variants pre-compile  # Configuration of the TcpIp (TCP/IP stack) module.
    container TcpIpConfig  # This container contains the configuration parameters and sub containers of the AUTOSAR TcpIp module.
      container TcpIpCtrl [1..*]: multiplicity set at pre-compile  # Specifies the EthIf controller used for IP communication.
        integer TcpIpIpFramePrioDefault [0..1]: 0..7, multiplicity set at link in variant link-time / post-build in variant post-build / pre-compile in variant pre-compile, set at link in variant link-time / post-build in variant post-build / pre-compile in variant pre-compile, default-value=0  # Specifies the default value for the priority for all outgoing frames. | Note: the value can be changed for each socket individually via TcpIp_ChangeParameter() service. If this optional parameter is not available, 0 is used as default priority.
        boolean TcpIpIpTtlConfigurationEnabled [0..1]: multiplicity set at pre-compile, origin=RB:42.0.3.0:2016-03-25, set at pre-compile, default-value=false  # RB (Vendor06) Enables (TRUE) or disables (FALSE) usage of configured TTL value per EthIfCtrl (VLAN). If it is disabled, default value 1 shall be used.
        enumeration TcpIpZeroCopyModeType [0..1]: {TCPIP_ZEROCOPY_STATIC, TCPIP_ZEROCOPY_DYNAMIC}, multiplicity set at pre-compile, origin=RB:42.8.4.0:2020-04-15, set at pre-compile  # RB (Vendor06) Selects the Mode in which ZeroCopy transmission takes place ( TCPIP_ZEROCOPY_DYNAMIC or TCPIP_ZEROCOPY_STATIC Mode ). In TCPIP_ZEROCOPY_STATIC mode, checksum offload need to be ON and IP fragmentation OFF. Note: This container is mandatory only when TcpIp ZeroCopy is required. | Note: In TCPIP_ZEROCOPY_STATIC Mode, only Reuse header are allocated with a predefined length, so this mode will be more efficient for transmission of frames with same sizes or a limited set of sizes and transmission of multiple Data buffers in a single transmit API. In TCPIP_ZEROCOPY_DYNAMIC Mode, all the headers (Reuse Header, IpOneTimeHeader and UdpOneTimeHeader) are included and this mode will be more efficient for transmission of frames with variable length but transmission of multiple Data pointers is not allowed in a single transmit API.
        reference TcpIpDhcpServerConfigRef [0..0]: set at link in variant link-time / post-build in variant post-build / pre-compile in variant pre-compile, destination=TcpIpDhcpServerConfig  # TcpIpDhcpServerConfigRef (currently unused) | Reference to a TcpIpDhcpServerConfig which shall be used for this controller setting (VLAN). Parameter is unused in implementation.
        reference TcpIpEthIfCtrlRef: set at link in variant link-time / post-build in variant post-build / pre-compile in variant pre-compile, requires-symbolic-name-value=true, destination=EthIfController  # Reference to EthIf controller where the IP address shall be assigned. | Separately for INET and INET6 domains, each TcpIpCtrl shall refer to one EthIfCtrl uniquely. It is possible to have one EthIfCtrl referenced by two TcpIpCtrl only if the domains are different (dual stack functionning on the same VLAN)
        reference TcpIpIpSecConfigSetRef [0..1]: multiplicity set at pre-compile, set at pre-compile, destination=TcpIpIpSecConfigSet  # Reference to set of SDP entries which shall be used for IPsec.
        choice container TcpIpIpVXCtrl  # Specifies whether this controller is an Internet Protocol version 4 (IPv4) or Internet Protocol version 6 (IPv6) instance. Note: one TcpIpCtrl can not support both IPv4 and IPv6 at the same time.
          container TcpIpIpV4Ctrl [0..1]: multiplicity set at pre-compile  # Specifies an Internet Protocol version 4 (IPv4) instance. Container must be configured to specify domain of TcpIpCtrl.
            boolean TcpIpArpTblAgeingDisabled [0..1]: multiplicity set at pre-compile, origin=RB:42.0.3.0:2016-03-25, set at pre-compile, default-value=false  # RB (Vendor06) specific parameter: Disables (TRUE) or enables (FALSE) ageing of ARP Table Entries per TcpIpCtrl. | When enabled(FALSE), the ARP table entries will be discarded after ARP table entry timeout occurs. This parameter does not disable ageing of Arp entries of IP addresses within the same subnet as that of the local address(In - vehicle ECUs). If TcpIpArpTableEntryTimeout is set to INF, then irrespective of TcpIpArpTblAgeingDisabled value, Arp entries will not be timed out.
            boolean TcpIpIcmpEchoBroadcastEnabled [0..1]: multiplicity set at pre-compile, origin=RB:42.0.3.0:2016-03-25, set at pre-compile, default-value=false  # RB (Vendor06) specific parameter: Enables (TRUE) or disables (FALSE) reply to ICMP Broadcast echo requests per TcpIpCtrl.
            reference TcpIpArpConfigRef [0..1]: multiplicity set at pre-compile, set at pre-compile, destination=TcpIpArpConfig  # Reference to ARP configuration for this IPv4 instance. | (Multiple IPv4 instances may use the same configuration container but will operate independently)
            reference TcpIpAutoIpConfigRef [0..0]: multiplicity set at pre-compile, set at pre-compile, destination=TcpIpAutoIpConfig  # TcpIpAutoIpConfigRef (currently unused) | Reference to AutoIp configuration for this IPv4 instance. | (Multiple IPv4 instances may use the same configuration container but will operate independently)
            reference TcpIpDhcpConfigRef [0..0]: multiplicity set at pre-compile, set at pre-compile, destination=TcpIpDhcpConfig  # TcpIpDhcpConfigRef (currently unused) | Reference to DHCP configuration for this IPv4 instance. | (Multiple IPv4 instances may use the same configuration container but will operate independently)
            reference TcpIpFragmentationConfigRef [0..1]: multiplicity set at pre-compile, set at pre-compile, destination=TcpIpIpFragmentationConfig  # Reference to Fragmentation configuration for this IPv4 instance. | (Multiple IPv4 instances may use the same configuration container but will operate independently)
            container TcpIpIpV4MtuConfig [0..0]  # TcpIpIpV4MtuConfig (currently unused) | This container specifies the Maximum Transmission Unit parameters for this IPv4 instance.
              boolean TcpIpIpV4PathMtuEnabled [0..0]: set at pre-compile, default-value=false  # TcpIpIpV4PathMtuEnabled (currently unused) | If enabled the IPv4 processes incoming ICMPv4 "Packet Too Big" messages and stores a MTU value for each destination address.
              float TcpIpIpV4PathMtuTimeout [0..0]: 1..86400, set at pre-compile, default-value=600  # TcpIpIpV4PathMtuTimeout (currently unused) | If this value is >0 the IpV4 will reset the MTU value stored for each destination after n seconds. | see [RFC1191 6.3. Purging stale PMTU information] Default: 600 seconds (10 minutes)
          container TcpIpIpV6Ctrl [0..1]: multiplicity set at pre-compile  # Specifies an Internet Protocol version 6 (IPv6) instance. Container must be configured to specify domain of TcpIpCtrl.
            reference TcpIpIpV6DhcpConfigRef [0..1]: multiplicity set at pre-compile, set at pre-compile, destination=TcpIpDhcpV6Config  # Reference to DHCPv6 configuration. | (Multiple IPv6 instances may use the same configuration container but will operate independently)
            reference TcpIpIpV6FragmentationConfigRef [0..0]: multiplicity set at pre-compile, set at pre-compile, destination=TcpIpIpV6FragmentationConfig  # TcpIpIpV6FragmentationConfigRef (currently unused) | Reference to IPv6 Fragmentation Configuration. | (Multiple IPv6 instances may use the same configuration container but will operate independently)
            reference TcpIpIpV6NdpConfigRef [0..0]: set at pre-compile, destination=TcpIpNdpConfig  # TcpIpIpV6NdpConfigRef (currently unused) | Reference to Neighbor Discovery Protocol Configuration. | (Multiple IPv6 instances may use the same configuration container but will operate independently)
            container TcpIpIpV6MtuConfig [0..0]  # TcpIpIpV6MtuConfig (currently unused) | This container specifies the Maximum Transmission Unit parameters for this IPv6 instance.
              boolean TcpIpIpV6PathMtuEnabled [0..0]: set at pre-compile, default-value=false  # TcpIpIpV6PathMtuEnabled (currently unused) | If enabled the IPv6 processes incoming ICMPv6 "Packet Too Big" messages and stores a MTU value for each destination address. | See RFC1981 "Path MTU Discovery for IP version 6" for details about PathMTU.
              float TcpIpIpV6PathMtuTimeout [0..0]: 1..86400, set at pre-compile, default-value=600  # TcpIpIpV6PathMtuTimeout (currently unused) | If this value is >0 the IpV6 will reset the MTU value stored for each destination after n seconds. | see [RFC1981 5.3. Purging stale PMTU information] Default: 600 seconds (10 minutes)
      container TcpIpDhcpServerConfig [0..0]: multiplicity set at link in variant link-time / post-build in variant post-build / pre-compile in variant pre-compile  # TcpIpDhcpServerConfig (currently unused) | Specifies the configuration parameters of the DHCP Server sub-module. Configuration is not used in implementation.
        string TcpIpDhcpDefaultRouter [0..0]: multiplicity set at link in variant link-time / post-build in variant post-build / pre-compile in variant pre-compile, set at link in variant link-time / post-build in variant post-build / pre-compile in variant pre-compile  # TcpIpDhcpDefaultRouter (currently unused) | IP address of default router (gateway).
        integer TcpIpDhcpNetmask [0..0]: 0..128, multiplicity set at link in variant link-time / post-build in variant post-build / pre-compile in variant pre-compile, set at link in variant link-time / post-build in variant post-build / pre-compile in variant pre-compile  # TcpIpDhcpNetmask (currently unused) | Network mask of IPv4 address or address prefix of IPv6 address in CIDR Notation, i.e. decimal value between 0 and 32 (IPv4) or 0 and 128 (IPv6) that describes the number of significant bits defining the network number or prefix of an IP address.
        reference TcpIpDhcpEthIfSwitchRef [0..0]: scope=ECU, multiplicity set at link in variant link-time / post-build in variant post-build / pre-compile in variant pre-compile, set at link in variant link-time / post-build in variant post-build / pre-compile in variant pre-compile, requires-symbolic-name-value=true, destination=EthIfSwitch  # TcpIpDhcpEthIfSwitchRef (currently unused) | Reference to EthIfSwitch representation. | Optional in case the Dhcp server is operating without an Ethernet switch.
        container TcpIpDhcpAddressAssignment [0..0]: multiplicity set at link in variant link-time / post-build in variant post-build / pre-compile in variant pre-compile  # TcpIpDhcpAddressAssignment (currently unused) | Defines a Ethernet Switch port based IP address assignment.
          string TcpIpDhcpAddressLowerBound [0..0]: set at link in variant link-time / post-build in variant post-build / pre-compile in variant pre-compile  # TcpIpDhcpAddressLowerBound (currently unused) | The lower bound IP address which shall be assigned. | If lower bound and upper bound are identical exactly this IP address shall be assigned.
          string TcpIpDhcpAddressUpperBound [0..0]: set at link in variant link-time / post-build in variant post-build / pre-compile in variant pre-compile  # TcpIpDhcpAddressUpperBound (currently unused) | The upper bound IP address which shall be assigned. | If lower bound and upper bound are identical exactly this IP address shall be assigned.
          reference TcpIpDhcpSwitchPortRef [0..0]: scope=ECU, multiplicity set at link in variant link-time / post-build in variant post-build / pre-compile in variant pre-compile, set at link in variant link-time / post-build in variant post-build / pre-compile in variant pre-compile, requires-symbolic-name-value=true, destination=EthSwtPort  # TcpIpDhcpSwitchPortRef (currently unused) | Reference to Ethernet Switch port. | Optional in case the Dhcp server is operating without an Ethernet switch.
      container TcpIpDuplicateAddressDetectionConfig [0..1]: multiplicity set at pre-compile  # Specifies the DAD callout function.
        function name TcpIpDuplicateAddressDetectionCalloutName: set at pre-compile  # This parameter defines the name of the DAD callout function <Up_DADAddressConflict>. | Note:It specifies the name of callout function which will be called by TcpIp for informing the upper layer whether the IP address is duplicate on the network.
      container TcpIpIpConfig [0..1]: multiplicity set at pre-compile  # Specifies the configuration parameters of the IP (Internet Protocol) sub-module
        container TcpIpIpV4Config [0..1]: multiplicity set at pre-compile  # Specifies the configuration parameters of the IPv4 (Internet Protocol version 4) sub-module.
          container TcpIpArpConfig [0..*]: multiplicity set at pre-compile  # Specifies the configuration parameters of the ARP (Address Resolution Protocol) sub-module.
            boolean TcpIpArpDefensiveProcessing [0..0]: multiplicity set at pre-compile, set at pre-compile, default-value=false  # TcpIpArpDefensiveProcessing (currently unused) | If enabled the ARP shall only process ARP replies which are received in reaction to a previously transmitted ARP request as well as skipping updates to the ARP table based on received Gratuitous ARP packets. If disabled all ARP packets shall be processed as specified in IETF RFC 826.
            integer TcpIpArpMaxRequests [0..1]: 1..65535, multiplicity set at link in variant link-time / post-build in variant post-build / pre-compile in variant pre-compile, origin=RB:42.4.3.0:2018-03-31, set at link in variant link-time / post-build in variant post-build / pre-compile in variant pre-compile  # RB (Vendor06) specific parameter: Maximum number of ARP requests that can be sent for a particular destination IP address. Suggested Default Value (1) | Note: Maximum number of ARP requests that are sent to resolve a particular destination IP. If ARP reply is not received after max number of requests are sent, the ARP entry is freed. It is possible to restart address resolution after entry has been freed. User may configure only one parameter out of TcpIpArpRequestTxTimeout and TcpIpArpMaxRequests as these features are mutually exclusive
            integer TcpIpArpNumGratuitousARPonStartup [0..0]: 0..255, set at link in variant link-time / post-build in variant post-build / pre-compile in variant pre-compile, default-value=1  # TcpIpArpNumGratuitousARPonStartup (currently unused) | Specifies the number of gratuitous ARP replies which shall be sent on assignment of a new IP address.
            boolean TcpIpArpPacketQueueEnabled [0..0]: set at pre-compile, default-value=false  # TcpIpArpPacketQueueEnabled (currently unused) | Enables (TRUE) or disables (FALSE) support of the ARP Packet Queue according to IETF RFC 1122, section 2.3.2.2. Parameter unused.
            boolean TcpIpArpReplyBroadcastEnabled [0..1]: multiplicity set at pre-compile, origin=RB:42.7.4.0:2019-10-15, set at pre-compile, default-value=false  # RB (Vendor06) Enables (TRUE) or disables (FALSE) If The ARP reply shall be sent as broadcast for a IPv4 Link- Local address range.
            float TcpIpArpRequestTimeout: 0..INF, set at link in variant link-time / post-build in variant post-build / pre-compile in variant pre-compile, default-value=1  # TcpIpArpRequestTimeout (ArpCycleTime) | Specifies a timeout in seconds for the validity of ARP requests. After the transmission of an ARP request the TcpIp shall skip the transmission of any further ARP requests to the same destination within a duration of TcpIpArpRequestTimeout seconds. (IETF RFC 1122, section 2.3.2.1) The value for this parameter shall be an integral multiple of TcpIpMainFunctionPeriod. | The Timeout in seconds after which ARP resends an ARP Request if ARP Reply was not received. The maximum number of ARP requests to be send before quitting the address resolution is governed by TcpIpArpMaxRequests or TcpIpArpRequestTxTimeout parameters.
            float TcpIpArpRequestTxTimeout [0..1]: 0.0001..4294967.295, multiplicity set at link in variant link-time / post-build in variant post-build / pre-compile in variant pre-compile, origin=RB:42.4.3.0:2018-03-31, set at link in variant link-time / post-build in variant post-build / pre-compile in variant pre-compile  # TcpIpArpRequestTxTimeout (TcpIpArpTrialMax) | RB (Vendor06) specific parameter: Timeout in seconds after which an ECU stops sending ARP request. | Note: After configured timeout is elapsed ECU stops sending ARP request for the particular destination IP, if no reply is received, address resolution sequence will not be repeated for this remote IP afterwards. I.e. further transmit requests to this destination will be rejected. The ARP entry for this IP would be permanently occupied and never freed.User may configure only one parameter out of TcpIpArpRequestTxTimeout and TcpIpArpMaxRequests as these features are mutually exclusive
            float TcpIpArpTableEntryTimeout: 0..INF, set at link in variant link-time / post-build in variant post-build / pre-compile in variant pre-compile  # Timeout in seconds after which an unused ARP entry is removed.
            integer TcpIpArpTableSizeMax: 1..65535, set at link in variant link-time+post-build / pre-compile in variant pre-compile  # Maximum number of entries in the ARP table.
            boolean TcpIpIpConflictDetectionArpFrames [0..1]: multiplicity set at pre-compile, origin=RB:42.2.0.0:2017-01-30, set at pre-compile, default-value=true  # RB (Vendor06) specific parameter: Enables (TRUE) or disables (FALSE) IP conflict detection based on ARP frames. This parameter shall be enabled if Dhcp or AutoIp is configured, and may be disabled if only static IP addresses are used for in-vehicle communication.
            boolean TcpIpIpConflictDetectionIPv4Frames [0..1]: multiplicity set at pre-compile, origin=RB:42.2.0.0:2017-01-30, set at pre-compile, default-value=false  # RB (Vendor06) specific parameter: Enables (TRUE) or disables (FALSE) IP conflict detection based on IPv4 frames. This parameter needs to be enabled only if IP conflict detection needs to be done on reception every IPv4 frame. This might be required to identify IP conflicts after some node has assigned same IP as the current node, but for some reason probing frame has not reached the current node (eg. link was down for the current node).
            boolean TcpIpRbArpProtocolDisabledByDefault [0..0]: multiplicity set at pre-compile, origin=RB:45.5.0.0:2023-06-30, set at pre-compile, default-value=false  # TcpIpRbArpProtocolDisabledByDefault (currently unused) | RB (Vendor06) specific parameter: Disables (TRUE) or enables (FALSE) the support of ARP protocol by default. | Disabling ARP protocol means that there will be no ARP requests and no ARP replies sent form ECU, ARP table will not be updated neither on reception of ARP messages nor IP messages and no IP conflict detection will be executed. When setting this parameter to TRUE, the API TcpIp_EnableArp() will be available to enable ARP protocol during runtime. When ARP protocol is disabled, it is still possible to add static entries in the ARP table using API TcpIp_SetRemotePhysAddr().
          container TcpIpAutoIpConfig [0..*]: multiplicity set at pre-compile  # Specifies the configuration parameters of the Auto-IP (automatic private IP addressing) sub-module.
            float TcpIpAutoIpInitTimeout: 0..INF, set at link in variant link-time / post-build in variant post-build / pre-compile in variant pre-compile  # The time in seconds Auto-IP waits at startup, before beginning with ARP probing. This delay is used to give DHCP time to acquire a lease in case a DHCP server is present.
          container TcpIpDhcpConfig [0..0]  # TcpIpDhcpConfig (currently unused) | Specifies the configuration parameters of the DHCPv4. Configuration Parameter is not supported by Implementation. | This container may be referenced by multiple IPv4 instances if they shall use the same configuration. This container may have multiple instances if different configurations are required for different IPv4 instances.
          container TcpIpIcmpConfig [0..1]: multiplicity set at pre-compile  # Specifies the configuration parameters of the ICMP (Internet Control Message Protocol) sub-module.
            boolean TcpIpIcmpEchoReplyEnabled: set at pre-compile, default-value=false  # Enables or disables transmission of ICMP echo reply message in case of a ICMP echo reception.
            integer TcpIpIcmpTtl: 1..255, set at link in variant link-time / post-build in variant post-build / pre-compile in variant pre-compile  # Default Time-to-live value of outgoing ICMP packets. | This Time-To-Live value decides how long packet stays alive on network when destination is not reachable
            container TcpIpIcmpMsgHandler [0..1]: multiplicity set at pre-compile  # This container is a subcontainer of TcpIpIcmpConfig and specifies the configuration parameters for the ICMP message handler.
              function name TcpIpIcmpMsgHandlerName: set at link in variant link-time+post-build / pre-compile in variant pre-compile  # This parameter defines the name of the ICMP message handler function <Up_IcmpMsgHandler>.
          container TcpIpIpFragmentationConfig [0..*]: multiplicity set at pre-compile  # Specifies the configuration parameters of IPv4 packet fragmentation/reassembly. | This container may be referenced by multiple IPv4 instances if they shall use the same configuration. This container may have multiple instances if different configurations are required for different IPv4 instances.
            boolean TcpIpIpFragmentationRxEnabled [0..0]: set at pre-compile, default-value=false  # TcpIpIpFragmentationRxEnabled (currently unused) | Enables (TRUE) or disables (FALSE) support for reassembling of incoming datagrams that are fragmented according to IETF RFC 815 (IP Datagram Reassembly Algorithms). Currently unused in Implementation
            integer TcpIpIpNumFragments [0..0]: 0..255, multiplicity set at link in variant link-time / post-build in variant post-build / pre-compile in variant pre-compile, set at link in variant link-time / post-build in variant post-build / pre-compile in variant pre-compile, default-value=0  # TcpIpIpNumFragments (currently unused) | Specifies the maximum number of IP fragments per datagram. Currently unused in Implementation. | Note: this parameter is only relevant if TcpIpIpFragmentationRxEnabled is TRUE.
            integer TcpIpIpNumReassDgrams [0..0]: 0..65535, multiplicity set at link in variant link-time / post-build in variant post-build / pre-compile in variant pre-compile, set at link in variant link-time / post-build in variant post-build / pre-compile in variant pre-compile, default-value=3  # TcpIpIpNumReassDgrams (currently unused) | Specifies the maximum number of fragmented IP datagrams that can be reassembled in parallel. Currently unused in Implementation. | Note: this parameter is only relevant if TcpIpIpFragmentationRxEnabled is TRUE.
            float TcpIpIpReassTimeout [0..1]: 0.001..120, multiplicity set at link in variant link-time / post-build in variant post-build / pre-compile in variant pre-compile, set at link in variant link-time / post-build in variant post-build / pre-compile in variant pre-compile, default-value=60  # Specifies the timeout in [s] after which an incomplete datagram gets discarded. RFC 1122 recommends the value to be in between 60 seconds and 120 seconds. | Note: This parameter is only relevant if TcpIpIpReassemblyBufferCount is configured to a value greater than zero.
            integer TcpIpIpReassemblyBufferCount: 0..255, origin=RB:42.2.0.0:2017-01-30, set at pre-compile, default-value=1  # RB (Vendor06) specific parameter: Number of buffers that can be used for fragment reassembly. A value of 0 disables fragment reassembly. | For all the fragments of a particular quadruple (source IP, destination IP, frame identifier and protocol) only one buffer will be allocated during reassembly. And hence value of the parameter specifies the maximum number of parallel reassembly operations possible for different quadruples.
            integer TcpIpIpReassemblyBufferSize [0..1]: 576..65535, multiplicity set at pre-compile, origin=RB:42.2.0.0:2017-01-30, set at pre-compile, default-value=576  # RB (Vendor06) specific parameter: The parameter specifies size of the buffer in bytes required to reassemble all the fragments of an original frame. Expected value here corresponds to only IPv4 payload size before frame undergoing fragmentation. | Note: This parameter is only relevant if TcpIpIpReassemblyBufferCount is configured to a value greater than zero. It shall be configured to a value greater than or equal to the EthIfCtrlMtu. The node must be able to reassemble frames that is atleast equal to the size of the EthIfCtrlMtu according to RFC 1122.
            integer TcpIpIpTxFragmentBufferSize [0..1]: multiplicity set at pre-compile, origin=RB:42.1.2.0:2016-08-12, set at pre-compile  # RB (Vendor06) specific parameter: Specifies the fragmentation buffer size in terms of bytes for the controller. If the fragmentation needs to be disabled for the controller the parameter shall not be configured. | Note: It shall be configured to a value greater than EthIfCtrlMtu. A frame gets fragmented only when the frame length is greater than EthIfCtrlMtu. Hence IPv4 is always expected to buffer frame sizes greater than EthIfCtrlMtu during fragmentation.
        container TcpIpIpV6Config [0..1]: multiplicity set at pre-compile  # Specifies the configuration parameters of the IPv6 (Internet Protocol version 6) sub-module. This is not supported in present implementation and hence not to be configured.
          container TcpIpDhcpV6Config [0..*]: multiplicity set at pre-compile  # Specifies the configuration parameters of the DHCPv6. | This container may be referenced by multiple IPv6 instances if they shall use the same configuration. This container may have multiple instances if different configurations are required for different IPv6 instances.
            float TcpIpDhcpV6CnfDelayMax: 0..100, set at pre-compile, default-value=1  # Maximum delay (s) before sending the first Confirm message. If this value is bigger than the previous minimum delay value a random delay will be chosen from the interval.
            float TcpIpDhcpV6CnfDelayMin: 0..100, set at pre-compile, default-value=0  # Minimum delay (s) before the first Confirm message will be sent.
            float TcpIpDhcpV6InfDelayMax: 0..100, set at pre-compile, default-value=1  # Maximum delay (s) before sending the first Information Request message. If this value is bigger than the previous minimum delay value a random delay will be chosen from the interval.
            float TcpIpDhcpV6InfDelayMin: 0..100, set at pre-compile, default-value=0  # Minimum delay (s) before the first Information Request message will be sent.
            float TcpIpDhcpV6SolDelayMax: 0..100, set at pre-compile, default-value=1  # Maximum delay (s) before sending the first Solicit message. If this value is bigger than the previous minimum delay value a random delay will be chosen from the interval.
            float TcpIpDhcpV6SolDelayMin: 0..100, set at pre-compile, default-value=0  # Minimum delay (s) before the first Solicit message will be sent.
          container TcpIpIcmpV6Config  # Specifies the configuration parameters of the ICMPv6 (Internet Control Message Protocol for IPv6) sub-module.
            boolean TcpIpIcmpV6EchoReplyAvoidFragmentation: set at pre-compile, default-value=false  # If enabled, the stack will respond only to incoming ICMPv6 Echo Requests (Pings) that fit the MTU of the respective interface, i.e. can be transmitted without IPv6 fragmentation. Only relevant if TcpIpIcmpV6EchoReplyEnabled is enabled.
            boolean TcpIpIcmpV6EchoReplyEnabled: set at pre-compile, default-value=false  # If enabled, the stack will respond to incoming ICMPv6 Echo Requests (Pings).
            integer TcpIpIcmpV6HopLimit: 1..255, set at link in variant link-time / post-build in variant post-build / pre-compile in variant pre-compile  # Default Hop-Limit value of outgoing ICMPv6 packets.
            boolean TcpIpIcmpV6MsgDestinationUnreachableEnabled: set at pre-compile  # Dis/Enables transmission of Destination Unreachable Messages.
            boolean TcpIpIcmpV6MsgParameterProblemEnabled: set at pre-compile, default-value=true  # If enabled an ICMPv6 parameter problem message will be sent if a received packet has been dropped due to unknown options or headers that are found in the packet. | [RFC8200 4. IPv6 Extension Headers]
            container TcpIpIcmpV6MsgHandler [0..1]: multiplicity set at pre-compile  # This container is a subcontainer of TcpIpIcmpConfig and specifies the configuration parameters for the ICMPv6 message handler.
              function name TcpIpIcmpV6MsgHandlerName: set at link in variant link-time+post-build / pre-compile in variant pre-compile  # This parameter defines the name of the ICMP message handler function <Up_IcmpMsgHandler>.
          container TcpIpIpV6ConfigExtHeaderFilter [0..*]: multiplicity set at pre-compile  # This container describes the white list for the filtering of IPv6 extension headers, i.e. frames containing IPv6 extension headers not listed here shall be silently dropped. | Next Header values for UL protocols are not considered as Extension Headers, therefore UL values should not be configured as Filter entries. It is possible to configure an empty white list, such a configuration will not allow any IPv6 frame with an Extension Header to be received.
            integer TcpIpIpV6ConfigExtHeaderFilterEntry [0..*]: 0..255, multiplicity set at pre-compile, set at pre-compile  # IPv6 Extension Header type allowed by this filter.
          container TcpIpIpV6FragmentationConfig [0..0]  # TcpIpIpV6FragmentationConfig (currently unused) | Specifies the configuration parameters of IPv6 packet fragmentation/reassembly. | This container may be referenced by multiple IPv6 instances if they shall use the same configuration. This container may have multiple instances if different configurations are required for different IPv6 instances.
            integer TcpIpIpV6ReassemblyBufferCount [0..0]: 0..255, set at pre-compile, default-value=255  # TcpIpIpV6ReassemblyBufferCount (currently unused) | Number of buffers that can be used for fragment reassembly. In case of a reassembly error or if not all fragments are received in time this buffer will be blocked until the specified "Fragment Reassembly Timeout" has been exceeded. | A value of 0 disables fragment reassembly. [RFC8200 5. Packet Size Issues] "In order to send a packet larger than a path's MTU, a node may use the IPv6 Fragment header to fragment the packet at the source and have it reassembled at the destination(s). However, the use of such fragmentation is discouraged in any application that is able to adjust its packets to fit the measured path MTU (i.e., down to 1280 octets)."
            integer TcpIpIpV6ReassemblyBufferSize [0..0]: 1500..65535, multiplicity set at pre-compile, set at pre-compile, default-value=1500  # TcpIpIpV6ReassemblyBufferSize (currently unused) | [RFC8200 5. Packet Size Issues] | "A node must be able to accept a fragmented packet that, after reassembly, is as large as 1500 octets. A node is permitted to accept fragmented packets that reassemble to more than 1500 octets."the measured path MTU (i.e., down to 1280 octets)."
            integer TcpIpIpV6ReassemblySegmentCount [0..0]: 1..255, multiplicity set at pre-compile, set at pre-compile, default-value=5  # TcpIpIpV6ReassemblySegmentCount (currently unused) | Specifies the maximum number of consecutive data segments that can be managed in each reassembly buffer. If all fragments are received in order, only one segment will be needed. | To deal with fragments received out of order this value should be configured bigger than 1.
            float TcpIpIpV6ReassemblyTimeout [0..0]: 0.001..100, multiplicity set at pre-compile, set at pre-compile, default-value=60  # TcpIpIpV6ReassemblyTimeout (currently unused) | [RFC8200 4.5 Fragment Header] | Default: 60 seconds
            integer TcpIpIpV6TxFragmentBufferCount [0..0]: 1..1000, set at pre-compile, default-value=2  # TcpIpIpV6TxFragmentBufferCount (currently unused) | These buffers will be used if the IpV6 receives packets from the upper layer that do not fit into the MTU and thus must be fragmented. | A value of 0 disables tx fragmentation. If the upper layer transmits packets that do not fit into the link or path MTU, the IpV6 will split-up the packet into fragments. see "Enable Fragment Reassembly"
            integer TcpIpIpV6TxFragmentBufferSize [0..0]: 1500..65535, multiplicity set at pre-compile, set at pre-compile, default-value=1500  # TcpIpIpV6TxFragmentBufferSize (currently unused) | Size of each fragment tx buffer in bytes
          container TcpIpNdpConfig [0..*]: multiplicity set at pre-compile  # Specifies the configuration parameters of the Neighbor Discovery Protocol for IPv6 | This container may be referenced by multiple IPv6 instances if they shall use the same configuration. This container may have multiple instances if different configurations are required for different IPv6 instances.
            container TcpIpNdpArNudConfig [0..1]: multiplicity set at pre-compile  # Specifies the configuration parameters for NDP Address Resolution and Neighbor Unreachability Detection.
              float TcpIpNdpDefaultReachableTime: 0..120, set at pre-compile, default-value=30  # Configuration of the ReachableTime (s) specified in [RFC4861 6.3.2. Host Variables]. | "The time a neighbor is considered reachable after receiving a reachability confirmation." If "TcpIpNdpDynamicReachableTimeEnabled" is checked, this value may be reconfigured based on received Router Advertisements. Default: REACHABLE_TIME = 30 seconds
              integer TcpIpNdpDefaultRefreshTimeStaticRtr: 0..60, origin=RB:42.4.0.0:2017-12-12, set at pre-compile, default-value=1  # RB (Vendor06) specific parameter: The refresh time of the Default Router for all the Static TcpIp Local IPv6 Address configurations containers. The value of this parameter is interpreted in number of seconds.
              float TcpIpNdpDefaultRetransTimer: 0..60, set at pre-compile, default-value=1  # Configures the default value (s) for the RetransTimer variable specified in [RFC4861 6.3.2. Host Variables]. | "The time between retransmissions of Neighbor Solicitation messages to a neighbor when resolving the address or when probing the reachability of a neighbor." If "TcpIpNdpDynamicRetransTimeEnabled" is checked, this value may be reconfigured based on received Router Advertisements. Default: RETRANS_TIMER = 1 second
              boolean TcpIpNdpDefensiveProcessing [0..0]: set at pre-compile, default-value=false  # TcpIpNdpDefensiveProcessing (currently unused) | If enabled the NDP shall only process Neighbor Advertisements which are received in reaction to a previously transmitted Neighbor Solicitation as well as skipping updates to the Neighbor Cache based on received Neighbor Solicitations. If disabled all Neighbor Advertisements and Solicitations shall be processed as specified in RFC4861. | [RFC4861 7.2.5. Receipt of Neighbor Advertisements]
              float TcpIpNdpDelayFirstProbeTime [0..0]: 0..60, set at pre-compile, default-value=5  # TcpIpNdpDelayFirstProbeTime (currently unused) | Delay before sending the first NUD probe in (s). | [RFC4861 7.3.3. Node Behavior] Default: DELAY_FIRST_PROBE_TIME = 5 seconds
              integer TcpIpNdpMaxNeighborCacheSize: 1..254, set at pre-compile, default-value=5  # Maximum number of entries in the neighbor cache. | [RFC4861 5.1. Conceptual Data Structures]
              integer TcpIpNdpMaxRandomFactor: 0..100, set at pre-compile, default-value=15  # Maximum random factor used for randomization | [RFC4861 10. Protocol Constants] Default: 15 (MAX_RANDOM_FACTOR = 1.5)
              integer TcpIpNdpMinRandomFactor: 0..100, set at pre-compile, default-value=5  # Minimum random factor used for randomization | [RFC4861 10. Protocol Constants] Default: 5 (MIN_RANDOM_FACTOR = 0.5)
              boolean TcpIpNdpNeighborUnreachabilityDetectionEnabled: set at pre-compile, default-value=true  # Neighbor Unreachability Detection is used to remove unused entries from the neighbor cache. This feature is a basic feature of NDP and should be turned on.
              integer TcpIpNdpNumMulticastSolicitations: 0..255, set at pre-compile, default-value=3  # Maximum number of multicast solicitations that will be sent when performing address resolution. | [RFC4861 7.2.2. Sending Neighbor Solicitations] Default: MAX_MULTICAST_SOLICIT = 3
              integer TcpIpNdpNumUnicastSolicitations: 0..255, set at pre-compile, default-value=3  # Maximum number of unicast solicitations that will be sent when performing Neighbor Unreachability Detection. | [RFC4861 7.3.3. Node Behavior] Default: MAX_UNICAST_SOLICIT = 3
              boolean TcpIpNdpPacketQueueEnabled: set at pre-compile, default-value=true  # Enables (TRUE) or disables (FALSE) support of a NDP Packet Queue according to IETF RFC 4861, section 7.2.2.
              boolean TcpIpNdpRandomReachableTimeEnabled: set at pre-compile, default-value=true  # If enabled the value of ReachableTime will be multiplied with a random value between MIN_RANDOM_FACTOR and MAX_RANDOM_FACTOR in order to prevent multiple nodes from transmitting at exactly the same time | [RFC4861 6.3.2. Host Variables / ReachableTime]
              boolean TcpIpRbNdpProbeOnReceivedMessage [0..1]: multiplicity set at pre-compile, origin=RB:45.4.0.0:2023-01-20, set at pre-compile, default-value=false  # RB (Vendor06) specific parameter: Enables (TRUE) or disables (FALSE) the support of probing when a unicast or multicast IPv6 frame is received (with Udp or Icmpv6 protocol). | When ENABLED : If an IP frame is received from a remote node for which neighbor entry does not exist, an entry will be created in PROBE state. The entry will become reachable on receiving NA from remote node else it will be deleted after PROBE sequence is complete. When DISABLED: On receiving IP frame, neighbor entry is created in REACHABLE state.
            container TcpIpNdpPrefixRouterDiscoveryConfig [0..1]: multiplicity set at pre-compile  # Specifies the configuration parameters for NDP Prefix and Router Discovery.
              integer TcpIpNdpDefaultRouterListSize: 2..254, set at pre-compile, default-value=2  # Maximum number of default router entries. | [RFC4861 5.1. Conceptual Data Structures]
              integer TcpIpNdpDestinationCacheSize: 1..254, set at pre-compile, default-value=5  # Maximum number of entries in the destination cache. | [RFC4861 5.1. Conceptual Data Structures]
              boolean TcpIpNdpDynamicHopLimitEnabled: set at pre-compile, default-value=true  # If enabled the default hop limit may be reconfigured based on received Router Advertisements. | [RFC4861 6.3.4. Processing Received Router Advertisements]
              boolean TcpIpNdpDynamicMtuEnabled: set at pre-compile, default-value=false  # Allow dynamic reconfiguration of link MTU via Router Advertisements. | [RFC4861 4.6.4. MTU]
              boolean TcpIpNdpDynamicReachableTimeEnabled: set at pre-compile, default-value=true  # If enabled the default Reachable Time value may be reconfigured based on received Router Advertisements. | [RFC4861 6.3.4. Processing Received Router Advertisements] Default: Enabled
              boolean TcpIpNdpDynamicRetransTimeEnabled: set at pre-compile, default-value=true  # If enabled the default Retransmit Timer value may be reconfigured based on received Router Advertisements. | [RFC4861 6.3.4. Processing Received Router Advertisements] Default: Enabled
              float TcpIpNdpMaxRtrSolicitationDelay: 0.001..60, set at pre-compile, default-value=1  # Maximum delay before the first Router Solicitation will be sent after interface initialization in (s). | [RFC4861 6.3.7. Sending Router Solicitations] Default: MAX_RTR_SOLICITATION_DELAY = 1 second
              integer TcpIpNdpMaxRtrSolicitations: 0..255, set at pre-compile, default-value=3  # Maximum number of Router Solicitations that will be sent before the first Router Advertisement has been received. | 0 = No Router Solicitations will be sent. This has no impact on handling Router Advertisements. [RFC4861 6.3.7. Sending Router Solicitations] Default: MAX_RTR_SOLICITATIONS = 3 transmissions
              integer TcpIpNdpPrefixListSize: 1..254, set at pre-compile, default-value=5  # Maximum number of entries in the on-link prefix list. | [RFC4861 5.1. Conceptual Data Structures]
              boolean TcpIpNdpRndRtrSolicitationDelayEnabled: set at pre-compile, default-value=true  # If enabled the first router solicitation will be delayed randomly from [0...MAX_RTR_SOLICITATION_DELAY]. Otherwise the first router solicitation will be sent after exactly MAX_RTR_SOLICITATION_DELAY milliseconds. | [RFC4861 6.3.7. Sending Router Solicitations] Default: Enabled
              float TcpIpNdpRtrSolicitationInterval: 0.001..60, set at pre-compile, default-value=4  # Interval between consecutive Router Solicitations in (s). | [RFC4861 6.3.7. Sending Router Solicitations] Default: RTR_SOLICITATION_INTERVAL = 4 seconds
              container TcpIpNdpPrefixList [0..0]  # TcpIpNdpPrefixList (currently unused) | Specifies a list of prefixes to be treated as "on-link" according to IETF RFC 4861 Section 5.1.
                container TcpIpNdpPrefixListEntry [0..0]  # TcpIpNdpPrefixListEntry (currently unused) | Single entry in the prefix list.
                  string TcpIpNdpPrefixListEntryPrefixAddress [0..0]: set at pre-compile  # TcpIpNdpPrefixListEntryPrefixAddress (currently unused) | The prefix of an IP address. This prefix can be used for on-link determination.
                  integer TcpIpNdpPrefixListEntryPrefixLength [0..0]: 0..128, set at pre-compile  # TcpIpNdpPrefixListEntryPrefixLength (currently unused) | The number of leading bits in the Prefix that are valid.
            container TcpIpNdpSlaacConfig [0..1]: multiplicity set at pre-compile  # Specifies the configuration parameters for StateLess Address AutoConfiguration.
              integer TcpIpNdpSlaacDadNumberOfTransmissions [0..0]: 0..254, set at pre-compile, default-value=1  # TcpIpNdpSlaacDadNumberOfTransmissions (currently unused) | Number of Neighbor Solicitations that have to be unanswered in order to set an autoconfigurated address to PREFERRED (usable) state. | [RFC4861 5.1. Node Configuration Variables] Default: DupAddrDetectTransmits = 1 Setting this value to 0 turns off DAD.
              float TcpIpNdpSlaacDadRetransmissionDelay [0..0]: 0..10, set at pre-compile, default-value=1  # TcpIpNdpSlaacDadRetransmissionDelay (currently unused) | Sets the maximum value for the address configuration delay (s). | According to [RFC4861 5.4.2. Sending Neighbor Solicitation Messages] this value should be the same as MAX_RTR_SOLICITATION_DELAY. Default: MAX_RTR_SOLICITATION_DELAY = 1 second
              boolean TcpIpNdpSlaacDelayEnabled [0..0]: set at pre-compile, default-value=false  # TcpIpNdpSlaacDelayEnabled (currently unused) | If enabled transmission of the first DAD Neighbor Solicitation will be delayed by a random value from [0...MAX_DAD_DELAY]. | "This serves to alleviate congestion when many nodes start up on the link at the same time, such as after a power failure, and may help to avoid race conditions when more than one node is trying to solicit for the same address at the same time." "The delay will avoid similar congestion when multiple nodes are going to configure addresses by receiving the same single multicast router advertisement." [RFC4861 5.4.2. Sending Neighbor Solicitation Messages] Default: True
              boolean TcpIpNdpSlaacOptimisticDadEnabled [0..0]: set at pre-compile, default-value=false  # TcpIpNdpSlaacOptimisticDadEnabled (currently unused) | Enable Optimistic Duplicate Address Detection (DAD) according to RFC4429.
              float TcpIpRbNdpSlaacNeighborAdvertisementRetransTimer [0..1]: 0..60, multiplicity set at pre-compile, origin=RB:42.9.4.0:2020-10-15, set at pre-compile  # Configures the default value (s) for the RetransTimer variable specified in [RFC4861 7.2.6. Sending Unsolicited Neighbor Advertisements]. | The time between retransmissions of Neighbor Advertisement messages when IP conflict is detected. IP conflict is detected when source IP address and destination IP address of an incoming IPv6 packet are equal or when target IP address of Neighbor Advertisement is assigned to the TcpIpCtrl. When IP conflict is detected, Unsolicited Neighbor Advertisement is sent to All Node Multicast address as a way of defending the IP address. IP address is defended only for TCPIP_LINKLOCAL_DOIP, TCPIP_LINKLOCAL, TCPIP_IPV6_ROUTER and TCPIP_STATIC IPv6 addresses. For TCPIP_DHCP addresses, new address is requested from DHCPv6 server when conflict is detected and no Neighbor Advertisement is sent in return. When the parameter is not configured or configured to 0 seconds, Ndp disables transmission of Unsollicited Neighbor Advertisements for defend mechanism purpose.
      container TcpIpIpSecConfigSet [0..*]: multiplicity set at pre-compile  # Specifies the IPsec configuration.
        function name TcpIpIpSecAuditEventCalloutFunction [0..1]: multiplicity set at pre-compile, set at pre-compile  # This parameter specifies the name of a callout function that will be called for each auditable event.
        string TcpIpIpSecCalloutHeaderFile [0..1]: multiplicity set at pre-compile, set at pre-compile  # This parameter specifies the name of the header file containing the definition for the functions specified in TcpIpIpSecSpdCalloutFunction and TcpIpIpSecAuditEvent
        function name TcpIpIpSecSpdCalloutFunction [0..1]: multiplicity set at pre-compile, set at pre-compile  # This parameter specifies the name of a callout function that shall be called for each Rx/Tx messag, after the IPsec has processed all corresponding SPD entries and has determined the policy. The callout function allows it to override the applied policy.
        integer TcpIpRemoteDeviceNum: 1..18446744073709551615, set at pre-compile  # Amount of remote clients which will negotiate a Security Association (SA).
        container TcpIpEncryptionAlgorithm [0..*]: multiplicity set at pre-compile  # Container for configuration of supported encryption algorithm transforms. This container is used to configure supported algorithms for ESP. The transform algorithm must be configured in the Crypto module.
          enumeration TcpIpEncryptionTransformIdentifier: {TCPIP_IPSEC_TRANSFORM_ENCR_3DES, TCPIP_IPSEC_TRANSFORM_ENCR_3IDEA, TCPIP_IPSEC_TRANSFORM_ENCR_AES_CBC, TCPIP_IPSEC_TRANSFORM_ENCR_AES_CCM_12, TCPIP_IPSEC_TRANSFORM_ENCR_AES_CCM_16, TCPIP_IPSEC_TRANSFORM_ENCR_AES_CCM_8, TCPIP_IPSEC_TRANSFORM_ENCR_AES_CCM_8_IIV, TCPIP_IPSEC_TRANSFORM_ENCR_AES_CTR, TCPIP_IPSEC_TRANSFORM_ENCR_AES_GCM_12, TCPIP_IPSEC_TRANSFORM_ENCR_AES_GCM_16, TCPIP_IPSEC_TRANSFORM_ENCR_AES_GCM_16_IIV, TCPIP_IPSEC_TRANSFORM_ENCR_AES_GCM_8, TCPIP_IPSEC_TRANSFORM_ENCR_BLOWFISH, TCPIP_IPSEC_TRANSFORM_ENCR_CAMELLIA_CBC, TCPIP_IPSEC_TRANSFORM_ENCR_CAMELLIA_CCM_12, TCPIP_IPSEC_TRANSFORM_ENCR_CAMELLIA_CCM_16, TCPIP_IPSEC_TRANSFORM_ENCR_CAMELLIA_CCM_8, TCPIP_IPSEC_TRANSFORM_ENCR_CAMELLIA_CTR, TCPIP_IPSEC_TRANSFORM_ENCR_CAST, TCPIP_IPSEC_TRANSFORM_ENCR_CHACHA20_POLY1305, TCPIP_IPSEC_TRANSFORM_ENCR_CHACHA20_POLY1305_II, TCPIP_IPSEC_TRANSFORM_ENCR_DES, TCPIP_IPSEC_TRANSFORM_ENCR_DES_IV32, TCPIP_IPSEC_TRANSFORM_ENCR_DES_IV64, TCPIP_IPSEC_TRANSFORM_ENCR_IDEA, TCPIP_IPSEC_TRANSFORM_ENCR_NULL, TCPIP_IPSEC_TRANSFORM_ENCR_RC5}, multiplicity set at pre-compile, set at pre-compile, default-value=TCPIP_IPSEC_TRANSFORM_ENCR_DES  # Encryption algorithm transform identifier. Parameter values are defined as per IETF RFC 7296 3.3.2
          container TcpIpEncryptionTransformJobPair [1..*]: multiplicity set at pre-compile  # Container for storing the CSM integrity transform job references for performing authentication. Valid for ESP and AH.At least one Integrity transform job pair needs to be configured for each Integrity Algorithm.
            reference TcpIpCsmDecryptJobRef: multiplicity set at pre-compile, set at pre-compile, requires-symbolic-name-value=true, destination=CsmJob  # The referenced Csm job is used for the execution of the CsmMacVerify primitive needed for this transform. | Must be a valid decryption job of the parent type.
            reference TcpIpCsmEncryptJobRef: multiplicity set at pre-compile, set at pre-compile, requires-symbolic-name-value=true, destination=CsmJob  # The referenced Csm job is used for the execution of the CsmMacGenerate primitive needed for this transform. | Must be a valid encryption job of the parent type.
        container TcpIpIntegrityAlgorithm [1..*]: multiplicity set at pre-compile  # Container for configuration of supported integrity algorithm transforms. This container is used to configure supported algorithms for AH. The transform algorithm must be configured in the Crypto module.
          enumeration TcpIpIntegrityTransformIdentifier: {TCPIP_IPSEC_TRANSFORM_AUTH_AES_128_GMAC, TCPIP_IPSEC_TRANSFORM_AUTH_AES_192_GMAC, TCPIP_IPSEC_TRANSFORM_AUTH_AES_256_GMAC, TCPIP_IPSEC_TRANSFORM_AUTH_AES_CMAC_96, TCPIP_IPSEC_TRANSFORM_AUTH_AES_XCBC_96, TCPIP_IPSEC_TRANSFORM_AUTH_DES_MAC, TCPIP_IPSEC_TRANSFORM_AUTH_HMAC_MD5_128, TCPIP_IPSEC_TRANSFORM_AUTH_HMAC_MD5_96, TCPIP_IPSEC_TRANSFORM_AUTH_HMAC_SHA1_160, TCPIP_IPSEC_TRANSFORM_AUTH_HMAC_SHA1_96, TCPIP_IPSEC_TRANSFORM_AUTH_HMAC_SHA2_256_128, TCPIP_IPSEC_TRANSFORM_AUTH_HMAC_SHA2_384_192, TCPIP_IPSEC_TRANSFORM_AUTH_HMAC_SHA2_512_256, TCPIP_IPSEC_TRANSFORM_AUTH_KPDK_MD5}, multiplicity set at pre-compile, set at pre-compile, default-value=TCPIP_IPSEC_TRANSFORM_AUTH_HMAC_SHA2_256_128  # Integrity algorithm transform identifier. Parameter values are defined as per IETF RFC 7296 3.3.2
          container TcpIpIntegrityTransformJobPair [1..*]: multiplicity set at pre-compile  # Container for storing the CSM integrity transform job references for performing authentication. Valid for ESP and AH.At least one Integrity transform job pair needs to be configured for each Integrity Algorithm.
            reference TcpIpCsmGenerateJobRef: multiplicity set at pre-compile, set at pre-compile, requires-symbolic-name-value=true, destination=CsmJob  # The referenced Csm job is used for the execution of the CsmMacGenerate primitive needed for this transform. | Must be a valid MAC generate job of the parent type.
            reference TcpIpCsmVerifyJobRef: multiplicity set at pre-compile, set at pre-compile, requires-symbolic-name-value=true, destination=CsmJob  # The referenced Csm job is used for the execution of the CsmMacVerify primitive needed for this transform. | Must be a valid MAC verify job of the parent type.
        container TcpIpSpdEntry [1..*]: multiplicity set at pre-compile  # Entry of the Security Policy Database (SPD).
          enumeration TcpIpIpSecHeaderType: {TCPIP_IPSEC_HDR_AH, TCPIP_IPSEC_HDR_ESP, TCPIP_IPSEC_HDR_NONE}, multiplicity set at pre-compile, set at pre-compile, default-value=TCPIP_IPSEC_HDR_AH  # Header type specifying the IPsec security mechanism.
          enumeration TcpIpIpSecPolicy: {TCPIP_IPSEC_POLICY_BYPASS, TCPIP_IPSEC_POLICY_DISCARD, TCPIP_IPSEC_POLICY_OPTIONAL, TCPIP_IPSEC_POLICY_PROTECT}, multiplicity set at pre-compile, set at pre-compile  # Policy for usage of IPsec.
          integer TcpIpIpSecPriority: 0..18446744073709551615, multiplicity set at pre-compile, set at pre-compile, default-value=0  # Priority of the SPD entry. The processing of entries is based on priority, starting with the highest priority "0". The first matching SPD entry defines the policy.
          string TcpIpLocalIpAddrEnd [0..1]: multiplicity set at pre-compile, set at pre-compile  # End value of the remote IP address range.
          string TcpIpLocalIpAddrStart [0..1]: multiplicity set at pre-compile, set at pre-compile  # Start value of the local IP address range.
          integer TcpIpLocalPortRangeEnd [0..1]: 1..65535, multiplicity set at pre-compile, set at pre-compile  # End value of the local port range.
          integer TcpIpLocalPortRangeStart [0..1]: 1..65535, multiplicity set at pre-compile, set at pre-compile  # Start value of the local port range.
          enumeration TcpIpProtocol: {TCPIP_PROTOCOL_ANY, TCPIP_PROTOCOL_ICMP, TCPIP_PROTOCOL_TCP, TCPIP_PROTOCOL_UDP}, multiplicity set at pre-compile, set at pre-compile  # Relevant IP protocol. | Note: As specified in IETF Rfc 4301 section 6, ICMP error messages will always be BYPASSed. The policy for TCPIP_PROTOCOL_ICMP only applies to ICMP non-error messages. (Echo reply/response).
          string TcpIpRemIpAddrEnd [0..1]: multiplicity set at pre-compile, set at pre-compile  # End value of the remote IP address range.
          string TcpIpRemIpAddrStart [0..1]: multiplicity set at pre-compile, set at pre-compile  # Start value of the remote IP address range.
          integer TcpIpRemPortRangeEnd [0..1]: 1..65535, multiplicity set at pre-compile, set at pre-compile  # End value of the remote port range.
          integer TcpIpRemPortRangeStart [0..1]: 1..65535, multiplicity set at pre-compile, set at pre-compile  # Start value of the remote port range.
      container TcpIpLocalAddr [1..*]: multiplicity set at pre-compile  # Specifies the local IP (Internet Protocol) addresses used for IP communication.
        integer TcpIpAddrId: 0..254, scope=ECU, set at pre-compile, symbolic-name-value=true, with-auto=true  # TcpIpAddrId (Automatically generated) | IP address table identifier assigned by TCP/IP stack.
        enumeration TcpIpAddressType: {TCPIP_ANYCAST, TCPIP_MULTICAST, TCPIP_UNICAST}, set at link in variant link-time / post-build in variant post-build / pre-compile in variant pre-compile  # Address type. | Address type indentifies whether IP address is unicast or multicast address. Valid range for multicast IP is 224.0.0.0 to 239.255.255.255. No Unicast IP should be configured in that range. With Multicast, TcpIpAssignmentMethod shall be TCPIP_STATIC
        enumeration TcpIpDomainType: {TCPIP_AF_INET, TCPIP_AF_INET6}, set at link in variant link-time / post-build in variant post-build / pre-compile in variant pre-compile  # Address family. | When address family is TCPIP_AF_INET, TcpIpIpV4Ctrl container for the referenced TcpIpCtrl shall be configured and for TCPIP_AF_INET_6, TcpIpIpV6Ctrl container for the referenced TcpIpCtrl shall be configured
        reference TcpIpCtrlRef: set at link in variant link-time / post-build in variant post-build / pre-compile in variant pre-compile, destination=TcpIpCtrl  # Reference to a TcpIpCtrl specifying the EthIf Controller where the IP address shall be assigned.
        reference TcpIpLocalAddrIPv6ExtHeaderFilterRef [0..1]: multiplicity set at link in variant link-time / post-build in variant post-build / pre-compile in variant pre-compile, set at link in variant link-time / post-build in variant post-build / pre-compile in variant pre-compile, destination=TcpIpIpV6ConfigExtHeaderFilter  # Reference to a set of IPv6 Extension Headers which are allowed for this local IPv6 address. | Note: this parameter is only relevant if the related TcpIpDomainType is TCPIP_AF_INET6.
        container TcpIpAddrAssignment [1..*]: multiplicity set at pre-compile  # This container is a subcontainer of TcpIpLocalAddr and specifies the assignment policy for the IP address.
          enumeration TcpIpAssignmentLifetime [0..0]: {TCPIP_FORGET, TCPIP_STORE}, set at link in variant link-time / post-build in variant post-build / pre-compile in variant pre-compile, default-value=TCPIP_FORGET  # TcpIpAssignmentLifetime (currently unused) | Defines the lifetime of a dynamically fetched IP address. Parameter unused. | If TcpIpAssignmentMethod = TCPIP_STATIC then TcpIpAssignmentLifetime shall be omitted.
          enumeration TcpIpAssignmentMethod: {TCPIP_DHCP, TCPIP_IPV6_ROUTER, TCPIP_LINKLOCAL, TCPIP_LINKLOCAL_DOIP, TCPIP_STATIC}, set at link in variant link-time / post-build in variant post-build / pre-compile in variant pre-compile  # Method of address assignment | TCPIP_DHCP is dynamic ip address assignment based on Dhcp protocol, TCPIP_LINKLOCAL and TCPIP_LINKLOCAL_DOIP are based on address autoconfiguration (AutoIp which dynamically assigns IP address in range of 169.254.1.0 to 169.254.254.255 for IPv4, SLAAC LinkLocal for IPv6) and TCPIP_STATIC is for static IP address assignment where address is decided at configuration time if trigger is TCPIP_AUTOMATIC and if trigger is TCPIP_MANUAL then TcpIp_RequestIpAddrAssignment api does the assignment. For IPv6 address assigment, there is no difference between TCPIP_LINKLOCAL and TCPIP_LINKLOCAL_DOIP assignment methods.
          integer TcpIpAssignmentPriority: 1..3, set at link in variant link-time / post-build in variant post-build / pre-compile in variant pre-compile  # Priority of assignment (1 is highest). If a new address from an assignment method with a higher priority is available, it overwrites the IP address previously assigned by an assignment method with a lower priority.
          enumeration TcpIpAssignmentTrigger: {TCPIP_AUTOMATIC, TCPIP_MANUAL}, set at link in variant link-time / post-build in variant post-build / pre-compile in variant pre-compile  # Trigger of address assignment. | In TCPIP_AUTOMATIC trigger method assignment shall be initiated automatically by TCP/IP stack. TCPIP_MANUAL assignment shall be initiated manually via TcpIp_RequestIpAddrAssignment() api.
        container TcpIpStaticIpAddressConfig [0..1]: multiplicity set at pre-compile  # This container is a subcontainer of TcpIpLocalAddr and specifies a static IP address including directly related parameters.
          string TcpIpDefaultRouter [0..1]: multiplicity set at link in variant link-time / post-build in variant post-build / pre-compile in variant pre-compile, post-build-variant-value=true, set at link in variant link-time / post-build in variant post-build / pre-compile in variant pre-compile  # IP address of default router (gateway) | DefaultRouter shall not be configured for multicast address.
          integer TcpIpNetmask [0..1]: 0..128, multiplicity set at link in variant link-time / post-build in variant post-build / pre-compile in variant pre-compile, post-build-variant-value=true, set at link in variant link-time / post-build in variant post-build / pre-compile in variant pre-compile  # Network mask of IPv4 address or address prefix of IPv6 address in CIDR Notation, i.e. decimal value between 0 and 32 (IPv4) or 0 and 128 (IPv6) that describes the number of significant bits defining the network number or prefix of an IP address. | Netmask is mandatory if TcpIpAssignmentMethod is configured as TCPIP_STATIC, TcpIpAssignmentTrigger is configured as TCPIP_AUTOMATIC, and TcpIpAddressType is configured as TCPIP_UNICAST. Netmask shall not be configured for multicast address.
          string TcpIpStaticIpAddress: post-build-variant-value=true, set at link in variant link-time / post-build in variant post-build / pre-compile in variant pre-compile  # Static IP Address. | To specify any IP address for a certain EthIfCtrl, "ANY" has to be set as wildcard. See TcpIp_Bind() for more details.Static IP address is mandatory if TcpIpAssignmentMethod is configured as TCPIP_STATIC, TcpIpAssignmentTrigger is configured as TCPIP_AUTOMATIC and TcpIpAddressType is configured as TCPIP_UNICAST.
      container TcpIpNvmBlock [0..0]: multiplicity set at link in variant link-time+post-build / pre-compile in variant pre-compile  # TcpIpNvmBlock (currently unused) | Configuration of optional usage of Nvm in case the TcpIp module requires non volatile memory in the Ecu to store information (e.g. IP Address received via DHCP and shall be stored). Configuration parameter not supported in implementation.
        reference TcpIpNvmBlockDescriptorRef [0..0]: scope=ECU, set at link in variant link-time+post-build / pre-compile in variant pre-compile, requires-symbolic-name-value=true, destination=NvMBlockDescriptor  # TcpIpNvmBlockDescriptorRef (currently unused) | Reference to the Nvm block description in the Nvm module configuration.
      container TcpIpPhysAddrConfig [0..0]  # TcpIpPhysAddrConfig (currently unused) | Specifies the physical address configuration. Configuration not supported in implementation.
        container TcpIpPhysAddrChgHandler [0..0]  # TcpIpPhysAddrChgHandler (currently unused) | This container is a subcontainer of TcpIpPhysAddrConfig and | specifies the configuration parameters for physical address change handler.
          function name TcpIpPhysAddrChgHandlerName [0..0]: scope=ECU, set at pre-compile  # TcpIpPhysAddrChgHandlerName (currently unused) | This parameter defines the name of the physical address change function <Up>_PhysAddrTableChg.
      container TcpIpRbDtlsConfig [0..0]: multiplicity set at pre-compile  # TcpIpRbDtlsConfig (currently unused) | Specifies the configuration parameters of the DTLS (Datagram Transport Layer Security) sub module.
        integer TcpIpRbDtlsCertificateAttributesMaxLength [0..1]: 1..255, multiplicity set at pre-compile, origin=RB:45.4.4.0:2023-04-15, set at pre-compile, default-value=32  # RB (Vendor06) specific parameter: The parameter specifies maximum length of a certificate attributes. | Note: This parameter is used to hold the maximum length of certificate attributes such as extension, version number, issuer name, subject name etc which could be retrived via KeyM_CertElementGet() API. If this parameter is not configured, then it can be configured with default value 32.
        integer TcpIpRbDtlsClientCertificateTypesMaxCount [0..1]: 1..4, multiplicity set at pre-compile, origin=RB:45.4.4.0:2023-04-15, set at pre-compile, default-value=2  # RB (Vendor06) specific parameter: The parameter specifies the maximum number of certificate types could be supported in DTLS Client. | Note: This parameter shall be configured only for DTLS Client and Client authentication is enabled. This parameter specifies the number of certificate types like RSA, ECC, RSA fixed ECDH, ECDSA fixed ECDH that could be processed in the received Certificate Request message from DTLS Server. If this parameter is not configured, then it can be configured with default value 1.
        integer TcpIpRbDtlsCookieMaxLength [0..1]: 0..256, multiplicity set at pre-compile, origin=RB:45.4.4.0:2023-04-15, set at pre-compile, default-value=32  # RB (Vendor06) specific parameter: The parameter specifies the length of the cookie which will be generated by the Server.
        integer TcpIpRbDtlsCookieSecretMaxLength [0..1]: 32..256, multiplicity set at pre-compile, origin=RB:45.4.4.0:2023-04-15, set at pre-compile, default-value=32  # RB (Vendor06) specific parameter: The parameter specifies the length of the cookie secret used to generate the cookie by the Server.
        integer TcpIpRbDtlsCookieSeedMaxLength [0..1]: 48..16777215, multiplicity set at pre-compile, origin=RB:45.4.4.0:2023-04-15, set at pre-compile, default-value=256  # RB (Vendor06) specific parameter: The parameter specifies the length of the seed which is used as input to generate the cookie. | Note: Minimum size of this parameter is set to 48 bytes by considering all mandatory fields (Cookie Label(6) + Client IPv4 address(4) + minimum Client Hello(38))
        integer TcpIpRbDtlsDistinguishedNameMaxLength [0..1]: 1..65535, multiplicity set at pre-compile, origin=RB:45.4.4.0:2023-04-15, set at pre-compile, default-value=512  # RB (Vendor06) specific parameter: The parameter specifies maximum length of a server or client certificate attribute - Distinguish name. | Note: This parameter is configured only when client authentication is enabled and TcpIpRbDtlsRequestCertificateAuthority is enabled. This parameter will specify the maximum length of Distinguish name that can be sent in certificate request handshake message.
        integer TcpIpRbDtlsDistinguishedNamesMaxCount [0..1]: 1..4, multiplicity set at pre-compile, origin=RB:45.4.4.0:2023-04-15, set at pre-compile, default-value=2  # RB (Vendor06) specific parameter: The parameter specifies the maximum number of distinguished names supported by DTLS Client. | Note: This parameter shall be configured only for DTLS Client and Client authentication is enabled. This parameter specifies the number of distinguished names that could be processed in the received Certificate Request message from DTLS Server. If this parameter is not configured, then it can be configured with default value 1.
        integer TcpIpRbDtlsECSupportedGrpsMaxCount [0..1]: 1..16, multiplicity set at pre-compile, origin=RB:45.4.4.0:2023-04-15, set at pre-compile, default-value=10  # RB (Vendor06) specific parameter: The parameter specifies maximum number of Elliptic curve groups that can be supported if Elliptic curve related ciphersuite is selected in the configuration. | Note: If this parameter is not configured, then it can be configured with default value 10.
        integer TcpIpRbDtlsECSupportedPointsMaxCount [0..1]: 1..5, multiplicity set at pre-compile, origin=RB:45.4.4.0:2023-04-15, set at pre-compile, default-value=1  # RB (Vendor06) specific parameter: The parameter specifies maximum number of Elliptic curve point formats that can be supported if Elliptic curve related ciphersuite is selected in the configuration. | Note: If this parameter is not configured, then it can be configured with default value 1.
        integer TcpIpRbDtlsExtensionDataMaxLength [0..1]: 0..256, multiplicity set at pre-compile, origin=RB:45.4.4.0:2023-04-15, set at pre-compile, default-value=128  # RB (Vendor06) specific parameter: This parameter specifies maximum length of a Dtls extension data that could be allowed per extension. If this parameter is not configured then by default configure it with 128bytes.
        integer TcpIpRbDtlsHandshakeReassemblyBufferSizePerConnection [0..1]: 0..16777215, multiplicity set at pre-compile, origin=RB:45.4.4.0:2023-04-15, set at pre-compile, default-value=4096  # RB (Vendor06) specific parameter: The parameter specifies the size of the Handshake Reassembly buffer per Dtls connection. | Note: According to DTLS Rfc 6347, single DTLS handshake message could be fragmented into multiple DTLS records and it shall be reassembled until complete DTLS handshake message is received. This parameter shall be used to reassemble the received fragmented handshake message in rx path and it shall be processed after complete DTLS handshake message is received. This parameter shall be configured at max of individual handshake message could be received from peer. If this parameter is not configured then by default configure it with 4KB by assuming that 3 level certificates could be received.
        float TcpIpRbDtlsMainFunctionPeriod: 0..INF, origin=RB:45.4.4.0:2023-04-15, set at link in variant link-time+post-build / pre-compile in variant pre-compile  # RB (Vendor06) specific parameter: Period of rba_EthTls_MainFunction in [s].
        integer TcpIpRbDtlsMaxBufferSizeForCompleteHandshakeMsg [0..1]: 0..16777215, multiplicity set at pre-compile, origin=RB:45.4.4.0:2023-04-15, set at pre-compile, default-value=4096  # RB (Vendor06) specific parameter: The parameter specifies the size of the buffer to hold DTLS handshake messages from client hello to client finished. | Note: If this buffer is configured with zero, then two TcpIpRbDtlsCsmHashVerifyJobRef should be configured. Because two jobs are mandatory to calculate the hash for server and client finished messages separately. In the configured two TcpIpRbDtlsCsmHashVerifyJobRefs either of them should be mapped to rba_CryptoCCL. If this parameter is not configured then by default configure it with 4KB.
        integer TcpIpRbDtlsMaxBufferSizeForHashFailedHandshakeMsg [0..1]: 0..16777215, multiplicity set at pre-compile, origin=RB:45.4.4.0:2023-04-15, set at pre-compile, default-value=4096  # RB (Vendor06) specific parameter: The parameter specifies the size of the buffer to hold DTLS handshake messages for hash calculation in case hash job is failed/not performed. This buffer is used only when TcpIpRbDtlsMaxBufferSizeForCompleteHandshakeMsg is configured as zero. | Note: This buffer is used to accumlate the hash failed or not performed DTLS messages to the existing buffer messages. So that hash calculation can be retried during next iteration for all buffer messages. If this parameter is not configured then by default configure it with 4KB.
        integer TcpIpRbDtlsMaxCertificateLength [0..1]: 512..16777216, multiplicity set at pre-compile, origin=RB:45.4.4.0:2023-04-15, set at pre-compile, default-value=1024  # RB (Vendor06) specific parameter: The parameter specifies maximum size for a certificate which is used during server certificate or client certificate handshakes. The size is measured in bytes
        integer TcpIpRbDtlsMaxConnections: 1..65535, origin=RB:45.4.4.0:2023-04-15, set at pre-compile  # Defines the max. number of DTLS connections that can be opened at the same time. | This parameter will refer to the number of dynamic connections. Note: The parameter specifies number of remote connections used simultaneously. For example if one Dtls server wants to communicate with two Dtls clients at same time then value for this parameter will be 2.
        integer TcpIpRbDtlsMaxPseudoHashOperationCount [0..1]: 1..1024, multiplicity set at pre-compile, origin=RB:45.4.4.0:2023-04-15, set at pre-compile, default-value=5  # RB (Vendor06) specific parameter: The parameter specifies maximum number of Pseudo Hash operation that could be performed in same main function.
        integer TcpIpRbDtlsMaxResumptionsPerSession [0..1]: 0..65535, multiplicity set at pre-compile, origin=RB:45.4.4.0:2023-04-15, set at pre-compile, default-value=5  # RB (Vendor06) specific parameter: The parameter specifies the number of times a given session can be resumed by Client by providing the same Session Ticket given by the Server. | Note: This parameter should be enabled only if TcpIpRbDtlsSessionResumptionEnabled is enabled.
        integer TcpIpRbDtlsMaxRxBufferSizePerConnection [0..1]: 256..4294967295, multiplicity set at pre-compile, origin=RB:45.4.4.0:2023-04-15, set at pre-compile, default-value=4096  # RB (Vendor06) specific parameter: The parameter specifies the size of the Rx buffer per Dtls connection. | Note: The DTLS records are framed and stored in this buffer and it shall be copied to driver buffer later via rba_EthUdp_SecureTransmit() API. If this parameter is not configured then by default configure it is configured with 4KB.
        integer TcpIpRbDtlsMaxTxBufferSizePerConnection [0..1]: 256..4294967295, multiplicity set at pre-compile, origin=RB:45.4.4.0:2023-04-15, set at pre-compile, default-value=4096  # RB (Vendor06) specific parameter: The parameter specifies the size of the Tx buffer per Dtls connection. | Note: The DTLS records received in UDP module shall be stored in this buffer and then it shall be processed in main function context. If this parameter is not configured then by default configure it with 4KB.
        float TcpIpRbDtlsMsl [0..1]: 0..INF, multiplicity set at pre-compile, origin=RB:45.4.4.0:2023-04-15, set at pre-compile, default-value=120  # RB (Vendor06) specific parameter: The parameter specifies the time in [s] for which it allows the retransmission of remote's last flight. Whenever remote retransmits it's last flight within this time, then ECU responds to the received retransmitted flight. | Note: According to Dtls Rfc 6347, multiple records together can be called as flight. This parameter is applicable for server in an initial/renegotiation handshake, also it is applicable for client in the resumed handshake. If the last flight is not accepted because of expiration of timer, then received retransmitted flights will be discarded and DTLS connection will be closed.
        integer TcpIpRbDtlsMultipleOfHMacOutputPerIteration [0..1]: 1..8, multiplicity set at pre-compile, origin=RB:45.4.4.0:2023-04-15, set at pre-compile, default-value=1  # RB (Vendor06) specific parameter: The parameter specifies how many HMAC operation needs to be performed based on the output size of algorithm selected for Dtls handshake.
        boolean TcpIpRbDtlsPerformFinishedMsgOperationConsecutively [0..1]: multiplicity set at pre-compile, origin=RB:45.4.4.0:2023-04-15, set at pre-compile, default-value=true  # RB (Vendor06) specific parameter: This parameter specifies if preparation/processing of finished message has to be performed consectively. | Note: If this parameter is TRUE then Dtls server/client finished messages will be prepared and processed in same main function. Finished Msg contains the following operations, Hash Calculation, PRF Calculation and then Encryption/decryption which happen in parallel for processing client finished and preparing server finished during Dtls Server vice versa for Dtls Client.
        boolean TcpIpRbDtlsPerformKeyExchangeHMacOperationConsecutively [0..1]: multiplicity set at pre-compile, origin=RB:45.4.4.0:2023-04-15, set at pre-compile, default-value=true  # RB (Vendor06) specific parameter: This parameter specifies if HMAC operation for key exchange process has to be performed in same mainfunction if requested output size is more than output which shall be produced per HMAC operation. HMAC output will be varied based on the ciphersuite selection. | Note: Consecutively means that all HMAC operations needed for key exchange are done in same main function.
        integer TcpIpRbDtlsPresharedKeyIdentityHintMaxLength [0..1]: 1..128, multiplicity set at pre-compile, origin=RB:45.4.4.0:2023-04-15, set at pre-compile, default-value=32  # RB (Vendor06) specific parameter: The parameter specifies maximum length of the PresharedKeyIdentityHint. | Dependency: This parameter is used only when Pre-shared key related ciphersuites are selected. If this parameter is not configured, then it can be configured with default value 32.
        integer TcpIpRbDtlsPresharedKeyIdentityMaxLength [0..1]: 1..128, multiplicity set at pre-compile, origin=RB:45.4.4.0:2023-04-15, set at pre-compile, default-value=32  # RB (Vendor06) specific parameter: The parameter specifies maximum length of the PresharedKeyIdentity. | Dependency: This parameter is used only when Pre-shared key related ciphersuites are selected. If this parameter is not configured, then it can be configured with default value 32.
        integer TcpIpRbDtlsPresharedKeyMaxLength [0..1]: 1..128, multiplicity set at pre-compile, origin=RB:45.4.4.0:2023-04-15, set at pre-compile, default-value=32  # RB (Vendor06) specific parameter: The parameter specifies length of the TcpIpRbDtlsPresharedKey. | Note: Dependency: This parameter is used only when Pre-shared key related ciphersuites are selected. If this parameter is not configured, then it can be configured with default value 32.
        boolean TcpIpRbDtlsProcessMultipleHandshakeMsgConsecutively [0..1]: multiplicity set at pre-compile, origin=RB:45.4.4.0:2023-04-15, set at pre-compile, default-value=true  # RB (Vendor06) specific parameter: This parameter specifies whether multiple handshake messages can be processed consecutively in same main function context if it is set to true else handshake messages shall be processed in different main functions. This is required to reduce runtime of Dtls main function.
        integer TcpIpRbDtlsRecordReassemblyBufferSizePerConnection [0..1]: 0..65535, multiplicity set at pre-compile, origin=RB:45.4.4.0:2023-04-15, set at pre-compile, default-value=4096  # RB (Vendor06) specific parameter: The parameter specifies the size of the Record Reassembly buffer per Dtls connection. | Note: According to DTLS Rfc 6347, single DTLS record could be fragmented into multiple UDP packets and it shall be reassembled until complete DTLS record is received. This parameter shall be used to reassemble the received fragmented DTLS records in rx path and it shall be processed after complete DTLS record is received. This parameter shall be configured based on the TcpIpRbDtlsMaxFragmentLength if it is configured, else it shall be atleast greater than TcpIpRbDtlsMaxRxBufferSizePerConnection parameter value. If this parameter is not configured then by default configure it with 4KB.
        integer TcpIpRbDtlsRemoteCertificateChainMaxCount [0..1]: 1..255, multiplicity set at pre-compile, origin=RB:45.4.4.0:2023-04-15, set at pre-compile, default-value=3  # RB (Vendor06) specific parameter: The parameter specifies maximum number of certificates that can be in chain of certificate sent by remote node. The count is including the user certificate.
        integer TcpIpRbDtlsRtxRetryCount [0..1]: 0..255, multiplicity set at link in variant link-time / post-build in variant post-build / pre-compile in variant pre-compile, origin=RB:45.4.4.0:2023-04-15, set at link in variant link-time / post-build in variant post-build / pre-compile in variant pre-compile, default-value=3  # Maximum number of times that a DTLS handshake message is retransmitted before DTLS connection is closed if no response is received from remote node. This parameter is only valid if TcpIpRbDtlsRtxTimeout is configured.
        float TcpIpRbDtlsRtxTimeout [0..1]: 0..INF, multiplicity set at link in variant link-time / post-build in variant post-build / pre-compile in variant pre-compile, origin=RB:45.4.4.0:2023-04-15, set at link in variant link-time / post-build in variant post-build / pre-compile in variant pre-compile, default-value=1  # Timeout in [s] before a DTLS handshake message is retransmitted.
        integer TcpIpRbDtlsServerNameIdentificationMaxLength [0..1]: 1..128, multiplicity set at pre-compile, origin=RB:45.4.4.0:2023-04-15, set at pre-compile, default-value=32  # RB (Vendor06) specific parameter: The parameter specifies the maximum length of the TcpIpRbDtlsServerNameIdentification received from remote client. This parameter is applicable for server connection only. | Note: If this parameter is not configured, then it can be configured with default value 64.
        float TcpIpRbDtlsSessionRenegotiationInitiateTimeout [0..1]: 0..INF, multiplicity set at pre-compile, origin=RB:45.4.4.0:2023-04-15, set at pre-compile, default-value=1  # RB (Vendor06) specific parameter: The parameter specifies the time in seconds for which ECU waits before initiating the renegotiation process after renegotiation request is received from Upper layer. | Note: This parameters helps to be in synchronization with remote ecu. For example: There are chances to receive the application data message from remote after renegotiation is initiated at ECU. During this time interval, ECU will ignore the application data and will wait until handshake messages are received.
        float TcpIpRbDtlsSessionRenegotiationTimeout [0..1]: 2..INF, multiplicity set at pre-compile, origin=RB:45.4.4.0:2023-04-15, set at pre-compile, default-value=240  # RB (Vendor06) specific parameter: The parameter specifies the time duration of the session in seconds. | Note: ECU will initiate the renegotiation of the session if this time expires.
        integer TcpIpRbDtlsSessionTicketMaxSize [0..1]: 128..65535, multiplicity set at pre-compile, origin=RB:45.4.4.0:2023-04-15, set at pre-compile, default-value=4096  # RB (Vendor06) specific parameter: The parameter specifies the size of Session Ticket which will be included in New Session Ticket handshake message. | Note: Minimum size of this parameter is set to 128 bytes by considering all mandatory fields (keyname(16) + IV(16) + encrpted_state(64) + mac(32)) of the Session Ticket according to Rfc 5077. Default size of this parameter is set to 1024 bytes by considering minimum of one client certificate in encryption state if client authentication is enabled. This parameter should be enabled only if TcpIpRbDtlsSessionResumptionEnabled is enabled.
        float TcpIpRbDtlsSessionTicketTimeout [0..1]: 0..INF, multiplicity set at pre-compile, origin=RB:45.4.4.0:2023-04-15, set at pre-compile, default-value=120  # RB (Vendor06) specific parameter: The parameter specifies the time in seconds for which a given Session Ticket is valid. | Note: When this timer elapses, the Session Ticket is no longer valid and will be renewed. This parameter should be enabled only if TcpIpRbDtlsSessionResumptionEnabled is enabled.
        integer TcpIpRbDtlsSignatureAlgorithmsMaxCount [0..1]: 2..32, multiplicity set at pre-compile, origin=RB:45.4.4.0:2023-04-15, set at pre-compile, default-value=12  # RB (Vendor06) specific parameter: The parameter specifies maximum number of signature algorithms supported. | Note: If this parameter is not configured, then it can be configured with default value 12.
        integer TcpIpRbDtlsSignatureValueMaxLength [0..1]: 1..255, multiplicity set at pre-compile, origin=RB:45.4.4.0:2023-04-15, set at pre-compile, default-value=128  # RB (Vendor06) specific parameter: The parameter specifies maximum number of signature values that could be supported. | Note: If this parameter is not configured, then it can be configured with default value 128.
        float TcpIpRbDtlsWaitForPeerTimeout [0..1]: 0..INF, multiplicity set at pre-compile, origin=RB:45.4.4.0:2023-04-15, set at pre-compile, default-value=0.3  # RB (Vendor06) specific parameter: The parameter specifies the timeout for which ECU will wait until it receives next DTLS handshake message from remote. | Note: This parameter is used to determine the timeout for DTLS message reception. Timeout in seconds after which an ECU stops waiting for the reception of DTLS messages and ECU notifies to remote node by sending Alert message with Alert description code 0x50 (internal error).
        reference TcpIpRbDtlsCsmRandomGenerateJobRef: origin=RB:45.4.4.0:2023-04-15, set at pre-compile, requires-symbolic-name-value=true, destination=CsmJob  # Reference to a CSM job to generate a random value.
        container TcpIpRbDtlsCiphersuites  # This container provides the information about supported ciphersuites used by DTLS.
          container TcpIpRbDtlsCertificateIdentity [1..*]: multiplicity set at pre-compile  # This container provides information about the certificates used for ciphersuites.
            string TcpIpRbDtlsServerNameIdentification [0..1]: multiplicity set at pre-compile, origin=RB:45.4.4.0:2023-04-15, set at pre-compile  # Defines a server identification name. If present, the name will be added as an extension with the "DTLS client hello" handshake message. The DTLS server will check for the name to identify the server certificate.
            reference TcpIpRbDtlsCipherKeyMLocalCertificate [0..1]: multiplicity set at pre-compile, origin=RB:45.4.4.0:2023-04-15, set at pre-compile, requires-symbolic-name-value=true, destination=KeyMCertificate  # Reference to a KeyM certificate used to address the local certificate.
            reference TcpIpRbDtlsCipherKeyMRemoteCertificate [0..1]: multiplicity set at pre-compile, origin=RB:45.4.4.0:2023-04-15, set at pre-compile, requires-symbolic-name-value=true, destination=KeyMCertificate  # Reference to KeyM certificate container to reference the remote certificate.
          container TcpIpRbDtlsCiphersuiteDefinition [1..*]: multiplicity set at pre-compile  # This container provides the static information of a ciphersuite used by DTLS.
            integer TcpIpRbDtlsCiphersuiteId: 0..65535, origin=RB:45.4.4.0:2023-04-15, set at pre-compile, with-auto=true  # ID that represents the ciphersuite according to IETF, e.g. RFC4492, Sect. 6, RFC8446, Appendix B.4 or RFC5246, Appendix A.5.
            string TcpIpRbDtlsCiphersuiteName [0..1]: multiplicity set at pre-compile, origin=RB:45.4.4.0:2023-04-15, set at pre-compile  # Provides a verbal name for the ciphersuite. The name should be the one defined in the respective RFC, e.g. DTLS_ECDHE_ECDSA_WITH_AES_128_CBC_SHA256 (DTLS 1.2) or DTLS_AES_128_GCM_SHA256 (DTLS 1.3)
            integer TcpIpRbDtlsCiphersuitePriority: 1..65535, origin=RB:45.4.4.0:2023-04-15, set at pre-compile  # Defines the priority of the cipher. The higher the number the lower the priority.
            boolean TcpIpRbDtlsUseAEADCipher [0..0]: origin=RB:45.4.4.0:2023-04-15, set at pre-compile, default-value=false  # TcpIpRbDtlsUseAEADCipher (currently unused) | Specifies if the ciphersuite supports AEAD for data en-/decryption.
            boolean TcpIpRbDtlsUsePresharedKeys: origin=RB:45.4.4.0:2023-04-15, set at pre-compile, default-value=false  # Defines if this ciphersuite uses pre-shared keys. If so, additional configuration or callbacks will be used for pre-shared key negotiation.
            boolean TcpIpRbDtlsUseSecurityExtensionForceEncryptThenMac: origin=RB:45.4.4.0:2023-04-15, set at pre-compile, default-value=false  # Defines if the security extension according to IETF RFC 7366 shall be supported. This is useful for ciphersuites using CBC mode.
            boolean TcpIpRbDtlsUseSecurityExtensionSupportedGroups [0..1]: multiplicity set at pre-compile, origin=RB:45.4.4.0:2023-04-15, set at pre-compile, default-value=false  # RB (Vendor06) specific parameter: This parameter if configured to TRUE then supported groups extension can be included in the extensions list.
            boolean TcpIpRbDtlsUseSecurityExtensionSupportedPointFormats [0..1]: multiplicity set at pre-compile, origin=RB:45.4.4.0:2023-04-15, set at pre-compile, default-value=false  # RB (Vendor06) specific parameter: This parameter if configured to TRUE then supported points extension can be included in the extensions list.
            enumeration TcpIpRbDtlsVersion: {DTLS_VERSION_V12, DTLS_VERSION_V13}, origin=RB:45.4.4.0:2023-04-15, set at pre-compile  # Declares the DTLS version that this ciphersuite shall be used for.
          container TcpIpRbDtlsCiphersuiteWorker [1..*]: multiplicity set at pre-compile  # This container provides the jobs and keys necessary for DTLS data transmission and reception.
            integer TcpIpRbDtlsCipherAEADCipherKeyLength [0..0]: 1..65535, multiplicity set at pre-compile, origin=RB:45.4.4.0:2023-04-15, set at pre-compile  # TcpIpRbDtlsCipherAEADCipherKeyLength (currently unused) | Defines the key length for en- / decryption with authentication data (AEAD).
            integer TcpIpRbDtlsCipherEncryptKeyLength [0..0]: 1..65535, origin=RB:45.4.4.0:2023-04-15, set at pre-compile  # TcpIpRbDtlsCipherEncryptKeyLength (currently unused) | Defines the key length used for en- or decryption. The key length is valid for (symmetric) encryption and decryption.
            integer TcpIpRbDtlsCipherMacKeyLength [0..0]: 1..65535, origin=RB:45.4.4.0:2023-04-15, set at pre-compile  # TcpIpRbDtlsCipherMacKeyLength (currently unused) | Specifies the length of the MAC key
            reference TcpIpRbDtlsCipherCsmDecryptJobRef [0..1]: multiplicity set at pre-compile, origin=RB:45.4.4.0:2023-04-15, set at pre-compile, requires-symbolic-name-value=true, destination=CsmJob  # Reference to a CSM job to perform the data decryption operation
            reference TcpIpRbDtlsCipherCsmDecryptKeyRef [0..1]: multiplicity set at pre-compile, origin=RB:45.4.4.0:2023-04-15, set at pre-compile, requires-symbolic-name-value=true, destination=CsmKey  # Reference to a CSM key associated to the CSM job that performs the data decryption operation
            reference TcpIpRbDtlsCipherCsmEncryptJobRef [0..1]: multiplicity set at pre-compile, origin=RB:45.4.4.0:2023-04-15, set at pre-compile, requires-symbolic-name-value=true, destination=CsmJob  # Reference to a CSM job to perform the data encryption operation
            reference TcpIpRbDtlsCipherCsmEncryptKeyRef [0..1]: multiplicity set at pre-compile, origin=RB:45.4.4.0:2023-04-15, set at pre-compile, requires-symbolic-name-value=true, destination=CsmKey  # Reference to a CSM key associated to the CSM job that performs the data encryption operation
            reference TcpIpRbDtlsCipherCsmMacGenerateJobRef: origin=RB:45.4.4.0:2023-04-15, set at pre-compile, requires-symbolic-name-value=true, destination=CsmJob  # Reference to a CSM job to perform the MAC generate operation
            reference TcpIpRbDtlsCipherCsmMacGenerateKeyRef: origin=RB:45.4.4.0:2023-04-15, set at pre-compile, requires-symbolic-name-value=true, destination=CsmKey  # Reference to a CSM key associated to the CSM job that performs the MAC generate operation
            reference TcpIpRbDtlsCipherCsmMacVerifyJobRef: origin=RB:45.4.4.0:2023-04-15, set at pre-compile, requires-symbolic-name-value=true, destination=CsmJob  # Reference to a CSM job to perform the MAC verify operation
            reference TcpIpRbDtlsCipherCsmMacVerifyKeyRef: origin=RB:45.4.4.0:2023-04-15, set at pre-compile, requires-symbolic-name-value=true, destination=CsmKey  # Reference to a CSM key associated to the CSM job that performs the MAC verify operation
            reference TcpIpRbDtlsCiphersuiteDefinitionRef: origin=RB:45.4.4.0:2023-04-15, set at pre-compile, destination=TcpIpRbDtlsCiphersuiteDefinition  # Reference to a a ciphersuite definition container
            reference TcpIpRbDtlsConnectionHandshakeRef [1..*]: multiplicity set at pre-compile, origin=RB:45.4.4.0:2023-04-15, set at pre-compile, destination=TcpIpRbDtlsHandshake  # References the container that contains the jobs and keys for handshake operation. | Referencing multiple handshake containers allow to share them between workers and to choose the next unused during the handshake.
          container TcpIpRbDtlsHandshake [1..*]: multiplicity set at pre-compile  # This container provides information that is needed to process a handshake. It contains the appropriate references to jobs and keys of the CSM to perform the key exchange cryptographic for the ciphersuite and involved certificates.
            enumeration TcpIpRbDtlsCsmPRFSupportType [0..1]: {DTLS_PRF_CSM_FULL_SUPPORT, DTLS_PRF_CSM_INOUT_REDIRECT_SUPPORT, DTLS_PRF_CSM_NO_SUPPORT, DTLS_PRF_NO_SUPPORT}, multiplicity set at pre-compile, origin=RB:45.4.4.0:2023-04-15, set at pre-compile  # Specifies how the CSM job supports the PRF operation.
            reference TcpIpRbDtlsCsmHashVerifyJobRef [1..2]: multiplicity set at pre-compile, origin=RB:45.4.4.0:2023-04-15, set at pre-compile, requires-symbolic-name-value=true, destination=CsmJob  # Reference to a CSM job to perform the hash operation for the whole handshake.
            reference TcpIpRbDtlsCsmKeyElementSetJobRef [0..1]: multiplicity set at pre-compile, origin=RB:45.4.4.0:2023-04-15, set at pre-compile, requires-symbolic-name-value=true, destination=CsmJob  # RB (Vendor06) specific parameter: Reference to a CSM job to load the private key to generate the Signature for Edward curve. | This parameter shall be configured only when Edward curve is selected for any cryptographic operations in handshake container. Because, time taken to load the key for Edward curve exceeds main function period and hence system will crash. So the key loading operation for Edward curve shall be performed asynchronously via this CSM job
            reference TcpIpRbDtlsCsmKeyExchangeCalcPubValJobRef [0..1]: multiplicity set at pre-compile, origin=RB:45.4.4.0:2023-04-15, set at pre-compile, requires-symbolic-name-value=true, destination=CsmJob  # Reference to a CSM job to perform the DH Key Exchange algorithm operation
            reference TcpIpRbDtlsCsmKeyExchangeCalcSecretJobRef [0..1]: multiplicity set at pre-compile, origin=RB:45.4.4.0:2023-04-15, set at pre-compile, requires-symbolic-name-value=true, destination=CsmJob  # Reference to a CSM job to perform the Key Exchange algorithm operation
            reference TcpIpRbDtlsCsmKeyExchangeDecryptJobRef [0..0]: multiplicity set at pre-compile, origin=RB:45.4.4.0:2023-04-15, set at pre-compile, requires-symbolic-name-value=true, destination=CsmJob  # TcpIpRbDtlsCsmKeyExchangeDecryptJobRef (currently unused) | Reference to a CSM job to perform data decryption, e.g. with RSA key exchange operation.
            reference TcpIpRbDtlsCsmKeyExchangeDecryptKeyRef [0..0]: multiplicity set at pre-compile, origin=RB:45.4.4.0:2023-04-15, set at pre-compile, requires-symbolic-name-value=true, destination=CsmKey  # TcpIpRbDtlsCsmKeyExchangeDecryptKeyRef (currently unused) | Reference to a CSM key to perform data decryption, e.g. with RSA, used for exchange operation.
            reference TcpIpRbDtlsCsmKeyExchangeEncryptJobRef [0..0]: multiplicity set at pre-compile, origin=RB:45.4.4.0:2023-04-15, set at pre-compile, requires-symbolic-name-value=true, destination=CsmJob  # TcpIpRbDtlsCsmKeyExchangeEncryptJobRef (currently unused) | Reference to a CSM job to perform data encryption, e.g. with RSA key exchange operation.
            reference TcpIpRbDtlsCsmKeyExchangeEncryptKeyRef [0..0]: multiplicity set at pre-compile, origin=RB:45.4.4.0:2023-04-15, set at pre-compile, requires-symbolic-name-value=true, destination=CsmKey  # TcpIpRbDtlsCsmKeyExchangeEncryptKeyRef (currently unused) | Reference to a CSM key to perform data encryption, e.g. with RSA, used for exchange operation.
            reference TcpIpRbDtlsCsmKeyExchangeKeyPairKeyRef [0..1]: multiplicity set at pre-compile, origin=RB:45.4.4.0:2023-04-15, set at pre-compile, requires-symbolic-name-value=true, destination=CsmKey  # Reference to a CSM key used for Diffie Hellman (DH) key exchange operation with static key pair. | Note: This parameter shall be configured for cipher suite which requires ECDH key exchange operation. In this key exchange operation, configured static key pair shall be used instead of Csm_JobCalcPubVal operation. Also, static key pair could be loaded via Csm_KeyElementSet() API dynamically.
            reference TcpIpRbDtlsCsmKeyExchangeKeyRef [0..1]: multiplicity set at pre-compile, origin=RB:45.4.4.0:2023-04-15, set at pre-compile, requires-symbolic-name-value=true, destination=CsmKey  # Reference to a CSM key used for Diffie Hellman (DH) key exchange operation.
            reference TcpIpRbDtlsCsmKeyExchangeSignatureGenerateJobRef [0..1]: multiplicity set at pre-compile, origin=RB:45.4.4.0:2023-04-15, set at pre-compile, requires-symbolic-name-value=true, destination=CsmJob  # Reference to a CSM job to perform signature generation for DH operation
            reference TcpIpRbDtlsCsmKeyExchangeSignatureGenerateKeyRef [0..1]: multiplicity set at pre-compile, origin=RB:45.4.4.0:2023-04-15, set at pre-compile, requires-symbolic-name-value=true, destination=CsmKey  # Reference to a CSM key to perform signature generation for DH operation
            reference TcpIpRbDtlsCsmKeyExchangeSignatureVerifyJobRef [0..1]: multiplicity set at pre-compile, origin=RB:45.4.4.0:2023-04-15, set at pre-compile, requires-symbolic-name-value=true, destination=CsmJob  # Reference to a CSM job to perform signature verification for DH operation
            reference TcpIpRbDtlsCsmKeyExchangeSignatureVerifyKeyRef [0..1]: multiplicity set at pre-compile, origin=RB:45.4.4.0:2023-04-15, set at pre-compile, requires-symbolic-name-value=true, destination=CsmKey  # Reference to a CSM key to perform signature verification for DH operation
            reference TcpIpRbDtlsCsmMasterSecretKeyRef [0..0]: multiplicity set at pre-compile, origin=RB:45.4.4.0:2023-04-15, set at pre-compile, requires-symbolic-name-value=true, destination=CsmKey  # TcpIpRbDtlsCsmMasterSecretKeyRef (currently unused) | This is the reference to the master key that is calculated during the session.
            reference TcpIpRbDtlsCsmPrfMacJobRef: origin=RB:45.4.4.0:2023-04-15, set at pre-compile, requires-symbolic-name-value=true, destination=CsmJob  # Reference to a CSM job to perform the PRF hash operation
            reference TcpIpRbDtlsCsmPrfMacKeyRef: origin=RB:45.4.4.0:2023-04-15, set at pre-compile, requires-symbolic-name-value=true, destination=CsmKey  # Reference to a CSM key associated to the CSM job that performs the PRF hash operation
            reference TcpIpRbDtlsSessionTicketCsmDecryptJobRef [0..1]: multiplicity set at pre-compile, origin=RB:45.4.4.0:2023-04-15, set at pre-compile, requires-symbolic-name-value=true, destination=CsmJob  # RB (Vendor06) specific parameter: Reference to a CSM job used by Server to perform decryption of Session Ticket.
            reference TcpIpRbDtlsSessionTicketCsmDecryptKeyRef [0..1]: multiplicity set at pre-compile, origin=RB:45.4.4.0:2023-04-15, set at pre-compile, requires-symbolic-name-value=true, destination=CsmKey  # RB (Vendor06) specific parameter: Reference to a CSM key associated to the CSM job used by Server to perform decryption of Session Ticket.
            reference TcpIpRbDtlsSessionTicketCsmEncryptJobRef [0..1]: multiplicity set at pre-compile, origin=RB:45.4.4.0:2023-04-15, set at pre-compile, requires-symbolic-name-value=true, destination=CsmJob  # RB (Vendor06) specific parameter: Reference to a CSM job used by Server to perform encryption of Session Ticket.
            reference TcpIpRbDtlsSessionTicketCsmEncryptKeyRef [0..1]: multiplicity set at pre-compile, origin=RB:45.4.4.0:2023-04-15, set at pre-compile, requires-symbolic-name-value=true, destination=CsmKey  # RB (Vendor06) specific parameter: Reference to a CSM key associated to the CSM job used by Server to perform encryption of Session Ticket.
            reference TcpIpRbDtlsSessionTicketCsmMacGenerateJobRef [0..1]: multiplicity set at pre-compile, origin=RB:45.4.4.0:2023-04-15, set at pre-compile, requires-symbolic-name-value=true, destination=CsmJob  # RB (Vendor06) specific parameter: Reference to a CSM job used by Server to calculate the mac on fields present in Session Ticket.
            reference TcpIpRbDtlsSessionTicketCsmMacGenerateKeyRef [0..1]: multiplicity set at pre-compile, origin=RB:45.4.4.0:2023-04-15, set at pre-compile, requires-symbolic-name-value=true, destination=CsmKey  # RB (Vendor06) specific parameter: Reference to a CSM key associated to the CSM job used by Server to calculate the mac on fields present in Session Ticket.
            reference TcpIpRbDtlsSessionTicketCsmMacVerifyJobRef [0..1]: multiplicity set at pre-compile, origin=RB:45.4.4.0:2023-04-15, set at pre-compile, requires-symbolic-name-value=true, destination=CsmJob  # RB (Vendor06) specific parameter: Reference to a CSM job used by Server to verify the mac on fields present in Session Ticket.
            reference TcpIpRbDtlsSessionTicketCsmMacVerifyKeyRef [0..1]: multiplicity set at pre-compile, origin=RB:45.4.4.0:2023-04-15, set at pre-compile, requires-symbolic-name-value=true, destination=CsmKey  # RB (Vendor06) specific parameter: Reference to a CSM key associated to the CSM job used by Server to verify the mac on fields present in Session Ticket.
          container TcpIpRbDtlsPskIdentity [0..*]: multiplicity set at pre-compile  # This container provides information about static definition of pre-shared keys. It is used during the handshake to negotiate pre-shared keys between a client and a server. | Note: The callbacks for pre-shared keys are an alternative to the static definition. The callbacks allow to define the associated keys at runtime if pre-shared keys are used but no static definition is available. The container definition is used for static configuration.
            string TcpIpRbDtlsPresharedKeyIdentity [0..1]: multiplicity set at pre-compile, origin=RB:45.4.4.0:2023-04-15, set at pre-compile  # This item provides the key identification. The DTLS client selects the pre-shared key based on the identification hint provided by the server and returns the key identification name back to the server.
            string TcpIpRbDtlsPresharedKeyIdentityHint [0..1]: multiplicity set at pre-compile, origin=RB:45.4.4.0:2023-04-15, set at pre-compile  # Provides the identity hint for a pre-shared key. This information is transmitted by the DTLS Server to provide its identification to the DTLS client. | The DTLS client uses the same information to select the pre-shared key.
            function name TcpIpRbDtlsPskGetClientKeyIdentityFunc [0..1]: multiplicity set at pre-compile, origin=RB:45.4.4.0:2023-04-15, set at pre-compile  # Defines the function name for the Up_TlsClientGetPskIdentity() callback.
            function name TcpIpRbDtlsPskGetKeyIdentityHintFunc [0..1]: multiplicity set at pre-compile, origin=RB:45.4.4.0:2023-04-15, set at pre-compile  # Defines the function name for the Up_TlsServerGetPskIdentityHint() callback.
            function name TcpIpRbDtlsPskGetServerKeyIdentityFunc [0..1]: multiplicity set at pre-compile, origin=RB:45.4.4.0:2023-04-15, set at pre-compile  # Defines the function name for the Up_TlsServerGetPskIdentity () callback.
            reference TcpIpRbDtlsPresharedKeyCsmKeyRef [0..1]: multiplicity set at pre-compile, origin=RB:45.4.4.0:2023-04-15, set at pre-compile, requires-symbolic-name-value=true, destination=CsmKey  # Reference to a CSM key associated to the CSM job that performs the PRF hash operation
        container TcpIpRbDtlsConnection [1..*]: multiplicity set at pre-compile  # This container defines the properties of a DTLS connection
          function name TcpIpRbDtlsConnectionGetTimeFunc [0..0]: multiplicity set at pre-compile, origin=RB:45.4.4.0:2023-04-15, set at pre-compile  # TcpIpRbDtlsConnectionGetTimeFunc (currently unused) | Defines the function name for the Up_TlsGetCurrentTimeStamp() callback.
          integer TcpIpRbDtlsConnectionId: 0..65535, origin=RB:45.4.4.0:2023-04-15, set at pre-compile, symbolic-name-value=true  # Identifier of the connection. The set of configured identifiers shall be consecutive and gapless.
          enumeration TcpIpRbDtlsConnectionType: {DTLS_CLIENT, DTLS_SERVER}, origin=RB:45.4.4.0:2023-04-15, set at pre-compile  # Specifies if the DTLS connection is a server or a client.
          boolean TcpIpRbDtlsContinueHandshakeIfEmptyClientCertificateRcvd [0..1]: multiplicity set at pre-compile, origin=RB:45.4.4.0:2023-04-15, set at pre-compile, default-value=false  # RB (Vendor06) specific parameter: This parameter specifies whether handshake can be continued or terminated when empty client certificate message is received from the client during client authentication. | Note: During Client authentication feature, if Client sends empty client certificate message to Server then this parameter shall decide whether server needs to continue the handshake or it has to terminate the handshake. In case of termination, Server sends Certificate required Alert Message to the Client. This parameter shall be configured if Client Authentication parameter is set to TRUE.
          boolean TcpIpRbDtlsContinueHandshakeIfSessionRenegotiationDisabled [0..1]: multiplicity set at pre-compile, origin=RB:45.4.4.0:2023-04-15, set at pre-compile, default-value=false  # RB (Vendor06) specific parameter: This parameter specifies whether handshake can be continued or terminated when session renegotiation is disabled. | Note: This parameter should decide whether to continue or terminate the handshake when session renegotiation request is not received from the peer. If this parameter is set as false and we do not receieve session renegotiation request from the peer, handshake will be terminated by sending handshake failure alert.
          boolean TcpIpRbDtlsContinueHandshakeIfUntrustedClientCertificateRcvd [0..1]: multiplicity set at pre-compile, origin=RB:45.4.4.0:2023-04-15, set at pre-compile, default-value=false  # RB (Vendor06) specific parameter: This parameter specifies whether handshake can be continued or terminated when untrusted client certificate message is received from the client during client authentication. | Note: During Client authentication feature, if Client sends untrusted client certificate message to Server then this parameter shall decide whether server needs to continue the handshake or it has to terminate the handshake. In case of termination, Server sends Handshake Failure Alert Message to the Client. This parameter shall be configured if Client Authentication parameter is set to TRUE.
          boolean TcpIpRbDtlsContinueHandshakeIfWarningAlertRcvd [0..1]: multiplicity set at pre-compile, origin=RB:45.4.4.0:2023-04-15, set at pre-compile, default-value=true  # RB (Vendor06) specific parameter: This parameter indicates whether handshake can be continued or terminate the connection if alert message type warning is received. | Note: If this parameter is set to TRUE, then Dtls Server/Client can continue the handshake even after receiving alert message type as warning, else connection shall be terminated.
          boolean TcpIpRbDtlsDisableSessionResumptionOnSessionRenegotiation [0..1]: multiplicity set at pre-compile, origin=RB:45.4.4.0:2023-04-15, set at pre-compile, default-value=false  # RB (Vendor06) specific parameter: This parameter specifies whether Session Resumption is allowed during Session Renegotiation. | Note: If this parameter is enabled, Server will not allow Session Resumption during Session Renegotiation even if Client tries to resume the session by presenting a valid Session Ticket.
          integer TcpIpRbDtlsMaxFragmentLength: 1..16384, origin=RB:45.4.4.0:2023-04-15, set at pre-compile, default-value=4096  # Specifies the max length in bytes of a DTLS fragment that is sent as a block.
          integer TcpIpRbDtlsPortAssignment [0..1]: 1..65535, multiplicity set at pre-compile, origin=RB:45.4.4.0:2023-04-15, set at pre-compile  # Specifies the port address that is used for DTLS communication.
          integer TcpIpRbDtlsRecordSizeLimit [0..1]: 1..16384, multiplicity set at pre-compile, origin=RB:45.4.4.0:2023-04-15, set at pre-compile, default-value=4096  # RB (Vendor06) specific parameter: The parameter specifies length of record in the Record size limit extention. | Note: The value of RecordSizeLimit is the maximum size of record in octets that the endpoint is willing to receive. This value is used to limit the size of records that are created when encoding application data and the protected handshake message into records. The limit is 2^14+1 octets. If this parameter is not configured, then it can be configured with default value 4096 bytes.
          boolean TcpIpRbDtlsRequestCertificateAuthority [0..1]: multiplicity set at pre-compile, origin=RB:45.4.4.0:2023-04-15, set at pre-compile, default-value=false  # RB (Vendor06) specific parameter: This parameter will be configured if Client Authentication parameter is set to TRUE and TcpIpRbDtlsConnectionType is DTLS_SERVER. | Note: This parameter is used to decide whether issuer of certificates configured per connection will be sent in Certificate Request message in distinguishedName certificate_authorities field or not.
          integer TcpIpRbDtlsSessionIdLength [0..1]: 0..32, multiplicity set at pre-compile, origin=RB:45.4.4.0:2023-04-15, set at pre-compile, default-value=0  # RB (Vendor06) specific parameter: The parameter specifies length of session id for current Dtls connection. | Note: If this parameter is not configured, then it can be configured with default value 0.
          boolean TcpIpRbDtlsSessionRenegotiationCertComparisonEnabled [0..1]: multiplicity set at pre-compile, origin=RB:45.4.4.0:2023-04-15, set at pre-compile, default-value=false  # RB (Vendor06) specific parameter: This parameter specifies whether the renegotiated handshake's certificate(s) or certificate SNI(Server name indication) will be compared with the initial handshake's certificate(s) or SNI(Server name indication) during renegotiation. | Note: If this parameter is enabled, handshake failure alert shall be sent if renegotiated handshake's certificate(s) or certificate SNI(Server name indication) is different from the initial handshake's certificate(s) or SNI(Server name indication).
          boolean TcpIpRbDtlsSessionRenegotiationEnabled [0..1]: multiplicity set at pre-compile, origin=RB:45.4.4.0:2023-04-15, set at pre-compile, default-value=false  # RB (Vendor06) specific parameter: This parameter will be configured when session renegotiation is supported. | Note: If Session Renegotiation parameter is configured to true then DTLS Server/Client supports renegotiation feature. If Session Renegotiation parameter is true for server, then server can allow the client hello msg when session is ongoing. Similarly, If Session Renegotiation parameter is enabled for client, client can allow the hello request msg when session is complete. If Session Renegotiation parameter is enabled and remote does not send the renegotiation info extension then ECU will terminate the current session by sending the alert msg with no renegotiation or continue the handshake depending on wheteher TcpIpRbDtlsContinueHandshakeIfRenegotiationDisabled is configured as false or true respectively.
          boolean TcpIpRbDtlsSessionRenegotiationSCSVCiphersuiteEnabled [0..1]: multiplicity set at pre-compile, origin=RB:45.4.4.0:2023-04-15, set at pre-compile, default-value=false  # RB (Vendor06) specific parameter: This parameter specifies renegotiation SCSV(Special Signalling Ciphersuite Value) ciphersuite shall be enabled or not. | Note: This parameter specifies whether DTLS_EMPTY_RENEGOTIATION_INFO_SCSV ciphersuite will be sent in the initial client hello message during session renegotiation. It shall be enabled to communicate with legacy server when ECU is configured as Client. If ECU Client will be communicating with latest Server always, then this parameter shall be disabled and same semantics could be achieved through renegotiation_info extension. Also, It is not a true ciphersuite and cannot be negotiated as like as other ciphersuites
          boolean TcpIpRbDtlsSessionResumptionEnabled [0..1]: multiplicity set at pre-compile, origin=RB:45.4.4.0:2023-04-15, set at pre-compile, default-value=false  # RB (Vendor06) specific parameter: This parameter specifies whether Session Resumption is supported. | Note: If Session Resumption is enabled: Server can allow the Client to resume a previous session by presenting the Session Ticket instead of establishing a full handshake. Client can resume a previous session by presenting a Session Ticket obtained in the previous handshake.
          boolean TcpIpRbDtlsUseClientAuthenticationRequest [0..1]: multiplicity set at pre-compile, origin=RB:45.4.4.0:2023-04-15, set at pre-compile, default-value=false  # Defines if client authentication shall be applied for this DTLS connection.
          boolean TcpIpRbDtlsUseRootCertInRequestCertificateAuthority [0..1]: multiplicity set at pre-compile, origin=RB:45.4.4.0:2023-04-15, set at pre-compile, default-value=false  # RB (Vendor06) specific parameter: This parameter specifies whether certificate authority identifier(Name) has to be fetched only for root certificate or for complete chain of certificates configured for that particular connection. This parameter should be TRUE only when TcpIpRbDtlsUseClientAuthenticationRequest parameter is TRUE, TcpIpRbDtlsRequestCertificateAuthority parameter is TRUE and and TcpIpRbDtlsConnectionType is DTLS_SERVER. | Note: For example if 3 TcpIpRbDtlsCertificateIdentityRefs are configured to the connection,and TcpIpRbDtlsUseRootCertInRequestCertificateAuthority is configured to TRUE, then certificate authority identifier will be fetched only for root certificates of all 3 configured TcpIpRbDtlsCertificateIdentityRefs. If TcpIpRbDtlsUseRootCertInRequestCertificateAuthority is configured to FALSE, then certificate authority identifier should be fetched for complete chain of certificates configured in 3 TcpIpRbDtlsCertificateIdentityRefs. Certificate authority identifier attribute is required to frame the certificate request handshake message which is to be sent during client authentication feature(TcpIpRbDtlsUseClientAuthenticationRequest) enabled.
          boolean TcpIpRbDtlsUseSecurityExtensionMaxFragmentLength [0..1]: multiplicity set at pre-compile, origin=RB:45.4.4.0:2023-04-15, set at pre-compile, default-value=false  # RB (Vendor06) specific parameter: Enables Maximum fragment length Extention. | Note: This parameter used only when maximum fragment length extention parameter is required. This parameter is enabled when maximum fragment size extention is used.
          boolean TcpIpRbDtlsUseSecurityExtensionMaxFragmentLengthOfRemote [0..1]: multiplicity set at pre-compile, origin=RB:45.4.4.0:2023-04-15, set at pre-compile, default-value=false  # RB (Vendor06) specific parameter: This parameter specifies if Maximum fragment length extension from remote has to be considered for handshake or not. | Note: This parameter used only when maximum fragment length extention parameter is required. This parameter is enabled when maximum fragment size extention is used.
          boolean TcpIpRbDtlsUseSecurityExtensionRecordSizeLimitOfRemote [0..1]: multiplicity set at pre-compile, origin=RB:45.4.4.0:2023-04-15, set at pre-compile, default-value=false  # Defines if the security extension for record size limit if received from remote has to be considered for handshake or not.
          boolean TcpIpRbDtlsUseSecurityExtensionSignatureAlgorithms [0..1]: multiplicity set at pre-compile, origin=RB:45.4.4.0:2023-04-15, set at pre-compile, default-value=false  # RB (Vendor06) specific parameter: If this parameter is configured to TRUE then signature algorithm extension can be included in the extension list.
          reference TcpIpRbDtlsCertificateIdentityRef [1..*]: multiplicity set at pre-compile, origin=RB:45.4.4.0:2023-04-15, set at pre-compile, destination=TcpIpRbDtlsCertificateIdentity  # References the container that contains the certificate and identity information.
          reference TcpIpRbDtlsConnectionCiphersuiteWorkerRef [1..*]: multiplicity set at pre-compile, origin=RB:45.4.4.0:2023-04-15, set at pre-compile, destination=TcpIpRbDtlsCiphersuiteWorker  # References the container that contains the jobs and keys to process the application data.
          reference TcpIpRbDtlsConnectionGroupRef [0..0]: multiplicity set at pre-compile, origin=RB:45.4.4.0:2023-04-15, set at pre-compile, destination=TcpIpRbDtlsConnectionGroup  # TcpIpRbDtlsConnectionGroupRef (currently unused) | Assigns the DTLS connection to a connection group.
          reference TcpIpRbDtlsConnectionPskIdentityRef [0..*]: multiplicity set at pre-compile, origin=RB:45.4.4.0:2023-04-15, set at pre-compile, destination=TcpIpRbDtlsPskIdentity  # References the container that contains information about pre-shared keys.
          reference TcpIpRbDtlsIpAddressAssignment [0..1]: multiplicity set at pre-compile, origin=RB:45.4.4.0:2023-04-15, set at pre-compile, destination=TcpIpStaticIpAddressConfig  # Contains additional information about the endpoint IP address information. If this reference is present, the IP address of the connecting socket shall also be checked if a DTLS connection shall be assigned automatically to a socket.
        container TcpIpRbDtlsConnectionGroup [0..0]  # TcpIpRbDtlsConnectionGroup (currently unused) | This optional container is used to collect all DtlsConnections that belong to a DtlsConnectionGroup. The intention of a DTLS connection group is to share resources among DTLS connections collected in a group, because only one connection of a group can be used at a time.
      container TcpIpSocketOwnerConfig  # Specifies the upper layer modules of TcpIp using the socket API.
        container TcpIpSocketOwner [1..*]: multiplicity set at pre-compile  # This container is a subcontainer of TcpIpSocketOwnerConfig and specifies an upper layer of TcpIp that uses the socket API.
          function name TcpIpSocketOwnerCopyTxDataMetaDataName [0..1]: multiplicity set at link in variant link-time+post-build / pre-compile in variant pre-compile, origin=RB:42.10.0.0:2020-12-31, set at link in variant link-time+post-build / pre-compile in variant pre-compile  # RB (Vendor06) specific parameter: This parameter defines the name of the <Up_CopyTxDataMetaData> function of the TcpIpSocketOwner module. The function name shall only be configurable if TcpIpSocketOwnerUpperLayerType is set to CDD.
          function name TcpIpSocketOwnerCopyTxDataName [0..1]: multiplicity set at link in variant link-time+post-build / pre-compile in variant pre-compile, set at link in variant link-time+post-build / pre-compile in variant pre-compile  # This parameter defines the name of the <Up_CopyTxData> function of the TcpIpSocketOwner module. The function name shall only be configurable if TcpIpSocketOwnerUpperLayerType is set to CDD.
          string TcpIpSocketOwnerHeaderFileName [0..1]: multiplicity set at link in variant link-time+post-build / pre-compile in variant pre-compile, set at link in variant link-time+post-build / pre-compile in variant pre-compile  # This parameter specifies the name of the header file containing the definition of the TcpIpSocketOwner module functions. The header file name shall only be configurable if TcpIpSocketOwnerUpperLayerType is set to CDD.
          integer TcpIpSocketOwnerId: 0..65535, multiplicity set at pre-compile, set at pre-compile, symbolic-name-value=true, with-auto=true, default-value=0  # This value specifies the ID of the socket user.
          function name TcpIpSocketOwnerLocalIpAddrAssignmentChgName [0..1]: multiplicity set at link in variant link-time+post-build / pre-compile in variant pre-compile, set at link in variant link-time+post-build / pre-compile in variant pre-compile  # This parameter defines the name of the <Up_LocalIpAddrAssignmentChg> function of the TcpIpSocketOwner module. The function name shall only be configurable if TcpIpSocketOwnerUpperLayerType is set to CDD.
          function name TcpIpSocketOwnerRxIndicationName [0..1]: multiplicity set at link in variant link-time+post-build / pre-compile in variant pre-compile, set at link in variant link-time+post-build / pre-compile in variant pre-compile  # This parameter defines the name of the <Up_RxIndication> function of the TcpIpSocketOwner module. The function name shall only be configurable if TcpIpSocketOwnerUpperLayerType is set to CDD.
          function name TcpIpSocketOwnerTcpAcceptedName [0..1]: multiplicity set at link in variant link-time+post-build / pre-compile in variant pre-compile, set at link in variant link-time+post-build / pre-compile in variant pre-compile  # This parameter defines the name of the <Up_TcpAccepted> function of the TcpIpSocketOwner module. The function name shall only be configurable if TcpIpSocketOwnerUpperLayerType is set to CDD.
          function name TcpIpSocketOwnerTcpConnectedName [0..1]: multiplicity set at link in variant link-time+post-build / pre-compile in variant pre-compile, set at link in variant link-time+post-build / pre-compile in variant pre-compile  # This parameter defines the name of the <Up_TcpConnected> function of the TcpIpSocketOwner module. The function name shall only be configurable if TcpIpSocketOwnerUpperLayerType is set to CDD.
          function name TcpIpSocketOwnerTcpIpEventName [0..1]: multiplicity set at link in variant link-time+post-build / pre-compile in variant pre-compile, set at link in variant link-time+post-build / pre-compile in variant pre-compile  # This parameter defines the name of the <Up_TcpIpEvent> function of the TcpIpSocketOwner module. The function name shall only be configurable if TcpIpSocketOwnerUpperLayerType is set to CDD.
          function name TcpIpSocketOwnerTxConfirmationName [0..1]: multiplicity set at link in variant link-time+post-build / pre-compile in variant pre-compile, set at link in variant link-time+post-build / pre-compile in variant pre-compile  # This parameter defines the name of the <Up_TxConfirmation> function of the TcpIpSocketOwner module. The function name shall only be configurable if TcpIpSocketOwnerUpperLayerType is set to CDD.
          enumeration TcpIpSocketOwnerUpperLayerType: {CDD, SOAD}, set at link in variant link-time / post-build in variant post-build / pre-compile in variant pre-compile  # This parameter specifies the type of the upper layer module. | SoAd can not be configured as upper layer for more than 1 time. All the configuration parameters specifying the name of the callback function should not be configured for SoAd
          function name TcpIpSocketOwnerZeroCopyTxConfirmationName [0..1]: multiplicity set at link in variant link-time+post-build / pre-compile in variant pre-compile, origin=RB:42.8.0.0:2019-12-31, set at link in variant link-time+post-build / pre-compile in variant pre-compile  # RB (Vendor06) specific parameter: This parameter defines the name of the <Up_ZeroCopyTxConfirmation> function of the TcpIpSocketOwner module. The function name shall only be configurable if TcpIpSocketOwnerUpperLayerType is set to CDD.
      container TcpIpTcpConfig [0..1]: multiplicity set at pre-compile  # Specifies the configuration parameters of the TCP (Transmission Control Protocol) sub-module.
        integer TcpIpRbTcpMaxQSizeForTxReq [0..1]: 1..255, multiplicity set at link in variant link-time / post-build in variant post-build / pre-compile in variant pre-compile, origin=RB:42.9.0.0:2020-06-30, set at link in variant link-time / post-build in variant post-build / pre-compile in variant pre-compile, default-value=5  # RB (Vendor06) specific parameter: Maximum queue size to store tx requests for TLS data. | Note: It specifies upto how many Transmit request information can be stored before Tx confirmation to UL for each request. Default: default of 5 queues will be used to store transmit requests. Dependency: TcpIpTcpMaxTxBuffPerSock is configured. TcpIpTlsConfig container is configured or TcpIpRbExternalTlsSupport is set to TRUE.
        integer TcpIpRbTcpMaxTlsConnections [0..1]: 1..65535, multiplicity set at link in variant link-time / post-build in variant post-build / pre-compile in variant pre-compile, origin=RB:45.1.0.0:2021-06-30, set at link in variant link-time / post-build in variant post-build / pre-compile in variant pre-compile  # RB (Vendor06) specific parameter: Defines the maximum number of TLS connections that can be handled at the same time within Tcp. | Note: When communication need to be secured via TLS, the Tcp component need to store extra information about ongoing Tcp communication for each TLS connection. When TcpIpTlsConfig container is configured, this parameter should be set to the size of TcpIpTlsConfig.TcpIpTlsMaxConnections. Dependency: TcpIpTlsConfig container is configured or TcpIpRbExternalTlsSupport is set to TRUE.
        boolean TcpIpRbTcpReopenFromLastAck [0..1]: multiplicity set at pre-compile, origin=RB:42.9.0.0:2020-06-30, set at pre-compile, default-value=false  # RB (Vendor06) specific parameter: Enables (TRUE) or disables (FALSE) reopening of the socket from state LAST_ACK upon reception of a SYN frame. | Note: If reopening of the socket from state LAST_ACK is considered as a security threat this parameter needs to be disabled.
        integer TcpIpRbTcpReorderBufferCount [0..1]: 0..65535, multiplicity set at pre-compile, origin=RB:42.9.4.0:2020-10-15, set at pre-compile, default-value=0  # RB (Vendor06) specific parameter: Number of reorder buffer indicates number of TCP sockets capable of handling out of order reception in parallel. Each buffer can store multiple TCP segments belonging to the same TCP socket. Value 0 indicates out of order handling is disabled. | Note: A received frame shall be considered as out of order when received sequence number is inside the receive window but higher than the next expected sequence number. If the reodering is enabled and received out of order TCP segment fits in the available reoder buffer, the TCP segment will be stored in the reorder buffer and processed later when missing segments arrive.
        integer TcpIpRbTcpReorderBufferSize [0..1]: 24..65535, multiplicity set at pre-compile, origin=RB:42.9.4.0:2020-10-15, set at pre-compile  # RB (Vendor06) specific parameter: Size of each reorder buffer and indicates memory available for individual TCP socket in bytes for out of order reception. Each buffer can store multiple TCP segments belonging to the same TCP socket. | Note: This parameter is only relevant if the parameter TcpIpRbTcpReorderBufferCount is configured to a non-zero value. Number of TCP segments stored in a buffer depends on the value of the parameter, size of incoming TCP segment and availability of enough continuous memory for the incoming out of order segment. For each TCP segment in addition to TCP segment length (TCP header + Payload length) 4 more bytes are consumed to store meta data to handle buffer management. If the out of order segment cannot be stored because of unavailability of the memory the segment will be dropped. Minimum value for the parameter must be 24 = TCP header length (20) + Meta data for buffer management(4).
        boolean TcpIpRbTcpTimeStampEnabled [0..1]: multiplicity set at pre-compile, origin=RB:45.1.4.0:2021-09-30, set at pre-compile, default-value=false  # RB (Vendor06) specific parameter: Enables (TRUE) or disables (FALSE) support of Timestamp feature. | Note: If the parameter is enabled Timestamp option is negotiated during 3-way handshaking. If successfully negotiated, Timestamp option is included in every segment for the duration of connection.
        boolean TcpIpTcpCongestionAvoidanceEnabled: set at pre-compile  # Enables (TRUE) or disables (FALSE) support of TCP congestion avoidance algorithm according to IETF RFC 5681.
        float TcpIpTcpDelayedAckTimeout [0..1]: 0..0.5, multiplicity set at link in variant link-time / post-build in variant post-build / pre-compile in variant pre-compile, set at link in variant link-time / post-build in variant post-build / pre-compile in variant pre-compile, default-value=0.5  # The maximal time an acknowledgment is delayed for transmission in seconds.For further details, see also IETF RfC 1122 section 4.2.3.2 | Note: Default: 0.5 is used when parameter is disbled. Dependency: TcpIpTcpDlyAckEnabled
        boolean TcpIpTcpDlyAckEnabled [0..1]: multiplicity set at pre-compile, origin=RB:42.0.3.0:2016-03-25, set at pre-compile, default-value=false  # RB (Vendor06) specific parameter: Enables (TRUE) or disables (FALSE) support of Delayed Ack feature. | Note: If the parameter is enabled the acknowledgments sent to the remote shall be delayed by 200ms or ACK responses shall be sent after two MSS.
        boolean TcpIpTcpDynReTxTimerEnabled [0..1]: multiplicity set at pre-compile, origin=RB:42.0.3.0:2016-03-25, set at pre-compile, default-value=false  # RB (Vendor06) specific parameter: Enables (TRUE) or disables (FALSE) use of TCP Dynamic ReTx Timer. | Note: If the parameter is enabled the Retransmission Timeout shall be calculated dynamically according to the time the remote acknowledge data segments(RTT). Dependency: TcpIpTcpReTxEnabled.
        float TcpIpTcpDynReTxTimerLwrBound [0..1]: 0..INF, multiplicity set at link in variant link-time / post-build in variant post-build / pre-compile in variant pre-compile, origin=RB:45.3.4.0:2022-10-14, set at link in variant link-time / post-build in variant post-build / pre-compile in variant pre-compile, default-value=1  # RB (Vendor06) specific parameter: Lower bound of Timeout in [s] when Retransmission TimeOut is calculated dynamically. | Note: This parameter specifies the minimum limit that shall be used during computing of dynamic retransmission timeout. Default: 1 second is used when parameter is disabled (RFC2988, p3, section 2.4) Dependency: TcpIpTcpDynReTxTimerEnabled
        float TcpIpTcpDynReTxTimerUprBound [0..1]: 0..INF, multiplicity set at link in variant link-time / post-build in variant post-build / pre-compile in variant pre-compile, origin=RB:42.0.3.0:2016-03-25, set at link in variant link-time / post-build in variant post-build / pre-compile in variant pre-compile  # RB (Vendor06) specific parameter: Upper bound of Timeout in [s] when Retransmission TimeOut is calculated dynamically. | Note: This parameter specifies the maximum limit that shall be used during computing of dynamic retransmission timeout (from RTT or exponential backoff). Default: INF is used when parameter is disabled Dependency: TcpIpTcpDynReTxTimerEnabled
        boolean TcpIpTcpFastRecoveryEnabled: set at pre-compile  # Enables (TRUE) or disables (FALSE) support of TCP Fast Recovery according to IETF RFC 5681.
        boolean TcpIpTcpFastRetransmitEnabled: set at pre-compile  # Enables (TRUE) or disables (FALSE) support of TCP Fast Retransmission according to IETF RFC 5681.
        float TcpIpTcpFinWait2Timeout: 0..INF, set at link in variant link-time / post-build in variant post-build / pre-compile in variant pre-compile  # Timeout in [s] to receive a FIN from the remote node (after this node has initiated connection termination), i.e. maximum time waiting in FINWAIT-2 for a connection termination request from the remote TCP.
        boolean TcpIpTcpHalfDuplxCloseEnabled [0..1]: multiplicity set at pre-compile, origin=RB:42.0.3.0:2016-03-25, set at pre-compile, default-value=false  # RB (Vendor06) specific parameter: Enables (TRUE) or disables (FALSE) Implementation of Half Duplex Close as per RFC 1122 | Note: If the parameter is enabled the Half Duplex Close feature is activated which shall send a reset segment if Close call was requested and new data is received.
        enumeration TcpIpTcpIsnGenerationMethod [0..1]: {PSEUDO_RANDOM, CLOCK_DRIVEN, CLOCK_HASH_BASED}, multiplicity set at pre-compile, origin=RB:42.0.6.0:2016-06-03, set at pre-compile, default-value=PSEUDO_RANDOM  # RB (Vendor06) specific parameter: Specify how the Initial Sequence Number should be generated. | Note: PSEUDO_RANDOM : The Initial Sequence Number is generated pseudo randomly (resource efficient, this method is not secure and does not respect RFC793 and RFC1122 assumption) CLOCK_DRIVEN : The Initial Sequence Number is chosen based on clock driven selection (resource efficient, this method is not secure but respect RFC793 and RFC1122 assumption) CLOCK_HASH_BASED : The Initial Sequence Number is chosen using clock and MD4 hash as per RFC6528 (higher resource consumption, this method is more secure) Default: PSEUDO_RANDOM is used when parameter is disabled
        boolean TcpIpTcpKeepAliveEnabled: set at pre-compile, default-value=false  # Enables (TRUE) or disables (FALSE) TCP Keep Alive Probes according to IETF RFC 1122 chapter 4.2.3.6
        float TcpIpTcpKeepAliveInterval: 0..INF, set at link in variant link-time / post-build in variant post-build / pre-compile in variant pre-compile  # Specifies the interval in [s] between subsequent keepalive probes. | Dependency: TcpIpTcpKeepAliveEnabled
        integer TcpIpTcpKeepAliveProbesMax: 0..65535, set at link in variant link-time / post-build in variant post-build / pre-compile in variant pre-compile  # Maximum number of times that a TCP Keep Alive is retransmitted before the connection is closed. | Dependency: TcpIpTcpKeepAliveEnabled
        float TcpIpTcpKeepAliveTime: 0..INF, set at link in variant link-time / post-build in variant post-build / pre-compile in variant pre-compile, default-value=7200  # Specifies the time in [s] between the last data packet sent (simple ACKs are not considered data) and the first keepalive probe. | Note: Setting this configuration parameter to a value smaller or equal to the value of TcpIpMainFunctionPeriod results in the transmission of keep alive probes within every MainFunction cycle. Dependency: TcpIpTcpKeepAliveEnabled
        boolean TcpIpTcpMSSEnabled [0..1]: multiplicity set at pre-compile, origin=RB:42.0.3.0:2016-03-25, set at pre-compile, default-value=false  # RB (Vendor06) specific parameter: Enables (TRUE) or disables (FALSE) support of TCP Maximum Segment Size option. | Note: If the parameter is enabled the Maximum Segment Size permitted on reception shall be advertised to the remote within SYN or SYN-ACK segments (MSS option).
        integer TcpIpTcpMaxRtx [0..1]: 0..255, multiplicity set at link in variant link-time / post-build in variant post-build / pre-compile in variant pre-compile, set at link in variant link-time / post-build in variant post-build / pre-compile in variant pre-compile  # Maximum number of times that a TCP segment is retransmitted before the TCP connection is closed. This parameter is only valid if TcpIpTcpRetransmissionTimeout is configured. | Note: This parameter also applies for FIN retransmissions. Default: 255 is used when parameter is disabled Dependency: TcpIpTcpReTxEnabled
        integer TcpIpTcpMaxTxBuffPerSock [0..1]: 0..65535, multiplicity set at pre-compile, origin=RB:42.0.3.0:2016-03-25, set at pre-compile, default-value=4096  # RB (Vendor06) specific parameter: Maximum size of TCP Tx window buffer allocated per TCP socket. | Note: This parameter specifies the size of the Tcp Tx Buffer per socket that shall be used to store the data before transmission.
        float TcpIpTcpMsl: 0..INF, set at link in variant link-time / post-build in variant post-build / pre-compile in variant pre-compile  # Maximum segment lifetime in [s]. | (Note: TIME-WAIT = 2 x TcpIpTcpMsl - to ensure that the remote node received the acknowledgment to its connection termination request.)
        boolean TcpIpTcpNagleEnabled: set at pre-compile  # Enables (TRUE) or disables (FALSE) support of Nagle's algorithm according to IETF RFC 1122 (chapter 4.2.3.4 When to Send Data). If enabled the Nagle's algorithm is activated per default for all TCP sockets, but can be deactivated via TcpIp_ChangeParameter() API.
        boolean TcpIpTcpReTxEnabled [0..1]: multiplicity set at pre-compile, origin=RB:42.2.0.0:2017-01-19, set at pre-compile, default-value=false  # RB (Vendor06) specific parameter: Enables (TRUE) or disables (FALSE) support of Retransmission feature. | Note: If the parameter is enabled the retransmissions of Tcp segments (SYN, DATA, FIN-ACK(1st packet of close sequence)) shall be possible.
        integer TcpIpTcpReceiveWindowMax: 0..65535, set at link in variant link-time / post-build in variant post-build / pre-compile in variant pre-compile  # Default value of maximum receive window in bytes.
        float TcpIpTcpRetransmissionTimeout [0..1]: 0.001..INF, multiplicity set at link in variant link-time / post-build in variant post-build / pre-compile in variant pre-compile, set at link in variant link-time / post-build in variant post-build / pre-compile in variant pre-compile  # Timeout in [s] before an unacknowledged TCP segment is sent again. | Note: If the timeout is disabled or set to INF, no TCP segments shall be retransmitted. Value can be overwritten by TcpIp_ChangeParameter() API for a particular connection. Default: INF is used when parameter is disabled Dependency: TcpIpTcpReTxEnabled
        boolean TcpIpTcpSlowStartEnabled: set at pre-compile  # Enables (TRUE) or disables (FALSE) support of TCP slow start algorithm according to IETF RFC 5681.
        integer TcpIpTcpSynMaxRtx: 0..255, set at link in variant link-time / post-build in variant post-build / pre-compile in variant pre-compile  # Maximum number of times that a TCP SYN is retransmitted. | Note: SYN will be retried after TcpIpTcpRetransmissionTimeout. The connection will be dropped if no matching connection request has been received after the last TCP SYN has been sent and TcpIpTcpRetransmissionTimeout has been expired. Dependency: TcpIpTcpReTxEnabled
        float TcpIpTcpSynReceivedTimeout: 0..INF, set at link in variant link-time / post-build in variant post-build / pre-compile in variant pre-compile  # Timeout in [s] to complete a remotely initiated TCP connection establishment, i.e. maximum time waiting in SYN-RECEIVED for a confirming connection request acknowledgment after having both received and sent a connection request.
        integer TcpIpTcpTtl: 0..255, set at link in variant link-time / post-build in variant post-build / pre-compile in variant pre-compile  # Default Time-to-live value of outgoing TCP packets. | This Time-To-Live value decides how long TCP packet stays alive on network when destination is unreachable.
        float TcpIpTcpUserTimeout [0..1]: 0..INF, multiplicity set at link in variant link-time / post-build in variant post-build / pre-compile in variant pre-compile, origin=RB:42.0.3.0:2016-03-25, set at link in variant link-time / post-build in variant post-build / pre-compile in variant pre-compile  # RB (Vendor06) specific parameter: Maximum amount of time in [s] that transmitted data may remain unacknowledged before TCP forcefully closes the connection. | Note: This parameter specifies the User Timeout which shall be used to forcefully close a Tcp connection when remote does not respond to sent data within selected time. Dependency: TcpIpTcpUserTimeoutEnabled
        boolean TcpIpTcpUserTimeoutEnabled [0..1]: multiplicity set at pre-compile, origin=RB:42.2.0.0:2017-01-19, set at pre-compile, default-value=false  # RB (Vendor06) specific parameter: Enables (TRUE) or disables (FALSE) support of User Timeout feature. | Note: If the parameter is enabled the TcpIpTcpUserTimeout shall be advertised to the remote within SYN or SYN-ACK segments (UTO option). If the remote does not respond to sent data within the TcpIpTcpUserTimeout the connection shall be forcefully closed.
        boolean TcpIpTcpZWPEnabled [0..1]: multiplicity set at pre-compile, origin=RB:42.0.3.0:2016-03-25, set at pre-compile, default-value=false  # RB (Vendor06) specific parameter: Enables (TRUE) or disables (FALSE) TCP Zero Window Probes according to IETF RFC 1122 chapter 4.2.2.17 | Note: If the parameter is enabled Zero Window Probes shall be transmitted to probe the remote window when remote advertise a window of 0. Dependency: TcpIpTcpReTxEnabled
        integer TcpIpTcpZWPMaxRetries [0..1]: 0..255, multiplicity set at link in variant link-time / post-build in variant post-build / pre-compile in variant pre-compile, origin=RB:42.0.3.0:2016-03-25, set at link in variant link-time / post-build in variant post-build / pre-compile in variant pre-compile, default-value=255  # RB (Vendor06) specific parameter: Maximum number of times that a Zero Window Probe segment transmitted. | Note: This parameter specifies the maximum number of times that a Zero Window Probe segment is retransmitted without any response from the remote before the TCP connection is closed. Dependency: TcpIpTcpZWPEnabled
        container TcpIpTcpConfigOptionFilter [0..0]: multiplicity set at link in variant link-time / post-build in variant post-build / pre-compile in variant pre-compile  # TcpIpTcpConfigOptionFilter (currently unused) | This container describes the white list for the filtering of TCP options, i.e. segments containing TCP options not listed here shall be silently dropped.
          integer TcpIpTcpConfigOptionFilterEntry [0..0]: 0..255, multiplicity set at link in variant link-time / post-build in variant post-build / pre-compile in variant pre-compile, set at link in variant link-time / post-build in variant post-build / pre-compile in variant pre-compile  # TcpIpTcpConfigOptionFilterEntry (currently unused) | TCP option kind allowed by this filter.
          integer TcpIpTcpConfigOptionFilterId [0..0]: 0..255, set at link in variant link-time / post-build in variant post-build / pre-compile in variant pre-compile, symbolic-name-value=true  # TcpIpTcpConfigOptionFilterId (currently unused) | Identification of the TCP option filter.
      container TcpIpTlsConfig [0..1]: multiplicity set at pre-compile  # Specifies the configuration parameters of the TLS (Transport Layer Security) sub module.
        integer TcpIpRbTlsCertificateAttributesMaxLength [0..1]: 1..255, multiplicity set at pre-compile, origin=RB:42.10.0.0:2020-12-31, set at pre-compile, default-value=32  # RB (Vendor06) specific parameter: The parameter specifies maximum length of a certificate attributes. | Note: This parameter is used to hold the maximum length of certificate attributes such as extension, version number, issuer name, subject name etc which could be retrived via KeyM_CertElementGet() API. If this parameter is not configured, then it can be configured with default value 32.
        integer TcpIpRbTlsClientCertificateTypesMaxCount [0..1]: 1..4, multiplicity set at pre-compile, origin=RB:45.3.0.0:2022-06-30, set at pre-compile, default-value=2  # RB (Vendor06) specific parameter: The parameter specifies the maximum number of certificate types could be supported in TLS Client. | Note: This parameter shall be configured only for TLS Client and Client authentication is enabled. This parameter specifies the number of certificate types like RSA, ECC, RSA fixed ECDH, ECDSA fixed ECDH that could be processed in the received Certificate Request message from TLS Server. If this parameter is not configured, then it can be configured with default value 1.
        integer TcpIpRbTlsDistinguishedNameMaxLength [0..1]: 1..65535, multiplicity set at pre-compile, origin=RB:45.0.4.0:2021-04-15, set at pre-compile, default-value=512  # RB (Vendor06) specific parameter: The parameter specifies maximum length of a server or client certificate attribute - Distinguish name. | Note: This parameter is configured only when client authentication is enabled and TcpIpRbTlsRequestCertificateAuthority is enabled. This parameter will specify the maximum length of Distinguish name that can be sent in certificate request handshake message.
        integer TcpIpRbTlsDistinguishedNamesMaxCount [0..1]: 1..4, multiplicity set at pre-compile, origin=RB:45.3.0.0:2022-06-30, set at pre-compile, default-value=2  # RB (Vendor06) specific parameter: The parameter specifies the maximum number of distinguished names supported by TLS Client. | Note: This parameter shall be configured only for TLS Client and Client authentication is enabled. This parameter specifies the number of distinguished names that could be processed in the received Certificate Request message from TLS Server. If this parameter is not configured, then it can be configured with default value 1.
        integer TcpIpRbTlsECSupportedGrpsMaxCount [0..1]: 1..16, multiplicity set at pre-compile, origin=RB:42.9.0.0:2020-06-30, set at pre-compile, default-value=10  # RB (Vendor06) specific parameter: The parameter specifies maximum number of Elliptic curve groups that can be supported if Elliptic curve related ciphersuite is selected in the configuration. | Note: If this parameter is not configured, then it can be configured with default value 10.
        integer TcpIpRbTlsECSupportedPointsMaxCount [0..1]: 1..5, multiplicity set at pre-compile, origin=RB:42.9.0.0:2020-06-30, set at pre-compile, default-value=1  # RB (Vendor06) specific parameter: The parameter specifies maximum number of Elliptic curve point formats that can be supported if Elliptic curve related ciphersuite is selected in the configuration. | Note: If this parameter is not configured, then it can be configured with default value 1.
        integer TcpIpRbTlsExtensionDataMaxLength [0..1]: 0..256, multiplicity set at pre-compile, origin=RB:45.1.4.0:2021-10-15, set at pre-compile, default-value=128  # RB (Vendor06) specific parameter: This parameter specifies maximum length of a Tls extension data that could be allowed per extension. If this parameter is not configured then by default configure it with 128bytes.
        integer TcpIpRbTlsHandshakeReassemblyBufferSizePerConnection [0..1]: 0..16777215, multiplicity set at pre-compile, origin=RB:45.3.4.0:2022-10-14, set at pre-compile, default-value=4096  # RB (Vendor06) specific parameter: The parameter specifies the size of the Handshake Reassembly buffer per Tls connection. | Note: According to TLS Rfc 5246, single TLS handshake message could be fragmented into multiple TLS records and it shall be reassembled until complete TLS handshake message is received. This parameter shall be used to reassemble the received fragmented handshake message in rx path and it shall be processed after complete TLS handshake message is received. This parameter shall be configured at max of individual handshake message could be received from peer. If this parameter is not configured then by default configure it with 4KB by assuming that 3 level certificates could be received.
        float TcpIpRbTlsMainFunctionPeriod: 0..INF, origin=RB:45.3.4.0:2022-10-14, set at link in variant link-time+post-build / pre-compile in variant pre-compile  # RB (Vendor06) specific parameter: Period of rba_EthTls_MainFunction in [s]. This main function handles the functionality of open and close tls connection. In other words, it exchanges messages such as Handshake, Change Cipher Spec, Alert.
        integer TcpIpRbTlsMaxBufferSizeForCompleteHandshakeMsg [0..1]: 0..16777215, multiplicity set at pre-compile, origin=RB:42.10.0.0:2020-12-31, set at pre-compile, default-value=4096  # RB (Vendor06) specific parameter: The parameter specifies the size of the buffer to hold TLS handshake messages from client hello to client finished. | Note: If this buffer is configured with zero, then two TcpIpTlsCsmHashVerifyJobRef should be configured. Because two jobs are mandatory to calculate the hash for server and client finished messages separately. In the configured two TcpIpTlsCsmHashVerifyJobRefs either of them should be mapped to rba_CryptoCCL. If this parameter is not configured then by default configure it with 4KB.
        integer TcpIpRbTlsMaxBufferSizeForHashFailedHandshakeMsg [0..1]: 0..16777215, multiplicity set at pre-compile, origin=RB:45.1.4.0:2021-10-15, set at pre-compile, default-value=4096  # RB (Vendor06) specific parameter: The parameter specifies the size of the buffer to hold TLS handshake messages for hash calculation in case hash job is failed/not performed. This buffer is used only when TcpIpRbTlsMaxBufferSizeForCompleteHandshakeMsg is configured as zero. | Note: This buffer is used to accumlate the hash failed or not performed TLS messages to the existing buffer messages. So that hash calculation can be retried during next iteration for all buffer messages. If this parameter is not configured then by default configure it with 4KB.
        integer TcpIpRbTlsMaxCertificateLength [0..1]: 512..16777216, multiplicity set at pre-compile, origin=RB:42.10.0.0:2020-12-31, set at pre-compile, default-value=1024  # RB (Vendor06) specific parameter: The parameter specifies maximum size for a certificate which is used during server certificate or client certificate handshakes. The size is measured in bytes
        integer TcpIpRbTlsMaxPseudoHashOperationCount [0..1]: 1..1024, multiplicity set at pre-compile, origin=RB:45.1.4.0:2021-10-15, set at pre-compile, default-value=5  # RB (Vendor06) specific parameter: The parameter specifies maximum number of Pseudo Hash operation that could be performed in same main function.
        integer TcpIpRbTlsMaxResumptionsPerSession [0..1]: 0..65535, multiplicity set at pre-compile, origin=RB:45.4.4.0:2023-04-15, set at pre-compile, default-value=5  # RB (Vendor06) specific parameter: The parameter specifies the number of times a given session can be resumed by Client by providing the same Session Ticket given by the Server. | Note: This parameter should be enabled only if TcpIpRbTlsSessionResumptionEnabled is enabled.
        integer TcpIpRbTlsMaxRxBufferSizePerConnection [0..1]: 256..4294967295, multiplicity set at pre-compile, origin=RB:42.9.0.0:2020-06-30, set at pre-compile, default-value=4096  # RB (Vendor06) specific parameter: The parameter specifies the size of the Rx buffer per Tls connection. | Note: The Tls payload present in Tcp buffer is copied to Rx buffer present in Tls component if Tls msg is fragmented. If this parameter is not configured then by default configure it with 4KB.
        integer TcpIpRbTlsMaxTxBufferSizePerConnection [0..1]: 256..4294967295, multiplicity set at pre-compile, origin=RB:42.9.0.0:2020-06-30, set at pre-compile, default-value=4096  # RB (Vendor06) specific parameter: The parameter specifies the size of the Tx buffer per Tls connection. | Note: The Tls messages are framed and stored in this buffer and it is copied to Tcp buffer. If this parameter is not configured then by default configure it with 4KB.
        integer TcpIpRbTlsMultipleOfHMacOutputPerIteration [0..1]: 1..8, multiplicity set at pre-compile, origin=RB:45.1.4.0:2021-10-15, set at pre-compile, default-value=1  # RB (Vendor06) specific parameter: The parameter specifies how many HMAC operation needs to be performed based on the output size of algorithm selected for Tls handshake.
        boolean TcpIpRbTlsPerformFinishedMsgOperationConsecutively [0..1]: multiplicity set at pre-compile, origin=RB:45.1.4.0:2021-10-15, set at pre-compile, default-value=true  # RB (Vendor06) specific parameter: This parameter specifies if preparation/processing of finished message has to be performed consectively. | Note: If this parameter is TRUE then Tls server/client finished messages will be prepared and processed in same main function. Finished Msg contains the following operations, Hash Calculation, PRF Calculation and then Encryption/decryption which happen in parallel for processing client finished and preparing server finished during Tls Server vice versa for Tls Client.
        boolean TcpIpRbTlsPerformKeyExchangeHMacOperationConsecutively [0..1]: multiplicity set at pre-compile, origin=RB:45.1.4.0:2021-10-15, set at pre-compile, default-value=true  # RB (Vendor06) specific parameter: This parameter specifies if HMAC operation for key exchange process has to be performed in same mainfunction if requested output size is more than output which shall be produced per HMAC operation. HMAC output will be varied based on the ciphersuite selection. | Note: Consecutively means that all HMAC operations needed for key exchange are done in same main function.
        integer TcpIpRbTlsPresharedKeyIdentityHintMaxLength [0..1]: 1..128, multiplicity set at pre-compile, origin=RB:42.9.0.0:2020-06-30, set at pre-compile, default-value=32  # RB (Vendor06) specific parameter: The parameter specifies maximum length of the PresharedKeyIdentityHint. | Dependency: This parameter is used only when Pre-shared key related ciphersuites are selected. If this parameter is not configured, then it can be configured with default value 32.
        integer TcpIpRbTlsPresharedKeyIdentityMaxLength [0..1]: 1..128, multiplicity set at pre-compile, origin=RB:42.9.0.0:2020-06-30, set at pre-compile, default-value=32  # RB (Vendor06) specific parameter: The parameter specifies maximum length of the PresharedKeyIdentity. | Dependency: This parameter is used only when Pre-shared key related ciphersuites are selected. If this parameter is not configured, then it can be configured with default value 32.
        integer TcpIpRbTlsPresharedKeyMaxLength [0..1]: 1..128, multiplicity set at pre-compile, origin=RB:42.9.0.0:2020-06-30, set at pre-compile, default-value=32  # RB (Vendor06) specific parameter: The parameter specifies length of the TcpIpTlsPresharedKey. | Note: Dependency: This parameter is used only when Pre-shared key related ciphersuites are selected. If this parameter is not configured, then it can be configured with default value 32.
        boolean TcpIpRbTlsProcessMultipleHandshakeMsgConsecutively [0..1]: multiplicity set at pre-compile, origin=RB:45.1.4.0:2021-10-15, set at pre-compile, default-value=true  # RB (Vendor06) specific parameter: This parameter specifies whether multiple handshake messages can be processed consecutively in same main function context if it is set to true else handshake messages shall be processed in different main functions. This is required to reduce runtime of tls main function.
        integer TcpIpRbTlsRecordReassemblyBufferSizePerConnection [0..1]: 0..65535, multiplicity set at pre-compile, origin=RB:45.3.4.0:2022-10-14, set at pre-compile, default-value=4096  # RB (Vendor06) specific parameter: The parameter specifies the size of the Record Reassembly buffer per Tls connection. | Note: According to TLS Rfc 5246, single TLS record could be fragmented into multiple TCP packets and it shall be reassembled until complete TLS record is received. This parameter shall be used to reassemble the received fragmented TLS records in rx path and it shall be processed after complete TLS record is received. This parameter shall be configured based on the TcpIpTlsMaxFragmentLength if it is configured, else it shall be atleast greater than TcpIpRbTlsMaxRxBufferSizePerConnection parameter value. If this parameter is not configured then by default configure it with 4KB.
        integer TcpIpRbTlsRemoteCertificateChainMaxCount [0..1]: 1..255, multiplicity set at pre-compile, origin=RB:45.0.4.0:2021-04-15, set at pre-compile, default-value=3  # RB (Vendor06) specific parameter: The parameter specifies maximum number of certificates that can be in chain of certificate sent by remote node. The count is including the user certificate.
        float TcpIpRbTlsRxMainFunctionPeriod: 0..INF, origin=RB:45.5.0.0:2023-06-30, set at link in variant link-time+post-build / pre-compile in variant pre-compile  # RB (Vendor06) specific parameter: Period of rba_EthTls_MainFunctionRx in [s]. This main function handles the functionality of reception for application data.
        integer TcpIpRbTlsServerNameIdentificationMaxLength [0..1]: 1..128, multiplicity set at pre-compile, origin=RB:42.9.0.0:2020-06-30, set at pre-compile, default-value=32  # RB (Vendor06) specific parameter: The parameter specifies the maximum length of the TcpIpTlsServerNameIdentification received from remote client. This parameter is applicable for server connection only. | Note: If this parameter is not configured, then it can be configured with default value 64.
        float TcpIpRbTlsSessionRenegotiationInitiateTimeout [0..1]: 0..INF, multiplicity set at pre-compile, origin=RB:45.4.0.0:2023-01-20, set at pre-compile, default-value=1  # RB (Vendor06) specific parameter: The parameter specifies the time in seconds for which ECU waits before initiating the renegotiation process after renegotiation request is received from Upper layer. | Note: This parameters helps to be in synchronization with remote ecu. For example: There are chances to receive the application data message from remote after renegotiation is initiated at ECU. During this time interval, ECU will ignore the application data and will wait until handshake messages are received.
        float TcpIpRbTlsSessionRenegotiationTimeout [0..1]: 2..INF, multiplicity set at pre-compile, origin=RB:45.4.0.0:2023-01-20, set at pre-compile, default-value=240  # RB (Vendor06) specific parameter: The parameter specifies the time duration of the session in seconds. | Note: ECU will initiate the renegotiation of the session if this time expires.
        integer TcpIpRbTlsSessionTicketMaxSize [0..1]: 128..65535, multiplicity set at pre-compile, origin=RB:45.4.4.0:2023-04-15, set at pre-compile, default-value=4096  # RB (Vendor06) specific parameter: The parameter specifies the size of Session Ticket which will be included in New Session Ticket handshake message. | Note: Minimum size of this parameter is set to 128 bytes by considering all mandatory fields (keyname(16) + IV(16) + encrpted_state(64) + mac(32)) of the Session Ticket according to Rfc 5077. Default size of this parameter is set to 1024 bytes by considering minimum of one client certificate in encryption state if client authentication is enabled. This parameter should be enabled only if TcpIpRbTlsSessionResumptionEnabled is enabled.
        float TcpIpRbTlsSessionTicketTimeout [0..1]: 0..INF, multiplicity set at pre-compile, origin=RB:45.4.4.0:2023-04-15, set at pre-compile, default-value=120  # RB (Vendor06) specific parameter: The parameter specifies the time in seconds for which a given Session Ticket is valid. | Note: When this timer elapses, the Session Ticket is no longer valid and will be renewed. This parameter should be enabled only if TcpIpRbTlsSessionResumptionEnabled is enabled.
        integer TcpIpRbTlsSignatureAlgorithmsMaxCount [0..1]: 2..32, multiplicity set at pre-compile, origin=RB:42.10.0.0:2020-12-31, set at pre-compile, default-value=12  # RB (Vendor06) specific parameter: The parameter specifies maximum number of signature algorithms supported. | Note: If this parameter is not configured, then it can be configured with default value 12.
        integer TcpIpRbTlsSignatureValueMaxLength [0..1]: 1..255, multiplicity set at pre-compile, origin=RB:42.10.0.0:2020-12-31, set at pre-compile, default-value=128  # RB (Vendor06) specific parameter: The parameter specifies maximum number of signature values that could be supported. | Note: If this parameter is not configured, then it can be configured with default value 128.
        float TcpIpRbTlsTxMainFunctionPeriod: 0..INF, origin=RB:45.5.0.0:2023-06-30, set at link in variant link-time+post-build / pre-compile in variant pre-compile  # RB (Vendor06) specific parameter: Period of rba_EthTls_MainFunctionTx in [s]. This main function handles the functionality of transmission for application data.
        float TcpIpRbTlsWaitForPeerTimeout [0..1]: 0..INF, multiplicity set at pre-compile, origin=RB:42.10.0.0:2020-12-31, set at pre-compile, default-value=0.3  # RB (Vendor06) specific parameter: The parameter specifies the timeout for which ECU will wait until it receives next TLS handshake message from remote. | Note: This parameter is used to determine the timeout for TLS message reception. Timeout in seconds after which an ECU stops waiting for the reception of TLS messages and ECU notifies to remote node by sending Alert message with Alert description code 0x50 (internal error).
        integer TcpIpTlsMaxConnections: 1..65535, set at pre-compile  # Defines the max. number of TLS connections that can be opened at the same time. | This parameter will refer to the number of dynamic connections. Note: The parameter specifies number of remote connections used simultaneously. For example if one Tls server wants to communicate with two Tls clients at same time then value for this parameter will be 2.
        reference TcpIpTlsCsmRandomGenerateJobRef: set at pre-compile, requires-symbolic-name-value=true, destination=CsmJob  # Reference to a CSM job to generate a random value.
        container TcpIpTlsCiphersuites  # This container provides the information about supported ciphersuites used by TLS.
          container TcpIpTlsCertificateIdentity [1..*]: multiplicity set at pre-compile  # This container provides information about the certificates used for ciphersuites.
            string TcpIpTlsServerNameIdentification [0..1]: multiplicity set at pre-compile, set at pre-compile  # Defines a server identification name. If present, the name will be added as an extension with the "TLS client hello" handshake message. The TLS server will check for the name to identify the server certificate.
            reference TcpIpTlsCipherKeyMLocalCertificate [0..1]: multiplicity set at pre-compile, set at pre-compile, requires-symbolic-name-value=true, destination=KeyMCertificate  # Reference to a KeyM certificate used to address the local certificate.
            reference TcpIpTlsCipherKeyMRemoteCertificate [0..1]: multiplicity set at pre-compile, set at pre-compile, requires-symbolic-name-value=true, destination=KeyMCertificate  # Reference to KeyM certificate container to reference the remote certificate.
          container TcpIpTlsCiphersuiteDefinition [1..*]: multiplicity set at pre-compile  # This container provides the static information of a ciphersuite used by TLS.
            boolean TcpIpRbTlsUseSecurityExtensionSupportedGroups [0..1]: multiplicity set at pre-compile, origin=RB:42.10.0.0:2020-12-31, set at pre-compile, default-value=false  # RB (Vendor06) specific parameter: This parameter if configured to TRUE then supported groups extension can be included in the extensions list.
            boolean TcpIpRbTlsUseSecurityExtensionSupportedPointFormats [0..1]: multiplicity set at pre-compile, origin=RB:42.10.0.0:2020-12-31, set at pre-compile, default-value=false  # RB (Vendor06) specific parameter: This parameter if configured to TRUE then supported points extension can be included in the extensions list.
            integer TcpIpTlsCiphersuiteId: 0..65535, set at pre-compile, with-auto=true  # ID that represents the ciphersuite according to IETF, e.g. RFC4492, Sect. 6, RFC8446, Appendix B.4 or RFC5246, Appendix A.5.
            string TcpIpTlsCiphersuiteName [0..1]: multiplicity set at pre-compile, set at pre-compile  # Provides a verbal name for the ciphersuite. The name should be the one defined in the respective RFC, e.g. TLS_ECDHE_ECDSA_WITH_AES_128_CBC_SHA256 (TLS 1.2) or TLS_AES_128_GCM_SHA256 (TLS 1.3)
            integer TcpIpTlsCiphersuitePriority: 1..65535, set at pre-compile  # Defines the priority of the cipher. The higher the number the lower the priority.
            boolean TcpIpTlsUseAEADCipher [0..0]: set at pre-compile, default-value=false  # TcpIpTlsUseAEADCipher (currently unused) | Specifies if the ciphersuite supports AEAD for data en-/decryption.
            boolean TcpIpTlsUsePresharedKeys: set at pre-compile, default-value=false  # Defines if this ciphersuite uses pre-shared keys. If so, additional configuration or callbacks will be used for pre-shared key negotiation.
            boolean TcpIpTlsUseSecurityExtensionForceEncryptThenMac: set at pre-compile, default-value=false  # Defines if the security extension according to IETF RFC 7366 shall be supported. This is useful for ciphersuites using CBC mode.
            enumeration TcpIpTlsVersion: {TLS_VERSION_V12, TLS_VERSION_V13}, set at pre-compile  # Declares the TLS version that this ciphersuite shall be used for.
          container TcpIpTlsCiphersuiteWorker [1..*]: multiplicity set at pre-compile  # This container provides the jobs and keys necessary for TLS data transmission and reception.
            integer TcpIpTlsCipherAEADCipherKeyLength [0..0]: 1..65535, multiplicity set at pre-compile, set at pre-compile  # TcpIpTlsCipherAEADCipherKeyLength (currently unused) | Defines the key length for en- / decryption with authentication data (AEAD).
            integer TcpIpTlsCipherEncryptKeyLength [0..0]: 1..65535, set at pre-compile  # TcpIpTlsCipherEncryptKeyLength (currently unused) | Defines the key length used for en- or decryption. The key length is valid for (symmetric) encryption and decryption.
            integer TcpIpTlsCipherMacKeyLength [0..0]: 1..65535, set at pre-compile  # TcpIpTlsCipherMacKeyLength (currently unused) | Specifies the length of the MAC key
            reference TcpIpTlsCipherCsmDecryptJobRef [0..1]: multiplicity set at pre-compile, set at pre-compile, requires-symbolic-name-value=true, destination=CsmJob  # Reference to a CSM job to perform the data decryption operation
            reference TcpIpTlsCipherCsmDecryptKeyRef [0..1]: multiplicity set at pre-compile, set at pre-compile, requires-symbolic-name-value=true, destination=CsmKey  # Reference to a CSM key associated to the CSM job that performs the data decryption operation
            reference TcpIpTlsCipherCsmEncryptJobRef [0..1]: multiplicity set at pre-compile, set at pre-compile, requires-symbolic-name-value=true, destination=CsmJob  # Reference to a CSM job to perform the data encryption operation
            reference TcpIpTlsCipherCsmEncryptKeyRef [0..1]: multiplicity set at pre-compile, set at pre-compile, requires-symbolic-name-value=true, destination=CsmKey  # Reference to a CSM key associated to the CSM job that performs the data encryption operation
            reference TcpIpTlsCipherCsmMacGenerateJobRef: set at pre-compile, requires-symbolic-name-value=true, destination=CsmJob  # Reference to a CSM job to perform the MAC generate operation
            reference TcpIpTlsCipherCsmMacGenerateKeyRef: set at pre-compile, requires-symbolic-name-value=true, destination=CsmKey  # Reference to a CSM key associated to the CSM job that performs the MAC generate operation
            reference TcpIpTlsCipherCsmMacVerifyJobRef: set at pre-compile, requires-symbolic-name-value=true, destination=CsmJob  # Reference to a CSM job to perform the MAC verify operation
            reference TcpIpTlsCipherCsmMacVerifyKeyRef: set at pre-compile, requires-symbolic-name-value=true, destination=CsmKey  # Reference to a CSM key associated to the CSM job that performs the MAC verify operation
            reference TcpIpTlsCiphersuiteDefinitionRef: set at pre-compile, destination=TcpIpTlsCiphersuiteDefinition  # Reference to a a ciphersuite definition container
            reference TcpIpTlsConnectionHandshakeRef [1..*]: multiplicity set at pre-compile, set at pre-compile, destination=TcpIpTlsHandshake  # References the container that contains the jobs and keys for handshake operation. | Referencing multiple handshake containers allow to share them between workers and to choose the next unused during the handshake.
          container TcpIpTlsHandshake [1..*]: multiplicity set at pre-compile  # This container provides information that is needed to process a handshake. It contains the appropriate references to jobs and keys of the CSM to perform the key exchange cryptographic for the ciphersuite and involved certificates.
            enumeration TcpIpTlsCsmPRFSupportType [0..1]: {TLS_PRF_CSM_FULL_SUPPORT, TLS_PRF_CSM_INOUT_REDIRECT_SUPPORT, TLS_PRF_CSM_NO_SUPPORT, TLS_PRF_NO_SUPPORT}, multiplicity set at pre-compile, set at pre-compile  # Specifies how the CSM job supports the PRF operation.
            reference TcpIpRbTlsCsmKeyElementSetJobRef [0..1]: multiplicity set at pre-compile, origin=RB:45.3.4.0:2022-10-14, set at pre-compile, requires-symbolic-name-value=true, destination=CsmJob  # RB (Vendor06) specific parameter: Reference to a CSM job to load the private key to generate the Signature for Edward curve. | This parameter shall be configured only when Edward curve is selected for any cryptographic operations in handshake container. Because, time taken to load the key for Edward curve exceeds main function period and hence system will crash. So the key loading operation for Edward curve shall be performed asynchronously via this CSM job
            reference TcpIpRbTlsCsmKeyExchangeKeyPairKeyRef [0..1]: multiplicity set at pre-compile, origin=RB:45.4.4.0:2023-04-15, set at pre-compile, requires-symbolic-name-value=true, destination=CsmKey  # Reference to a CSM key used for Diffie Hellman (DH) key exchange operation with static key pair. | Note: This parameter shall be configured for cipher suite which requires ECDH key exchange operation. In this key exchange operation, configured static key pair shall be used instead of Csm_JobCalcPubVal operation. Also, static key pair could be loaded via Csm_KeyElementSet() API dynamically.
            reference TcpIpRbTlsSessionTicketCsmDecryptJobRef [0..1]: multiplicity set at pre-compile, origin=RB:45.4.4.0:2023-04-15, set at pre-compile, requires-symbolic-name-value=true, destination=CsmJob  # RB (Vendor06) specific parameter: Reference to a CSM job used by Server to perform decryption of Session Ticket.
            reference TcpIpRbTlsSessionTicketCsmDecryptKeyRef [0..1]: multiplicity set at pre-compile, origin=RB:45.4.4.0:2023-04-15, set at pre-compile, requires-symbolic-name-value=true, destination=CsmKey  # RB (Vendor06) specific parameter: Reference to a CSM key associated to the CSM job used by Server to perform decryption of Session Ticket.
            reference TcpIpRbTlsSessionTicketCsmEncryptJobRef [0..1]: multiplicity set at pre-compile, origin=RB:45.4.4.0:2023-04-15, set at pre-compile, requires-symbolic-name-value=true, destination=CsmJob  # RB (Vendor06) specific parameter: Reference to a CSM job used by Server to perform encryption of Session Ticket.
            reference TcpIpRbTlsSessionTicketCsmEncryptKeyRef [0..1]: multiplicity set at pre-compile, origin=RB:45.4.4.0:2023-04-15, set at pre-compile, requires-symbolic-name-value=true, destination=CsmKey  # RB (Vendor06) specific parameter: Reference to a CSM key associated to the CSM job used by Server to perform encryption of Session Ticket.
            reference TcpIpRbTlsSessionTicketCsmMacGenerateJobRef [0..1]: multiplicity set at pre-compile, origin=RB:45.4.4.0:2023-04-15, set at pre-compile, requires-symbolic-name-value=true, destination=CsmJob  # RB (Vendor06) specific parameter: Reference to a CSM job used by Server to calculate the mac on fields present in Session Ticket.
            reference TcpIpRbTlsSessionTicketCsmMacGenerateKeyRef [0..1]: multiplicity set at pre-compile, origin=RB:45.4.4.0:2023-04-15, set at pre-compile, requires-symbolic-name-value=true, destination=CsmKey  # RB (Vendor06) specific parameter: Reference to a CSM key associated to the CSM job used by Server to calculate the mac on fields present in Session Ticket.
            reference TcpIpRbTlsSessionTicketCsmMacVerifyJobRef [0..1]: multiplicity set at pre-compile, origin=RB:45.4.4.0:2023-04-15, set at pre-compile, requires-symbolic-name-value=true, destination=CsmJob  # RB (Vendor06) specific parameter: Reference to a CSM job used by Server to verify the mac on fields present in Session Ticket.
            reference TcpIpRbTlsSessionTicketCsmMacVerifyKeyRef [0..1]: multiplicity set at pre-compile, origin=RB:45.4.4.0:2023-04-15, set at pre-compile, requires-symbolic-name-value=true, destination=CsmKey  # RB (Vendor06) specific parameter: Reference to a CSM key associated to the CSM job used by Server to verify the mac on fields present in Session Ticket.
            reference TcpIpTlsCsmHashVerifyJobRef [1..2]: multiplicity set at pre-compile, set at pre-compile, requires-symbolic-name-value=true, destination=CsmJob  # Reference to a CSM job to perform the hash operation for the whole handshake.
            reference TcpIpTlsCsmKeyExchangeCalcPubValJobRef [0..1]: multiplicity set at pre-compile, set at pre-compile, requires-symbolic-name-value=true, destination=CsmJob  # Reference to a CSM job to perform the DH Key Exchange algorithm operation
            reference TcpIpTlsCsmKeyExchangeCalcSecretJobRef [0..1]: multiplicity set at pre-compile, set at pre-compile, requires-symbolic-name-value=true, destination=CsmJob  # Reference to a CSM job to perform the Key Exchange algorithm operation
            reference TcpIpTlsCsmKeyExchangeDecryptJobRef [0..0]: multiplicity set at pre-compile, set at pre-compile, requires-symbolic-name-value=true, destination=CsmJob  # TcpIpTlsCsmKeyExchangeDecryptJobRef (currently unused) | Reference to a CSM job to perform data decryption, e.g. with RSA key exchange operation.
            reference TcpIpTlsCsmKeyExchangeDecryptKeyRef [0..0]: multiplicity set at pre-compile, set at pre-compile, requires-symbolic-name-value=true, destination=CsmKey  # TcpIpTlsCsmKeyExchangeDecryptKeyRef (currently unused) | Reference to a CSM key to perform data decryption, e.g. with RSA, used for exchange operation.
            reference TcpIpTlsCsmKeyExchangeEncryptJobRef [0..0]: multiplicity set at pre-compile, set at pre-compile, requires-symbolic-name-value=true, destination=CsmJob  # TcpIpTlsCsmKeyExchangeEncryptJobRef (currently unused) | Reference to a CSM job to perform data encryption, e.g. with RSA key exchange operation.
            reference TcpIpTlsCsmKeyExchangeEncryptKeyRef [0..0]: multiplicity set at pre-compile, set at pre-compile, requires-symbolic-name-value=true, destination=CsmKey  # TcpIpTlsCsmKeyExchangeEncryptKeyRef (currently unused) | Reference to a CSM key to perform data encryption, e.g. with RSA, used for exchange operation.
            reference TcpIpTlsCsmKeyExchangeKeyRef [0..1]: multiplicity set at pre-compile, set at pre-compile, requires-symbolic-name-value=true, destination=CsmKey  # Reference to a CSM key used for Diffie Hellman (DH) key exchange operation.
            reference TcpIpTlsCsmKeyExchangeSignatureGenerateJobRef [0..1]: multiplicity set at pre-compile, set at pre-compile, requires-symbolic-name-value=true, destination=CsmJob  # Reference to a CSM job to perform signature generation for DH operation
            reference TcpIpTlsCsmKeyExchangeSignatureGenerateKeyRef [0..1]: multiplicity set at pre-compile, set at pre-compile, requires-symbolic-name-value=true, destination=CsmKey  # Reference to a CSM key to perform signature generation for DH operation
            reference TcpIpTlsCsmKeyExchangeSignatureVerifyJobRef [0..1]: multiplicity set at pre-compile, set at pre-compile, requires-symbolic-name-value=true, destination=CsmJob  # Reference to a CSM job to perform signature verification for DH operation
            reference TcpIpTlsCsmKeyExchangeSignatureVerifyKeyRef [0..1]: multiplicity set at pre-compile, set at pre-compile, requires-symbolic-name-value=true, destination=CsmKey  # Reference to a CSM key to perform signature verification for DH operation
            reference TcpIpTlsCsmMasterSecretKeyRef [0..0]: multiplicity set at pre-compile, set at pre-compile, requires-symbolic-name-value=true, destination=CsmKey  # TcpIpTlsCsmMasterSecretKeyRef (currently unused) | This is the reference to the master key that is calculated during the session.
            reference TcpIpTlsCsmPrfMacJobRef: set at pre-compile, requires-symbolic-name-value=true, destination=CsmJob  # Reference to a CSM job to perform the PRF hash operation
            reference TcpIpTlsCsmPrfMacKeyRef: set at pre-compile, requires-symbolic-name-value=true, destination=CsmKey  # Reference to a CSM key associated to the CSM job that performs the PRF hash operation
          container TcpIpTlsPskIdentity [0..*]: multiplicity set at pre-compile  # This container provides information about static definition of pre-shared keys. It is used during the handshake to negotiate pre-shared keys between a client and a server. | Note: The callbacks for pre-shared keys are an alternative to the static definition. The callbacks allow to define the associated keys at runtime if pre-shared keys are used but no static definition is available. The container definition is used for static configuration.
            string TcpIpTlsPresharedKeyIdentity [0..1]: multiplicity set at pre-compile, set at pre-compile  # This item provides the key identification. The TLS client selects the pre-shared key based on the identification hint provided by the server and returns the key identification name back to the server.
            string TcpIpTlsPresharedKeyIdentityHint [0..1]: multiplicity set at pre-compile, set at pre-compile  # Provides the identity hint for a pre-shared key. This information is transmitted by the TLS Server to provide its identification to the TLS client. | The TLS client uses the same information to select the pre-shared key.
            function name TcpIpTlsPskGetClientKeyIdentityFunc [0..1]: multiplicity set at pre-compile, set at pre-compile  # Defines the function name for the Up_TlsClientGetPskIdentity() callback.
            function name TcpIpTlsPskGetKeyIdentityHintFunc [0..1]: multiplicity set at pre-compile, set at pre-compile  # Defines the function name for the Up_TlsServerGetPskIdentityHint() callback.
            function name TcpIpTlsPskGetServerKeyIdentityFunc [0..1]: multiplicity set at pre-compile, set at pre-compile  # Defines the function name for the Up_TlsServerGetPskIdentity () callback.
            reference TcpIpTlsPresharedKeyCsmKeyRef [0..1]: multiplicity set at pre-compile, set at pre-compile, requires-symbolic-name-value=true, destination=CsmKey  # Reference to a CSM key associated to the CSM job that performs the PRF hash operation
        container TcpIpTlsConnection [1..*]: multiplicity set at pre-compile  # This container defines the properties of a TLS connection
          boolean TcpIpRbTlsContinueHandshakeIfEmptyClientCertificateRcvd [0..1]: multiplicity set at pre-compile, origin=RB:45.0.4.0:2021-04-15, set at pre-compile, default-value=false  # RB (Vendor06) specific parameter: This parameter specifies whether handshake can be continued or terminated when empty client certificate message is received from the client during client authentication. | Note: During Client authentication feature, if Client sends empty client certificate message to Server then this parameter shall decide whether server needs to continue the handshake or it has to terminate the handshake. In case of termination, Server sends Certificate required Alert Message to the Client. This parameter shall be configured if Client Authentication parameter is set to TRUE.
          boolean TcpIpRbTlsContinueHandshakeIfSessionRenegotiationDisabled [0..1]: multiplicity set at pre-compile, origin=RB:45.3.4.0:2022-10-14, set at pre-compile, default-value=false  # RB (Vendor06) specific parameter: This parameter specifies whether handshake can be continued or terminated when session renegotiation is disabled. | Note: This parameter should decide whether to continue or terminate the handshake when session renegotiation request is not received from the peer. If this parameter is set as false and we do not receieve session renegotiation request from the peer, handshake will be terminated by sending handshake failure alert.
          boolean TcpIpRbTlsContinueHandshakeIfUntrustedClientCertificateRcvd [0..1]: multiplicity set at pre-compile, origin=RB:45.2.0.0:2022-01-21, set at pre-compile, default-value=false  # RB (Vendor06) specific parameter: This parameter specifies whether handshake can be continued or terminated when untrusted client certificate message is received from the client during client authentication. | Note: During Client authentication feature, if Client sends untrusted client certificate message to Server then this parameter shall decide whether server needs to continue the handshake or it has to terminate the handshake. In case of termination, Server sends Handshake Failure Alert Message to the Client. This parameter shall be configured if Client Authentication parameter is set to TRUE.
          boolean TcpIpRbTlsContinueHandshakeIfWarningAlertRcvd [0..1]: multiplicity set at pre-compile, origin=RB:45.1.4.0:2021-10-15, set at pre-compile, default-value=true  # RB (Vendor06) specific parameter: This parameter indicates whether handshake can be continued or terminate the connection if alert message type warning is received. | Note: If this parameter is set to TRUE, then Tls Server/Client can continue the handshake even after receiving alert message type as warning, else connection shall be terminated.
          boolean TcpIpRbTlsDisableSessionResumptionOnSessionRenegotiation [0..1]: multiplicity set at pre-compile, origin=RB:45.4.4.0:2023-04-15, set at pre-compile, default-value=false  # RB (Vendor06) specific parameter: This parameter specifies whether Session Resumption is allowed during Session Renegotiation. | Note: If this parameter is enabled, Server will not allow Session Resumption during Session Renegotiation even if Client tries to resume the session by presenting a valid Session Ticket.
          integer TcpIpRbTlsRecordSizeLimit [0..1]: 1..16384, multiplicity set at pre-compile, origin=RB:42.9.0.0:2020-06-30, set at pre-compile, default-value=4096  # RB (Vendor06) specific parameter: The parameter specifies length of record in the Record size limit extention. | Note: The value of RecordSizeLimit is the maximum size of record in octets that the endpoint is willing to receive. This value is used to limit the size of records that are created when encoding application data and the protected handshake message into records. The limit is 2^14+1 octets. If this parameter is not configured, then it can be configured with default value 4096 bytes.
          boolean TcpIpRbTlsRequestCertificateAuthority [0..1]: multiplicity set at pre-compile, origin=RB:45.0.4.0:2021-04-15, set at pre-compile, default-value=false  # RB (Vendor06) specific parameter: This parameter will be configured if Client Authentication parameter is set to TRUE and TcpIpTlsConnectionType is TLS_SERVER. | Note: This parameter is used to decide whether issuer of certificates configured per connection will be sent in Certificate Request message in distinguishedName certificate_authorities field or not.
          integer TcpIpRbTlsSessionIdLength [0..1]: 0..32, multiplicity set at pre-compile, origin=RB:42.10.0.0:2020-12-31, set at pre-compile, default-value=0  # RB (Vendor06) specific parameter: The parameter specifies length of session id for current Tls connection. | Note: If this parameter is not configured, then it can be configured with default value 0.
          boolean TcpIpRbTlsSessionRenegotiationCertComparisonEnabled [0..1]: multiplicity set at pre-compile, origin=RB:45.3.4.0:2022-10-14, set at pre-compile, default-value=false  # RB (Vendor06) specific parameter: This parameter specifies whether the renegotiated handshake's certificate(s) or certificate SNI(Server name indication) will be compared with the initial handshake's certificate(s) or SNI(Server name indication) during renegotiation. | Note: If this parameter is enabled, handshake failure alert shall be sent if renegotiated handshake's certificate(s) or certificate SNI(Server name indication) is different from the initial handshake's certificate(s) or SNI(Server name indication).
          boolean TcpIpRbTlsSessionRenegotiationEnabled [0..1]: multiplicity set at pre-compile, origin=RB:45.1.4.0:2021-10-15, set at pre-compile, default-value=false  # RB (Vendor06) specific parameter: This parameter will be configured when session renegotiation is supported. | Note: If Session Renegotiation parameter is configured to true then TLS Server/Client supports renegotiation feature. If Session Renegotiation parameter is true for server, then server can allow the client hello msg when session is ongoing. Similarly, If Session Renegotiation parameter is enabled for client, client can allow the hello request msg when session is complete. If Session Renegotiation parameter is enabled and remote does not send the renegotiation info extension then ECU will terminate the current session by sending the alert msg with no renegotiation or continue the handshake depending on wheteher TcpIpRbTlsContinueHandshakeIfRenegotiationDisabled is configured as false or true respectively.
          boolean TcpIpRbTlsSessionRenegotiationSCSVCiphersuiteEnabled [0..1]: multiplicity set at pre-compile, origin=RB:45.3.4.0:2022-10-14, set at pre-compile, default-value=false  # RB (Vendor06) specific parameter: This parameter specifies renegotiation SCSV(Special Signalling Ciphersuite Value) ciphersuite shall be enabled or not. | Note: This parameter specifies whether TLS_EMPTY_RENEGOTIATION_INFO_SCSV ciphersuite will be sent in the initial client hello message during session renegotiation. It shall be enabled to communicate with legacy server when ECU is configured as Client. If ECU Client will be communicating with latest Server always, then this parameter shall be disabled and same semantics could be achieved through renegotiation_info extension. Also, It is not a true ciphersuite and cannot be negotiated as like as other ciphersuites
          boolean TcpIpRbTlsSessionResumptionEnabled [0..1]: multiplicity set at pre-compile, origin=RB:45.4.4.0:2023-04-15, set at pre-compile, default-value=false  # RB (Vendor06) specific parameter: This parameter specifies whether Session Resumption is supported. | Note: If Session Resumption is enabled: Server can allow the Client to resume a previous session by presenting the Session Ticket instead of establishing a full handshake. Client can resume a previous session by presenting a Session Ticket obtained in the previous handshake.
          boolean TcpIpRbTlsUseRootCertInRequestCertificateAuthority [0..1]: multiplicity set at pre-compile, origin=RB:45.2.0.0:2022-01-21, set at pre-compile, default-value=false  # RB (Vendor06) specific parameter: This parameter specifies whether certificate authority identifier(Name) has to be fetched only for root certificate or for complete chain of certificates configured for that particular connection. This parameter should be TRUE only when TcpIpTlsUseClientAuthenticationRequest parameter is TRUE, TcpIpRbTlsRequestCertificateAuthority parameter is TRUE and and TcpIpTlsConnectionType is TLS_SERVER. | Note: For example if 3 TcpIpTlsCertificateIdentityRefs are configured to the connection,and TcpIpRbTlsUseRootCertInRequestCertificateAuthority is configured to TRUE, then certificate authority identifier will be fetched only for root certificates of all 3 configured TcpIpTlsCertificateIdentityRefs. If TcpIpRbTlsUseRootCertInRequestCertificateAuthority is configured to FALSE, then certificate authority identifier should be fetched for complete chain of certificates configured in 3 TcpIpTlsCertificateIdentityRefs. Certificate authority identifier attribute is required to frame the certificate request handshake message which is to be sent during client authentication feature(TcpIpTlsUseClientAuthenticationRequest) enabled.
          boolean TcpIpRbTlsUseSecurityExtensionMaxFragmentLength [0..1]: multiplicity set at pre-compile, origin=RB:42.9.0.0:2020-06-30, set at pre-compile, default-value=false  # RB (Vendor06) specific parameter: Enables Maximum fragment length Extention. | Note: This parameter used only when maximum fragment length extention parameter is required. This parameter is enabled when maximum fragment size extention is used.
          boolean TcpIpRbTlsUseSecurityExtensionMaxFragmentLengthOfRemote [0..1]: multiplicity set at pre-compile, origin=RB:42.9.0.0:2020-06-30, set at pre-compile, default-value=false  # RB (Vendor06) specific parameter: This parameter specifies if Maximum fragment length extension from remote has to be considered for handshake or not. | Note: This parameter used only when maximum fragment length extention parameter is required. This parameter is enabled when maximum fragment size extention is used.
          boolean TcpIpRbTlsUseSecurityExtensionRecordSizeLimitOfRemote [0..1]: multiplicity set at pre-compile, origin=RB:42.10.0.0:2020-12-31, set at pre-compile, default-value=false  # Defines if the security extension for record size limit if received from remote has to be considered for handshake or not.
          boolean TcpIpRbTlsUseSecurityExtensionSignatureAlgorithms [0..1]: multiplicity set at pre-compile, origin=RB:42.9.0.0:2020-06-30, set at pre-compile, default-value=false  # RB (Vendor06) specific parameter: If this parameter is configured to TRUE then signature algorithm extension can be included in the extension list.
          function name TcpIpTlsConnectionGetTimeFunc [0..0]: multiplicity set at pre-compile, set at pre-compile  # TcpIpTlsConnectionGetTimeFunc (currently unused) | Defines the function name for the Up_TlsGetCurrentTimeStamp() callback.
          integer TcpIpTlsConnectionId: 0..65535, set at pre-compile, symbolic-name-value=true  # Identifier of the connection. The set of configured identifiers shall be consecutive and gapless.
          enumeration TcpIpTlsConnectionType: {TLS_CLIENT, TLS_SERVER}, set at pre-compile  # Specifies if the TLS connection is a server or a client.
          integer TcpIpTlsMaxFragmentLength: 1..16384, set at pre-compile, default-value=4096  # Specifies the max length in bytes of a TLS fragment that is sent as a block.
          integer TcpIpTlsPortAssignment [0..1]: 1..65535, multiplicity set at pre-compile, set at pre-compile  # Specifies the port address that is used for TLS communication.
          boolean TcpIpTlsUseClientAuthenticationRequest [0..1]: multiplicity set at pre-compile, set at pre-compile, default-value=false  # Defines if client authentication shall be applied for this TLS connection.
          boolean TcpIpTlsUseSecurityExtensionRecordSizeLimit: set at pre-compile, default-value=false  # Defines if the security extension for max_fragment_length shall be supported as defined in IETF RFC 8449.
          reference TcpIpTlsCertificateIdentityRef [1..*]: multiplicity set at pre-compile, set at pre-compile, destination=TcpIpTlsCertificateIdentity  # References the container that contains the certificate and identity information.
          reference TcpIpTlsConnectionCiphersuiteWorkerRef [1..*]: multiplicity set at pre-compile, set at pre-compile, destination=TcpIpTlsCiphersuiteWorker  # References the container that contains the jobs and keys to process the application data.
          reference TcpIpTlsConnectionGroupRef [0..0]: multiplicity set at pre-compile, set at pre-compile, destination=TcpIpTlsConnectionGroup  # TcpIpTlsConnectionGroupRef (currently unused) | Assigns the TLS connection to a connection group.
          reference TcpIpTlsConnectionPskIdentityRef [0..*]: multiplicity set at pre-compile, set at pre-compile, destination=TcpIpTlsPskIdentity  # References the container that contains information about pre-shared keys.
          reference TcpIpTlsIpAddressAssignment [0..1]: multiplicity set at pre-compile, set at pre-compile, destination=TcpIpStaticIpAddressConfig  # Contains additional information about the endpoint IP address information. If this reference is present, the IP address of the connecting socket shall also be checked if a TLS connection shall be assigned automatically to a socket.
        container TcpIpTlsConnectionGroup [0..0]  # TcpIpTlsConnectionGroup (currently unused) | This optional container is used to collect all TlsConnections that belong to a TlsConnectionGroup. The intention of a TLS connection group is to share resources among TLS connections collected in a group, because only one connection of a group can be used at a time.
      container TcpIpUdpConfig [0..1]: multiplicity set at pre-compile  # Specifies the configuration parameters of the UDP (User Datagram Protocol) sub-module
        boolean TcpIpRbUdpMulticastAddrReuse [0..1]: multiplicity set at pre-compile, origin=RB:45.4.4.0:2023-04-15, set at pre-compile, default-value=false  # RB (Vendor06) specific parameter: Enables (TRUE) or disables (FALSE) sockets to reuse same local address and port in case of IP address of type TCPIP_MULTICAST. | If the parameter is disabled, binding multiple sockets on the same local address and port will be forbidden for Multicast addresses. Therefore, Udp will allow runtime optimized search in RxIndication where the breaking of the socket searching loop can be done. If multiple Upper Layers are configured above TcpIp, and if more than one UL want to receive the same multicast messages, then this parameter shall be set to true.
        integer TcpIpUdpTtl: 1..255, set at link in variant link-time / post-build in variant post-build / pre-compile in variant pre-compile  # Default Time-to-live value of outgoing UDP packets. | This Time-To-Live value decides how long UDP packet stays alive on network when destination is unreachable.
