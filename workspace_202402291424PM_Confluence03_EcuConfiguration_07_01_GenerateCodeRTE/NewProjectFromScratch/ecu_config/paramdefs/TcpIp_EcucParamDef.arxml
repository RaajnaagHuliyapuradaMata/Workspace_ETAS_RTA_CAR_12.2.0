[part 2 of 2: package /AUTOSAR_TcpIp/EcucModuleDefs]
AUTOSAR XML (schema 00048)
package /AUTOSAR_TcpIp/EcucModuleDefs  (continued)
  module definition TcpIp [0..1]: category=VENDOR_SPECIFIC_MODULE_DEFINITION, post-build-variant-support=true, refined-module-def=TcpIp, variants pre-compile  (continued)
    container TcpIpGeneral  # This container is a subcontainer of TcpIp and specifies the general configuration parameters of the TCP/IP stack.
      integer TcpIpBufferMemory [0..0]: 0..4294967295, set at link in variant link-time+post-build / pre-compile in variant pre-compile  # TcpIpBufferMemory (currently unused) | Memory size in bytes reserved for TCP/IP buffers.
      boolean TcpIpDevErrorDetect: set at pre-compile, default-value=false  # Switches the Default Error Tracer (Det) notification ON or OFF. | * true: detection and notification is enabled. * false: notification is disabled (detection remains active).
      boolean TcpIpDhcpServerEnabled [0..0]: set at pre-compile  # TcpIpDhcpServerEnabled (currently unused) | Enables (TRUE) or disables (FALSE) the DHCP (Dynamic Host Configuration Protocol) Server.
      boolean TcpIpEnableSecurityEventReporting: scope=ECU, set at pre-compile, default-value=false  # Switches the reporting of security events to the IdsM: | - true: reporting is enabled. - false: reporting is disabled.
      boolean TcpIpGetAndResetMeasurementDataApi: set at pre-compile  # Enables / Disables the Get and Reset Measurement Data API
      float TcpIpMainFunctionPeriod: 0..INF, set at link in variant link-time+post-build / pre-compile in variant pre-compile  # Period of TcpIp_MainFunction in [s].
      boolean TcpIpRbExternalDtlsSupport [0..1]: multiplicity set at pre-compile, origin=RB:45.3.4.0:2022-10-14, set at pre-compile, default-value=false  # RB (Vendor06) specific parameter: Enables/disables the support of third party DTLS component in TcpIp. | If this parameter is enabled, the DTLS functionnality of TcpIp and Udp sub module will be enabled. rba_EthDtls interfaces which are called by rba_EthUdp module need to be implemented by integrator in order to interact with the third party DTLS component. In this configuration, the TcpIpDtlsConfig container can be completely removed.
      boolean TcpIpRbExternalTlsSupport [0..1]: multiplicity set at pre-compile, origin=RB:45.1.0.0:2021-06-30, set at pre-compile, default-value=false  # RB (Vendor06) specific parameter: Enables/disables the support of third party TLS component in TcpIp. | If this parameter is enabled, the TLS functionnality of TcpIp and Tcp sub module will be enabled. rba_EthTls interfaces which are called by rba_EthTcp module need to be implemented by integrator in order to interact with the third party TLS component. In this configuration, the TcpIpTlsConfig container can be completely removed.
      boolean TcpIpResetIpAssignmentApi [0..0]: set at pre-compile  # TcpIpResetIpAssignmentApi (currently unused) | Enables/disables the API TcpIp_ResetIpAssignment of a DHCP-client. Currently unused in Implementation
      enumeration TcpIpScalabilityClass: {SC1, SC2, SC3}, set at pre-compile  # In order to customize the TcpIp Stack to the specific needs of the user it can be scaled according to the scalability classes. There are 3 possible scalability classes: SC1 (IPv4 - In-Vehicle and Diagnostic Communication), SC2 (IPv6 - In-Vehicle and Diagnostic Communication) and SC3 (IPv4 and IPv6 (Dual Stack) - In-Vehicle and Diagnostic). | If SC1: TcpIpIpV4General shall be configured, all TcpIpCtrl shall have TcpIpIpV4Ctrl configured and all TcpIpLocalAddr shall have domain type TCPIP_AF_INET If SC2: TcpIpIpV6General shall be configured, all TcpIpCtrl shall have TcpIpIpV6Ctrl configured and all TcpIpLocalAddr shall have domain type TCPIP_AF_INET_6 If SC3: TcpIpIpV4General and TcpIpIpV6General shall be configured
      boolean TcpIpTcpEnabled [0..0]: set at pre-compile  # TcpIpTcpEnabled (currently unused) | Enables (TRUE) or disabled (FALSE) support of TCP (Transmission Control Protocol). This parameter is unused in current implementation because Tcp is implicitly enabled if the maximum number of Tcp sockets configured is greater than 0.
      integer TcpIpTcpSocketMax: 0..65535, set at link in variant link-time+post-build / pre-compile in variant pre-compile  # Maximum number of TCP sockets. Important: If this parameter is set to 0, then all TCP protocol specific configuration will be disabled.
      boolean TcpIpUdpEnabled [0..0]: set at pre-compile  # TcpIpUdpEnabled (currently unused) | Enables (TRUE) or disabled (FALSE) support of UDP (User Datagram Protocol). This parameter is unused in current implementation because Udp is implicitly enabled if the maximum number of Udp sockets configured is greater than 0.
      integer TcpIpUdpSocketMax: 0..65535, set at link in variant link-time+post-build / pre-compile in variant pre-compile  # Maximum number of UDP sockets. Important: If this parameter is set to 0, then all UDP protocol specific configuration will be disabled. | If Udp sockets are configured to 0, then DHCP assignment shall not be configured (DHCP uses Udp) and there shall be no TcpIpLocalAddr configured with TcpIpAssignmentMethod set as TCPIP_DHCP.
      boolean TcpIpVersionInfoApi: set at pre-compile, default-value=false  # If true the TcpIp_GetVersionInfo API is available.
      container TcpIpIpV4General [0..1]: multiplicity set at pre-compile  # This container is a subcontainer of TcpIp and specifies the general configuration parameters of the TCP/IP stack for IPv4. This container is mandatory only when TcpIpScalabilityClass is configured as SC1 or SC3. TcpIpIpV4General must not be configured for Scalability Class 2.
        boolean TcpIpArpEnabled [0..0]: set at pre-compile  # TcpIpArpEnabled (currently unused) | Enables (TRUE) or disables (FALSE) support of ARP (Address Resolution Protocol). This parameter is unused in current implementation because Arp is enabled only if there is any IPv4 unicast communication configured. For multicast and broadcast communication only, Arp is disabled.
        boolean TcpIpAutoIpEnabled [0..0]: set at pre-compile  # TcpIpAutoIpEnabled (currently unused) | Enables (TRUE) or disables (FALSE) the Auto-IP (automatic private IP addressing) sub-module. This is unused in current implementation because the AutoIp module is only enabled if there is at least one local IP address assignment method configured as AutoIp (link-local or link-local DoIp).
        boolean TcpIpDhcpClientEnabled [0..0]: set at pre-compile  # TcpIpDhcpClientEnabled (currently unused) | Enables (TRUE) or disables (FALSE) the DHCP (Dynamic Host Configuration Protocol) Client. This is unused in current implementation because the DHCP client is only enabled if there is at least one local IP address assignment by Dhcp configured.
        boolean TcpIpIcmpEnabled: set at pre-compile  # Enables (TRUE) or disabled (FALSE) support of ICMP (Internet Control Message Protocol).
        boolean TcpIpIcmpMessageFragmentationAllowed [0..1]: multiplicity set at pre-compile, origin=RB:42.8.0.0:2019-12-31, set at pre-compile, default-value=false  # RB (Vendor06) specific parameter: Parameter to allow fragmentation of ICMP messages exceeding MTU size. TRUE allows fragmentation of ICMP messages( messages with length greater than MTU size ), FALSE truncates the ICMP message length to MTU size.
        boolean TcpIpIpV4Enabled [0..0]: set at pre-compile  # TcpIpIpV4Enabled (currently unused) | Enables (TRUE) or disables (FALSE) support of IPv4 (Internet Protocol version 4). Configuration parameter not supported in present implementation, as IPv4 is enabled/disabled automatically based on configured scalability class.
        integer TcpIpLocalAddrIpv4EntriesMax [0..0]: 0..255, set at link in variant link-time+post-build / pre-compile in variant pre-compile  # TcpIpLocalAddrIpv4EntriesMax(currently unused) | Maximum number of LocalAddr table entries for IPv4. This parameter is not required as maximum number of LocalAddr table can be determined by applying size operator on the container TcpIpLocalAddr.
        boolean TcpIpPathMtuDiscoveryEnabled [0..0]: set at pre-compile  # TcpIpPathMtuDiscoveryEnabled (currently unused) | Enables (TRUE) or disables (FALSE) the discovery of the maximum transmission unit on a path according to IETF RfC 1191.
        container TcpIpDHCPGeneral [0..1]: multiplicity set at pre-compile  # RB (Vendor06) specific container: DHCP general configuration parameters
          container TcpIpDHCPClientGeneral  # RB (Vendor06) specific container: General configuration parameters used for the DHCP Client process.
            float TcpIpDHCPTimeToWaitBeforeReTx: 1.0..4.0, origin=RB:42.0.3.0:2018-03-31, set at link in variant link-time+post-build / pre-compile in variant pre-compile, default-value=4  # RB (Vendor06) specific parameter: Parameter for DHCP Client. Time to wait before the retransmission if no response received from a Server. (Time in Seconds).
      container TcpIpIpV6General [0..1]: multiplicity set at pre-compile  # This container is a subcontainer of TcpIp and specifies the general configuration parameters of the TCP/IP stack for IPv6. | This container is mandatory only when TcpIpScalabilityClass is configured as SC2 or SC3. TcpIpIpV6General must not be configured for Scalability Class 1.
        boolean TcpIpDhcpV6ClientEnabled [0..0]: set at pre-compile  # TcpIpDhcpV6ClientEnabled (currently unused) | Enables (TRUE) or disables (FALSE) the DHCPv6 (Dynamic Host Configuration Protocol for IPv6) Client.
        boolean TcpIpIpV6Enabled [0..0]: set at pre-compile  # TcpIpIpV6Enabled (currently unused) | Enables (TRUE) or disables (FALSE) support of IPv6 (Internet Protocol version 6).
        boolean TcpIpIpV6PathMtuDiscoveryEnabled [0..0]: set at pre-compile  # TcpIpIpV6PathMtuDiscoveryEnabled (currently unused) | Enables (TRUE) or disables (FALSE) Path MTU Discovery support for IPv6 according to IETF RFC 1981.
        integer TcpIpLocalAddrIpv6EntriesMax [0..0]: 0..255, set at link in variant link-time+post-build / pre-compile in variant pre-compile  # TcpIpLocalAddrIpv6EntriesMax (currently unused) | Maximum number of LocalAddr table entries for IPv6.
        boolean TcpIpNdpAddressResolutionUnrechabilityDetectionEnabled: set at pre-compile  # Enables (TRUE) or disables (FALSE) support of Address Resolution and Neighbor Unreachability Detection via NDP.
        boolean TcpIpNdpPrefixAndRouterDiscoveryEnabled: set at pre-compile  # Enables (TRUE) or disables (FALSE) support of Prefix and Router Discovery via NDP.
      container TcpIpSecurityEventRefs [0..1]: multiplicity set at pre-compile  # Container for the references to IdsMEvent elements representing the security events that the TcpIp module shall report to the IdsM in case the coresponding security related event occurs (and if TcpIpEnableSecurityEventReporting is set to "true"). The standardized security events in this container can be extended by vendor-specific security events.
        symbolic name reference TCPIP_SEV_ARP_IP_ADDR_CONFLICT [0..1]: multiplicity set at pre-compile, set at pre-compile, destination=IdsMEvent  # Received local IP address in ARP reply for different MAC.
        symbolic name reference TCPIP_SEV_DROP_INV_IPV4_ADDR [0..1]: multiplicity set at pre-compile, set at pre-compile, destination=IdsMEvent  # Dropped datagram because of invalid IPV4 address.
        symbolic name reference TCPIP_SEV_DROP_INV_IPV6_ADDR [0..1]: multiplicity set at pre-compile, set at pre-compile, destination=IdsMEvent  # Dropped datagram because of invalid IPV6 address.
        symbolic name reference TCPIP_SEV_DROP_INV_PORT_TCP [0..1]: multiplicity set at pre-compile, set at pre-compile, destination=IdsMEvent  # Dropped TCP packet because of invalid destination TCP-Port.
        symbolic name reference TCPIP_SEV_DROP_INV_PORT_UDP [0..1]: multiplicity set at pre-compile, set at pre-compile, destination=IdsMEvent  # Dropped UDP packet because of invalid destination UDP-Port.
      container TcpIpZeroCopyGeneral [0..1]: multiplicity set at pre-compile  # RB (Vendor06) specific container: This is a RB specific container introduced in addition to AUTOSAR which specifies the general configuration parameters for ZeroCopy transmission. | This container is mandatory only when TcpIp ZeroCopy is required. When container is disabled, ZeroCopy API will be disabled.
        integer TcpIpZeroCopyDescriptorCount: 1..65535, origin=RB:42.8.0.0:2019-12-31, set at link in variant link-time+post-build / pre-compile in variant pre-compile  # RB (Vendor06) specific parameter: Maximum number of ZeroCopy descriptors. When a ZeroCopy transmission is executed on a socket, a new descriptor will be allocated. The parameter TcpIpZeroCopyDescriptorCount therefore determines the number of sockets that can execute Zero Copy Tx.
        integer TcpIpZeroCopyMaxIpFragmentPerTx [0..1]: 1..255, multiplicity set at pre-compile, origin=RB:42.8.0.0:2019-12-31, set at pre-compile  # RB (Vendor06) specific parameter: Maximum number of IP fragments that can be part of a single ZeroCopy transmission. Relevant only if fragmentation is enabled.
        integer TcpIpZeroCopyMaxMonitoredTxConf: 1..65535, origin=RB:42.8.0.0:2019-12-31, set at link in variant link-time+post-build / pre-compile in variant pre-compile  # RB (Vendor06) specific parameter: Maximum number of ZeroCopy TxConfirmations that can be monitored by TcpIp. Each time TcpIp_ZeroCopyTransmit() API is called with TxConfFlag_b set to TRUE, new TxConf monitoring entry will be used until ZeroCopy TxConfirmation callback is invoked.
        integer TcpIpZeroCopyMaxTxBeforeConfirmation: 1..65535, origin=RB:42.8.0.0:2019-12-31, set at link in variant link-time+post-build / pre-compile in variant pre-compile  # RB (Vendor06) specific parameter: Maximum number of ZeroCopy transmissions that can be executed on a socket connection until ZeroCopyTxConfirmation is received. This parameter influences the number of available ZeroCopy header buffers.
