AUTOSAR XML (schema 00051)
package /ApplicationECU_FlatView/SwComponentTypes
  composition sw component type ApplicationECU_FlatView
    require port RPortPrototype_0: required-interface=My_SR_Interface
    7 x component:
      CPT_MyReceivingSWC_ApplicationEcu: type=MyReceivingSWC
      CPT_MyTransmittingSWC_ApplicationEcu: type=MyTransmittingSWC
      CPT_ComM: type=ComM
      CPT_rba_DiagLib: type=rba_DiagLib
      CPT_BswM: type=BswM
      CPT_EcuM: type=EcuM
      CPT_NvM: type=NvM
    delegate CPT_MyReceivingSWC_ApplicationEcu.RPortPrototype_0 <-> outer port RPortPrototype_0
