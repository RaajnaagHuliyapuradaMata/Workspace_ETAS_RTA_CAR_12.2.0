AUTOSAR XML (schema 00051)
package /ETAS_Project/EcucModuleConfigurationValuess
  module config ComM: implementation-config-variant=VARIANT-PRE-COMPILE
    ComMConfigSet
      Can_Network_Channel_Can_Network (ComMChannel):
        ComMNoCom = true
        ComMFullCommRequestNotificationEnabled = false
        ComMMainFunctionPeriod = 0.01
        ComMBusType = COMM_BUS_TYPE_CAN
        ComMNoWakeUpInhibitionNvmStorage = false
        ComMNoWakeup = true
        ComMNetworkManagement: ComMNmVariant=NONE, ComMNmLightTimeout=10, ComMPncNmRequest=false
        ComMUserPerChannel_Can_Network_Channel_Can_Network (ComMUserPerChannel): ComMUserChannel=ComMUser_Can_Network_Channel_Can_Network
      ComMUser_Can_Network_Channel_Can_Network (ComMUser)
    ComMGeneral:
      ComMResetAfterForcingNoComm = false
      ComMModeLimitationEnabled = false
      ComMPncGatewayEnabled = false
      ComMEcuGroupClassification = 0
      ComMDevErrorDetect = false
      ComMWakeupInhibitionEnabled = false
      ComMPncSupport = false
      ComMTMinFullComModeDuration = 0.01
      ComMVersionInfoApi = false
      ComMRteEnabled = false
      ComMSynchronousWakeUp = false
  module config EcuC: implementation-config-variant=VARIANT-PRE-COMPILE
    EcucConfigSet
      EcucPduCollection: PduIdTypeEnum=uint16, PduLengthTypeEnum=uint16
        4 x Pdu, all with PduLength=8:
          TestECU_TestCode_Tx_CanIf2PduR_Can_Network_Channel_CAN: SysTPduToPduTriggeringRef=PduTrig_TestECU_TestCode_Tx
          TestECU_TestCode_Tx_PduR2Com_Can_Network_Channel_CAN: SysTPduToPduTriggeringRef=PduTrig_TestECU_TestCode_Tx
          ApplicationECU_TestResult_Tx_Com2PduR_Can_Network_Channel_CAN: SysTPduToPduTriggeringRef=PduTrig_ApplicationECU_TestResult_Tx
          ApplicationECU_TestResult_Tx_PduR2CanIf_Can_Network_Channel_CAN: SysTPduToPduTriggeringRef=PduTrig_ApplicationECU_TestResult_Tx
    EcuCRbSettings: EcuCRbRteInUse=true, EcuCRbArRelease=AR45_Rev0
  module config PduR: implementation-config-variant=VARIANT-PRE-COMPILE
    PduRRoutingPaths: PduRConfigurationId=0
      TestECU_TestCode_Tx_CanIf2Com_Can_Network_Channel_CAN (PduRRoutingPath):
        PduRSrcPduRRef = PduRRoutingPaths/TestECU_TestCode_Tx_CanIf2PduR_Can_Network_Channel_CAN
        PduRDestPduRRef = PduRRoutingPaths/TestECU_TestCode_Tx_PduR2Com_Can_Network_Channel_CAN
      TestECU_TestCode_Tx_CanIf2PduR_Can_Network_Channel_CAN (PduRSrcPdu): PduRSrcPduRef=EcucPduCollection/TestECU_TestCode_Tx_CanIf2PduR_Can_Network_Channel_CAN
      TestECU_TestCode_Tx_PduR2Com_Can_Network_Channel_CAN (PduRDestPdu): PduRDestPduRef=EcucPduCollection/TestECU_TestCode_Tx_PduR2Com_Can_Network_Channel_CAN
      ApplicationECU_TestResult_Tx_Com2CanIf_Can_Network_Channel_CAN (PduRRoutingPath):
        PduRSrcPduRRef = PduRRoutingPaths/ApplicationECU_TestResult_Tx_Com2PduR_Can_Network_Channel_CAN
        PduRDestPduRRef = PduRRoutingPaths/ApplicationECU_TestResult_Tx_PduR2CanIf_Can_Network_Channel_CAN
      ApplicationECU_TestResult_Tx_Com2PduR_Can_Network_Channel_CAN (PduRSrcPdu): PduRSrcPduRef=EcucPduCollection/ApplicationECU_TestResult_Tx_Com2PduR_Can_Network_Channel_CAN
      ApplicationECU_TestResult_Tx_PduR2CanIf_Can_Network_Channel_CAN (PduRDestPdu): PduRDestPduRef=EcucPduCollection/ApplicationECU_TestResult_Tx_PduR2CanIf_Can_Network_Channel_CAN
    CanIf (PduRBswModules):
      PduRUpperModule = false
      PduRTriggertransmit = false
      PduRCommunicationInterface = true
      PduRTransportProtocol = false
      PduRCancelTransmit = false
      PduRLowerModule = true
      PduRCancelReceive = false
      PduRTxConfirmation = true
      PduRBswModuleRef = CanIf
    Com (PduRBswModules):
      PduRUpperModule = true
      PduRTriggertransmit = true
      PduRCommunicationInterface = true
      PduRTransportProtocol = true
      PduRCancelTransmit = false
      PduRLowerModule = false
      PduRCancelReceive = false
      PduRTxConfirmation = false
      PduRBswModuleRef = Com
    PduRGeneral:
      PduRRbTPGatewayOperation = false
      PduRRbMulticastFromTpSupport = false
      PduRVersionInfoApi = false
      PduRRbQueueingSupport = false
      PduRZeroCostOperation = false
      PduRDevErrorDetect = false
      PduRRbMulticastToTpSupport = false
      PduRRbIFGatewayOperation = false
      PduRRbMulticastToIfSupport = false
  module config Com: implementation-config-variant=VARIANT-PRE-COMPILE
    ComConfig
      IP_TestECU_TestCode_Tx_Can_Network_Channel_CAN_Rx (ComIPdu):
        ComIPduDirection = RECEIVE
        ComIPduSignalProcessing = IMMEDIATE
        ComIPduType = NORMAL
        ComIPduSignalRef = S_TestECU_SG_TestCode_Tx_Can_Network_Channel_CAN_Rx
        ComIPduGroupRef = ComIPduGroup_Rx
        ComPduIdRef = EcucPduCollection/TestECU_TestCode_Tx_PduR2Com_Can_Network_Channel_CAN
      S_TestECU_SG_TestCode_Tx_Can_Network_Channel_CAN_Rx (ComSignal):
        ComNotification = Rte_COMCbk_S_TestECU_SG_TestCode_Tx_Can_Network_Channel_CAN_Rx
        ComSignalType = SINT8
        ComSignalEndianness = LITTLE_ENDIAN
        ComBitSize = 8
        ComTransferProperty = TRIGGERED
        ComBitPosition = 0
        ComTimeoutNotification = Rte_COMCbkTOut_S_TestECU_SG_TestCode_Tx_Can_Network_Channel_CAN_Rx
        ComSystemTemplateSystemSignalRef = TestECU_SG_TestCode_Tx
      IP_ApplicationECU_TestResult_Tx_Can_Network_Channel_CAN_Tx (ComIPdu):
        ComIPduDirection = SEND
        ComTimeout = 0.1
        ComIPduSignalProcessing = IMMEDIATE
        ComIPduType = NORMAL
        ComFirstTimeout = 0.1
        ComIPduSignalRef = S_ApplicationECU_SG_TestResult_Tx_Can_Network_Channel_CAN_Tx
        ComIPduGroupRef = ComIPduGroup_Tx
        ComPduIdRef = EcucPduCollection/ApplicationECU_TestResult_Tx_Com2PduR_Can_Network_Channel_CAN
        ComTxIPdu: ComTxIPduUnusedAreasDefault=255
          ComTxModeTrue
            ComTxMode: ComTxModeNumberOfRepetitions=0, ComTxModeMode=PERIODIC, ComTxModeTimeOffset=0.0, ComTxModeTimePeriod=0.1, ComTxModeRepetitionPeriod=0
          ComTxModeFalse
            ComTxMode: ComTxModeNumberOfRepetitions=0, ComTxModeMode=PERIODIC, ComTxModeTimeOffset=0.0, ComTxModeTimePeriod=0.1, ComTxModeRepetitionPeriod=0
      S_ApplicationECU_SG_TestResult_Tx_Can_Network_Channel_CAN_Tx (ComSignal):
        ComSignalType = SINT8
        ComSignalEndianness = LITTLE_ENDIAN
        ComBitSize = 8
        ComTransferProperty = TRIGGERED
        ComBitPosition = 0
        ComSystemTemplateSystemSignalRef = ApplicationECU_SG_TestResult_Tx
        ComFilter: ComFilterAlgorithm=NEW_IS_WITHIN, ComFilterMin=0, ComFilterMax=0, ComFilterOffset=0
      ComMainFunctionTx: ComMainTxTimeBase=0.01
      ComIPduGroup_Tx (ComIPduGroup)
      ComMainFunctionRx: ComMainRxTimeBase=0.01
      ComIPduGroup_Rx (ComIPduGroup)
    ComGeneral:
      ComCancellationSupport = false
      ComEnableJitterFilter = false
      ComCommonIPduTxPeriodFeature = false
      ComVersionInfoApi = false
      ComEnableSignalGroupArrayApi = false
      ComConfigurationUseDet = false
  module config Can: implementation-config-variant=VARIANT-PRE-COMPILE
    CanConfigSet
      Can_Network_CANNODE_0 (CanController):
        CanRxProcessing = POLLING
        CanControllerId = 0
        CanWakeupProcessing = POLLING
        CanControllerBaseAddress = 0
        CanTxProcessing = POLLING
        CanBusoffProcessing = POLLING
        CanControllerActivation = true
        CanWakeupSupport = false
        CanCpuClockRef = McuClockReferencePoint
        CanControllerDefaultBaudrate = Can_Network_CANNODE_0_BR_0
        Can_Network_CANNODE_0_BR_0 (CanControllerBaudrateConfig):
          CanControllerBaudRate = 500
          CanControllerBaudRateConfigID = 1
          CanControllerSeg1 = 10
          CanControllerSyncJumpWidth = 0
          CanControllerSeg2 = 0
          CanControllerPropSeg = 0
          CanControllerFdBaudrateConfig:
            CanControllerFdBaudRate = 800
            CanControllerSeg1 = 10
            CanControllerSyncJumpWidth = 0
            CanControllerSeg2 = 0
            CanControllerTxBitRateSwitch = true
            CanControllerPropSeg = 0
      Can_Network_CANNODE_0_Rx_Std_MailBox_1 (CanHardwareObject): CanHandleType=FULL, CanObjectId=0, CanObjectType=RECEIVE, CanHwObjectCount=1, CanIdType=STANDARD, CanControllerRef=CanConfigSet/Can_Network_CANNODE_0
        CanHwFilter: CanHwFilterMask=2047, CanHwFilterCode=20
      Can_Network_CANNODE_0_Tx_Std_MailBox_1 (CanHardwareObject): CanHandleType=FULL, CanObjectId=1, CanObjectType=TRANSMIT, CanHwObjectCount=1, CanIdType=STANDARD, CanControllerRef=CanConfigSet/Can_Network_CANNODE_0
    CanGeneral:
      CanIndex = 0
      CanMultiplexedTransmission = false
      CanMainFunctionModePeriod = 0.001
      CanVersionInfoApi = false
      CanDevErrorDetect = false
      CanMainFunctionBusoffPeriod = 0.001
      CanEnableSecurityEventReporting = false
      CanGlobalTimeSupport = false
      CanTimeoutDuration = 1
  module config CanIf: implementation-config-variant=VARIANT-PRE-COMPILE
    CanIfCtrlDrvCfg:
      CanIfRbCtrlDrvPrefix = CanConf_CanHardwareObject
      CanIfRbForeignDrvSupport = true
      CanIfCtrlDrvNameRef = CanGeneral
      CanIfCtrlDrvInitHohConfigRef = CanIfInitHohCfg
      Can_Network_CANNODE_0 (CanIfCtrlCfg): CanIfCtrlWakeupSupport=false, CanIfCtrlCanCtrlRef=CanConfigSet/Can_Network_CANNODE_0
    CanIfInitCfg: CanIfInitCfgSet=0
      CanIfInitHohCfg
        Can_Network_CANNODE_0_Rx_Std_MailBox_1 (CanIfHrhCfg): CanIfHrhIdSymRef=CanConfigSet/Can_Network_CANNODE_0_Rx_Std_MailBox_1, CanIfHrhCanCtrlIdRef=CanIfCtrlDrvCfg/Can_Network_CANNODE_0
        Can_Network_CANNODE_0_Tx_Std_MailBox_1 (CanIfHthCfg): CanIfHthCanCtrlIdRef=CanIfCtrlDrvCfg/Can_Network_CANNODE_0, CanIfHthIdSymRef=CanConfigSet/Can_Network_CANNODE_0_Tx_Std_MailBox_1
      TestECU_TestCode_Tx_Can_Network_CANNODE_0_IN (CanIfRxPduCfg):
        CanIfRxPduUserRxIndicationUL = PDUR
        CanIfRxPduCanId = 20
        CanIfRxPduDataLength = 8
        CanIfRxPduCanIdType = STANDARD_NO_FD_CAN
        CanIfRxPduReadData = false
        CanIfRxPduReadNotifyStatus = true
        CanIfRxPduUserRxIndicationName = PduR_CanIfRxIndication
        CanIfRxPduRef = EcucPduCollection/TestECU_TestCode_Tx_CanIf2PduR_Can_Network_Channel_CAN
        CanIfRxPduHrhIdRef = CanIfInitHohCfg/Can_Network_CANNODE_0_Rx_Std_MailBox_1
      ApplicationECU_TestResult_Tx_Can_Network_CANNODE_0_OUT (CanIfTxPduCfg):
        CanIfTxPduUserTxConfirmationName = PduR_CanIfTxConfirmation
        CanIfTxPduReadNotifyStatus = false
        CanIfTxPduUserTxConfirmationUL = PDUR
        CanIfTxPduCanIdType = STANDARD_CAN
        CanIfTxPduCanId = 10
        CanIfTxPduTruncation = false
        CanIfTxPduType = STATIC
        CanIfTxPduRef = EcucPduCollection/ApplicationECU_TestResult_Tx_PduR2CanIf_Can_Network_Channel_CAN
        CanIfTxPduBufferRef = Bu_Can_Network_CANNODE_0_Tx_Std_MailBox_1
      Bu_Can_Network_CANNODE_0_Tx_Std_MailBox_1 (CanIfBufferCfg): CanIfBufferSize=0, CanIfBufferHthRef=CanIfInitHohCfg/Can_Network_CANNODE_0_Tx_Std_MailBox_1
    CanIfPublicCfg:
      CanIfPublicWakeupCheckValidSupport = false
      CanIfPublicHandleTypeEnum = UINT8
      CanIfPublicErrorPassiveSupport = false
      CanIfPublicBusoffRecoveryfromRxIndication = false
      CanIfPublicTxBuffering = false
      CanIfPublicReadTxPduNotifyStatusApi = true
      CanIfPublicCanIfLiteConfiguration = false
      CanIfVersionInfoApi = false
      CanIfPublicTxConfirmPollingSupport = false
      CanIfTxOfflineActiveSupport = false
      CanIfPublicCancelTransmitSupport = false
      CanIfPublicReadRxPduNotifyStatusApi = true
      CanIfWakeupSupport = false
      CanIfTriggerTransmitSupport = false
      CanIfPublicSetDynamicTxIdApi = false
      CanIfPublicMultipleDrvSupport = false
      CanIfPublicPnSupport = false
      CanIfPublicReadRxPduDataApi = false
      CanIfDevErrorDetect = false
      CanIfPublicUserTpTxInOfflineMode = false
      CanIfGlobalTimeSupport = false
      CanIfRbCalibrationSupport: CanIfRbCalibration=false
    CanIfDispatchCfg: CanIfDispatchUserTrcvModeIndicationName=CAN_SM, CanIfDispatchUserCtrlBusOffUL=CAN_SM, CanIfDispatchUserCtrlModeIndicationUL=CAN_SM
    CanIfPrivateCfg: CanIfPrivateDataLengthCheck=false
  module config CanSM: implementation-config-variant=VARIANT-PRE-COMPILE
    CanSMConfiguration: CanSMModeRequestRepetitionMax=5, CanSMModeRequestRepetitionTime=0.07
      Can_Network_CANNODE_0 (CanSMManagerNetwork):
        CanSMBorCounterL1ToL2 = 0
        CanSMBorTimeL1 = 0.04
        CanSMBorTimeL2 = 0.1
        CanSMBorTimeTxEnsured = 0.02
        CanSMBorTxConfirmationPolling = false
        CanSMComMNetworkHandleRef = Can_Network_Channel_Can_Network
        Can_Network_CANNODE_0 (CanSMController): CanSMControllerId=CanIfCtrlDrvCfg/Can_Network_CANNODE_0
        CanSMDemEventParameterRefs: CanSMRbDynCreate_CANSM_E_BUS_OFF=Standard
    CanSMGeneral: CanSMMainFunctionTimePeriod=0.01, CanSMDevErrorDetect=false, CanSMVersionInfoApi=false
  module config Mcu: implementation-config-variant=VARIANT-PRE-COMPILE
    McuGeneralConfiguration: McuDevErrorDetect=false, McuInitClock=true, McuGetRamStateApi=false, McuNoPll=true, McuPerformResetApi=true, McuVersionInfoApi=false
    McuPublishedInformation
      McuResetReasonConf: McuResetReason=0
    McuModuleConfiguration: McuNumberOfMcuModes=1, McuRamSectors=0, McuResetSetting=1, McuClockSrcFailureNotification=DISABLED
      McuClockSettingConfig: McuClockSettingId=1
        McuClockReferencePoint: McuClockReferencePointFrequency=0.0
      McuModeSettingConf: McuMode=1
  module config NvM: implementation-config-variant=VARIANT-PRE-COMPILE
    NvMCommon:
      NvMRbMainFunctionScheduling = NVM_RB_MAINFUNC_SCHEDULING_RTE_TIMED
      NvMJobPrioritization = false
      NvMSizeStandardJobQueue = 1
      NvMBswMMultiBlockJobStatusInformation = true
      NvMDevErrorDetect = false
      NvMDynamicConfiguration = false
      NvMCrcNumOfBytes = 1
      NvMDrvModeSwitch = false
      NvMMainFunctionPeriod = 0.001
      NvMMultiBlockCallback = NULL_PTR
      NvMVersionInfoApi = false
      NvMSetRamBlockStatusApi = true
      NvMRbSetWriteAllTriggerApi = false
      NvMPollingMode = true
      NvMCompiledConfigId = 2
      NvMApiConfigClass = NVM_API_CONFIG_CLASS_3
    4 x NvMBlockDescriptor, all with NvMStaticBlockIDCheck=false, NvMWriteVerification=false, NvMMaxNumOfReadRetries=0, NvMBlockUseSyncMechanism=false, NvMBlockWriteProt=false, NvMNvBlockNum=1, NvMCalcRamBlockCrc=false, NvMBlockManagementType=NVM_BLOCK_NATIVE, NvMWriteBlockOnce=false, NvMRomBlockNum=0, NvMBlockJobPriority=1, NvMResistantToChangedSw=false, NvMMaxNumOfWriteRetries=0, NvMNvramDeviceId=0, NvMWriteVerificationDataSize=0:
      NvM_MultiBlock: NvMBlockUseCrc=true, NvMBlockCrcType=NVM_CRC16, NvMNvBlockLength=1
      NvM_ConfigId: NvMSelectBlockForReadAll=true, NvMBlockUseCrc=true, NvMBlockCrcType=NVM_CRC16, NvMNvBlockLength=2, NvMRamBlockDataAddress=NvM_Prv_idConfigStored_u16, NvMSelectBlockForWriteAll=true
      NvM_NativeBlock_2: NvMRbSelectBlockForFirstInitAll=false, NvMBlockUseAutoValidation=false, NvMSelectBlockForReadAll=true, NvMBlockUsePort=true, NvMBlockCrcType=NVM_CRC32, NvMBlockUseCrc=false, NvMNvBlockLength=0, NvMRamBlockDataAddress=Rte_CPim_MyReceivingSWC_PIM_01, NvMSelectBlockForWriteAll=true
      NvM_NativeBlock_3: NvMRbSelectBlockForFirstInitAll=false, NvMBlockUseAutoValidation=false, NvMSelectBlockForReadAll=true, NvMBlockUsePort=true, NvMBlockCrcType=NVM_CRC32, NvMBlockUseCrc=false, NvMNvBlockLength=0, NvMRamBlockDataAddress=Rte_CPim_MyReceivingSWC_PIM_02, NvMSelectBlockForWriteAll=true
  module config MemIf: implementation-config-variant=VARIANT-PRE-COMPILE
    MemIfGeneral: MemIfVersionInfoApi=false, MemIfDevErrorDetect=false
  module config rba_MemLib: implementation-config-variant=PRECONFIGURED-CONFIGURATION
    rba_MemLibCentral: rba_MemLibCentralEnablePrototype=false, rba_MemLibVersionInfoApi=false
  module config Fee: implementation-config-variant=VARIANT-PRE-COMPILE
    FeeGeneral:
      FeeRbFsSelect = FS1X
      FeeVirtualPageSize = 8
      FeeSetModeSupported = false
      FeeDevErrorDetect = false
      FeeRbMachineType = FEE_RB_FULL_MANUAL_CFG
      FeeVersionInfoApi = false
      FeeRbInclPrjHeader = true
      FeePollingMode = true
      FeeRbConfirmSingleStorageBlockloss = true
    FeeRbDevice:
      FeeRbDeviceFsXFlsMachineType = MCU_RB_EVE_AUTOSAR
      FeeRbDeviceFs1xNoFallbackSuprtd = true
      FeeRbDeviceFsXPatErased = 0
      FeeRbDeviceFsXFlsDeviceType = RBA_FLSPC_DFLASH
      FeeRbDeviceFs1xDirectMemAccess = false
      FeeRbDeviceFsXPhySectorSize = 1024
      FeeRbDeviceFs1xHdrRecheck = false
      FeeRbDeviceFsXEraseCycles = 125000
      FeeRbDeviceFsXSectorSize = 1024
      FeeRbDeviceFsXPageSize = 8
      FeeRbDeviceFsXSectorList
        FeeRbDeviceSector_0 (FeeRbDeviceFsXSectorDesc): FeeRbDeviceFsXSectorStrtAddr=0
        FeeRbDeviceSector_1 (FeeRbDeviceFsXSectorDesc): FeeRbDeviceFsXSectorStrtAddr=1024
    FeePublishedInformation
