AUTOSAR XML (schema 4-2-2)
package /RB/UBK/Project/EcucModuleConfigurationValuess
  module config Compiler
    CompilerRbSettings_0 (CompilerRbSettings):
      CompilerRbArRelease = AR42_Rev2
      CompilerRbCompilerAbstraction = DEACTIVATE
      CompilerRbInlineDefinition = __attribute__((always_inline)) inline
      CompilerRbLocalInlineDefinition = __attribute__((always_inline)) static inline
