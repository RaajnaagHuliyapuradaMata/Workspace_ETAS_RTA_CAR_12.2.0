AUTOSAR XML (schema 4-2-2)
package /AUTOSAR_Fls/BswModuleEntrys
  bsw module entry Fls_MainFunction: service-id=1, is-reentrant=false, is-synchronous=true, call-type=SCHEDULED, execution-context=TASK, sw-service-impl-policy=STANDARD
