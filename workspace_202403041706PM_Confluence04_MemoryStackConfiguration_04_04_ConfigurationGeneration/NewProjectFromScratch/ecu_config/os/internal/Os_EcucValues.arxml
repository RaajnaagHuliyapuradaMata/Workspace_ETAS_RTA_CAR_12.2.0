AUTOSAR XML (schema 00051)
package /OS
  module config Os
    OSDEFAULTAPPMODE (OsAppMode)
    OsOS: OsStackMonitoring=false, OsUseGetServiceId=true, OsUseParameterAccess=true, OsUseResScheduler=true, OsStatus=STANDARD, OsScalabilityClass=SC1
      OsHooks: OsErrorHook=true, OsPostTaskHook=false, OsPreTaskHook=false, OsProtectionHook=false, OsShutdownHook=true, OsStackFaultHook=false, OsStartupHook=true
    OsRTATarget: OsRTATargetName=VRTA, OsRTATargetVariant=MinGW
    3 x OsTask, all with OsTaskActivation=1, OsTaskSchedule=FULL:
      OsTask_ASW: OsTaskPriority=1
      OsTask_BSW: OsTaskPriority=2
      OsTaskAutoStart: OsTaskPriority=3
        OsTaskAutostart: OsTaskAppModeRef=OSDEFAULTAPPMODE
