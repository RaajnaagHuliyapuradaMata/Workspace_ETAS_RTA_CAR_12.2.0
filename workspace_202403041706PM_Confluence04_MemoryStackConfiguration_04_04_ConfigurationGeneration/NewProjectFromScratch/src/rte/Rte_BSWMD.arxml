AUTOSAR XML (schema 00051)
standard types defined: uint8
package /AUTOSAR_Rte/BswModuleDescriptions
  bsw module description Rte: outgoing-callbacks=[Rte_StartHook_Return, Rte_StartHook_Start, Rte_StopHook_Return, Rte_StopHook_Start, Rte_Task_Activate]
    provided-entrys:
      Rte_ActivateRE
      Rte_DecrementWaitingCount
      Rte_GetCurrentTaskIndex
      Rte_MainFunction
      Rte_Mode_BswM_RP_BswM_MRP_SwcModeRequest_MDGP_MSI_ShutDown
      Rte_ReadQueue
      Rte_SetEvent
      Rte_Start
      Rte_Stop
      Rte_WaitWithTimeout
      Rte_WriteQueue
      Rte_WriteQueue_GetProtection
      Rte_WriteQueue_ReleaseProtection
      Rte_Write_CPT_MyTransmittingSWC_ApplicationEcu_PPortPrototype_0_DE_MyDataElement
      Rte_memcpy
      SchM_Deinit
      SchM_IModeInit
      SchM_Init
      SchM_Mode_BswM_MDGR_BswM_MRP_BswM_MDG
    bsw module dependency AUTOSAR_Os: target-module-id=1
    bsw module dependency AUTOSAR_Com: target-module-id=50
    bsw internal behavior RteInternalBehavior
      constant-memorys:
        13 x parameter data prototype:
          Rte_Inst_BswM: type=Rte_CDS_BswM
          Rte_Inst_ComM: type=Rte_CDS_ComM
          Rte_Inst_EcuM: type=Rte_CDS_EcuM
          Rte_Inst_rba_DiagLib: type=Rte_CDS_rba_DiagLib
          Rte_Instance_CPT_MyReceivingSWC_ApplicationEcu: type=Rte_CDS_MyReceivingSWC
          Rte_Instance_CPT_MyTransmittingSWC_ApplicationEcu: type=Rte_CDS_MyTransmittingSWC
          Rte_Self_CPT_ComM: type=Rte_SelfType_ComM
          Rte_Self_CPT_MyReceivingSWC_ApplicationEcu: type=Rte_SelfType_MyReceivingSWC
          Rte_Self_CPT_MyTransmittingSWC_ApplicationEcu: type=Rte_SelfType_MyTransmittingSWC
          Rte_Self_SWCI3: type=Rte_SelfType_rba_DiagLib
          Rte_Self_SWCI4: type=Rte_SelfType_BswM
          Rte_Self_SWCI5: type=Rte_SelfType_EcuM
          Rte_Tasks: type=Rte_TaskInfo
      static-memorys:
        8 x data:
          Rte_ImplicitBufs: type=Rte_ImplicitBufsType
          Rte_ModeCurrent_{0..2}: type=uint8
          Rte_ModeNext_2: type=uint8
          Rte_ModeSchMNext_1: type=uint8
          Rte_RECount_OsTask_BSW_divby10_0: type=uint8
          Rte_Rx_000000: type=uint8
      19 x bsw called entity, all with sw-addr-method=CODE:
        Rte_ActivateRE: implemented-entry=Rte_ActivateRE
        Rte_DecrementWaitingCount: implemented-entry=Rte_DecrementWaitingCount
        Rte_GetCurrentTaskIndex: implemented-entry=Rte_GetCurrentTaskIndex
        Rte_MainFunction: implemented-entry=Rte_MainFunction
        Rte_Mode_BswM_RP_BswM_MRP_SwcModeRequest_MDGP_MSI_ShutDown: implemented-entry=Rte_Mode_BswM_RP_BswM_MRP_SwcModeRequest_MDGP_MSI_ShutDown
        Rte_ReadQueue: implemented-entry=Rte_ReadQueue
        Rte_SetEvent: implemented-entry=Rte_SetEvent
        Rte_Start: implemented-entry=Rte_Start
        Rte_Stop: implemented-entry=Rte_Stop
        Rte_WaitWithTimeout: implemented-entry=Rte_WaitWithTimeout
        Rte_WriteQueue: implemented-entry=Rte_WriteQueue
        Rte_WriteQueue_GetProtection: implemented-entry=Rte_WriteQueue_GetProtection
        Rte_WriteQueue_ReleaseProtection: implemented-entry=Rte_WriteQueue_ReleaseProtection
        Rte_Write_CPT_MyTransmittingSWC_ApplicationEcu_PPortPrototype_0_DE_MyDataElement: implemented-entry=Rte_Write_CPT_MyTransmittingSWC_ApplicationEcu_PPortPrototype_0_DE_MyDataElement
        Rte_memcpy: implemented-entry=Rte_memcpy
        SchM_Deinit: implemented-entry=SchM_Deinit
        SchM_IModeInit: implemented-entry=SchM_IModeInit
        SchM_Init: implemented-entry=SchM_Init
        SchM_Mode_BswM_MDGR_BswM_MRP_BswM_MDG: implemented-entry=SchM_Mode_BswM_MDGR_BswM_MRP_BswM_MDG
package /AUTOSAR_Rte/BswModuleEntrys
  24 x bsw module entry:
    Rte_ActivateRE: call-type=REGULAR
    Rte_DecrementWaitingCount: call-type=REGULAR
    Rte_GetCurrentTaskIndex: call-type=REGULAR
    Rte_MainFunction: call-type=REGULAR
    Rte_Mode_BswM_RP_BswM_MRP_SwcModeRequest_MDGP_MSI_ShutDown: call-type=REGULAR
    Rte_ReadQueue: call-type=REGULAR
    Rte_SetEvent: call-type=REGULAR
    Rte_Start: call-type=REGULAR
    Rte_StartHook_Return: call-type=CALLBACK
    Rte_StartHook_Start: call-type=CALLBACK
    Rte_Stop: call-type=REGULAR
    Rte_StopHook_Return: call-type=CALLBACK
    Rte_StopHook_Start: call-type=CALLBACK
    Rte_Task_Activate: call-type=CALLBACK
    Rte_WaitWithTimeout: call-type=REGULAR
    Rte_WriteQueue: call-type=REGULAR
    Rte_WriteQueue_GetProtection: call-type=REGULAR
    Rte_WriteQueue_ReleaseProtection: call-type=REGULAR
    Rte_Write_CPT_MyTransmittingSWC_ApplicationEcu_PPortPrototype_0_DE_MyDataElement: call-type=REGULAR
    Rte_memcpy: call-type=REGULAR
    SchM_Deinit: call-type=REGULAR
    SchM_IModeInit: call-type=REGULAR
    SchM_Init: call-type=REGULAR
    SchM_Mode_BswM_MDGR_BswM_MRP_BswM_MDG: call-type=REGULAR
package /AUTOSAR_Rte/BswImplementations
  bsw implementation Rte: programming-language=C, sw-version=0.0.0, used-code-generator=ETAS RTEGen, vendor-id=11, ar-release-version=4.0.0, behavior=RteInternalBehavior
    generated-artifacts:
      48 x dependency on artifact:
        BswM_MemMap_h: artifact-descriptor={short-label=BswM_MemMap_h, category=SWHDR, domain=AUTOSAR}
        Com_h: artifact-descriptor={short-label=Com_h, category=SWHDR, domain=AUTOSAR}
        ComM_MemMap_h: artifact-descriptor={short-label=ComM_MemMap_h, category=SWHDR, domain=AUTOSAR}
        EcuM_MemMap_h: artifact-descriptor={short-label=EcuM_MemMap_h, category=SWHDR, domain=AUTOSAR}
        Ioc_h: artifact-descriptor={short-label=Ioc_h, category=SWHDR, domain=AUTOSAR}
        MyReceivingSWC_MemMap_h: artifact-descriptor={short-label=MyReceivingSWC_MemMap_h, category=SWHDR, domain=AUTOSAR}
        MyTransmittingSWC_MemMap_h: artifact-descriptor={short-label=MyTransmittingSWC_MemMap_h, category=SWHDR, domain=AUTOSAR}
        NvM_h: artifact-descriptor={short-label=NvM_h, category=SWHDR, domain=AUTOSAR}
        Os_h: artifact-descriptor={short-label=Os_h, category=SWHDR, domain=AUTOSAR}
        OsTask_ASW_h: artifact-descriptor={short-label=OsTask_ASW_h, category=SWHDR, domain=AUTOSAR}
        OsTask_BSW_h: artifact-descriptor={short-label=OsTask_BSW_h, category=SWHDR, domain=AUTOSAR}
        Rte_c: artifact-descriptor={short-label=Rte_c, category=SWSRC, domain=AUTOSAR}
        Rte_h: artifact-descriptor={short-label=Rte_h, category=SWHDR, domain=AUTOSAR}
        Rte_BswM_h: artifact-descriptor={short-label=Rte_BswM_h, category=SWHDR, domain=AUTOSAR}
        Rte_BswM_Type_h: artifact-descriptor={short-label=Rte_BswM_Type_h, category=SWHDR, domain=AUTOSAR}
        Rte_Cbk_h: artifact-descriptor={short-label=Rte_Cbk_h, category=SWHDR, domain=AUTOSAR}
        Rte_Cfg_h: artifact-descriptor={short-label=Rte_Cfg_h, category=SWHDR, domain=AUTOSAR}
        Rte_ComM_h: artifact-descriptor={short-label=Rte_ComM_h, category=SWHDR, domain=AUTOSAR}
        Rte_ComM_Type_h: artifact-descriptor={short-label=Rte_ComM_Type_h, category=SWHDR, domain=AUTOSAR}
        Rte_Const_h: artifact-descriptor={short-label=Rte_Const_h, category=SWHDR, domain=AUTOSAR}
        Rte_DataHandleType_h: artifact-descriptor={short-label=Rte_DataHandleType_h, category=SWHDR, domain=AUTOSAR}
        Rte_EcuM_h: artifact-descriptor={short-label=Rte_EcuM_h, category=SWHDR, domain=AUTOSAR}
        Rte_EcuM_Type_h: artifact-descriptor={short-label=Rte_EcuM_Type_h, category=SWHDR, domain=AUTOSAR}
        Rte_Hook_h: artifact-descriptor={short-label=Rte_Hook_h, category=SWHDR, domain=AUTOSAR}
        Rte_Intl_h: artifact-descriptor={short-label=Rte_Intl_h, category=SWHDR, domain=AUTOSAR}
        Rte_Lib_c: artifact-descriptor={short-label=Rte_Lib_c, category=SWSRC, domain=AUTOSAR}
        Rte_Main_h: artifact-descriptor={short-label=Rte_Main_h, category=SWHDR, domain=AUTOSAR}
        Rte_MemMap_h: artifact-descriptor={short-label=Rte_MemMap_h, category=SWHDR, domain=AUTOSAR}
        Rte_MyReceivingSWC_h: artifact-descriptor={short-label=Rte_MyReceivingSWC_h, category=SWHDR, domain=AUTOSAR}
        Rte_MyReceivingSWC_Type_h: artifact-descriptor={short-label=Rte_MyReceivingSWC_Type_h, category=SWHDR, domain=AUTOSAR}
        Rte_MyTransmittingSWC_h: artifact-descriptor={short-label=Rte_MyTransmittingSWC_h, category=SWHDR, domain=AUTOSAR}
        Rte_MyTransmittingSWC_Type_h: artifact-descriptor={short-label=Rte_MyTransmittingSWC_Type_h, category=SWHDR, domain=AUTOSAR}
        Rte_Type_h: artifact-descriptor={short-label=Rte_Type_h, category=SWHDR, domain=AUTOSAR}
        Rte_rba_DiagLib_h: artifact-descriptor={short-label=Rte_rba_DiagLib_h, category=SWHDR, domain=AUTOSAR}
        Rte_rba_DiagLib_Type_h: artifact-descriptor={short-label=Rte_rba_DiagLib_Type_h, category=SWHDR, domain=AUTOSAR}
        SchM_BswM_h: artifact-descriptor={short-label=SchM_BswM_h, category=SWHDR, domain=AUTOSAR}
        SchM_BswM_Type_h: artifact-descriptor={short-label=SchM_BswM_Type_h, category=SWHDR, domain=AUTOSAR}
        SchM_Can_h: artifact-descriptor={short-label=SchM_Can_h, category=SWHDR, domain=AUTOSAR}
        SchM_CanSM_h: artifact-descriptor={short-label=SchM_CanSM_h, category=SWHDR, domain=AUTOSAR}
        SchM_CanSM_Type_h: artifact-descriptor={short-label=SchM_CanSM_Type_h, category=SWHDR, domain=AUTOSAR}
        SchM_Can_Type_h: artifact-descriptor={short-label=SchM_Can_Type_h, category=SWHDR, domain=AUTOSAR}
        SchM_Com_h: artifact-descriptor={short-label=SchM_Com_h, category=SWHDR, domain=AUTOSAR}
        SchM_ComM_h: artifact-descriptor={short-label=SchM_ComM_h, category=SWHDR, domain=AUTOSAR}
        SchM_ComM_Type_h: artifact-descriptor={short-label=SchM_ComM_Type_h, category=SWHDR, domain=AUTOSAR}
        SchM_Com_Type_h: artifact-descriptor={short-label=SchM_Com_Type_h, category=SWHDR, domain=AUTOSAR}
        SchM_EcuM_h: artifact-descriptor={short-label=SchM_EcuM_h, category=SWHDR, domain=AUTOSAR}
        SchM_EcuM_Type_h: artifact-descriptor={short-label=SchM_EcuM_Type_h, category=SWHDR, domain=AUTOSAR}
        rba_DiagLib_MemMap_h: artifact-descriptor={short-label=rba_DiagLib_MemMap_h, category=SWHDR, domain=AUTOSAR}
    resource consumption ResConsumption
      15 x memory section:
        RTE_BSWM_CODE: executable-entity=[Rte_Mode_BswM_RP_BswM_MRP_SwcModeRequest_MDGP_MSI_ShutDown, SchM_Mode_BswM_MDGR_BswM_MRP_BswM_MDG], prefix=RTE_BSWM, sw-addrmethod=CODE, symbol=CODE
        RTE_EXT_CODE: executable-entity=[Rte_ActivateRE, Rte_SetEvent, Rte_WriteQueue, Rte_WriteQueue_GetProtection, Rte_WriteQueue_ReleaseProtection], prefix=RTE_EXT, sw-addrmethod=CODE, symbol=CODE
        RTE_LIB_CODE: executable-entity=[Rte_GetCurrentTaskIndex, Rte_memcpy], prefix=RTE_LIB, sw-addrmethod=CODE, symbol=CODE
        RTE_MAIN_CODE: executable-entity=[Rte_MainFunction, Rte_Start, Rte_Stop, SchM_Deinit, SchM_Init], prefix=RTE_MAIN, sw-addrmethod=CODE, symbol=CODE
        RTE_MYTRANSMITTINGSWC_CODE: executable-entity=Rte_Write_CPT_MyTransmittingSWC_ApplicationEcu_PPortPrototype_0_DE_MyDataElement, prefix=RTE_MYTRANSMITTINGSWC, sw-addrmethod=CODE, symbol=CODE
        RTE_SIG_S_APPLICATIONECU_SG_TESTRESULT_TX_CAN_NETWORK_CHANNEL_CAN_TX_CODE: executable-entity=Rte_COMCbk_S_ApplicationECU_SG_TestResult_Tx_Can_Network_Channel_CAN_Tx, prefix=RTE_SIG_S_APPLICATIONECU_SG_TESTRESULT_TX_CAN_NETWORK_CHANNEL_CAN_TX, sw-addrmethod=CODE, symbol=CODE
        RTE_SIG_S_TESTECU_SG_TESTCODE_TX_CAN_NETWORK_CHANNEL_CAN_RX_CODE: executable-entity=Rte_COMCbk_S_TestECU_SG_TestCode_Tx_Can_Network_Channel_CAN_Rx, prefix=RTE_SIG_S_TESTECU_SG_TESTCODE_TX_CAN_NETWORK_CHANNEL_CAN_RX, sw-addrmethod=CODE, symbol=CODE
        RTE_SYS_CODE: executable-entity=[Rte_DecrementWaitingCount, Rte_ReadQueue, Rte_WaitWithTimeout, SchM_IModeInit], prefix=RTE_SYS, sw-addrmethod=CODE, symbol=CODE
        CONST_UNSPECIFIED: alignment=UNSPECIFIED, sw-addrmethod=CONST
        VAR_CLEARED_16: alignment=16, sw-addrmethod=VAR_CLEARED
        RTE_SYS_VAR_CLEARED_32: alignment=32, prefix=RTE_SYS, sw-addrmethod=VAR_CLEARED, symbol=VAR_CLEARED_32
        VAR_CLEARED_8: alignment=8, sw-addrmethod=VAR_CLEARED
        RTE_OSTASK_BSW_VAR_CLEARED_8: alignment=8, prefix=RTE_OSTASK_BSW, sw-addrmethod=VAR_CLEARED, symbol=VAR_CLEARED_8
        VAR_CLEARED_BOOLEAN: alignment=BOOLEAN, sw-addrmethod=VAR_CLEARED
        VAR_INIT_8: alignment=8, sw-addrmethod=VAR_INIT
      9 x section name prefix:
        RTE_BSWM
        RTE_EXT
        RTE_LIB
        RTE_MAIN
        RTE_MYTRANSMITTINGSWC
        RTE_OSTASK_BSW
        RTE_SIG_S_APPLICATIONECU_SG_TESTRESULT_TX_CAN_NETWORK_CHANNEL_CAN_TX
        RTE_SIG_S_TESTECU_SG_TESTCODE_TX_CAN_NETWORK_CHANNEL_CAN_RX
        RTE_SYS
package /AUTOSAR_Rte/ImplementationDataTypes
  22 x impl type:
    Rte_DE_uint8: category=STRUCTURE
      element value: implementation-data-type=uint8
    Rte_TDB_OsTask_ASW: category=STRUCTURE
      element rbuf0: implementation-data-type=Rte_DE_uint8
    Rte_ISA_1: category=UNION
      element Rte_OsTask_ASW: implementation-data-type=Rte_TDB_OsTask_ASW
    Rte_ImplicitBufsType: category=STRUCTURE
      element isa_1: implementation-data-type=Rte_ISA_1
    Rte_CDS_BswM: category=STRUCTURE
      element Rte_Dummy: implementation-data-type=uint8
    Rte_CDS_ComM: category=STRUCTURE
      element Rte_Dummy: implementation-data-type=uint8
    Rte_CDS_EcuM: category=STRUCTURE
      element Rte_Dummy: implementation-data-type=uint8
    Rte_CDS_rba_DiagLib: category=STRUCTURE
      element Rte_Dummy: implementation-data-type=uint8
    Rte_PDS_MyReceivingSWC_My_SR_Interface_R: category=STRUCTURE
      element Rte_Dummy: implementation-data-type=uint8
    Rte_PDS_MyReceivingSWC_My_SR_Interface_RA: category=ARRAY
      element Rte_PDS_MyReceivingSWC_My_SR_Interface_RAElement: array-size=1, array-size-semantics=FIXED-SIZE, implementation-data-type=Rte_PDS_MyReceivingSWC_My_SR_Interface_R
    Rte_CDS_MyReceivingSWC: category=STRUCTURE
      element RE_Rx_RPortPrototype_0_DE_MyDataElement: implementation-data-type=Rte_DE_uint8
      element RPortPrototype_0: implementation-data-type=Rte_PDS_MyReceivingSWC_My_SR_Interface_RA
    Rte_WriteFP_MyTransmittingSWC_My_SR_Interface_DE_MyDataElement: category=FUNCTION_REFERENCE
    Rte_PDS_MyTransmittingSWC_My_SR_Interface_P: category=STRUCTURE
      element Write_DE_MyDataElement: implementation-data-type=Rte_WriteFP_MyTransmittingSWC_My_SR_Interface_DE_MyDataElement
    Rte_PDS_MyTransmittingSWC_My_SR_Interface_PA: category=ARRAY
      element Rte_PDS_MyTransmittingSWC_My_SR_Interface_PAElement: array-size=1, array-size-semantics=FIXED-SIZE, implementation-data-type=Rte_PDS_MyTransmittingSWC_My_SR_Interface_P
    Rte_CDS_MyTransmittingSWC: category=STRUCTURE
      element PPortPrototype_0: implementation-data-type=Rte_PDS_MyTransmittingSWC_My_SR_Interface_PA
    Rte_SelfType_ComM: implementation-data-type=Rte_CDS_ComM
    Rte_SelfType_MyReceivingSWC: implementation-data-type=Rte_CDS_MyReceivingSWC
    Rte_SelfType_MyTransmittingSWC: implementation-data-type=Rte_CDS_MyTransmittingSWC
    Rte_SelfType_rba_DiagLib: implementation-data-type=Rte_CDS_rba_DiagLib
    Rte_SelfType_BswM: implementation-data-type=Rte_CDS_BswM
    Rte_SelfType_EcuM: implementation-data-type=Rte_CDS_EcuM
    Rte_TaskInfo: category=VALUE  # This is an external type, i.e. it is declared in the Rte Library and not in the XML. RTEGen does not have any information about this type apart from its name.
package /AUTOSAR_Rte/SwAddrMethods
  6 x sw addr method:
    CODE: memory-allocation-keyword-policy=ADDR-METHOD-SHORT-NAME, section-type=CODE
    CODE_OSTASK_ASW: memory-allocation-keyword-policy=ADDR-METHOD-SHORT-NAME, section-type=CODE
    CODE_OSTASK_BSW: memory-allocation-keyword-policy=ADDR-METHOD-SHORT-NAME, section-type=CODE
    CONST: memory-allocation-keyword-policy=ADDR-METHOD-SHORT-NAME-AND-ALIGNMENT, section-type=CONST
    VAR_CLEARED: memory-allocation-keyword-policy=ADDR-METHOD-SHORT-NAME-AND-ALIGNMENT, section-initialization-policy=CLEARED, section-type=VAR
    VAR_INIT: memory-allocation-keyword-policy=ADDR-METHOD-SHORT-NAME-AND-ALIGNMENT, section-initialization-policy=INIT, section-type=VAR
package /AUTOSAR_Rte/SwBaseTypes
  base type AUTOSAR_Platform_BaseTypes_uint8: category=FIXED_LENGTH, base-type-size=8, base-type-encoding=NONE, mem-alignment=8, native-declaration=uint8  # unsigned integer 8bit | This standard AUTOSAR type shall be of 8 bit unsigned.
