AUTOSAR XML (schema 4-2-2)
package /MSI_ShutDown
  mode switch interface MSI_ShutDown: is-service=true
    mode group MDGP_MSI_ShutDown: type=MDG_ShutDown
  data type mapping set MG_Shutdown_Mapping: mode-request-type-map{implementation-data-type=uint8, mode-group=MDG_ShutDown}
package /MSI_ShutDown/MDG
  mode declaration group MDG_ShutDown: category=EXPLICIT_ORDER, initial-mode=RUN
    mode SHUT_DOWN: category=EXPLICIT_ORDER, value=0
    mode RUN: category=EXPLICIT_ORDER, value=1
package /System
  mode declaration group Mdg2: initial-mode=Mode1
    mode Mode1
