AUTOSAR XML (schema 00051)
package /Composition
  composition sw component type TopLevelComposition
    5 x component:
      CPT_MyTransmittingSWC_ApplicationEcu: type=MyTransmittingSWC
      CPT_MyReceivingSWC_ApplicationEcu: type=MyReceivingSWC
      CPT_MyTransmittingSWC_TestEcu: type=MyTransmittingSWC
      CPT_MyReceivingSWC_TestEcu: type=MyReceivingSWC
      CPT_ComM: type=ComM
    connect CPT_MyTransmittingSWC_ApplicationEcu.PPortPrototype_0 -> CPT_MyReceivingSWC_TestEcu.RPortPrototype_0
    connect CPT_MyTransmittingSWC_TestEcu.PPortPrototype_0 -> CPT_MyReceivingSWC_ApplicationEcu.RPortPrototype_0
