VERSION ""

BU_: ApplicationECU TestECU

BO_ 10 ApplicationECU_TestResult_Tx: 8 ApplicationECU
 SG_ ApplicationECU_SG_TestResult_Tx : 0|8@1- (1,0) [0|0] ""  TestECU

BO_ 20 TestECU_TestCode_Tx: 8 TestECU
 SG_ TestECU_SG_TestCode_Tx : 0|8@1- (1,0) [0|0] ""  ApplicationECU

BA_DEF_  "BusType" STRING ;
BA_DEF_ BO_  "VFrameFormat" ENUM  "StandardCAN","ExtendedCAN","StandardCAN_FD","ExtendedCAN_FD";
BA_DEF_  "SamplePointMax" FLOAT 0 100;
BA_DEF_DEF_  "BusType" "CAN";
BA_DEF_DEF_  "VFrameFormat" "StandardCAN";
BA_ "BusType" "CAN FD";
BA_ "SamplePointMax" 81.4;
