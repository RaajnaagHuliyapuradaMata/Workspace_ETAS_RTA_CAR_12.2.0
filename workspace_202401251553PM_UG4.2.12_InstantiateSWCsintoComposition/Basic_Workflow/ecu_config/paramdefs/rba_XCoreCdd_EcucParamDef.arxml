AUTOSAR XML (schema 4-2-2)
package /RB/RBA/rba_XCoreCdd/EcucModuleDefs
  module definition rba_XCoreCdd [0..1]: category=VENDOR_SPECIFIC_MODULE_DEFINITION, variants pre-compile  # Module to define XCoreCdd relevant configuration parameters
    container rba_XCoreCddGeneral: multiplicity set at pre-compile  # General | Configuration of rba_XCoreCdd relevant code generation parameters
      boolean rba_XCoreCddDebug [0..1]: multiplicity set at pre-compile, origin=RB:3.0.0:2017-05-30, set at pre-compile, default-value=false  # Debug | DEBUG_INSTRUMENTATION_ACTIVE ON or OFF.
      boolean rba_XCoreCddDebugMeasurement [0..1]: multiplicity set at pre-compile, origin=RB:3.0.0:2017-05-30, set at pre-compile, default-value=false  # Debug Measurement | DEBUG_TIMING_MEASUREMENT_ACTIVE ON or OFF.
      boolean rba_XCoreCddDevErrorDetect [0..1]: multiplicity set at pre-compile, origin=RB:3.0.0:2017-05-30, set at pre-compile, default-value=false  # Development Error Detection | Enables/disables the detection and notification of development errors. If this parameter is enabled, then extended error checking is performed during runtime; any errors detected by these checks are reported to the Dem module. This feature should be switched off in series software.
    container rba_XCoreCddPipe [0..*]: multiplicity set at pre-compile  # Pipe | Configuration of rba_XCoreCdd relevant code generation parameters
      integer rba_XCoreCddPipeDestCore: 0..255, multiplicity set at pre-compile, origin=RB:3.0.0:2017-05-30, set at pre-compile  # Pipe Destination Core | Destination Core ID of this pipe
      integer rba_XCoreCddPipeId: 0..65535, multiplicity set at pre-compile, origin=RB:3.0.0:2017-05-30, set at pre-compile, symbolic-name-value=true, with-auto=true  # Pipe Id | ID of this pipe
      float rba_XCoreCddPipePeriod [0..1]: 0..3600, multiplicity set at pre-compile, origin=RB:3.0.0:2017-05-30, set at pre-compile  # Pipe Period [s] | Period in seconds, the function rba_XCoreCdd_PipeRead() shall be called. Parameter is needed to generate rba_XCoreCdd_PipeMainfunction_xxx() function.
      enumeration rba_XCoreCddPipeProcessingMode: multiplicity set at pre-compile, origin=RB:3.0.0:2017-05-30, set at pre-compile  # Pipe Processing Mode | Polling, INTERRUPT, TASK
        POLLING  # Polling
        SWI  # SW Interrupt
        TASK  # Task
      enumeration rba_XCoreCddPipeProcessingType: {RX, TX, TXCONF}, multiplicity set at pre-compile, origin=RB:3.0.0:2017-05-30, set at pre-compile  # Pipe Processing Type | Rx, Tx, TxConfirmation...
      integer rba_XCoreCddPipeRamSize [0..1]: 8..65535, multiplicity set at pre-compile, origin=RB:3.0.0:2017-05-30, set at pre-compile, default-value=2048  # Pipe RAM Size | RAM_SIZE of this pipe in bytes. Minimum value 8 bytes is for the default invalid packet header at fifo end.
      integer rba_XCoreCddPipeSrcCore: 0..255, multiplicity set at pre-compile, origin=RB:3.0.0:2017-05-30, set at pre-compile  # Pipe Source Core | Source Core ID of this pipe
      boolean rba_XCoreCddPipeVariablePktSize [0..1]: multiplicity set at pre-compile, origin=RB:3.0.0:2017-05-30, set at pre-compile, default-value=true  # Pipe Variable Pkt Size | This paramter controls what algorithm is used for the PIPE data. Variable Packet size is the only type of allocation used so far.This parameter is kept for future usage.
      boolean rba_XCoreCddPipeAllowBypassByTaskId [0..1]: multiplicity set at pre-compile, origin=RB:3.4.0:202-09-01, set at pre-compile, default-value=false  # Is Bypass by task Id specific to PIPE required | This parameter controls the bypassing of the PIPE specific calls and directly calling intended lower layer API. TRUE - Enables bypassing based on Task Id. No Pipe specific calls are invoked. Also locking of this Pipe is ensured independent of value configured rba_XcoreCddPipeSpecificLock, till rba_XCoreCdd_PipeRead API is called for the first time on this Pipe. FALSE - Disables bypassing based on taskId. Pipe Specific calls are invoked.
      boolean rba_XCoreCddPipeSpecificLock [0..1]: multiplicity set at pre-compile, origin=RB:3.0.0:2019-06-05, set at pre-compile, default-value=true  # Is lock specific to PIPE required | This parameter controls the Disabling and Restoring of local core interrupts when operating on a specific PIPE.TRUE ensures that disabling and restoring of local core IRQ's are taken care when operating on PIPE whereas FALSE ensures that local core IRQ's are not disabled and restored.
      string rba_XCoreCddPipeDestTask [0..1]: multiplicity set at pre-compile, origin=2022-03-29, set at pre-compile  # Pipe Task Name | Destination OS task in which the Pipe is processed
      container rba_XCoreCddPipePdu [1..*]: multiplicity set at pre-compile  # Pipe Pdu | Configuration of rba_XCoreCdd relevant code generation parameters
        reference rba_XCoreCddPipeDestPduRef: multiplicity set at pre-compile, origin=RB:3.0.0:2017-05-30, set at pre-compile, destination=Pdu  # Pipe Destination Pdu Ref | Reference to the XCoreCdd upper Layer PDU
        reference rba_XCoreCddPipeSrcPduRef: multiplicity set at pre-compile, origin=RB:3.0.0:2017-05-30, set at pre-compile, destination=Pdu  # Pipe Source Pdu Ref | Reference to the XCoreCdd lower Layer PDU
