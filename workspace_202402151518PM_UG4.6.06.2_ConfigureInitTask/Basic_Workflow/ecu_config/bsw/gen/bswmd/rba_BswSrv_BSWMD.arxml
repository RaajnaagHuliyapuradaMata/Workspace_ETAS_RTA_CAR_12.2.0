AUTOSAR XML (schema 4-0-3)
package /RB/RBA/rba_BswSrv/BswImplementations
  bsw implementation rba_BswSrv: programming-language=C, behavior=BswInternalBehaviour
    code-descriptors:
      code CodeDescriptor: artifact-descriptors=autosar-engineering-object={short-label=ArEngObj, category=SWSRC}
    resource consumption rba_BswSrv_ResourceConsumption
      5 x memory section, all with prefix=RBA_BSWSRV:
        RBA_BSWSRV_CODE: sw-addrmethod=CODE, symbol=CODE
        RBA_BSWSRV_VAR_CLEARED_32: alignment=32, sw-addrmethod=VAR_CLEARED, symbol=VAR_CLEARED_32
        RBA_BSWSRV_VAR_CLEARED_UNSPECIFIED: alignment=UNSPECIFIED, sw-addrmethod=VAR_CLEARED, symbol=VAR_CLEARED_UNSPECIFIED
        RBA_BSWSRV_VAR_INIT_UNSPECIFIED: alignment=UNSPECIFIED, sw-addrmethod=VAR_INIT, symbol=VAR_INIT_UNSPECIFIED
        RBA_BSWSRV_CONFIG_DATA_UNSPECIFIED: alignment=UNSPECIFIED, sw-addrmethod=CONFIG_DATA, symbol=CONFIG_DATA_UNSPECIFIED
      section name prefix RBA_BSWSRV
package /RB/RBA/rba_BswSrv/BswModuleDescriptions
  bsw module description rba_BswSrv: category=BSW_MODULE, module-id=255
    provided-entrys:
      rba_BswSrv_ByteOrderSwap16
      rba_BswSrv_ByteOrderSwap32
      rba_BswSrv_CountLeadingZero32
      rba_BswSrv_MemCompare
      rba_BswSrv_MemCompare16
      rba_BswSrv_MemCompare32
      rba_BswSrv_MemCompare64
      rba_BswSrv_MemCompare8
      rba_BswSrv_MemCopy
      rba_BswSrv_MemCopy16
      rba_BswSrv_MemCopy32
      rba_BswSrv_MemCopy64
      rba_BswSrv_MemCopy8
      rba_BswSrv_MemSet
      rba_BswSrv_MemSet16
      rba_BswSrv_MemSet32
      rba_BswSrv_MemSet64
      rba_BswSrv_MemSet8
    bsw module dependency Standard: target-module-id=197
    bsw internal behavior BswInternalBehaviour
package /RB/RBA/rba_BswSrv/BswModuleEntrys
  18 x bsw module entry, all with service-id=0, is-reentrant=false, is-synchronous=false, call-type=REGULAR, execution-context=UNSPECIFIED, sw-service-impl-policy=STANDARD:
    rba_BswSrv_ByteOrderSwap16  # rba_BswSrv_ByteOrderSwap16 Swaps the byte order of a 16 bit value for endianess conversion. \param Input_u16: input value \return value with swapped byte order \retval uint16 \seealso \usedresources
      sw service arg Input_u16: implementation-data-type=uint16
    rba_BswSrv_ByteOrderSwap32  # rba_BswSrv_ByteOrderSwap32 Swaps the byte order of a 32 bit value for endianess conversion. \param Input_u32: input value \return value with swapped byte order \retval uint32 \seealso \usedresources
      sw service arg Input_u32: implementation-data-type=uint32
    rba_BswSrv_CountLeadingZero32  # rba_BswSrv_CountLeadingZero32 count leading zeros in 32 bit value. \param Input_u32: input value \return number of leading zeros \retval uint32 \seealso \usedresources
      sw service arg Input_u32: implementation-data-type=uint32
    rba_BswSrv_MemCompare  # The rba_BswSrv_MemCompare API shall compare data between two memory locations.
      sw service arg xSrc1_pcv: base-type=void
      sw service arg xSrc2_pcv: base-type=void
      sw service arg numBytes_u32: implementation-data-type=uint32
    rba_BswSrv_MemCompare16  # rba_BswSrv_MemCompare16 - compare memory in 16 Bit blocks Memory compare routine. Pointer parameters must be 2 Byte aligned. The size should be a multiple of 2. If not, it is rounded down to the next multiple of 2. \param xSrc1_pcu16 first source address \param xSrc2_pcu16 second source address \param numBytes_u32 number of bytes to be compared \return stEqual_u32 result of comparison \retval 0 memory area contents are equal \retval 1 memory area contents differ \seealso rba_BswSrv_MemCompare8, rba_BswSrv_MemCompare32, rba_BswSrv_MemCompare64
      sw service arg xSrc1_pcu16: implementation-data-type=uint16
      sw service arg xSrc2_pcu16: implementation-data-type=uint16
      sw service arg numBytes_u32: implementation-data-type=uint32
    rba_BswSrv_MemCompare32  # rba_BswSrv_MemCompare32 - compare memory in 32 Bit blocks Memory compare routine. Pointer parameters must be 4 Byte aligned. The size should be a multiple of 4. If not, it is rounded down to the next multiple of 4. \param xSrc1_pcu32 first source address \param xSrc2_pcu32 second source address \param numBytes_u32 number of bytes to be compared \return stEqual_u32 result of comparison \retval 0 memory area contents are equal \retval 1 memory area contents differ \seealso rba_BswSrv_MemCompare8, rba_BswSrv_MemCompare16, rba_BswSrv_MemCompare64
      sw service arg xSrc1_pcu32: implementation-data-type=uint32
      sw service arg xSrc2_pcu32: implementation-data-type=uint32
      sw service arg numBytes_u32: implementation-data-type=uint32
    rba_BswSrv_MemCompare64  # rba_BswSrv_MemCompare64 - compare memory in 64 Bit blocks Memory compare routine. Pointer parameters must be 8 Byte aligned. The size should be a multiple of 8. If not, it is rounded down to the next multiple of 8. \param xSrc1_pcu32 first source address \param xSrc2_pcu32 second source address \param numBytes_u32 number of bytes to be compared \return stEqual_u32 result of comparison \retval 0 memory area contents are equal \retval 1 memory area contents differ \seealso rba_BswSrv_MemCompare8, rba_BswSrv_MemCompare16, rba_BswSrv_MemCompare32
      sw service arg xSrc1_pcu64: implementation-data-type=rba_BswSrv_uint64
      sw service arg xSrc2_pcu64: implementation-data-type=rba_BswSrv_uint64
      sw service arg numBytes_u32: implementation-data-type=uint32
    rba_BswSrv_MemCompare8  # rba_BswSrv_MemCompare8 - compare memory Memory compare routine. \param xSrc1_pcu8 pointer to the first source address \param xSrc2_pcu8 pointer to the second source address \param numBytes_u32 number of bytes to be compared \return stEqual_u32 result of comparison \retval 0 memory area contents are equal \retval 1 memory area contents differ \seealso rba_BswSrv_MemCompare16, rba_BswSrv_MemCompare32, rba_BswSrv_MemCompare64
      sw service arg xSrc1_pcu8: implementation-data-type=uint8
      sw service arg xSrc2_pcu8: implementation-data-type=uint8
      sw service arg numBytes_u32: implementation-data-type=uint32
    rba_BswSrv_MemCopy  # The rba_BswSrv_MemCopy API shall copy a 8-bit, 16-bit , 32-bit and 64 bit data from one predefined memory location to other.
      sw service arg xDest_pv: base-type=void
      sw service arg xSrc_pcv: base-type=void
      sw service arg numBytes_u32: implementation-data-type=uint32
    rba_BswSrv_MemCopy16  # rba_BswSrv_MemCopy16 - copy non overlapping memory in 16 Bit blocks Memory copy routine. Source and destination must not overlap. Pointer parameters must be 2 Byte aligned. The size should be a multiple of 2. If not, it is rounded down to the next multiple of 2. \param xDest_pu16 destination address \param xSrc_pcu16 source address \param numBytes_u32 number of bytes to be copied \seealso rba_BswSrv_MemCopy8, rba_BswSrv_MemCopy32, rba_BswSrv_MemCopy64
      sw service arg xDest_pu16: implementation-data-type=uint16
      sw service arg xSrc_pcu16: implementation-data-type=uint16
      sw service arg numBytes_u32: implementation-data-type=uint32
    rba_BswSrv_MemCopy32  # rba_BswSrv_MemCopy32 - copy non overlapping memory in 32 Bit blocks Memory copy routine. Source and destination must not overlap. Pointer parameters must be 4 Byte aligned. The size should be a multiple of 4. If not, it is rounded down to the next multiple of 4. \param xDest_pu32 destination address \param xSrc_pcu32 source address \param numBytes_u32 number of bytes to be copied \seealso rba_BswSrv_MemCopy8, rba_BswSrv_MemCopy16, rba_BswSrv_MemCopy64
      sw service arg xDest_pu32: implementation-data-type=uint32
      sw service arg xSrc_pcu32: implementation-data-type=uint32
      sw service arg numBytes_u32: implementation-data-type=uint32
    rba_BswSrv_MemCopy64  # rba_BswSrv_MemCopy64 - copy non overlapping memory in 64 Bit blocks Memory copy routine. Source and destination must not overlap. Pointer parameters must be 8 Byte aligned. The size should be a multiple of 8. If not, it is rounded down to the next multiple of 8. \param xDest_pu64 destination address \param xSrc_pcu64 source address \param numBytes_u32 number of bytes to be copied \seealso rba_BswSrv_MemCopy8, rba_BswSrv_MemCopy16, rba_BswSrv_MemCopy32
      sw service arg xDest_pu64: implementation-data-type=rba_BswSrv_uint64
      sw service arg xSrc_pcu64: implementation-data-type=rba_BswSrv_uint64
      sw service arg numBytes_u32: implementation-data-type=uint32
    rba_BswSrv_MemCopy8  # rba_BswSrv_MemCopy8 - copy non overlapping memory Memory copy routine. Source and destination must not overlap. \param xDest_pu8 destination address \param xSrc_pcu8 source address \param numBytes_u32 number of bytes to be copied \seealso rba_BswSrv_MemCopy16, rba_BswSrv_MemCopy32, rba_BswSrv_MemCopy64
      sw service arg xDest_pu8: implementation-data-type=uint8
      sw service arg xSrc_pcu8: implementation-data-type=uint8
      sw service arg numBytes_u32: implementation-data-type=uint32
    rba_BswSrv_MemSet  # The rba_BswSrv_MemSet API shall set a predefined 8 bit ,16 bit ,32 bit and 64 bit pattern .
      sw service arg xDest_pv: base-type=void
      sw service arg xPattern_s32: implementation-data-type=sint32
      sw service arg numBytes_u32: implementation-data-type=uint32
    rba_BswSrv_MemSet16  # rba_BswSrv_MemSet16 - initialize memory with 16 Bit data Memory initialization routine. 16 Bit Pattern is written to the destination. Destination must be 2 Byte aligned. The size should be a multiple of 2. If not, it is rounded down to the next multiple of 2. \param xDest_pu32 destination address \param Pattern_u32 fill pattern \param numBytes_u32 number of bytes to be initialized \seealso rba_BswSrv_MemSet8, rba_BswSrv_MemSet32, rba_BswSrv_MemSet64
      sw service arg xDest_pu16: implementation-data-type=uint16
      sw service arg xPattern_u32: implementation-data-type=uint32
      sw service arg numBytes_u32: implementation-data-type=uint32
    rba_BswSrv_MemSet32  # rba_BswSrv_MemSet32 - initialize memory with 32 Bit data Memory initialization routine. 32 Bit Pattern is written to the destination. Destination must be 4 Byte aligned. The size should be a multiple of 4. If not, it is rounded down to the next multiple of 4. \param xDest_pu32 destination address \param Pattern_u32 fill pattern \param numBytes_u32 number of bytes to be initialized \seealso rba_BswSrv_MemSet8, rba_BswSrv_MemSet16, rba_BswSrv_MemSet64
      sw service arg xDest_pu32: implementation-data-type=uint32
      sw service arg xPattern_u32: implementation-data-type=uint32
      sw service arg numBytes_u32: implementation-data-type=uint32
    rba_BswSrv_MemSet64  # rba_BswSrv_MemSet64 - initialize memory with 64 Bit data Memory initialization routine. 64 Bit Pattern is written to the destination. Destination must be 4 Byte aligned. The size should be a multiple of 8. If not, it is rounded down to the next multiple of 8. \param xDest_pu32 destination address \param Pattern_u32 fill pattern \param numBytes_u32 number of bytes to be initialized \seealso rba_BswSrv_MemSet8, rba_BswSrv_MemSet16, rba_BswSrv_MemSet32
      sw service arg xDest_pu64: implementation-data-type=rba_BswSrv_uint64
      sw service arg xPattern_u64: implementation-data-type=rba_BswSrv_uint64
      sw service arg numBytes_u32: implementation-data-type=uint32
    rba_BswSrv_MemSet8  # rba_BswSrv_MemSet8 - initialize memory with 8 Bit data Memory initialization routine. 8 Bit Pattern is written to the destination. \param xDest_pu8 destination address \param xPattern_u32 fill pattern, only lower 8 bit used \param numBytes_u32 number of bytes to be initialized \seealso rba_BswSrv_MemSet16, rba_BswSrv_MemSet32, rba_BswSrv_MemSet64
      sw service arg xDest_pu8: implementation-data-type=uint8
      sw service arg xPattern_u32: implementation-data-type=uint32
      sw service arg numBytes_u32: implementation-data-type=uint32
package /RB/RBA/rba_BswSrv/ImplementationDataTypes
  impl type rba_BswSrv_uint64: implementation-data-type=uint64, type-emitter=HEADER-TYPE  # BswSrv spcific uint64
