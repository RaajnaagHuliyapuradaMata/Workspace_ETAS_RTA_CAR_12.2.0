AUTOSAR XML (schema 00051)
package /ETAS_Project/EcucModuleConfigurationValuess
  module config BswM
    BswMConfig_0 (BswMConfig)
      BswMArbitration_0 (BswMArbitration)
        4 x BswMModeRequestPort:
          BswM_MRP_RequestFullCom: BswMRequestProcessing=BSWM_DEFERRED
            BswMModeRequestSource_0 (BswMModeRequestSource)
              BswMGenericRequest: BswMRbRequestType=BSW, BswMModeRequesterId=1, BswMRequestedModeMax=3
          BswM_MRP_BswM_MDG: BswMRequestProcessing=BSWM_DEFERRED
            BswMModeRequestSource_0 (BswMModeRequestSource)
              BswMBswModeNotification: BswMRbBswModeDeclarationGroup=/ModeDeclarationGroups/MDG_ECUM_STATE
          BswM_MRP_ApplicationRequestPort: BswMRequestProcessing=BSWM_DEFERRED
            BswMModeRequestSource_0 (BswMModeRequestSource)
              BswMGenericRequest: BswMRbRequestType=SWC, BswMModeRequesterId=0, BswMRequestedModeMax=3
          BswM_MRP_ComM_Can0: BswMRequestProcessing=BSWM_IMMEDIATE
            BswMModeRequestSource_0 (BswMModeRequestSource)
              BswMComMIndication: BswMComMChannelRef=Can_Network_Channel_Can_Network
        7 x BswMModeCondition, all with BswMConditionType=BSWM_EQUALS:
          BswM_MC_BswM_StartupTwo: BswMConditionMode=BswM_MRP_RequestFullCom
            BswMConditionValue
              BswMBswMode: BswMBswRequestedMode=1
          BswM_MC_BswM_AppRun: BswMConditionMode=BswM_MRP_BswM_MDG
            BswMConditionValue
              BswMModeDeclaration: BswMModeValueRef=ECUM_STATE_APP_RUN
          BswM_MC_TestTask_StopDemand: BswMConditionMode=BswM_MRP_ApplicationRequestPort
            BswMConditionValue
              BswMBswMode: BswMBswRequestedMode=1
          BswM_MC_BswM_PostRun: BswMConditionMode=BswM_MRP_BswM_MDG
            BswMConditionValue
              BswMModeDeclaration: BswMModeValueRef=ECUM_STATE_APP_POST_RUN
          BswM_MC_ComMNoCom: BswMConditionMode=BswM_MRP_ComM_Can0
            BswMConditionValue
              BswMBswMode: BswMBswRequestedMode=COMM_NO_COMMUNICATION
          BswM_MC_BswM_PrepShutdown: BswMConditionMode=BswM_MRP_BswM_MDG
            BswMConditionValue
              BswMModeDeclaration: BswMModeValueRef=ECUM_STATE_PREP_SHUTDOWN
          BswM_MC_BswM_Run: BswMConditionMode=BswM_MRP_BswM_MDG
            BswMConditionValue
              BswMModeDeclaration: BswMModeValueRef=ECUM_STATE_RUN
        5 x BswMLogicalExpression:
          BswM_LE_InitBlockReadAllComplete: BswMArgumentRef=BswM_MC_BswM_StartupTwo
          BswM_LE_Run: BswMLogicalOperator=BSWM_AND, BswMArgumentRef=BswM_MC_TestTask_StopDemand, BswMArgumentRef=BswM_MC_BswM_AppRun
          BswM_LE_Shutdown: BswMLogicalOperator=BSWM_AND, BswMArgumentRef=BswM_MC_BswM_PostRun, BswMArgumentRef=BswM_MC_ComMNoCom
          BswM_LE_GoDown: BswMArgumentRef=BswM_MC_BswM_PrepShutdown
          BswM_LE_StartCom: BswMArgumentRef=BswM_MC_BswM_Run
        4 x BswMRule, all with BswMRuleInitState=BSWM_FALSE:
          BswM_AR_StartCom: BswMRuleExpressionRef=BswM_LE_InitBlockReadAllComplete, BswMRuleTrueActionList=BswM_AL_FullComm_AllBus
          BswM_AR_PostRun: BswMRuleExpressionRef=BswM_LE_Run, BswMRuleTrueActionList=BswM_AL_StopComm_AllBus
          BswM_AR_Shutdown: BswMRuleExpressionRef=BswM_LE_Shutdown, BswMRuleTrueActionList=BswM_AL_Shutdown
          BswM_AR_WriteAllComplete: BswMRuleExpressionRef=BswM_LE_GoDown, BswMRuleTrueActionList=BswM_AL_GoDown
      BswMModeControl_0 (BswMModeControl)
        15 x BswMAction:
          BswM_AI_StartPduGroup_All
            BswMAvailableActions_0 (BswMAvailableActions)
              BswMPduGroupSwitch: BswMPduGroupSwitchReinit=false, BswMEnabledPduGroupRef=ComIPduGroup_Rx, BswMEnabledPduGroupRef=ComIPduGroup_Tx
          BswM_AI_ComMCommAllowed_Can0
            BswMAvailableActions_0 (BswMAvailableActions)
              BswMComMAllowCom: BswMComAllowed=true, BswMComMAllowChannelRef=Can_Network_Channel_Can_Network
          BswM_AI_ComMReqFullComm_User0
            BswMAvailableActions_0 (BswMAvailableActions)
              BswMComMModeSwitch: BswMComMRequestedMode=BSWM_COMM_FULL_COMMUNICATION, BswMComMUserRef=ComMUser_Can_Network_Channel_Can_Network
          BswM_AI_BswMSwitchAppRun
            BswMAvailableActions_0 (BswMAvailableActions)
              BswMSchMSwitch: BswMSchMSwitchedMode=ECUM_STATE_APP_RUN
          BswM_AI_ComMReqNoComm_User0
            BswMAvailableActions_0 (BswMAvailableActions)
              BswMComMModeSwitch: BswMComMRequestedMode=BSWM_COMM_NO_COMMUNICATION, BswMComMUserRef=ComMUser_Can_Network_Channel_Can_Network
          BswM_AI_ComMCommNotAllowed_Can0
            BswMAvailableActions_0 (BswMAvailableActions)
              BswMComMAllowCom: BswMComAllowed=false, BswMComMAllowChannelRef=Can_Network_Channel_Can_Network
          BswM_AI_StopPduGroup_All
            BswMAvailableActions_0 (BswMAvailableActions)
              BswMPduGroupSwitch: BswMPduGroupSwitchReinit=false, BswMDisabledPduGroupRef=ComIPduGroup_Rx, BswMDisabledPduGroupRef=ComIPduGroup_Tx
          BswM_AI_BswMSwitchPostRun
            BswMAvailableActions_0 (BswMAvailableActions)
              BswMSchMSwitch: BswMSchMSwitchedMode=ECUM_STATE_APP_POST_RUN
          BswM_AI_RteStop
            BswMAvailableActions_0 (BswMAvailableActions)
              BswMUserCallout: BswMUserCalloutFunction=Rte_Stop()
          BswM_AI_ComMDeInit
            BswMAvailableActions_0 (BswMAvailableActions)
              BswMUserCallout: BswMUserCalloutFunction=ComM_DeInit()
          BswM_AI_BswMSwitchPrepShutdown
            BswMAvailableActions_0 (BswMAvailableActions)
              BswMSchMSwitch: BswMSchMSwitchedMode=ECUM_STATE_PREP_SHUTDOWN
          BswM_AI_GoDown
            BswMAvailableActions_0 (BswMAvailableActions)
              BswMUserCallout: BswMUserCalloutFunction=EcuM_GoDown(42)
          BswM_AI_RteStart
            BswMAvailableActions_0 (BswMAvailableActions)
              BswMUserCallout: BswMUserCalloutFunction=Rte_Start()
          BswM_AI_BswMSwitchRun
            BswMAvailableActions_0 (BswMAvailableActions)
              BswMSchMSwitch: BswMSchMSwitchedMode=ECUM_STATE_RUN
          BswM_AI_BswMSwitchStartupTwo
            BswMAvailableActions_0 (BswMAvailableActions)
              BswMSchMSwitch: BswMSchMSwitchedMode=ECUM_STATE_STARTUP_TWO
        4 x BswMActionList, all with BswMActionListExecution=BSWM_TRIGGER:
          BswM_AL_FullComm_AllBus
            4 x BswMActionListItem, all with BswMAbortOnFail=0, BswMReportFailRuntimeErrorId=128:
              BswMActionListItem_0: BswMActionListItemIndex=0, BswMActionListItemRef=BswM_AI_StartPduGroup_All
              BswMActionListItem_1: BswMActionListItemIndex=1, BswMActionListItemRef=BswM_AI_ComMCommAllowed_Can0
              BswMActionListItem_2: BswMActionListItemIndex=2, BswMActionListItemRef=BswM_AI_ComMReqFullComm_User0
              BswMActionListItem_3: BswMActionListItemIndex=3, BswMActionListItemRef=BswM_AI_BswMSwitchAppRun
          BswM_AL_StopComm_AllBus
            4 x BswMActionListItem, all with BswMReportFailRuntimeErrorId=128:
              BswMActionListItem_0: BswMAbortOnFail=false, BswMActionListItemIndex=0, BswMActionListItemRef=BswM_AI_ComMReqNoComm_User0
              BswMActionListItem_1: BswMAbortOnFail=0, BswMActionListItemIndex=1, BswMActionListItemRef=BswM_AI_ComMCommNotAllowed_Can0
              BswMActionListItem_2: BswMAbortOnFail=0, BswMActionListItemIndex=2, BswMActionListItemRef=BswM_AI_StopPduGroup_All
              BswMActionListItem_3: BswMAbortOnFail=0, BswMActionListItemIndex=3, BswMActionListItemRef=BswM_AI_BswMSwitchPostRun
          BswM_AL_Shutdown
            3 x BswMActionListItem, all with BswMReportFailRuntimeErrorId=128:
              BswMActionListItem_0: BswMAbortOnFail=false, BswMActionListItemIndex=0, BswMActionListItemRef=BswM_AI_RteStop
              BswMActionListItem_1: BswMAbortOnFail=0, BswMActionListItemIndex=1, BswMActionListItemRef=BswM_AI_ComMDeInit
              BswMActionListItem_2: BswMAbortOnFail=0, BswMActionListItemIndex=2, BswMActionListItemRef=BswM_AI_BswMSwitchPrepShutdown
          BswM_AL_GoDown
            BswMActionListItem_0 (BswMActionListItem): BswMAbortOnFail=false, BswMReportFailRuntimeErrorId=128, BswMActionListItemIndex=0, BswMActionListItemRef=BswM_AI_GoDown
      BswMDataTypeMappingSets: BswMDataTypeMappingSetRef=ECUM_STATE_Mapping
    BswMGeneral_0 (BswMGeneral):
      BswMCanSMEnabled = true
      BswMComMEnabled = true
      BswMDcmEnabled = 0
      BswMDevErrorDetect = 0
      BswMEcuMEnabled = true
      BswMEthIfEnabled = 0
      BswMEthSMEnabled = 0
      BswMFrSMEnabled = 0
      BswMGenericRequestEnabled = true
      BswMJ1939DcmEnabled = 0
      BswMJ1939NmEnabled = 0
      BswMLinSMEnabled = 0
      BswMLinTPEnabled = 0
      BswMNmEnabled = 0
      BswMNvMEnabled = 0
      BswMRbComEnabled = true
      BswMRbDebugEnable = 0
      BswMRbIntrptQueueMaxSize = 5
      BswMRbSoAdEnabled = 0
      BswMSchMEnabled = true
      BswMSdEnabled = 0
      BswMVersionInfoApi = 1
      BswMMainFunctionPeriod = 0.01
      BswMRbMaxNumOfRules = 255
      BswMUserIncludeFiles: BswMUserIncludeFile=CanSM_ComM.h, BswMUserIncludeFile=Mcu.h, BswMUserIncludeFile=CanIf.h, BswMUserIncludeFile=Can.h, BswMUserIncludeFile=Rte_Main.h
