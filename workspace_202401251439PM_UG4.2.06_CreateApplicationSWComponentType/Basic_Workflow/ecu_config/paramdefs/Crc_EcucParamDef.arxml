AUTOSAR XML (schema 4-2-2)
package /AUTOSAR_Crc/EcucModuleDefs
  module definition Crc [0..1]: category=VENDOR_SPECIFIC_MODULE_DEFINITION, refined-module-def=Crc, variants pre-compile  # Configuration of the Crc (Crc routines) module.
    container CrcGeneral  # Crc general configurations | General configurations of component Crc. The preferred crc polynomials and calculation methods shall be configured here.
      boolean Crc16: set at pre-compile, default-value=true  # enable Crc16 calculation | Enables / disables CRC 16-bit (CCITT) calculation methods. If Crc16 calculation is enabled the Crc16 calculation method must be selected.
      enumeration Crc16Mode [0..1]: {CRC_16_RUNTIME, CRC_16_TABLE, CRC_16_HARDWARE, CRC_16_HARDWARE_16BIT_DATA_PTR}, multiplicity set at pre-compile, set at pre-compile, default-value=CRC_16_TABLE  # Crc16 calculation method | Switch to select one of the available CRC 16-bit (CCITT) calculation methods. If Crc16 calculation is enabled the Crc16 calculation method must be selected here. The Crc16 calculation on hardware is supported for - RH850/R1x, RH850/P1x, CRC_HW_IFX_DEV2_40NM, CRC_HW_IFX_DEV3_40NM, CRC_HW_IFX_DEV4_40NM, CRC_HW_IFX_DEV5_40NM, CRC_HW_ST_CHORUS_4MC1, CRC_HW_ST_CHORUS_2MC1, CRC_HW_ST_CHORUS_1MC1, CRC_HW_ST_DEV5_28NM, CRC_HW_NXP_S32G2, CRC_HW_ST_DEV5_28_P6. If Crc16 calculation is disabled the Crc16 calculation method can be deleted. CRC_16_HARDWARE_16BIT_DATA_PTR option is to be selected if Api is to support 16bit Data pointer. This is only supported for RH850/P1x.
      boolean Crc32: set at pre-compile, default-value=true  # enable Crc32 calculation | Enables / disables CRC 32-bit (IEEE-802.3 CRC32 Ethernet Standard) calculation methods. If Crc32 calculation is enabled the Crc32 calculation method must be selected.
      enumeration Crc32Mode [0..1]: {CRC_32_RUNTIME, CRC_32_TABLE, CRC_32_HARDWARE}, multiplicity set at pre-compile, set at pre-compile, default-value=CRC_32_TABLE  # Crc32 calculation method | Switch to select one of the available CRC 32-bit (IEEE-802.3 CRC32 Ethernet Standard) calculation methods. If CRC32 calculation is enabled the CRC32 calculation method must be selected here. The CRC32 calculation on hardware is supported for - RH850/R1x, RH850/P1x, CRC_HW_ST_CHORUS_4MC1, CRC_HW_ST_CHORUS_2MC1, CRC_HW_ST_CHORUS_1MC1, CRC_HW_IFX_DEV4_40NM, CRC_HW_IFX_DEV2_40NM, CRC_HW_IFX_DEV3_40NM, CRC_HW_IFX_DEV5_40NM, CRC_HW_ST_DEV3_40NM, CRC_HW_IFX_DEV4_65NM, CRC_HW_ST_DEV5_28NM, CRC_HW_NXP_S32G2, CRC_HW_ST_DEV5_28_P6. If CRC32 calculation is disabled the Crc32 calculation method can be deleted.
      boolean Crc32P4: set at pre-compile, default-value=true  # enable Crc32P4 calculation | Enables / disables CRC 32-bit for E2E Profile 4 (32-bit 0xF4ACFB13 polynomial CRC calculation) calculation methods. If Crc32P4 calculation is enabled the Crc32P4 calculation method must be selected.
      enumeration Crc32P4Mode [0..1]: {CRC_32P4_RUNTIME, CRC_32P4_TABLE, CRC_32P4_HARDWARE}, multiplicity set at pre-compile, set at pre-compile, default-value=CRC_32P4_TABLE  # Crc32P4 calculation method | Switch to select one of the available CRC 32-bit for E2E Profile 4 (32-bit 0xF4ACFB13 polynomial CRC calculation) calculation methods. If CRC32P4 calculation is enabled the CRC32P4 calculation method must be selected here. The CRC32 calculation on hardware is only supported for - CRC_HW_IFX_DEV4_40NM, CRC_HW_IFX_DEV2_40NM, CRC_HW_IFX_DEV3_40NM, CRC_HW_IFX_DEV5_40NM. If CRC32 calculation is disabled the Crc32 calculation method can be deleted.
      boolean Crc64: set at pre-compile, default-value=true  # enable Crc64 calculation | Enables / disables CRC 64-bit (ECMA) calculation methods. If Crc64 calculation is enabled the Crc64 calculation method must be selected.
      enumeration Crc64Mode [0..1]: {CRC_64_RUNTIME, CRC_64_TABLE}, multiplicity set at pre-compile, set at pre-compile, default-value=CRC_64_TABLE  # Crc64 calculation method | Switch to select one of the available CRC 64-bit (EMCA) calculation methods. If CRC64 calculation is enabled the CRC64 calculation method must be selected here. The CRC64 calculation on hardware is currently not supported. If CRC64 calculation is disabled the Crc64 calculation method can be deleted.
      boolean Crc8: set at pre-compile, default-value=true  # enable Crc8 calculation | Enables / disables CRC 8-bit (SAE J1850) calculation methods. If Crc8 calculation is enabled the Crc8 calculation method must be selected.
      boolean Crc8H2F: set at pre-compile, default-value=true  # enable Crc8H2F calculation | Enables / disables CRC 8-bit (2Fh polynomial) calculation methods. If CRC8H2F calculation is enabled the Crc8H2F calculation method must be selected.
      enumeration Crc8H2FMode [0..1]: {CRC_8H2F_RUNTIME, CRC_8H2F_TABLE, CRC_8H2F_HARDWARE}, multiplicity set at pre-compile, set at pre-compile, default-value=CRC_8H2F_TABLE  # Crc8H2F calculation method | Switch to select one of the available Crc 8-bit (2Fh polynomial) calculation methods. If Crc8H2F calculation is enabled the Crc8h2F calculation method must be selected here. The CRC8H2F calculation on hardware is only supported for RH850/P1x, CRC_HW_ST_CHORUS_4MC1, CRC_HW_ST_CHORUS_2MC1, CRC_HW_ST_CHORUS_1MC1, CRC_HW_ST_DEV5_28NM, CRC_HW_NXP_S32G2, CRC_HW_ST_DEV5_28_P6. If Crc8H2F calculation is disabled the calculation method can be deleted.
      enumeration Crc8Mode [0..1]: {CRC_8_RUNTIME, CRC_8_TABLE, CRC_8_HARDWARE}, multiplicity set at pre-compile, set at pre-compile, default-value=CRC_8_TABLE  # Crc8 calculation method | Switch to select one of the available CRC 8-bit (SAE J1850) calculation methods. If Crc8 calculation is enabled the Crc8 calculation method must be selected here. The CRC8 calculation on hardware is only supported for - RH850/P1x, CRC_HW_IFX_DEV2_40NM, CRC_HW_IFX_DEV3_40NM, CRC_HW_IFX_DEV4_40NM, CRC_HW_IFX_DEV5_40NM, CRC_HW_ST_CHORUS_4MC1, CRC_HW_ST_CHORUS_2MC1, CRC_HW_ST_CHORUS_1MC1, CRC_HW_ST_DEV5_28NM, CRC_HW_NXP_S32G2, CRC_HW_ST_DEV5_28_P6. If Crc8 calculation is disabled the Crc8 calculation method can be deleted.
      enumeration CrcRbHardware [0..1]: multiplicity set at pre-compile, origin=RB:7.1.0:2020-10-20, set at pre-compile, default-value=CRC_HW_UNKNOWN  # Crc Hardware | Switch to select one of the available Hardware.
        CRC_HW_UNKNOWN  # Unknown Device
        CRC_HW_RH850_R1X  # RH850 R1x
        CRC_HW_RH850_P1XD{3..5}  # RH850 P1x D{3..5}
        CRC_HW_RH850_P1XD5EDV2  # RH850 P1x D5EDv2
        CRC_HW_ST_CHORUS_4MC1  # ST Chorus 4MC1
        CRC_HW_ST_CHORUS_2MC1  # ST Chorus 2MC1
        CRC_HW_ST_CHORUS_1MC1  # ST Chorus 1MC1
        CRC_HW_IFX_DEV{2..5}_40NM  # Ifx Dev{2..5} 40nm
        CRC_HW_IFX_DEV4_65NM  # Ifx Dev4 65nm
        CRC_HW_ST_DEV3_40NM  # ST Dev3 40nm
        CRC_HW_ST_DEV5_28NM  # ST Dev5 28nm
        CRC_HW_ST_DEV5_28_P6  # ST5 28nm P6
        CRC_HW_NXP_S32G2  # NXP S32G2
      boolean CrcVersionInfoApi: set at pre-compile, default-value=true  # enable Crc version info | Enables / disables Crc version information.
    container CrcRbRevision: multiplicity set at pre-compile  # Crc Autosar 4.0 revision | The Autosar 4.0 revision of the CRC calculations can be selected here. Currently Revision_1 and Revision_2 are supported. If Revision_1 is configured then it's meaning is CRC calculations are supported for AR4.0.1 and Previous Autosar version and if Revision_2 is configured it's meaning is CRC calculations are supported for AR 4.0.2 and greater than this Autosar version. The selection is mandatory.
      enumeration CrcRbRev [0..1]: {Revision_1, Revision_2}, multiplicity set at pre-compile, origin=RB:7.1.0:2020-10-20, set at pre-compile, default-value=Revision_2  # Autosar 4.0 Revision | Selection of Autosar 4.0 revision of CRC module. If Revision_2 is configured then all CRC calculation relevant API will have following behaviour : 1. There is an additional parameter Crc_IsFirstCall 2. The function has different start value and different XOR values (changed from 0x00 to OxFF). If Revision_1 is configured then all CRC calculation relevant API will have following behaviour : 1. There is no parameter Crc_IsFirstCall 2. The function has only start value.
    container CrcGM [0..1]  # Crc GM Specific configurations | GM Specific configurations of component Crc. The preferred crc polynomials and calculation methods shall be configured here.
      boolean Crc8GM: origin=RB:5.0.0:2023-06-26, set at pre-compile, default-value=false  # enable Crc8 GM calculation | Enables / disables CRC 8-bit GM calculation methods. If Crc8 GM calculation is enabled the Crc8 GM calculation method must be selected.
      enumeration Crc8GMMode [0..1]: {CRC_8_GM_RUNTIME, CRC_8_GM_TABLE}, multiplicity set at pre-compile, origin=RB:5.0.0:2023-06-26, set at pre-compile, default-value=CRC_8_GM_RUNTIME  # Crc8 GM calculation method | Switch to select one of the available CRC 8-bit calculation methods. If Crc8 calculation is enabled the Crc8 calculation method must be selected here. If Crc8 calculation is disabled the Crc8 calculation method can be deleted.
