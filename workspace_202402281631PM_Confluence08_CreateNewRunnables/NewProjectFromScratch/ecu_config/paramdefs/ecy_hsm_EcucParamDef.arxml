AUTOSAR XML (schema 4-2-2)
package /RB/ECY/ecy_hsm/EcucModuleDefs
  module definition ecy_hsm [0..1]: category=VENDOR_SPECIFIC_MODULE_DEFINITION, refined-module-def=Example, variants pre-compile/post-build  # HSM | Configuration of the ecy_hsm package
    container ecy_hsm_AES_KEY [0..1]: multiplicity set at pre-compile  # AES_KEY related configurations
      container VOLATILE [0..1]
        container CONFIG_PROP_SET_3997791729 [0..1]
          enumeration ecy_hsm_RESOURCE_OBJECTS [0..1]: {VOLATILE_BASIC_SHE_SECRET_KEY}
          integer ecy_hsm_USER_ID [0..1]: 0.., multiplicity set at pre-compile, origin=RB:0.1.0:2018-01-01, set at pre-compile  # User ID | User defined data object ID. The value must be an unique numeric value between 0 and 4294967295. The value itself is not used by the application.
          boolean ecy_hsm_DATA_ATTR_USE_AUTH_GEN [0..1]: multiplicity set at pre-compile, origin=RB:0.1.0:2018-01-01, set at pre-compile  # authentication generation capable data/key? | True: A key restricted to verification and generation usage can be written to this slot. False: A key restricted to verification and generation usage can not be written to this slot. Recommended Value: True. Details: If you want to write a key with property ecy_hsm_CSAI_KEYPROP_MAC_ONLY to this key-slot, set True. ecy_hsm_CSAI_KEYPROP_MAC_ONLY: The key can not be used for encryption and decryption. Important: This attribute does not specify the effective properties of the key-slot, but determines which properties of a given key can be written to this key-slotData/Key may be used for authentication generation.
          boolean ecy_hsm_DATA_ATTR_USE_AUTH_VERIFY [0..1]: multiplicity set at pre-compile, origin=RB:0.1.0:2018-01-01, set at pre-compile  # authentication verification capable data/key? | True: A key restricted to verification and generation usage can be written to this slot. False: A key restricted to verification and generation usage can not be written to this slot. Recommended Value: True. Details: If you want to write a key with property ecy_hsm_CSAI_KEYPROP_MAC_ONLY or ecy_hsm_CSAI_KEYPROP_IS_VERIFY_ONLY to this key-slot, set True. ecy_hsm_CSAI_KEYPROP_MAC_ONLY: The key can not be used for encryption and decryption. ecy_hsm_CSAI_KEYPROP_IS_VERIFY_ONLY: The key can not be used for encryption, decryption and MAC-Generation Important: This attribute does not specify the csai-properties of the key-slot, but determines which csai properties of a given key can be written to this key-slot.
          boolean ecy_hsm_DATA_ATTR_USE_ENCRYPT [0..1]: multiplicity set at pre-compile, origin=RB:0.1.0:2018-01-01, set at pre-compile  # encryption capable data/key? | True: A key restricted to encryption and decryption usage can be written to this slot. False: A key restricted to encryption and decryption usage can not be written to this slot. Recommended Value: True. Details: If you want to write a key with property. ecy_hsm_CSAI_KEYPROP_ENCDEC_ONLY to this key-slot, set True. ecy_hsm_CSAI_KEYPROP_ENCDEC_ONLY: The user can not use the key for the verification or generation of MACs. Important: This attribute does not specify the effective properties of the key-slot, but determines which properties of a given key can be written to this key-slot.
          boolean ecy_hsm_DATA_ATTR_USE_DECRYPT [0..1]: multiplicity set at pre-compile, origin=RB:0.1.0:2018-01-01, set at pre-compile  # decryption capable Data/Key? | True: A key restricted to encryption and decryption usage can be written to this slot. False: A key restricted to encryption and decryption usage can not be written to this slot. Recommended Value: True. Details: If you want to write a key with property . ecy_hsm_CSAI_KEYPROP_ENCDEC_ONLY to this key-slot, set True. ecy_hsm_CSAI_KEYPROP_ENCDEC_ONLY: The user can not use the key for the verification or generation of MACs. Important: This attribute does not specify the effective properties of the key-slot, but determines which properties of a given key can be written to this key-slot.
          boolean ecy_hsm_DATA_ATTR_ALLOW_WRITE [0..1]: multiplicity set at pre-compile, origin=RB:0.1.0:2018-01-01, set at pre-compile  # updatable and/or erasable Data/Key? | True: You can write to this key-slot multiple times. False: You can write to this key-slot only once. Details: True: A user is able to write a key with following properties to the key-slot: ecy_hsm_CSAI_KEYPROP_IS_READONLY_KEY, ecy_hsm_CSAI_KEYPROP_IS_DELETABLE_KEY. False: A user must assign following property to the key, if the key shall be written to the key-slot: ecy_hsm_CSAI_KEYPROP_IS_READONLY_KEY.. Property description: ecy_hsm_CSAI_KEYPROP_IS_READONLY_KEY: The key can only be written once to the slot. Every additional write attempt is rejected. ecy_hsm_CSAI_KEYPROP_IS_DELETABLE_KEY: The user can update the key slot by invoking ecy_hsm_Csai_WriteKeyToNvmKeyStore. Important: This attribute does not specify the effective properties of the key-slot, but determines which properties of a given key can be written to this key-slot.
          boolean ecy_hsm_DATA_ATTR_ALLOW_SECBOOT [0..1]: multiplicity set at pre-compile, origin=RB:0.1.0:2018-01-01, set at pre-compile  # secure boot capable Data/Key? | True: You can write a key to this slot, which can be used if secure boot has failed. False: You can not write a key to this slot, which can be used if secure boot has failed. Details: True: A user is able to write a key without property ecy_hsm_CSAI_KEYPROP_SECURE_BOOT_MUST_PASS to this key-slot. A key can be used even if Secure Boot has failed. False: A user must set the property ecy_hsm_CSAI_KEYPROP_SECURE_BOOT_MUST_PASS, if he wants to write the key to the key-slot. ecy_hsm_CSAI_KEYPROP_SECURE_BOOT_MUST_PASS: The symetric key can only be used when the validation of Secure-Boot resp. Trusted-Boot has been sucessfull.
          boolean ecy_hsm_DATA_ATTR_ALLOW_DEBUG [0..1]: multiplicity set at pre-compile, origin=RB:0.1.0:2018-01-01, set at pre-compile  # debugging capable Data/Key? | True: A key allowing usage with attached debuger, can be written to this slot. False: A key allowing usage with attached debuger, can not be written to this slot. Recommended Value: True. Details: True: A user is allowed to use the key-slot, if a debugger is attached. False: A user must set the property ecy_hsm_CSAI_KEYPROP_LOCKED_ON_DEBUG, if he wants to write the key to the key-slot. ecy_hsm_CSAI_KEYPROP_LOCKED_ON_DEBUG: The key can not be used if a debugger is attached Important: This attribute does not specify the effective properties of the key-slot, but determines which properties of a given key can be written to this key-slot.
          boolean ecy_hsm_DATA_ATTR_ALLOW_WILDCARD [0..1]: multiplicity set at pre-compile, origin=RB:0.1.0:2018-01-01, set at pre-compile  # wildcard key usable for SHE overwriting? | Always set to True. The current version expects this data attribute to be set to true even if there is no effect.
          boolean ecy_hsm_DATA_ATTR_PUBLIC [0..1]: multiplicity set at pre-compile, origin=RB:0.1.0:2018-01-01, set at pre-compile  # does Data/Key contain public info? | Data/Key contains public information (may be exported)
          boolean ecy_hsm_DATA_ATTR_PRIVATE [0..1]: multiplicity set at pre-compile, origin=RB:0.1.0:2018-01-01, set at pre-compile  # does Data/Key contain private info? | Data/Key contains private information (shall NOT be exported)
          boolean ecy_hsm_DATA_ATTR_MULTISESSION [0..1]: multiplicity set at pre-compile, origin=RB:0.1.0:2018-01-01, set at pre-compile  # is Data/Key multisession capable? | Always set to True. The current version expects this data attribute to be set to true even if there is no effect.
          boolean ecy_hsm_DATA_ATTR_SSS [0..1]: multiplicity set at pre-compile, origin=RB:0.1.0:2018-01-01, set at pre-compile  # is Data/Key SSS only? | Data/Key is only usable by the SSS (Secure Space Script) middleware/applet
        container CONFIG_PROP_SET_368413962 [0..1]
          enumeration ecy_hsm_RESOURCE_OBJECTS [0..1]: {VOLATILE_BASIC_SHE_RAM_KEY}
          integer ecy_hsm_USER_ID [0..1]: 0.., multiplicity set at pre-compile, origin=RB:0.1.0:2018-01-01, set at pre-compile  # User ID | User defined data object ID. The value must be an unique numeric value between 0 and 4294967295. The value itself is not used by the application.
          boolean ecy_hsm_DATA_ATTR_USE_AUTH_GEN [0..1]: multiplicity set at pre-compile, origin=RB:0.1.0:2018-01-01, set at pre-compile  # authentication generation capable data/key? | True: A key restricted to verification and generation usage can be written to this slot. False: A key restricted to verification and generation usage can not be written to this slot. Recommended Value: True. Details: If you want to write a key with property ecy_hsm_CSAI_KEYPROP_MAC_ONLY to this key-slot, set True. ecy_hsm_CSAI_KEYPROP_MAC_ONLY: The key can not be used for encryption and decryption. Important: This attribute does not specify the effective properties of the key-slot, but determines which properties of a given key can be written to this key-slotData/Key may be used for authentication generation.
          boolean ecy_hsm_DATA_ATTR_USE_AUTH_VERIFY [0..1]: multiplicity set at pre-compile, origin=RB:0.1.0:2018-01-01, set at pre-compile  # authentication verification capable data/key? | True: A key restricted to verification and generation usage can be written to this slot. False: A key restricted to verification and generation usage can not be written to this slot. Recommended Value: True. Details: If you want to write a key with property ecy_hsm_CSAI_KEYPROP_MAC_ONLY or ecy_hsm_CSAI_KEYPROP_IS_VERIFY_ONLY to this key-slot, set True. ecy_hsm_CSAI_KEYPROP_MAC_ONLY: The key can not be used for encryption and decryption. ecy_hsm_CSAI_KEYPROP_IS_VERIFY_ONLY: The key can not be used for encryption, decryption and MAC-Generation Important: This attribute does not specify the csai-properties of the key-slot, but determines which csai properties of a given key can be written to this key-slot.
          boolean ecy_hsm_DATA_ATTR_USE_ENCRYPT [0..1]: multiplicity set at pre-compile, origin=RB:0.1.0:2018-01-01, set at pre-compile  # encryption capable data/key? | True: A key restricted to encryption and decryption usage can be written to this slot. False: A key restricted to encryption and decryption usage can not be written to this slot. Recommended Value: True. Details: If you want to write a key with property. ecy_hsm_CSAI_KEYPROP_ENCDEC_ONLY to this key-slot, set True. ecy_hsm_CSAI_KEYPROP_ENCDEC_ONLY: The user can not use the key for the verification or generation of MACs. Important: This attribute does not specify the effective properties of the key-slot, but determines which properties of a given key can be written to this key-slot.
          boolean ecy_hsm_DATA_ATTR_USE_DECRYPT [0..1]: multiplicity set at pre-compile, origin=RB:0.1.0:2018-01-01, set at pre-compile  # decryption capable Data/Key? | True: A key restricted to encryption and decryption usage can be written to this slot. False: A key restricted to encryption and decryption usage can not be written to this slot. Recommended Value: True. Details: If you want to write a key with property . ecy_hsm_CSAI_KEYPROP_ENCDEC_ONLY to this key-slot, set True. ecy_hsm_CSAI_KEYPROP_ENCDEC_ONLY: The user can not use the key for the verification or generation of MACs. Important: This attribute does not specify the effective properties of the key-slot, but determines which properties of a given key can be written to this key-slot.
          boolean ecy_hsm_DATA_ATTR_ALLOW_WRITE [0..1]: multiplicity set at pre-compile, origin=RB:0.1.0:2018-01-01, set at pre-compile  # updatable and/or erasable Data/Key? | True: You can write to this key-slot multiple times. False: You can write to this key-slot only once. Details: True: A user is able to write a key with following properties to the key-slot: ecy_hsm_CSAI_KEYPROP_IS_READONLY_KEY, ecy_hsm_CSAI_KEYPROP_IS_DELETABLE_KEY. False: A user must assign following property to the key, if the key shall be written to the key-slot: ecy_hsm_CSAI_KEYPROP_IS_READONLY_KEY.. Property description: ecy_hsm_CSAI_KEYPROP_IS_READONLY_KEY: The key can only be written once to the slot. Every additional write attempt is rejected. ecy_hsm_CSAI_KEYPROP_IS_DELETABLE_KEY: The user can update the key slot by invoking ecy_hsm_Csai_WriteKeyToNvmKeyStore. Important: This attribute does not specify the effective properties of the key-slot, but determines which properties of a given key can be written to this key-slot.
          boolean ecy_hsm_DATA_ATTR_ALLOW_SECBOOT [0..1]: multiplicity set at pre-compile, origin=RB:0.1.0:2018-01-01, set at pre-compile  # secure boot capable Data/Key? | True: You can write a key to this slot, which can be used if secure boot has failed. False: You can not write a key to this slot, which can be used if secure boot has failed. Details: True: A user is able to write a key without property ecy_hsm_CSAI_KEYPROP_SECURE_BOOT_MUST_PASS to this key-slot. A key can be used even if Secure Boot has failed. False: A user must set the property ecy_hsm_CSAI_KEYPROP_SECURE_BOOT_MUST_PASS, if he wants to write the key to the key-slot. ecy_hsm_CSAI_KEYPROP_SECURE_BOOT_MUST_PASS: The symetric key can only be used when the validation of Secure-Boot resp. Trusted-Boot has been sucessfull.
          boolean ecy_hsm_DATA_ATTR_ALLOW_DEBUG [0..1]: multiplicity set at pre-compile, origin=RB:0.1.0:2018-01-01, set at pre-compile  # debugging capable Data/Key? | True: A key allowing usage with attached debuger, can be written to this slot. False: A key allowing usage with attached debuger, can not be written to this slot. Recommended Value: True. Details: True: A user is allowed to use the key-slot, if a debugger is attached. False: A user must set the property ecy_hsm_CSAI_KEYPROP_LOCKED_ON_DEBUG, if he wants to write the key to the key-slot. ecy_hsm_CSAI_KEYPROP_LOCKED_ON_DEBUG: The key can not be used if a debugger is attached Important: This attribute does not specify the effective properties of the key-slot, but determines which properties of a given key can be written to this key-slot.
          boolean ecy_hsm_DATA_ATTR_ALLOW_WILDCARD [0..1]: multiplicity set at pre-compile, origin=RB:0.1.0:2018-01-01, set at pre-compile  # wildcard key usable for SHE overwriting? | Always set to True. The current version expects this data attribute to be set to true even if there is no effect.
          boolean ecy_hsm_DATA_ATTR_PUBLIC [0..1]: multiplicity set at pre-compile, origin=RB:0.1.0:2018-01-01, set at pre-compile  # does Data/Key contain public info? | Data/Key contains public information (may be exported)
          boolean ecy_hsm_DATA_ATTR_PRIVATE [0..1]: multiplicity set at pre-compile, origin=RB:0.1.0:2018-01-01, set at pre-compile  # does Data/Key contain private info? | Data/Key contains private information (shall NOT be exported)
          boolean ecy_hsm_DATA_ATTR_MULTISESSION [0..1]: multiplicity set at pre-compile, origin=RB:0.1.0:2018-01-01, set at pre-compile  # is Data/Key multisession capable? | Always set to True. The current version expects this data attribute to be set to true even if there is no effect.
          boolean ecy_hsm_DATA_ATTR_SSS [0..1]: multiplicity set at pre-compile, origin=RB:0.1.0:2018-01-01, set at pre-compile  # is Data/Key SSS only? | Data/Key is only usable by the SSS (Secure Space Script) middleware/applet
        container CONFIG_PROP_SET_3683553978 [0..1]
          enumeration ecy_hsm_RESOURCE_OBJECTS [0..1]: {VOLATILE_BASIC_SHE_RESERVED_KEY}
          integer ecy_hsm_USER_ID [0..1]: 0.., multiplicity set at pre-compile, origin=RB:0.1.0:2018-01-01, set at pre-compile  # User ID | User defined data object ID. The value must be an unique numeric value between 0 and 4294967295. The value itself is not used by the application.
          boolean ecy_hsm_DATA_ATTR_USE_AUTH_GEN [0..1]: multiplicity set at pre-compile, origin=RB:0.1.0:2018-01-01, set at pre-compile  # authentication generation capable data/key? | True: A key restricted to verification and generation usage can be written to this slot. False: A key restricted to verification and generation usage can not be written to this slot. Recommended Value: True. Details: If you want to write a key with property ecy_hsm_CSAI_KEYPROP_MAC_ONLY to this key-slot, set True. ecy_hsm_CSAI_KEYPROP_MAC_ONLY: The key can not be used for encryption and decryption. Important: This attribute does not specify the effective properties of the key-slot, but determines which properties of a given key can be written to this key-slotData/Key may be used for authentication generation.
          boolean ecy_hsm_DATA_ATTR_USE_AUTH_VERIFY [0..1]: multiplicity set at pre-compile, origin=RB:0.1.0:2018-01-01, set at pre-compile  # authentication verification capable data/key? | True: A key restricted to verification and generation usage can be written to this slot. False: A key restricted to verification and generation usage can not be written to this slot. Recommended Value: True. Details: If you want to write a key with property ecy_hsm_CSAI_KEYPROP_MAC_ONLY or ecy_hsm_CSAI_KEYPROP_IS_VERIFY_ONLY to this key-slot, set True. ecy_hsm_CSAI_KEYPROP_MAC_ONLY: The key can not be used for encryption and decryption. ecy_hsm_CSAI_KEYPROP_IS_VERIFY_ONLY: The key can not be used for encryption, decryption and MAC-Generation Important: This attribute does not specify the csai-properties of the key-slot, but determines which csai properties of a given key can be written to this key-slot.
          boolean ecy_hsm_DATA_ATTR_USE_ENCRYPT [0..1]: multiplicity set at pre-compile, origin=RB:0.1.0:2018-01-01, set at pre-compile  # encryption capable data/key? | True: A key restricted to encryption and decryption usage can be written to this slot. False: A key restricted to encryption and decryption usage can not be written to this slot. Recommended Value: True. Details: If you want to write a key with property. ecy_hsm_CSAI_KEYPROP_ENCDEC_ONLY to this key-slot, set True. ecy_hsm_CSAI_KEYPROP_ENCDEC_ONLY: The user can not use the key for the verification or generation of MACs. Important: This attribute does not specify the effective properties of the key-slot, but determines which properties of a given key can be written to this key-slot.
          boolean ecy_hsm_DATA_ATTR_USE_DECRYPT [0..1]: multiplicity set at pre-compile, origin=RB:0.1.0:2018-01-01, set at pre-compile  # decryption capable Data/Key? | True: A key restricted to encryption and decryption usage can be written to this slot. False: A key restricted to encryption and decryption usage can not be written to this slot. Recommended Value: True. Details: If you want to write a key with property . ecy_hsm_CSAI_KEYPROP_ENCDEC_ONLY to this key-slot, set True. ecy_hsm_CSAI_KEYPROP_ENCDEC_ONLY: The user can not use the key for the verification or generation of MACs. Important: This attribute does not specify the effective properties of the key-slot, but determines which properties of a given key can be written to this key-slot.
          boolean ecy_hsm_DATA_ATTR_ALLOW_WRITE [0..1]: multiplicity set at pre-compile, origin=RB:0.1.0:2018-01-01, set at pre-compile  # updatable and/or erasable Data/Key? | True: You can write to this key-slot multiple times. False: You can write to this key-slot only once. Details: True: A user is able to write a key with following properties to the key-slot: ecy_hsm_CSAI_KEYPROP_IS_READONLY_KEY, ecy_hsm_CSAI_KEYPROP_IS_DELETABLE_KEY. False: A user must assign following property to the key, if the key shall be written to the key-slot: ecy_hsm_CSAI_KEYPROP_IS_READONLY_KEY.. Property description: ecy_hsm_CSAI_KEYPROP_IS_READONLY_KEY: The key can only be written once to the slot. Every additional write attempt is rejected. ecy_hsm_CSAI_KEYPROP_IS_DELETABLE_KEY: The user can update the key slot by invoking ecy_hsm_Csai_WriteKeyToNvmKeyStore. Important: This attribute does not specify the effective properties of the key-slot, but determines which properties of a given key can be written to this key-slot.
          boolean ecy_hsm_DATA_ATTR_ALLOW_SECBOOT [0..1]: multiplicity set at pre-compile, origin=RB:0.1.0:2018-01-01, set at pre-compile  # secure boot capable Data/Key? | True: You can write a key to this slot, which can be used if secure boot has failed. False: You can not write a key to this slot, which can be used if secure boot has failed. Details: True: A user is able to write a key without property ecy_hsm_CSAI_KEYPROP_SECURE_BOOT_MUST_PASS to this key-slot. A key can be used even if Secure Boot has failed. False: A user must set the property ecy_hsm_CSAI_KEYPROP_SECURE_BOOT_MUST_PASS, if he wants to write the key to the key-slot. ecy_hsm_CSAI_KEYPROP_SECURE_BOOT_MUST_PASS: The symetric key can only be used when the validation of Secure-Boot resp. Trusted-Boot has been sucessfull.
          boolean ecy_hsm_DATA_ATTR_ALLOW_DEBUG [0..1]: multiplicity set at pre-compile, origin=RB:0.1.0:2018-01-01, set at pre-compile  # debugging capable Data/Key? | True: A key allowing usage with attached debuger, can be written to this slot. False: A key allowing usage with attached debuger, can not be written to this slot. Recommended Value: True. Details: True: A user is allowed to use the key-slot, if a debugger is attached. False: A user must set the property ecy_hsm_CSAI_KEYPROP_LOCKED_ON_DEBUG, if he wants to write the key to the key-slot. ecy_hsm_CSAI_KEYPROP_LOCKED_ON_DEBUG: The key can not be used if a debugger is attached Important: This attribute does not specify the effective properties of the key-slot, but determines which properties of a given key can be written to this key-slot.
          boolean ecy_hsm_DATA_ATTR_ALLOW_WILDCARD [0..1]: multiplicity set at pre-compile, origin=RB:0.1.0:2018-01-01, set at pre-compile  # wildcard key usable for SHE overwriting? | Always set to True. The current version expects this data attribute to be set to true even if there is no effect.
          boolean ecy_hsm_DATA_ATTR_PUBLIC [0..1]: multiplicity set at pre-compile, origin=RB:0.1.0:2018-01-01, set at pre-compile  # does Data/Key contain public info? | Data/Key contains public information (may be exported)
          boolean ecy_hsm_DATA_ATTR_PRIVATE [0..1]: multiplicity set at pre-compile, origin=RB:0.1.0:2018-01-01, set at pre-compile  # does Data/Key contain private info? | Data/Key contains private information (shall NOT be exported)
          boolean ecy_hsm_DATA_ATTR_MULTISESSION [0..1]: multiplicity set at pre-compile, origin=RB:0.1.0:2018-01-01, set at pre-compile  # is Data/Key multisession capable? | Always set to True. The current version expects this data attribute to be set to true even if there is no effect.
          boolean ecy_hsm_DATA_ATTR_SSS [0..1]: multiplicity set at pre-compile, origin=RB:0.1.0:2018-01-01, set at pre-compile  # is Data/Key SSS only? | Data/Key is only usable by the SSS (Secure Space Script) middleware/applet
        container CONFIG_PROP_SET_453517593 [0..1]
          enumeration ecy_hsm_RESOURCE_OBJECTS [0..1]: {VOLATILE_CFG_CMAC_AES_KEY_RAM}
          integer ecy_hsm_USER_ID [0..1]: 0.., multiplicity set at pre-compile, origin=RB:0.1.0:2018-01-01, set at pre-compile  # User ID | User defined data object ID. The value must be an unique numeric value between 0 and 4294967295. The value itself is not used by the application.
          boolean ecy_hsm_DATA_ATTR_USE_AUTH_GEN [0..1]: multiplicity set at pre-compile, origin=RB:0.1.0:2018-01-01, set at pre-compile  # authentication generation capable data/key? | True: A key restricted to verification and generation usage can be written to this slot. False: A key restricted to verification and generation usage can not be written to this slot. Recommended Value: True. Details: If you want to write a key with property ecy_hsm_CSAI_KEYPROP_MAC_ONLY to this key-slot, set True. ecy_hsm_CSAI_KEYPROP_MAC_ONLY: The key can not be used for encryption and decryption. Important: This attribute does not specify the effective properties of the key-slot, but determines which properties of a given key can be written to this key-slotData/Key may be used for authentication generation.
          boolean ecy_hsm_DATA_ATTR_USE_AUTH_VERIFY [0..1]: multiplicity set at pre-compile, origin=RB:0.1.0:2018-01-01, set at pre-compile  # authentication verification capable data/key? | True: A key restricted to verification and generation usage can be written to this slot. False: A key restricted to verification and generation usage can not be written to this slot. Recommended Value: True. Details: If you want to write a key with property ecy_hsm_CSAI_KEYPROP_MAC_ONLY or ecy_hsm_CSAI_KEYPROP_IS_VERIFY_ONLY to this key-slot, set True. ecy_hsm_CSAI_KEYPROP_MAC_ONLY: The key can not be used for encryption and decryption. ecy_hsm_CSAI_KEYPROP_IS_VERIFY_ONLY: The key can not be used for encryption, decryption and MAC-Generation Important: This attribute does not specify the csai-properties of the key-slot, but determines which csai properties of a given key can be written to this key-slot.
          boolean ecy_hsm_DATA_ATTR_USE_ENCRYPT [0..1]: multiplicity set at pre-compile, origin=RB:0.1.0:2018-01-01, set at pre-compile  # encryption capable data/key? | True: A key restricted to encryption and decryption usage can be written to this slot. False: A key restricted to encryption and decryption usage can not be written to this slot. Recommended Value: True. Details: If you want to write a key with property. ecy_hsm_CSAI_KEYPROP_ENCDEC_ONLY to this key-slot, set True. ecy_hsm_CSAI_KEYPROP_ENCDEC_ONLY: The user can not use the key for the verification or generation of MACs. Important: This attribute does not specify the effective properties of the key-slot, but determines which properties of a given key can be written to this key-slot.
          boolean ecy_hsm_DATA_ATTR_USE_DECRYPT [0..1]: multiplicity set at pre-compile, origin=RB:0.1.0:2018-01-01, set at pre-compile  # decryption capable Data/Key? | True: A key restricted to encryption and decryption usage can be written to this slot. False: A key restricted to encryption and decryption usage can not be written to this slot. Recommended Value: True. Details: If you want to write a key with property . ecy_hsm_CSAI_KEYPROP_ENCDEC_ONLY to this key-slot, set True. ecy_hsm_CSAI_KEYPROP_ENCDEC_ONLY: The user can not use the key for the verification or generation of MACs. Important: This attribute does not specify the effective properties of the key-slot, but determines which properties of a given key can be written to this key-slot.
          boolean ecy_hsm_DATA_ATTR_ALLOW_WRITE [0..1]: multiplicity set at pre-compile, origin=RB:0.1.0:2018-01-01, set at pre-compile  # updatable and/or erasable Data/Key? | True: You can write to this key-slot multiple times. False: You can write to this key-slot only once. Details: True: A user is able to write a key with following properties to the key-slot: ecy_hsm_CSAI_KEYPROP_IS_READONLY_KEY, ecy_hsm_CSAI_KEYPROP_IS_DELETABLE_KEY. False: A user must assign following property to the key, if the key shall be written to the key-slot: ecy_hsm_CSAI_KEYPROP_IS_READONLY_KEY.. Property description: ecy_hsm_CSAI_KEYPROP_IS_READONLY_KEY: The key can only be written once to the slot. Every additional write attempt is rejected. ecy_hsm_CSAI_KEYPROP_IS_DELETABLE_KEY: The user can update the key slot by invoking ecy_hsm_Csai_WriteKeyToNvmKeyStore. Important: This attribute does not specify the effective properties of the key-slot, but determines which properties of a given key can be written to this key-slot.
          boolean ecy_hsm_DATA_ATTR_ALLOW_SECBOOT [0..1]: multiplicity set at pre-compile, origin=RB:0.1.0:2018-01-01, set at pre-compile  # secure boot capable Data/Key? | True: You can write a key to this slot, which can be used if secure boot has failed. False: You can not write a key to this slot, which can be used if secure boot has failed. Details: True: A user is able to write a key without property ecy_hsm_CSAI_KEYPROP_SECURE_BOOT_MUST_PASS to this key-slot. A key can be used even if Secure Boot has failed. False: A user must set the property ecy_hsm_CSAI_KEYPROP_SECURE_BOOT_MUST_PASS, if he wants to write the key to the key-slot. ecy_hsm_CSAI_KEYPROP_SECURE_BOOT_MUST_PASS: The symetric key can only be used when the validation of Secure-Boot resp. Trusted-Boot has been sucessfull.
          boolean ecy_hsm_DATA_ATTR_ALLOW_DEBUG [0..1]: multiplicity set at pre-compile, origin=RB:0.1.0:2018-01-01, set at pre-compile  # debugging capable Data/Key? | True: A key allowing usage with attached debuger, can be written to this slot. False: A key allowing usage with attached debuger, can not be written to this slot. Recommended Value: True. Details: True: A user is allowed to use the key-slot, if a debugger is attached. False: A user must set the property ecy_hsm_CSAI_KEYPROP_LOCKED_ON_DEBUG, if he wants to write the key to the key-slot. ecy_hsm_CSAI_KEYPROP_LOCKED_ON_DEBUG: The key can not be used if a debugger is attached Important: This attribute does not specify the effective properties of the key-slot, but determines which properties of a given key can be written to this key-slot.
          boolean ecy_hsm_DATA_ATTR_ALLOW_WILDCARD [0..1]: multiplicity set at pre-compile, origin=RB:0.1.0:2018-01-01, set at pre-compile  # wildcard key usable for SHE overwriting? | Always set to True. The current version expects this data attribute to be set to true even if there is no effect.
          boolean ecy_hsm_DATA_ATTR_PUBLIC [0..1]: multiplicity set at pre-compile, origin=RB:0.1.0:2018-01-01, set at pre-compile  # does Data/Key contain public info? | Data/Key contains public information (may be exported)
          boolean ecy_hsm_DATA_ATTR_PRIVATE [0..1]: multiplicity set at pre-compile, origin=RB:0.1.0:2018-01-01, set at pre-compile  # does Data/Key contain private info? | Data/Key contains private information (shall NOT be exported)
          boolean ecy_hsm_DATA_ATTR_MULTISESSION [0..1]: multiplicity set at pre-compile, origin=RB:0.1.0:2018-01-01, set at pre-compile  # is Data/Key multisession capable? | Always set to True. The current version expects this data attribute to be set to true even if there is no effect.
          boolean ecy_hsm_DATA_ATTR_SSS [0..1]: multiplicity set at pre-compile, origin=RB:0.1.0:2018-01-01, set at pre-compile  # is Data/Key SSS only? | Data/Key is only usable by the SSS (Secure Space Script) middleware/applet
      container DYNAMIC [0..1]
        container CONFIG_PROP_SET_2125065353 [0..1]
          enumeration ecy_hsm_RESOURCE_OBJECTS [0..1]: {DYNAMIC_BASIC_SHE_MASTER_KEY}
          integer ecy_hsm_MAX_NUM_UPDATES [0..1]: 0.., multiplicity set at pre-compile, origin=RB:0.1.0:2018-01-01, set at pre-compile  # maximum number of updates | number of times that a resource in DFLASH can be updated or 0xFFFFFFFF if infinity
          integer ecy_hsm_USER_ID [0..1]: 0.., multiplicity set at pre-compile, origin=RB:0.1.0:2018-01-01, set at pre-compile  # User ID | User defined data object ID. The value must be an unique numeric value between 0 and 4294967295. The value itself is not used by the application.
          enumeration ecy_hsm_MIRROR [0..1]: {USER_DEMAND, BACKGROUND, STARTUP_HSM, STARTUP_HOST}
          boolean ecy_hsm_DATA_ATTR_USE_AUTH_GEN [0..1]: multiplicity set at pre-compile, origin=RB:0.1.0:2018-01-01, set at pre-compile  # authentication generation capable data/key? | True: A key restricted to verification and generation usage can be written to this slot. False: A key restricted to verification and generation usage can not be written to this slot. Recommended Value: True. Details: If you want to write a key with property ecy_hsm_CSAI_KEYPROP_MAC_ONLY to this key-slot, set True. ecy_hsm_CSAI_KEYPROP_MAC_ONLY: The key can not be used for encryption and decryption. Important: This attribute does not specify the effective properties of the key-slot, but determines which properties of a given key can be written to this key-slotData/Key may be used for authentication generation.
          boolean ecy_hsm_DATA_ATTR_USE_AUTH_VERIFY [0..1]: multiplicity set at pre-compile, origin=RB:0.1.0:2018-01-01, set at pre-compile  # authentication verification capable data/key? | True: A key restricted to verification and generation usage can be written to this slot. False: A key restricted to verification and generation usage can not be written to this slot. Recommended Value: True. Details: If you want to write a key with property ecy_hsm_CSAI_KEYPROP_MAC_ONLY or ecy_hsm_CSAI_KEYPROP_IS_VERIFY_ONLY to this key-slot, set True. ecy_hsm_CSAI_KEYPROP_MAC_ONLY: The key can not be used for encryption and decryption. ecy_hsm_CSAI_KEYPROP_IS_VERIFY_ONLY: The key can not be used for encryption, decryption and MAC-Generation Important: This attribute does not specify the csai-properties of the key-slot, but determines which csai properties of a given key can be written to this key-slot.
          boolean ecy_hsm_DATA_ATTR_USE_ENCRYPT [0..1]: multiplicity set at pre-compile, origin=RB:0.1.0:2018-01-01, set at pre-compile  # encryption capable data/key? | True: A key restricted to encryption and decryption usage can be written to this slot. False: A key restricted to encryption and decryption usage can not be written to this slot. Recommended Value: True. Details: If you want to write a key with property. ecy_hsm_CSAI_KEYPROP_ENCDEC_ONLY to this key-slot, set True. ecy_hsm_CSAI_KEYPROP_ENCDEC_ONLY: The user can not use the key for the verification or generation of MACs. Important: This attribute does not specify the effective properties of the key-slot, but determines which properties of a given key can be written to this key-slot.
          boolean ecy_hsm_DATA_ATTR_USE_DECRYPT [0..1]: multiplicity set at pre-compile, origin=RB:0.1.0:2018-01-01, set at pre-compile  # decryption capable Data/Key? | True: A key restricted to encryption and decryption usage can be written to this slot. False: A key restricted to encryption and decryption usage can not be written to this slot. Recommended Value: True. Details: If you want to write a key with property . ecy_hsm_CSAI_KEYPROP_ENCDEC_ONLY to this key-slot, set True. ecy_hsm_CSAI_KEYPROP_ENCDEC_ONLY: The user can not use the key for the verification or generation of MACs. Important: This attribute does not specify the effective properties of the key-slot, but determines which properties of a given key can be written to this key-slot.
          boolean ecy_hsm_DATA_ATTR_ALLOW_WRITE [0..1]: multiplicity set at pre-compile, origin=RB:0.1.0:2018-01-01, set at pre-compile  # updatable and/or erasable Data/Key? | True: You can write to this key-slot multiple times. False: You can write to this key-slot only once. Details: True: A user is able to write a key with following properties to the key-slot: ecy_hsm_CSAI_KEYPROP_IS_READONLY_KEY, ecy_hsm_CSAI_KEYPROP_IS_DELETABLE_KEY. False: A user must assign following property to the key, if the key shall be written to the key-slot: ecy_hsm_CSAI_KEYPROP_IS_READONLY_KEY.. Property description: ecy_hsm_CSAI_KEYPROP_IS_READONLY_KEY: The key can only be written once to the slot. Every additional write attempt is rejected. ecy_hsm_CSAI_KEYPROP_IS_DELETABLE_KEY: The user can update the key slot by invoking ecy_hsm_Csai_WriteKeyToNvmKeyStore. Important: This attribute does not specify the effective properties of the key-slot, but determines which properties of a given key can be written to this key-slot.
          boolean ecy_hsm_DATA_ATTR_ALLOW_SECBOOT [0..1]: multiplicity set at pre-compile, origin=RB:0.1.0:2018-01-01, set at pre-compile  # secure boot capable Data/Key? | True: You can write a key to this slot, which can be used if secure boot has failed. False: You can not write a key to this slot, which can be used if secure boot has failed. Details: True: A user is able to write a key without property ecy_hsm_CSAI_KEYPROP_SECURE_BOOT_MUST_PASS to this key-slot. A key can be used even if Secure Boot has failed. False: A user must set the property ecy_hsm_CSAI_KEYPROP_SECURE_BOOT_MUST_PASS, if he wants to write the key to the key-slot. ecy_hsm_CSAI_KEYPROP_SECURE_BOOT_MUST_PASS: The symetric key can only be used when the validation of Secure-Boot resp. Trusted-Boot has been sucessfull.
          boolean ecy_hsm_DATA_ATTR_ALLOW_DEBUG [0..1]: multiplicity set at pre-compile, origin=RB:0.1.0:2018-01-01, set at pre-compile  # debugging capable Data/Key? | True: A key allowing usage with attached debuger, can be written to this slot. False: A key allowing usage with attached debuger, can not be written to this slot. Recommended Value: True. Details: True: A user is allowed to use the key-slot, if a debugger is attached. False: A user must set the property ecy_hsm_CSAI_KEYPROP_LOCKED_ON_DEBUG, if he wants to write the key to the key-slot. ecy_hsm_CSAI_KEYPROP_LOCKED_ON_DEBUG: The key can not be used if a debugger is attached Important: This attribute does not specify the effective properties of the key-slot, but determines which properties of a given key can be written to this key-slot.
          boolean ecy_hsm_DATA_ATTR_ALLOW_WILDCARD [0..1]: multiplicity set at pre-compile, origin=RB:0.1.0:2018-01-01, set at pre-compile  # wildcard key usable for SHE overwriting? | Always set to True. The current version expects this data attribute to be set to true even if there is no effect.
          boolean ecy_hsm_DATA_ATTR_PUBLIC [0..1]: multiplicity set at pre-compile, origin=RB:0.1.0:2018-01-01, set at pre-compile  # does Data/Key contain public info? | Data/Key contains public information (may be exported)
          boolean ecy_hsm_DATA_ATTR_PRIVATE [0..1]: multiplicity set at pre-compile, origin=RB:0.1.0:2018-01-01, set at pre-compile  # does Data/Key contain private info? | Data/Key contains private information (shall NOT be exported)
          boolean ecy_hsm_DATA_ATTR_MULTISESSION [0..1]: multiplicity set at pre-compile, origin=RB:0.1.0:2018-01-01, set at pre-compile  # is Data/Key multisession capable? | Always set to True. The current version expects this data attribute to be set to true even if there is no effect.
          boolean ecy_hsm_DATA_ATTR_SSS [0..1]: multiplicity set at pre-compile, origin=RB:0.1.0:2018-01-01, set at pre-compile  # is Data/Key SSS only? | Data/Key is only usable by the SSS (Secure Space Script) middleware/applet
        container CONFIG_PROP_SET_3818139633 [0..1]
          enumeration ecy_hsm_RESOURCE_OBJECTS [0..1]: {DYNAMIC_BASIC_SHE_BOOT_KEY}
          integer ecy_hsm_MAX_NUM_UPDATES [0..1]: 0.., multiplicity set at pre-compile, origin=RB:0.1.0:2018-01-01, set at pre-compile  # maximum number of updates | number of times that a resource in DFLASH can be updated or 0xFFFFFFFF if infinity
          integer ecy_hsm_USER_ID [0..1]: 0.., multiplicity set at pre-compile, origin=RB:0.1.0:2018-01-01, set at pre-compile  # User ID | User defined data object ID. The value must be an unique numeric value between 0 and 4294967295. The value itself is not used by the application.
          enumeration ecy_hsm_MIRROR [0..1]: {USER_DEMAND, BACKGROUND, STARTUP_HSM, STARTUP_HOST}
          boolean ecy_hsm_DATA_ATTR_USE_AUTH_GEN [0..1]: multiplicity set at pre-compile, origin=RB:0.1.0:2018-01-01, set at pre-compile  # authentication generation capable data/key? | True: A key restricted to verification and generation usage can be written to this slot. False: A key restricted to verification and generation usage can not be written to this slot. Recommended Value: True. Details: If you want to write a key with property ecy_hsm_CSAI_KEYPROP_MAC_ONLY to this key-slot, set True. ecy_hsm_CSAI_KEYPROP_MAC_ONLY: The key can not be used for encryption and decryption. Important: This attribute does not specify the effective properties of the key-slot, but determines which properties of a given key can be written to this key-slotData/Key may be used for authentication generation.
          boolean ecy_hsm_DATA_ATTR_USE_AUTH_VERIFY [0..1]: multiplicity set at pre-compile, origin=RB:0.1.0:2018-01-01, set at pre-compile  # authentication verification capable data/key? | True: A key restricted to verification and generation usage can be written to this slot. False: A key restricted to verification and generation usage can not be written to this slot. Recommended Value: True. Details: If you want to write a key with property ecy_hsm_CSAI_KEYPROP_MAC_ONLY or ecy_hsm_CSAI_KEYPROP_IS_VERIFY_ONLY to this key-slot, set True. ecy_hsm_CSAI_KEYPROP_MAC_ONLY: The key can not be used for encryption and decryption. ecy_hsm_CSAI_KEYPROP_IS_VERIFY_ONLY: The key can not be used for encryption, decryption and MAC-Generation Important: This attribute does not specify the csai-properties of the key-slot, but determines which csai properties of a given key can be written to this key-slot.
          boolean ecy_hsm_DATA_ATTR_USE_ENCRYPT [0..1]: multiplicity set at pre-compile, origin=RB:0.1.0:2018-01-01, set at pre-compile  # encryption capable data/key? | True: A key restricted to encryption and decryption usage can be written to this slot. False: A key restricted to encryption and decryption usage can not be written to this slot. Recommended Value: True. Details: If you want to write a key with property. ecy_hsm_CSAI_KEYPROP_ENCDEC_ONLY to this key-slot, set True. ecy_hsm_CSAI_KEYPROP_ENCDEC_ONLY: The user can not use the key for the verification or generation of MACs. Important: This attribute does not specify the effective properties of the key-slot, but determines which properties of a given key can be written to this key-slot.
          boolean ecy_hsm_DATA_ATTR_USE_DECRYPT [0..1]: multiplicity set at pre-compile, origin=RB:0.1.0:2018-01-01, set at pre-compile  # decryption capable Data/Key? | True: A key restricted to encryption and decryption usage can be written to this slot. False: A key restricted to encryption and decryption usage can not be written to this slot. Recommended Value: True. Details: If you want to write a key with property . ecy_hsm_CSAI_KEYPROP_ENCDEC_ONLY to this key-slot, set True. ecy_hsm_CSAI_KEYPROP_ENCDEC_ONLY: The user can not use the key for the verification or generation of MACs. Important: This attribute does not specify the effective properties of the key-slot, but determines which properties of a given key can be written to this key-slot.
          boolean ecy_hsm_DATA_ATTR_ALLOW_WRITE [0..1]: multiplicity set at pre-compile, origin=RB:0.1.0:2018-01-01, set at pre-compile  # updatable and/or erasable Data/Key? | True: You can write to this key-slot multiple times. False: You can write to this key-slot only once. Details: True: A user is able to write a key with following properties to the key-slot: ecy_hsm_CSAI_KEYPROP_IS_READONLY_KEY, ecy_hsm_CSAI_KEYPROP_IS_DELETABLE_KEY. False: A user must assign following property to the key, if the key shall be written to the key-slot: ecy_hsm_CSAI_KEYPROP_IS_READONLY_KEY.. Property description: ecy_hsm_CSAI_KEYPROP_IS_READONLY_KEY: The key can only be written once to the slot. Every additional write attempt is rejected. ecy_hsm_CSAI_KEYPROP_IS_DELETABLE_KEY: The user can update the key slot by invoking ecy_hsm_Csai_WriteKeyToNvmKeyStore. Important: This attribute does not specify the effective properties of the key-slot, but determines which properties of a given key can be written to this key-slot.
          boolean ecy_hsm_DATA_ATTR_ALLOW_SECBOOT [0..1]: multiplicity set at pre-compile, origin=RB:0.1.0:2018-01-01, set at pre-compile  # secure boot capable Data/Key? | True: You can write a key to this slot, which can be used if secure boot has failed. False: You can not write a key to this slot, which can be used if secure boot has failed. Details: True: A user is able to write a key without property ecy_hsm_CSAI_KEYPROP_SECURE_BOOT_MUST_PASS to this key-slot. A key can be used even if Secure Boot has failed. False: A user must set the property ecy_hsm_CSAI_KEYPROP_SECURE_BOOT_MUST_PASS, if he wants to write the key to the key-slot. ecy_hsm_CSAI_KEYPROP_SECURE_BOOT_MUST_PASS: The symetric key can only be used when the validation of Secure-Boot resp. Trusted-Boot has been sucessfull.
          boolean ecy_hsm_DATA_ATTR_ALLOW_DEBUG [0..1]: multiplicity set at pre-compile, origin=RB:0.1.0:2018-01-01, set at pre-compile  # debugging capable Data/Key? | True: A key allowing usage with attached debuger, can be written to this slot. False: A key allowing usage with attached debuger, can not be written to this slot. Recommended Value: True. Details: True: A user is allowed to use the key-slot, if a debugger is attached. False: A user must set the property ecy_hsm_CSAI_KEYPROP_LOCKED_ON_DEBUG, if he wants to write the key to the key-slot. ecy_hsm_CSAI_KEYPROP_LOCKED_ON_DEBUG: The key can not be used if a debugger is attached Important: This attribute does not specify the effective properties of the key-slot, but determines which properties of a given key can be written to this key-slot.
          boolean ecy_hsm_DATA_ATTR_ALLOW_WILDCARD [0..1]: multiplicity set at pre-compile, origin=RB:0.1.0:2018-01-01, set at pre-compile  # wildcard key usable for SHE overwriting? | Always set to True. The current version expects this data attribute to be set to true even if there is no effect.
          boolean ecy_hsm_DATA_ATTR_PUBLIC [0..1]: multiplicity set at pre-compile, origin=RB:0.1.0:2018-01-01, set at pre-compile  # does Data/Key contain public info? | Data/Key contains public information (may be exported)
          boolean ecy_hsm_DATA_ATTR_PRIVATE [0..1]: multiplicity set at pre-compile, origin=RB:0.1.0:2018-01-01, set at pre-compile  # does Data/Key contain private info? | Data/Key contains private information (shall NOT be exported)
          boolean ecy_hsm_DATA_ATTR_MULTISESSION [0..1]: multiplicity set at pre-compile, origin=RB:0.1.0:2018-01-01, set at pre-compile  # is Data/Key multisession capable? | Always set to True. The current version expects this data attribute to be set to true even if there is no effect.
          boolean ecy_hsm_DATA_ATTR_SSS [0..1]: multiplicity set at pre-compile, origin=RB:0.1.0:2018-01-01, set at pre-compile  # is Data/Key SSS only? | Data/Key is only usable by the SSS (Secure Space Script) middleware/applet
        container CONFIG_PROP_SET_1363862004 [0..1]
          enumeration ecy_hsm_RESOURCE_OBJECTS [0..1]: {DYNAMIC_BASIC_SHE_MAC_KEY}
          integer ecy_hsm_MAX_NUM_UPDATES [0..1]: 0.., multiplicity set at pre-compile, origin=RB:0.1.0:2018-01-01, set at pre-compile  # maximum number of updates | number of times that a resource in DFLASH can be updated or 0xFFFFFFFF if infinity
          integer ecy_hsm_USER_ID [0..1]: 0.., multiplicity set at pre-compile, origin=RB:0.1.0:2018-01-01, set at pre-compile  # User ID | User defined data object ID. The value must be an unique numeric value between 0 and 4294967295. The value itself is not used by the application.
          enumeration ecy_hsm_MIRROR [0..1]: {USER_DEMAND, BACKGROUND, STARTUP_HSM, STARTUP_HOST}
          boolean ecy_hsm_DATA_ATTR_USE_AUTH_GEN [0..1]: multiplicity set at pre-compile, origin=RB:0.1.0:2018-01-01, set at pre-compile  # authentication generation capable data/key? | True: A key restricted to verification and generation usage can be written to this slot. False: A key restricted to verification and generation usage can not be written to this slot. Recommended Value: True. Details: If you want to write a key with property ecy_hsm_CSAI_KEYPROP_MAC_ONLY to this key-slot, set True. ecy_hsm_CSAI_KEYPROP_MAC_ONLY: The key can not be used for encryption and decryption. Important: This attribute does not specify the effective properties of the key-slot, but determines which properties of a given key can be written to this key-slotData/Key may be used for authentication generation.
          boolean ecy_hsm_DATA_ATTR_USE_AUTH_VERIFY [0..1]: multiplicity set at pre-compile, origin=RB:0.1.0:2018-01-01, set at pre-compile  # authentication verification capable data/key? | True: A key restricted to verification and generation usage can be written to this slot. False: A key restricted to verification and generation usage can not be written to this slot. Recommended Value: True. Details: If you want to write a key with property ecy_hsm_CSAI_KEYPROP_MAC_ONLY or ecy_hsm_CSAI_KEYPROP_IS_VERIFY_ONLY to this key-slot, set True. ecy_hsm_CSAI_KEYPROP_MAC_ONLY: The key can not be used for encryption and decryption. ecy_hsm_CSAI_KEYPROP_IS_VERIFY_ONLY: The key can not be used for encryption, decryption and MAC-Generation Important: This attribute does not specify the csai-properties of the key-slot, but determines which csai properties of a given key can be written to this key-slot.
          boolean ecy_hsm_DATA_ATTR_USE_ENCRYPT [0..1]: multiplicity set at pre-compile, origin=RB:0.1.0:2018-01-01, set at pre-compile  # encryption capable data/key? | True: A key restricted to encryption and decryption usage can be written to this slot. False: A key restricted to encryption and decryption usage can not be written to this slot. Recommended Value: True. Details: If you want to write a key with property. ecy_hsm_CSAI_KEYPROP_ENCDEC_ONLY to this key-slot, set True. ecy_hsm_CSAI_KEYPROP_ENCDEC_ONLY: The user can not use the key for the verification or generation of MACs. Important: This attribute does not specify the effective properties of the key-slot, but determines which properties of a given key can be written to this key-slot.
          boolean ecy_hsm_DATA_ATTR_USE_DECRYPT [0..1]: multiplicity set at pre-compile, origin=RB:0.1.0:2018-01-01, set at pre-compile  # decryption capable Data/Key? | True: A key restricted to encryption and decryption usage can be written to this slot. False: A key restricted to encryption and decryption usage can not be written to this slot. Recommended Value: True. Details: If you want to write a key with property . ecy_hsm_CSAI_KEYPROP_ENCDEC_ONLY to this key-slot, set True. ecy_hsm_CSAI_KEYPROP_ENCDEC_ONLY: The user can not use the key for the verification or generation of MACs. Important: This attribute does not specify the effective properties of the key-slot, but determines which properties of a given key can be written to this key-slot.
          boolean ecy_hsm_DATA_ATTR_ALLOW_WRITE [0..1]: multiplicity set at pre-compile, origin=RB:0.1.0:2018-01-01, set at pre-compile  # updatable and/or erasable Data/Key? | True: You can write to this key-slot multiple times. False: You can write to this key-slot only once. Details: True: A user is able to write a key with following properties to the key-slot: ecy_hsm_CSAI_KEYPROP_IS_READONLY_KEY, ecy_hsm_CSAI_KEYPROP_IS_DELETABLE_KEY. False: A user must assign following property to the key, if the key shall be written to the key-slot: ecy_hsm_CSAI_KEYPROP_IS_READONLY_KEY.. Property description: ecy_hsm_CSAI_KEYPROP_IS_READONLY_KEY: The key can only be written once to the slot. Every additional write attempt is rejected. ecy_hsm_CSAI_KEYPROP_IS_DELETABLE_KEY: The user can update the key slot by invoking ecy_hsm_Csai_WriteKeyToNvmKeyStore. Important: This attribute does not specify the effective properties of the key-slot, but determines which properties of a given key can be written to this key-slot.
          boolean ecy_hsm_DATA_ATTR_ALLOW_SECBOOT [0..1]: multiplicity set at pre-compile, origin=RB:0.1.0:2018-01-01, set at pre-compile  # secure boot capable Data/Key? | True: You can write a key to this slot, which can be used if secure boot has failed. False: You can not write a key to this slot, which can be used if secure boot has failed. Details: True: A user is able to write a key without property ecy_hsm_CSAI_KEYPROP_SECURE_BOOT_MUST_PASS to this key-slot. A key can be used even if Secure Boot has failed. False: A user must set the property ecy_hsm_CSAI_KEYPROP_SECURE_BOOT_MUST_PASS, if he wants to write the key to the key-slot. ecy_hsm_CSAI_KEYPROP_SECURE_BOOT_MUST_PASS: The symetric key can only be used when the validation of Secure-Boot resp. Trusted-Boot has been sucessfull.
          boolean ecy_hsm_DATA_ATTR_ALLOW_DEBUG [0..1]: multiplicity set at pre-compile, origin=RB:0.1.0:2018-01-01, set at pre-compile  # debugging capable Data/Key? | True: A key allowing usage with attached debuger, can be written to this slot. False: A key allowing usage with attached debuger, can not be written to this slot. Recommended Value: True. Details: True: A user is allowed to use the key-slot, if a debugger is attached. False: A user must set the property ecy_hsm_CSAI_KEYPROP_LOCKED_ON_DEBUG, if he wants to write the key to the key-slot. ecy_hsm_CSAI_KEYPROP_LOCKED_ON_DEBUG: The key can not be used if a debugger is attached Important: This attribute does not specify the effective properties of the key-slot, but determines which properties of a given key can be written to this key-slot.
          boolean ecy_hsm_DATA_ATTR_ALLOW_WILDCARD [0..1]: multiplicity set at pre-compile, origin=RB:0.1.0:2018-01-01, set at pre-compile  # wildcard key usable for SHE overwriting? | Always set to True. The current version expects this data attribute to be set to true even if there is no effect.
          boolean ecy_hsm_DATA_ATTR_PUBLIC [0..1]: multiplicity set at pre-compile, origin=RB:0.1.0:2018-01-01, set at pre-compile  # does Data/Key contain public info? | Data/Key contains public information (may be exported)
          boolean ecy_hsm_DATA_ATTR_PRIVATE [0..1]: multiplicity set at pre-compile, origin=RB:0.1.0:2018-01-01, set at pre-compile  # does Data/Key contain private info? | Data/Key contains private information (shall NOT be exported)
          boolean ecy_hsm_DATA_ATTR_MULTISESSION [0..1]: multiplicity set at pre-compile, origin=RB:0.1.0:2018-01-01, set at pre-compile  # is Data/Key multisession capable? | Always set to True. The current version expects this data attribute to be set to true even if there is no effect.
          boolean ecy_hsm_DATA_ATTR_SSS [0..1]: multiplicity set at pre-compile, origin=RB:0.1.0:2018-01-01, set at pre-compile  # is Data/Key SSS only? | Data/Key is only usable by the SSS (Secure Space Script) middleware/applet
        container CONFIG_PROP_SET_2953609807 [0..10]
          enumeration ecy_hsm_RESOURCE_OBJECTS [0..1]: {DYNAMIC_BASIC_SHE_DFLASH_KEY_BASE_0, DYNAMIC_BASIC_SHE_DFLASH_KEY_INST_1, DYNAMIC_BASIC_SHE_DFLASH_KEY_INST_2, DYNAMIC_BASIC_SHE_DFLASH_KEY_INST_3, DYNAMIC_BASIC_SHE_DFLASH_KEY_INST_4, DYNAMIC_BASIC_SHE_DFLASH_KEY_INST_5, DYNAMIC_BASIC_SHE_DFLASH_KEY_INST_6, DYNAMIC_BASIC_SHE_DFLASH_KEY_INST_7, DYNAMIC_BASIC_SHE_DFLASH_KEY_INST_8, DYNAMIC_BASIC_SHE_DFLASH_KEY_INST_9}
          integer ecy_hsm_MAX_NUM_UPDATES [0..1]: 0.., multiplicity set at pre-compile, origin=RB:0.1.0:2018-01-01, set at pre-compile  # maximum number of updates | number of times that a resource in DFLASH can be updated or 0xFFFFFFFF if infinity
          integer ecy_hsm_USER_ID [0..1]: 0.., multiplicity set at pre-compile, origin=RB:0.1.0:2018-01-01, set at pre-compile  # User ID | User defined data object ID. The value must be an unique numeric value between 0 and 4294967295. The value itself is not used by the application.
          enumeration ecy_hsm_MIRROR [0..1]: {USER_DEMAND, BACKGROUND, STARTUP_HSM, STARTUP_HOST}
          boolean ecy_hsm_DATA_ATTR_USE_AUTH_GEN [0..1]: multiplicity set at pre-compile, origin=RB:0.1.0:2018-01-01, set at pre-compile  # authentication generation capable data/key? | True: A key restricted to verification and generation usage can be written to this slot. False: A key restricted to verification and generation usage can not be written to this slot. Recommended Value: True. Details: If you want to write a key with property ecy_hsm_CSAI_KEYPROP_MAC_ONLY to this key-slot, set True. ecy_hsm_CSAI_KEYPROP_MAC_ONLY: The key can not be used for encryption and decryption. Important: This attribute does not specify the effective properties of the key-slot, but determines which properties of a given key can be written to this key-slotData/Key may be used for authentication generation.
          boolean ecy_hsm_DATA_ATTR_USE_AUTH_VERIFY [0..1]: multiplicity set at pre-compile, origin=RB:0.1.0:2018-01-01, set at pre-compile  # authentication verification capable data/key? | True: A key restricted to verification and generation usage can be written to this slot. False: A key restricted to verification and generation usage can not be written to this slot. Recommended Value: True. Details: If you want to write a key with property ecy_hsm_CSAI_KEYPROP_MAC_ONLY or ecy_hsm_CSAI_KEYPROP_IS_VERIFY_ONLY to this key-slot, set True. ecy_hsm_CSAI_KEYPROP_MAC_ONLY: The key can not be used for encryption and decryption. ecy_hsm_CSAI_KEYPROP_IS_VERIFY_ONLY: The key can not be used for encryption, decryption and MAC-Generation Important: This attribute does not specify the csai-properties of the key-slot, but determines which csai properties of a given key can be written to this key-slot.
          boolean ecy_hsm_DATA_ATTR_USE_ENCRYPT [0..1]: multiplicity set at pre-compile, origin=RB:0.1.0:2018-01-01, set at pre-compile  # encryption capable data/key? | True: A key restricted to encryption and decryption usage can be written to this slot. False: A key restricted to encryption and decryption usage can not be written to this slot. Recommended Value: True. Details: If you want to write a key with property. ecy_hsm_CSAI_KEYPROP_ENCDEC_ONLY to this key-slot, set True. ecy_hsm_CSAI_KEYPROP_ENCDEC_ONLY: The user can not use the key for the verification or generation of MACs. Important: This attribute does not specify the effective properties of the key-slot, but determines which properties of a given key can be written to this key-slot.
          boolean ecy_hsm_DATA_ATTR_USE_DECRYPT [0..1]: multiplicity set at pre-compile, origin=RB:0.1.0:2018-01-01, set at pre-compile  # decryption capable Data/Key? | True: A key restricted to encryption and decryption usage can be written to this slot. False: A key restricted to encryption and decryption usage can not be written to this slot. Recommended Value: True. Details: If you want to write a key with property . ecy_hsm_CSAI_KEYPROP_ENCDEC_ONLY to this key-slot, set True. ecy_hsm_CSAI_KEYPROP_ENCDEC_ONLY: The user can not use the key for the verification or generation of MACs. Important: This attribute does not specify the effective properties of the key-slot, but determines which properties of a given key can be written to this key-slot.
          boolean ecy_hsm_DATA_ATTR_ALLOW_WRITE [0..1]: multiplicity set at pre-compile, origin=RB:0.1.0:2018-01-01, set at pre-compile  # updatable and/or erasable Data/Key? | True: You can write to this key-slot multiple times. False: You can write to this key-slot only once. Details: True: A user is able to write a key with following properties to the key-slot: ecy_hsm_CSAI_KEYPROP_IS_READONLY_KEY, ecy_hsm_CSAI_KEYPROP_IS_DELETABLE_KEY. False: A user must assign following property to the key, if the key shall be written to the key-slot: ecy_hsm_CSAI_KEYPROP_IS_READONLY_KEY.. Property description: ecy_hsm_CSAI_KEYPROP_IS_READONLY_KEY: The key can only be written once to the slot. Every additional write attempt is rejected. ecy_hsm_CSAI_KEYPROP_IS_DELETABLE_KEY: The user can update the key slot by invoking ecy_hsm_Csai_WriteKeyToNvmKeyStore. Important: This attribute does not specify the effective properties of the key-slot, but determines which properties of a given key can be written to this key-slot.
          boolean ecy_hsm_DATA_ATTR_ALLOW_SECBOOT [0..1]: multiplicity set at pre-compile, origin=RB:0.1.0:2018-01-01, set at pre-compile  # secure boot capable Data/Key? | True: You can write a key to this slot, which can be used if secure boot has failed. False: You can not write a key to this slot, which can be used if secure boot has failed. Details: True: A user is able to write a key without property ecy_hsm_CSAI_KEYPROP_SECURE_BOOT_MUST_PASS to this key-slot. A key can be used even if Secure Boot has failed. False: A user must set the property ecy_hsm_CSAI_KEYPROP_SECURE_BOOT_MUST_PASS, if he wants to write the key to the key-slot. ecy_hsm_CSAI_KEYPROP_SECURE_BOOT_MUST_PASS: The symetric key can only be used when the validation of Secure-Boot resp. Trusted-Boot has been sucessfull.
          boolean ecy_hsm_DATA_ATTR_ALLOW_DEBUG [0..1]: multiplicity set at pre-compile, origin=RB:0.1.0:2018-01-01, set at pre-compile  # debugging capable Data/Key? | True: A key allowing usage with attached debuger, can be written to this slot. False: A key allowing usage with attached debuger, can not be written to this slot. Recommended Value: True. Details: True: A user is allowed to use the key-slot, if a debugger is attached. False: A user must set the property ecy_hsm_CSAI_KEYPROP_LOCKED_ON_DEBUG, if he wants to write the key to the key-slot. ecy_hsm_CSAI_KEYPROP_LOCKED_ON_DEBUG: The key can not be used if a debugger is attached Important: This attribute does not specify the effective properties of the key-slot, but determines which properties of a given key can be written to this key-slot.
          boolean ecy_hsm_DATA_ATTR_ALLOW_WILDCARD [0..1]: multiplicity set at pre-compile, origin=RB:0.1.0:2018-01-01, set at pre-compile  # wildcard key usable for SHE overwriting? | Always set to True. The current version expects this data attribute to be set to true even if there is no effect.
          boolean ecy_hsm_DATA_ATTR_PUBLIC [0..1]: multiplicity set at pre-compile, origin=RB:0.1.0:2018-01-01, set at pre-compile  # does Data/Key contain public info? | Data/Key contains public information (may be exported)
          boolean ecy_hsm_DATA_ATTR_PRIVATE [0..1]: multiplicity set at pre-compile, origin=RB:0.1.0:2018-01-01, set at pre-compile  # does Data/Key contain private info? | Data/Key contains private information (shall NOT be exported)
          boolean ecy_hsm_DATA_ATTR_MULTISESSION [0..1]: multiplicity set at pre-compile, origin=RB:0.1.0:2018-01-01, set at pre-compile  # is Data/Key multisession capable? | Always set to True. The current version expects this data attribute to be set to true even if there is no effect.
          boolean ecy_hsm_DATA_ATTR_SSS [0..1]: multiplicity set at pre-compile, origin=RB:0.1.0:2018-01-01, set at pre-compile  # is Data/Key SSS only? | Data/Key is only usable by the SSS (Secure Space Script) middleware/applet
        container CONFIG_PROP_SET_1070472209 [0..10]
          enumeration ecy_hsm_RESOURCE_OBJECTS [0..1]: {DYNAMIC_EXT_SHE_DFLASH_KEY_BASE_0, DYNAMIC_EXT_SHE_DFLASH_KEY_INST_1, DYNAMIC_EXT_SHE_DFLASH_KEY_INST_2, DYNAMIC_EXT_SHE_DFLASH_KEY_INST_3, DYNAMIC_EXT_SHE_DFLASH_KEY_INST_4, DYNAMIC_EXT_SHE_DFLASH_KEY_INST_5, DYNAMIC_EXT_SHE_DFLASH_KEY_INST_6, DYNAMIC_EXT_SHE_DFLASH_KEY_INST_7, DYNAMIC_EXT_SHE_DFLASH_KEY_INST_8, DYNAMIC_EXT_SHE_DFLASH_KEY_INST_9}
          integer ecy_hsm_MAX_NUM_UPDATES [0..1]: 0.., multiplicity set at pre-compile, origin=RB:0.1.0:2018-01-01, set at pre-compile  # maximum number of updates | number of times that a resource in DFLASH can be updated or 0xFFFFFFFF if infinity
          integer ecy_hsm_USER_ID [0..1]: 0.., multiplicity set at pre-compile, origin=RB:0.1.0:2018-01-01, set at pre-compile  # User ID | User defined data object ID. The value must be an unique numeric value between 0 and 4294967295. The value itself is not used by the application.
          enumeration ecy_hsm_MIRROR [0..1]: {USER_DEMAND, BACKGROUND, STARTUP_HSM, STARTUP_HOST}
          boolean ecy_hsm_DATA_ATTR_USE_AUTH_GEN [0..1]: multiplicity set at pre-compile, origin=RB:0.1.0:2018-01-01, set at pre-compile  # authentication generation capable data/key? | True: A key restricted to verification and generation usage can be written to this slot. False: A key restricted to verification and generation usage can not be written to this slot. Recommended Value: True. Details: If you want to write a key with property ecy_hsm_CSAI_KEYPROP_MAC_ONLY to this key-slot, set True. ecy_hsm_CSAI_KEYPROP_MAC_ONLY: The key can not be used for encryption and decryption. Important: This attribute does not specify the effective properties of the key-slot, but determines which properties of a given key can be written to this key-slotData/Key may be used for authentication generation.
          boolean ecy_hsm_DATA_ATTR_USE_AUTH_VERIFY [0..1]: multiplicity set at pre-compile, origin=RB:0.1.0:2018-01-01, set at pre-compile  # authentication verification capable data/key? | True: A key restricted to verification and generation usage can be written to this slot. False: A key restricted to verification and generation usage can not be written to this slot. Recommended Value: True. Details: If you want to write a key with property ecy_hsm_CSAI_KEYPROP_MAC_ONLY or ecy_hsm_CSAI_KEYPROP_IS_VERIFY_ONLY to this key-slot, set True. ecy_hsm_CSAI_KEYPROP_MAC_ONLY: The key can not be used for encryption and decryption. ecy_hsm_CSAI_KEYPROP_IS_VERIFY_ONLY: The key can not be used for encryption, decryption and MAC-Generation Important: This attribute does not specify the csai-properties of the key-slot, but determines which csai properties of a given key can be written to this key-slot.
          boolean ecy_hsm_DATA_ATTR_USE_ENCRYPT [0..1]: multiplicity set at pre-compile, origin=RB:0.1.0:2018-01-01, set at pre-compile  # encryption capable data/key? | True: A key restricted to encryption and decryption usage can be written to this slot. False: A key restricted to encryption and decryption usage can not be written to this slot. Recommended Value: True. Details: If you want to write a key with property. ecy_hsm_CSAI_KEYPROP_ENCDEC_ONLY to this key-slot, set True. ecy_hsm_CSAI_KEYPROP_ENCDEC_ONLY: The user can not use the key for the verification or generation of MACs. Important: This attribute does not specify the effective properties of the key-slot, but determines which properties of a given key can be written to this key-slot.
          boolean ecy_hsm_DATA_ATTR_USE_DECRYPT [0..1]: multiplicity set at pre-compile, origin=RB:0.1.0:2018-01-01, set at pre-compile  # decryption capable Data/Key? | True: A key restricted to encryption and decryption usage can be written to this slot. False: A key restricted to encryption and decryption usage can not be written to this slot. Recommended Value: True. Details: If you want to write a key with property . ecy_hsm_CSAI_KEYPROP_ENCDEC_ONLY to this key-slot, set True. ecy_hsm_CSAI_KEYPROP_ENCDEC_ONLY: The user can not use the key for the verification or generation of MACs. Important: This attribute does not specify the effective properties of the key-slot, but determines which properties of a given key can be written to this key-slot.
          boolean ecy_hsm_DATA_ATTR_ALLOW_WRITE [0..1]: multiplicity set at pre-compile, origin=RB:0.1.0:2018-01-01, set at pre-compile  # updatable and/or erasable Data/Key? | True: You can write to this key-slot multiple times. False: You can write to this key-slot only once. Details: True: A user is able to write a key with following properties to the key-slot: ecy_hsm_CSAI_KEYPROP_IS_READONLY_KEY, ecy_hsm_CSAI_KEYPROP_IS_DELETABLE_KEY. False: A user must assign following property to the key, if the key shall be written to the key-slot: ecy_hsm_CSAI_KEYPROP_IS_READONLY_KEY.. Property description: ecy_hsm_CSAI_KEYPROP_IS_READONLY_KEY: The key can only be written once to the slot. Every additional write attempt is rejected. ecy_hsm_CSAI_KEYPROP_IS_DELETABLE_KEY: The user can update the key slot by invoking ecy_hsm_Csai_WriteKeyToNvmKeyStore. Important: This attribute does not specify the effective properties of the key-slot, but determines which properties of a given key can be written to this key-slot.
          boolean ecy_hsm_DATA_ATTR_ALLOW_SECBOOT [0..1]: multiplicity set at pre-compile, origin=RB:0.1.0:2018-01-01, set at pre-compile  # secure boot capable Data/Key? | True: You can write a key to this slot, which can be used if secure boot has failed. False: You can not write a key to this slot, which can be used if secure boot has failed. Details: True: A user is able to write a key without property ecy_hsm_CSAI_KEYPROP_SECURE_BOOT_MUST_PASS to this key-slot. A key can be used even if Secure Boot has failed. False: A user must set the property ecy_hsm_CSAI_KEYPROP_SECURE_BOOT_MUST_PASS, if he wants to write the key to the key-slot. ecy_hsm_CSAI_KEYPROP_SECURE_BOOT_MUST_PASS: The symetric key can only be used when the validation of Secure-Boot resp. Trusted-Boot has been sucessfull.
          boolean ecy_hsm_DATA_ATTR_ALLOW_DEBUG [0..1]: multiplicity set at pre-compile, origin=RB:0.1.0:2018-01-01, set at pre-compile  # debugging capable Data/Key? | True: A key allowing usage with attached debuger, can be written to this slot. False: A key allowing usage with attached debuger, can not be written to this slot. Recommended Value: True. Details: True: A user is allowed to use the key-slot, if a debugger is attached. False: A user must set the property ecy_hsm_CSAI_KEYPROP_LOCKED_ON_DEBUG, if he wants to write the key to the key-slot. ecy_hsm_CSAI_KEYPROP_LOCKED_ON_DEBUG: The key can not be used if a debugger is attached Important: This attribute does not specify the effective properties of the key-slot, but determines which properties of a given key can be written to this key-slot.
          boolean ecy_hsm_DATA_ATTR_ALLOW_WILDCARD [0..1]: multiplicity set at pre-compile, origin=RB:0.1.0:2018-01-01, set at pre-compile  # wildcard key usable for SHE overwriting? | Always set to True. The current version expects this data attribute to be set to true even if there is no effect.
          boolean ecy_hsm_DATA_ATTR_PUBLIC [0..1]: multiplicity set at pre-compile, origin=RB:0.1.0:2018-01-01, set at pre-compile  # does Data/Key contain public info? | Data/Key contains public information (may be exported)
          boolean ecy_hsm_DATA_ATTR_PRIVATE [0..1]: multiplicity set at pre-compile, origin=RB:0.1.0:2018-01-01, set at pre-compile  # does Data/Key contain private info? | Data/Key contains private information (shall NOT be exported)
          boolean ecy_hsm_DATA_ATTR_MULTISESSION [0..1]: multiplicity set at pre-compile, origin=RB:0.1.0:2018-01-01, set at pre-compile  # is Data/Key multisession capable? | Always set to True. The current version expects this data attribute to be set to true even if there is no effect.
          boolean ecy_hsm_DATA_ATTR_SSS [0..1]: multiplicity set at pre-compile, origin=RB:0.1.0:2018-01-01, set at pre-compile  # is Data/Key SSS only? | Data/Key is only usable by the SSS (Secure Space Script) middleware/applet
        container CONFIG_PROP_SET_453517593 [0..10]
          enumeration ecy_hsm_RESOURCE_OBJECTS [0..1]: {DYNAMIC_CFG_CMAC_AES_KEY_BASE_0, DYNAMIC_CFG_CMAC_AES_KEY_INST_1, DYNAMIC_CFG_CMAC_AES_KEY_INST_2, DYNAMIC_CFG_CMAC_AES_KEY_INST_3, DYNAMIC_CFG_CMAC_AES_KEY_INST_4, DYNAMIC_CFG_CMAC_AES_KEY_INST_5, DYNAMIC_CFG_CMAC_AES_KEY_INST_6, DYNAMIC_CFG_CMAC_AES_KEY_INST_7, DYNAMIC_CFG_CMAC_AES_KEY_INST_8, DYNAMIC_CFG_CMAC_AES_KEY_INST_9}
          integer ecy_hsm_MAX_NUM_UPDATES [0..1]: 0.., multiplicity set at pre-compile, origin=RB:0.1.0:2018-01-01, set at pre-compile  # maximum number of updates | number of times that a resource in DFLASH can be updated or 0xFFFFFFFF if infinity
          integer ecy_hsm_USER_ID [0..1]: 0.., multiplicity set at pre-compile, origin=RB:0.1.0:2018-01-01, set at pre-compile  # User ID | User defined data object ID. The value must be an unique numeric value between 0 and 4294967295. The value itself is not used by the application.
          enumeration ecy_hsm_MIRROR [0..1]: {USER_DEMAND, BACKGROUND, STARTUP_HSM, STARTUP_HOST}
          boolean ecy_hsm_DATA_ATTR_USE_AUTH_GEN [0..1]: multiplicity set at pre-compile, origin=RB:0.1.0:2018-01-01, set at pre-compile  # authentication generation capable data/key? | True: A key restricted to verification and generation usage can be written to this slot. False: A key restricted to verification and generation usage can not be written to this slot. Recommended Value: True. Details: If you want to write a key with property ecy_hsm_CSAI_KEYPROP_MAC_ONLY to this key-slot, set True. ecy_hsm_CSAI_KEYPROP_MAC_ONLY: The key can not be used for encryption and decryption. Important: This attribute does not specify the effective properties of the key-slot, but determines which properties of a given key can be written to this key-slotData/Key may be used for authentication generation.
          boolean ecy_hsm_DATA_ATTR_USE_AUTH_VERIFY [0..1]: multiplicity set at pre-compile, origin=RB:0.1.0:2018-01-01, set at pre-compile  # authentication verification capable data/key? | True: A key restricted to verification and generation usage can be written to this slot. False: A key restricted to verification and generation usage can not be written to this slot. Recommended Value: True. Details: If you want to write a key with property ecy_hsm_CSAI_KEYPROP_MAC_ONLY or ecy_hsm_CSAI_KEYPROP_IS_VERIFY_ONLY to this key-slot, set True. ecy_hsm_CSAI_KEYPROP_MAC_ONLY: The key can not be used for encryption and decryption. ecy_hsm_CSAI_KEYPROP_IS_VERIFY_ONLY: The key can not be used for encryption, decryption and MAC-Generation Important: This attribute does not specify the csai-properties of the key-slot, but determines which csai properties of a given key can be written to this key-slot.
          boolean ecy_hsm_DATA_ATTR_USE_ENCRYPT [0..1]: multiplicity set at pre-compile, origin=RB:0.1.0:2018-01-01, set at pre-compile  # encryption capable data/key? | True: A key restricted to encryption and decryption usage can be written to this slot. False: A key restricted to encryption and decryption usage can not be written to this slot. Recommended Value: True. Details: If you want to write a key with property. ecy_hsm_CSAI_KEYPROP_ENCDEC_ONLY to this key-slot, set True. ecy_hsm_CSAI_KEYPROP_ENCDEC_ONLY: The user can not use the key for the verification or generation of MACs. Important: This attribute does not specify the effective properties of the key-slot, but determines which properties of a given key can be written to this key-slot.
          boolean ecy_hsm_DATA_ATTR_USE_DECRYPT [0..1]: multiplicity set at pre-compile, origin=RB:0.1.0:2018-01-01, set at pre-compile  # decryption capable Data/Key? | True: A key restricted to encryption and decryption usage can be written to this slot. False: A key restricted to encryption and decryption usage can not be written to this slot. Recommended Value: True. Details: If you want to write a key with property . ecy_hsm_CSAI_KEYPROP_ENCDEC_ONLY to this key-slot, set True. ecy_hsm_CSAI_KEYPROP_ENCDEC_ONLY: The user can not use the key for the verification or generation of MACs. Important: This attribute does not specify the effective properties of the key-slot, but determines which properties of a given key can be written to this key-slot.
          boolean ecy_hsm_DATA_ATTR_ALLOW_WRITE [0..1]: multiplicity set at pre-compile, origin=RB:0.1.0:2018-01-01, set at pre-compile  # updatable and/or erasable Data/Key? | True: You can write to this key-slot multiple times. False: You can write to this key-slot only once. Details: True: A user is able to write a key with following properties to the key-slot: ecy_hsm_CSAI_KEYPROP_IS_READONLY_KEY, ecy_hsm_CSAI_KEYPROP_IS_DELETABLE_KEY. False: A user must assign following property to the key, if the key shall be written to the key-slot: ecy_hsm_CSAI_KEYPROP_IS_READONLY_KEY.. Property description: ecy_hsm_CSAI_KEYPROP_IS_READONLY_KEY: The key can only be written once to the slot. Every additional write attempt is rejected. ecy_hsm_CSAI_KEYPROP_IS_DELETABLE_KEY: The user can update the key slot by invoking ecy_hsm_Csai_WriteKeyToNvmKeyStore. Important: This attribute does not specify the effective properties of the key-slot, but determines which properties of a given key can be written to this key-slot.
          boolean ecy_hsm_DATA_ATTR_ALLOW_SECBOOT [0..1]: multiplicity set at pre-compile, origin=RB:0.1.0:2018-01-01, set at pre-compile  # secure boot capable Data/Key? | True: You can write a key to this slot, which can be used if secure boot has failed. False: You can not write a key to this slot, which can be used if secure boot has failed. Details: True: A user is able to write a key without property ecy_hsm_CSAI_KEYPROP_SECURE_BOOT_MUST_PASS to this key-slot. A key can be used even if Secure Boot has failed. False: A user must set the property ecy_hsm_CSAI_KEYPROP_SECURE_BOOT_MUST_PASS, if he wants to write the key to the key-slot. ecy_hsm_CSAI_KEYPROP_SECURE_BOOT_MUST_PASS: The symetric key can only be used when the validation of Secure-Boot resp. Trusted-Boot has been sucessfull.
          boolean ecy_hsm_DATA_ATTR_ALLOW_DEBUG [0..1]: multiplicity set at pre-compile, origin=RB:0.1.0:2018-01-01, set at pre-compile  # debugging capable Data/Key? | True: A key allowing usage with attached debuger, can be written to this slot. False: A key allowing usage with attached debuger, can not be written to this slot. Recommended Value: True. Details: True: A user is allowed to use the key-slot, if a debugger is attached. False: A user must set the property ecy_hsm_CSAI_KEYPROP_LOCKED_ON_DEBUG, if he wants to write the key to the key-slot. ecy_hsm_CSAI_KEYPROP_LOCKED_ON_DEBUG: The key can not be used if a debugger is attached Important: This attribute does not specify the effective properties of the key-slot, but determines which properties of a given key can be written to this key-slot.
          boolean ecy_hsm_DATA_ATTR_ALLOW_WILDCARD [0..1]: multiplicity set at pre-compile, origin=RB:0.1.0:2018-01-01, set at pre-compile  # wildcard key usable for SHE overwriting? | Always set to True. The current version expects this data attribute to be set to true even if there is no effect.
          boolean ecy_hsm_DATA_ATTR_PUBLIC [0..1]: multiplicity set at pre-compile, origin=RB:0.1.0:2018-01-01, set at pre-compile  # does Data/Key contain public info? | Data/Key contains public information (may be exported)
          boolean ecy_hsm_DATA_ATTR_PRIVATE [0..1]: multiplicity set at pre-compile, origin=RB:0.1.0:2018-01-01, set at pre-compile  # does Data/Key contain private info? | Data/Key contains private information (shall NOT be exported)
          boolean ecy_hsm_DATA_ATTR_MULTISESSION [0..1]: multiplicity set at pre-compile, origin=RB:0.1.0:2018-01-01, set at pre-compile  # is Data/Key multisession capable? | Always set to True. The current version expects this data attribute to be set to true even if there is no effect.
          boolean ecy_hsm_DATA_ATTR_SSS [0..1]: multiplicity set at pre-compile, origin=RB:0.1.0:2018-01-01, set at pre-compile  # is Data/Key SSS only? | Data/Key is only usable by the SSS (Secure Space Script) middleware/applet
    container ecy_hsm_RSA_KEY [0..1]: multiplicity set at pre-compile  # RSA_KEY related configurations
      container DYNAMIC [0..1]
        container CONFIG_PROP_SET_2980115891 [0..1]
          enumeration ecy_hsm_RESOURCE_OBJECTS [0..1]: {DYNAMIC_CFG_RSA_PUBLIC_KEY}
          integer ecy_hsm_MAX_NUM_UPDATES [0..1]: 0.., multiplicity set at pre-compile, origin=RB:0.1.0:2018-01-01, set at pre-compile  # maximum number of updates | number of times that a resource in DFLASH can be updated or 0xFFFFFFFF if infinity
          integer ecy_hsm_USER_ID [0..1]: 0.., multiplicity set at pre-compile, origin=RB:0.1.0:2018-01-01, set at pre-compile  # User ID | User defined data object ID. The value must be an unique numeric value between 0 and 4294967295. The value itself is not used by the application.
          enumeration ecy_hsm_MIRROR [0..1]: {USER_DEMAND, BACKGROUND, STARTUP_HSM, STARTUP_HOST}
          boolean ecy_hsm_DATA_ATTR_USE_AUTH_GEN [0..1]: multiplicity set at pre-compile, origin=RB:0.1.0:2018-01-01, set at pre-compile  # authentication generation capable data/key? | True: A key restricted to verification and generation usage can be written to this slot. False: A key restricted to verification and generation usage can not be written to this slot. Recommended Value: True. Details: If you want to write a key with property ecy_hsm_CSAI_KEYPROP_MAC_ONLY to this key-slot, set True. ecy_hsm_CSAI_KEYPROP_MAC_ONLY: The key can not be used for encryption and decryption. Important: This attribute does not specify the effective properties of the key-slot, but determines which properties of a given key can be written to this key-slotData/Key may be used for authentication generation.
          boolean ecy_hsm_DATA_ATTR_USE_AUTH_VERIFY [0..1]: multiplicity set at pre-compile, origin=RB:0.1.0:2018-01-01, set at pre-compile  # authentication verification capable data/key? | True: A key restricted to verification and generation usage can be written to this slot. False: A key restricted to verification and generation usage can not be written to this slot. Recommended Value: True. Details: If you want to write a key with property ecy_hsm_CSAI_KEYPROP_MAC_ONLY or ecy_hsm_CSAI_KEYPROP_IS_VERIFY_ONLY to this key-slot, set True. ecy_hsm_CSAI_KEYPROP_MAC_ONLY: The key can not be used for encryption and decryption. ecy_hsm_CSAI_KEYPROP_IS_VERIFY_ONLY: The key can not be used for encryption, decryption and MAC-Generation Important: This attribute does not specify the csai-properties of the key-slot, but determines which csai properties of a given key can be written to this key-slot.
          boolean ecy_hsm_DATA_ATTR_USE_ENCRYPT [0..1]: multiplicity set at pre-compile, origin=RB:0.1.0:2018-01-01, set at pre-compile  # encryption capable data/key? | True: A key restricted to encryption and decryption usage can be written to this slot. False: A key restricted to encryption and decryption usage can not be written to this slot. Recommended Value: True. Details: If you want to write a key with property. ecy_hsm_CSAI_KEYPROP_ENCDEC_ONLY to this key-slot, set True. ecy_hsm_CSAI_KEYPROP_ENCDEC_ONLY: The user can not use the key for the verification or generation of MACs. Important: This attribute does not specify the effective properties of the key-slot, but determines which properties of a given key can be written to this key-slot.
          boolean ecy_hsm_DATA_ATTR_USE_DECRYPT [0..1]: multiplicity set at pre-compile, origin=RB:0.1.0:2018-01-01, set at pre-compile  # decryption capable Data/Key? | True: A key restricted to encryption and decryption usage can be written to this slot. False: A key restricted to encryption and decryption usage can not be written to this slot. Recommended Value: True. Details: If you want to write a key with property . ecy_hsm_CSAI_KEYPROP_ENCDEC_ONLY to this key-slot, set True. ecy_hsm_CSAI_KEYPROP_ENCDEC_ONLY: The user can not use the key for the verification or generation of MACs. Important: This attribute does not specify the effective properties of the key-slot, but determines which properties of a given key can be written to this key-slot.
          boolean ecy_hsm_DATA_ATTR_ALLOW_WRITE [0..1]: multiplicity set at pre-compile, origin=RB:0.1.0:2018-01-01, set at pre-compile  # updatable and/or erasable Data/Key? | True: You can write to this key-slot multiple times. False: You can write to this key-slot only once. Details: True: A user is able to write a key with following properties to the key-slot: ecy_hsm_CSAI_KEYPROP_IS_READONLY_KEY, ecy_hsm_CSAI_KEYPROP_IS_DELETABLE_KEY. False: A user must assign following property to the key, if the key shall be written to the key-slot: ecy_hsm_CSAI_KEYPROP_IS_READONLY_KEY.. Property description: ecy_hsm_CSAI_KEYPROP_IS_READONLY_KEY: The key can only be written once to the slot. Every additional write attempt is rejected. ecy_hsm_CSAI_KEYPROP_IS_DELETABLE_KEY: The user can update the key slot by invoking ecy_hsm_Csai_WriteKeyToNvmKeyStore. Important: This attribute does not specify the effective properties of the key-slot, but determines which properties of a given key can be written to this key-slot.
          boolean ecy_hsm_DATA_ATTR_ALLOW_SECBOOT [0..1]: multiplicity set at pre-compile, origin=RB:0.1.0:2018-01-01, set at pre-compile  # secure boot capable Data/Key? | True: You can write a key to this slot, which can be used if secure boot has failed. False: You can not write a key to this slot, which can be used if secure boot has failed. Details: True: A user is able to write a key without property ecy_hsm_CSAI_KEYPROP_SECURE_BOOT_MUST_PASS to this key-slot. A key can be used even if Secure Boot has failed. False: A user must set the property ecy_hsm_CSAI_KEYPROP_SECURE_BOOT_MUST_PASS, if he wants to write the key to the key-slot. ecy_hsm_CSAI_KEYPROP_SECURE_BOOT_MUST_PASS: The symetric key can only be used when the validation of Secure-Boot resp. Trusted-Boot has been sucessfull.
          boolean ecy_hsm_DATA_ATTR_ALLOW_DEBUG [0..1]: multiplicity set at pre-compile, origin=RB:0.1.0:2018-01-01, set at pre-compile  # debugging capable Data/Key? | True: A key allowing usage with attached debuger, can be written to this slot. False: A key allowing usage with attached debuger, can not be written to this slot. Recommended Value: True. Details: True: A user is allowed to use the key-slot, if a debugger is attached. False: A user must set the property ecy_hsm_CSAI_KEYPROP_LOCKED_ON_DEBUG, if he wants to write the key to the key-slot. ecy_hsm_CSAI_KEYPROP_LOCKED_ON_DEBUG: The key can not be used if a debugger is attached Important: This attribute does not specify the effective properties of the key-slot, but determines which properties of a given key can be written to this key-slot.
          boolean ecy_hsm_DATA_ATTR_ALLOW_WILDCARD [0..1]: multiplicity set at pre-compile, origin=RB:0.1.0:2018-01-01, set at pre-compile  # wildcard key usable for SHE overwriting? | Always set to True. The current version expects this data attribute to be set to true even if there is no effect.
          boolean ecy_hsm_DATA_ATTR_PUBLIC [0..1]: multiplicity set at pre-compile, origin=RB:0.1.0:2018-01-01, set at pre-compile  # does Data/Key contain public info? | Data/Key contains public information (may be exported)
          boolean ecy_hsm_DATA_ATTR_PRIVATE [0..1]: multiplicity set at pre-compile, origin=RB:0.1.0:2018-01-01, set at pre-compile  # does Data/Key contain private info? | Data/Key contains private information (shall NOT be exported)
          boolean ecy_hsm_DATA_ATTR_MULTISESSION [0..1]: multiplicity set at pre-compile, origin=RB:0.1.0:2018-01-01, set at pre-compile  # is Data/Key multisession capable? | Always set to True. The current version expects this data attribute to be set to true even if there is no effect.
          boolean ecy_hsm_DATA_ATTR_SSS [0..1]: multiplicity set at pre-compile, origin=RB:0.1.0:2018-01-01, set at pre-compile  # is Data/Key SSS only? | Data/Key is only usable by the SSS (Secure Space Script) middleware/applet
        container CONFIG_PROP_SET_1895272312 [0..1]
          enumeration ecy_hsm_RESOURCE_OBJECTS [0..1]: {DYNAMIC_CFG_RSA_KEY_PAIR}
          integer ecy_hsm_MAX_NUM_UPDATES [0..1]: 0.., multiplicity set at pre-compile, origin=RB:0.1.0:2018-01-01, set at pre-compile  # maximum number of updates | number of times that a resource in DFLASH can be updated or 0xFFFFFFFF if infinity
          integer ecy_hsm_USER_ID [0..1]: 0.., multiplicity set at pre-compile, origin=RB:0.1.0:2018-01-01, set at pre-compile  # User ID | User defined data object ID. The value must be an unique numeric value between 0 and 4294967295. The value itself is not used by the application.
          enumeration ecy_hsm_MIRROR [0..1]: {USER_DEMAND, BACKGROUND, STARTUP_HSM, STARTUP_HOST}
          boolean ecy_hsm_DATA_ATTR_USE_AUTH_GEN [0..1]: multiplicity set at pre-compile, origin=RB:0.1.0:2018-01-01, set at pre-compile  # authentication generation capable data/key? | True: A key restricted to verification and generation usage can be written to this slot. False: A key restricted to verification and generation usage can not be written to this slot. Recommended Value: True. Details: If you want to write a key with property ecy_hsm_CSAI_KEYPROP_MAC_ONLY to this key-slot, set True. ecy_hsm_CSAI_KEYPROP_MAC_ONLY: The key can not be used for encryption and decryption. Important: This attribute does not specify the effective properties of the key-slot, but determines which properties of a given key can be written to this key-slotData/Key may be used for authentication generation.
          boolean ecy_hsm_DATA_ATTR_USE_AUTH_VERIFY [0..1]: multiplicity set at pre-compile, origin=RB:0.1.0:2018-01-01, set at pre-compile  # authentication verification capable data/key? | True: A key restricted to verification and generation usage can be written to this slot. False: A key restricted to verification and generation usage can not be written to this slot. Recommended Value: True. Details: If you want to write a key with property ecy_hsm_CSAI_KEYPROP_MAC_ONLY or ecy_hsm_CSAI_KEYPROP_IS_VERIFY_ONLY to this key-slot, set True. ecy_hsm_CSAI_KEYPROP_MAC_ONLY: The key can not be used for encryption and decryption. ecy_hsm_CSAI_KEYPROP_IS_VERIFY_ONLY: The key can not be used for encryption, decryption and MAC-Generation Important: This attribute does not specify the csai-properties of the key-slot, but determines which csai properties of a given key can be written to this key-slot.
          boolean ecy_hsm_DATA_ATTR_USE_ENCRYPT [0..1]: multiplicity set at pre-compile, origin=RB:0.1.0:2018-01-01, set at pre-compile  # encryption capable data/key? | True: A key restricted to encryption and decryption usage can be written to this slot. False: A key restricted to encryption and decryption usage can not be written to this slot. Recommended Value: True. Details: If you want to write a key with property. ecy_hsm_CSAI_KEYPROP_ENCDEC_ONLY to this key-slot, set True. ecy_hsm_CSAI_KEYPROP_ENCDEC_ONLY: The user can not use the key for the verification or generation of MACs. Important: This attribute does not specify the effective properties of the key-slot, but determines which properties of a given key can be written to this key-slot.
          boolean ecy_hsm_DATA_ATTR_USE_DECRYPT [0..1]: multiplicity set at pre-compile, origin=RB:0.1.0:2018-01-01, set at pre-compile  # decryption capable Data/Key? | True: A key restricted to encryption and decryption usage can be written to this slot. False: A key restricted to encryption and decryption usage can not be written to this slot. Recommended Value: True. Details: If you want to write a key with property . ecy_hsm_CSAI_KEYPROP_ENCDEC_ONLY to this key-slot, set True. ecy_hsm_CSAI_KEYPROP_ENCDEC_ONLY: The user can not use the key for the verification or generation of MACs. Important: This attribute does not specify the effective properties of the key-slot, but determines which properties of a given key can be written to this key-slot.
          boolean ecy_hsm_DATA_ATTR_ALLOW_WRITE [0..1]: multiplicity set at pre-compile, origin=RB:0.1.0:2018-01-01, set at pre-compile  # updatable and/or erasable Data/Key? | True: You can write to this key-slot multiple times. False: You can write to this key-slot only once. Details: True: A user is able to write a key with following properties to the key-slot: ecy_hsm_CSAI_KEYPROP_IS_READONLY_KEY, ecy_hsm_CSAI_KEYPROP_IS_DELETABLE_KEY. False: A user must assign following property to the key, if the key shall be written to the key-slot: ecy_hsm_CSAI_KEYPROP_IS_READONLY_KEY.. Property description: ecy_hsm_CSAI_KEYPROP_IS_READONLY_KEY: The key can only be written once to the slot. Every additional write attempt is rejected. ecy_hsm_CSAI_KEYPROP_IS_DELETABLE_KEY: The user can update the key slot by invoking ecy_hsm_Csai_WriteKeyToNvmKeyStore. Important: This attribute does not specify the effective properties of the key-slot, but determines which properties of a given key can be written to this key-slot.
          boolean ecy_hsm_DATA_ATTR_ALLOW_SECBOOT [0..1]: multiplicity set at pre-compile, origin=RB:0.1.0:2018-01-01, set at pre-compile  # secure boot capable Data/Key? | True: You can write a key to this slot, which can be used if secure boot has failed. False: You can not write a key to this slot, which can be used if secure boot has failed. Details: True: A user is able to write a key without property ecy_hsm_CSAI_KEYPROP_SECURE_BOOT_MUST_PASS to this key-slot. A key can be used even if Secure Boot has failed. False: A user must set the property ecy_hsm_CSAI_KEYPROP_SECURE_BOOT_MUST_PASS, if he wants to write the key to the key-slot. ecy_hsm_CSAI_KEYPROP_SECURE_BOOT_MUST_PASS: The symetric key can only be used when the validation of Secure-Boot resp. Trusted-Boot has been sucessfull.
          boolean ecy_hsm_DATA_ATTR_ALLOW_DEBUG [0..1]: multiplicity set at pre-compile, origin=RB:0.1.0:2018-01-01, set at pre-compile  # debugging capable Data/Key? | True: A key allowing usage with attached debuger, can be written to this slot. False: A key allowing usage with attached debuger, can not be written to this slot. Recommended Value: True. Details: True: A user is allowed to use the key-slot, if a debugger is attached. False: A user must set the property ecy_hsm_CSAI_KEYPROP_LOCKED_ON_DEBUG, if he wants to write the key to the key-slot. ecy_hsm_CSAI_KEYPROP_LOCKED_ON_DEBUG: The key can not be used if a debugger is attached Important: This attribute does not specify the effective properties of the key-slot, but determines which properties of a given key can be written to this key-slot.
          boolean ecy_hsm_DATA_ATTR_ALLOW_WILDCARD [0..1]: multiplicity set at pre-compile, origin=RB:0.1.0:2018-01-01, set at pre-compile  # wildcard key usable for SHE overwriting? | Always set to True. The current version expects this data attribute to be set to true even if there is no effect.
          boolean ecy_hsm_DATA_ATTR_PUBLIC [0..1]: multiplicity set at pre-compile, origin=RB:0.1.0:2018-01-01, set at pre-compile  # does Data/Key contain public info? | Data/Key contains public information (may be exported)
          boolean ecy_hsm_DATA_ATTR_PRIVATE [0..1]: multiplicity set at pre-compile, origin=RB:0.1.0:2018-01-01, set at pre-compile  # does Data/Key contain private info? | Data/Key contains private information (shall NOT be exported)
          boolean ecy_hsm_DATA_ATTR_MULTISESSION [0..1]: multiplicity set at pre-compile, origin=RB:0.1.0:2018-01-01, set at pre-compile  # is Data/Key multisession capable? | Always set to True. The current version expects this data attribute to be set to true even if there is no effect.
          boolean ecy_hsm_DATA_ATTR_SSS [0..1]: multiplicity set at pre-compile, origin=RB:0.1.0:2018-01-01, set at pre-compile  # is Data/Key SSS only? | Data/Key is only usable by the SSS (Secure Space Script) middleware/applet
        container CONFIG_PROP_SET_2520996645 [0..1]
          enumeration ecy_hsm_RESOURCE_OBJECTS [0..1]: {DYNAMIC_CFG_RSA_PRIVATE_KEY}
          integer ecy_hsm_MAX_NUM_UPDATES [0..1]: 0.., multiplicity set at pre-compile, origin=RB:0.1.0:2018-01-01, set at pre-compile  # maximum number of updates | number of times that a resource in DFLASH can be updated or 0xFFFFFFFF if infinity
          integer ecy_hsm_USER_ID [0..1]: 0.., multiplicity set at pre-compile, origin=RB:0.1.0:2018-01-01, set at pre-compile  # User ID | User defined data object ID. The value must be an unique numeric value between 0 and 4294967295. The value itself is not used by the application.
          enumeration ecy_hsm_MIRROR [0..1]: {USER_DEMAND, BACKGROUND, STARTUP_HSM, STARTUP_HOST}
          boolean ecy_hsm_DATA_ATTR_USE_AUTH_GEN [0..1]: multiplicity set at pre-compile, origin=RB:0.1.0:2018-01-01, set at pre-compile  # authentication generation capable data/key? | True: A key restricted to verification and generation usage can be written to this slot. False: A key restricted to verification and generation usage can not be written to this slot. Recommended Value: True. Details: If you want to write a key with property ecy_hsm_CSAI_KEYPROP_MAC_ONLY to this key-slot, set True. ecy_hsm_CSAI_KEYPROP_MAC_ONLY: The key can not be used for encryption and decryption. Important: This attribute does not specify the effective properties of the key-slot, but determines which properties of a given key can be written to this key-slotData/Key may be used for authentication generation.
          boolean ecy_hsm_DATA_ATTR_USE_AUTH_VERIFY [0..1]: multiplicity set at pre-compile, origin=RB:0.1.0:2018-01-01, set at pre-compile  # authentication verification capable data/key? | True: A key restricted to verification and generation usage can be written to this slot. False: A key restricted to verification and generation usage can not be written to this slot. Recommended Value: True. Details: If you want to write a key with property ecy_hsm_CSAI_KEYPROP_MAC_ONLY or ecy_hsm_CSAI_KEYPROP_IS_VERIFY_ONLY to this key-slot, set True. ecy_hsm_CSAI_KEYPROP_MAC_ONLY: The key can not be used for encryption and decryption. ecy_hsm_CSAI_KEYPROP_IS_VERIFY_ONLY: The key can not be used for encryption, decryption and MAC-Generation Important: This attribute does not specify the csai-properties of the key-slot, but determines which csai properties of a given key can be written to this key-slot.
          boolean ecy_hsm_DATA_ATTR_USE_ENCRYPT [0..1]: multiplicity set at pre-compile, origin=RB:0.1.0:2018-01-01, set at pre-compile  # encryption capable data/key? | True: A key restricted to encryption and decryption usage can be written to this slot. False: A key restricted to encryption and decryption usage can not be written to this slot. Recommended Value: True. Details: If you want to write a key with property. ecy_hsm_CSAI_KEYPROP_ENCDEC_ONLY to this key-slot, set True. ecy_hsm_CSAI_KEYPROP_ENCDEC_ONLY: The user can not use the key for the verification or generation of MACs. Important: This attribute does not specify the effective properties of the key-slot, but determines which properties of a given key can be written to this key-slot.
          boolean ecy_hsm_DATA_ATTR_USE_DECRYPT [0..1]: multiplicity set at pre-compile, origin=RB:0.1.0:2018-01-01, set at pre-compile  # decryption capable Data/Key? | True: A key restricted to encryption and decryption usage can be written to this slot. False: A key restricted to encryption and decryption usage can not be written to this slot. Recommended Value: True. Details: If you want to write a key with property . ecy_hsm_CSAI_KEYPROP_ENCDEC_ONLY to this key-slot, set True. ecy_hsm_CSAI_KEYPROP_ENCDEC_ONLY: The user can not use the key for the verification or generation of MACs. Important: This attribute does not specify the effective properties of the key-slot, but determines which properties of a given key can be written to this key-slot.
          boolean ecy_hsm_DATA_ATTR_ALLOW_WRITE [0..1]: multiplicity set at pre-compile, origin=RB:0.1.0:2018-01-01, set at pre-compile  # updatable and/or erasable Data/Key? | True: You can write to this key-slot multiple times. False: You can write to this key-slot only once. Details: True: A user is able to write a key with following properties to the key-slot: ecy_hsm_CSAI_KEYPROP_IS_READONLY_KEY, ecy_hsm_CSAI_KEYPROP_IS_DELETABLE_KEY. False: A user must assign following property to the key, if the key shall be written to the key-slot: ecy_hsm_CSAI_KEYPROP_IS_READONLY_KEY.. Property description: ecy_hsm_CSAI_KEYPROP_IS_READONLY_KEY: The key can only be written once to the slot. Every additional write attempt is rejected. ecy_hsm_CSAI_KEYPROP_IS_DELETABLE_KEY: The user can update the key slot by invoking ecy_hsm_Csai_WriteKeyToNvmKeyStore. Important: This attribute does not specify the effective properties of the key-slot, but determines which properties of a given key can be written to this key-slot.
          boolean ecy_hsm_DATA_ATTR_ALLOW_SECBOOT [0..1]: multiplicity set at pre-compile, origin=RB:0.1.0:2018-01-01, set at pre-compile  # secure boot capable Data/Key? | True: You can write a key to this slot, which can be used if secure boot has failed. False: You can not write a key to this slot, which can be used if secure boot has failed. Details: True: A user is able to write a key without property ecy_hsm_CSAI_KEYPROP_SECURE_BOOT_MUST_PASS to this key-slot. A key can be used even if Secure Boot has failed. False: A user must set the property ecy_hsm_CSAI_KEYPROP_SECURE_BOOT_MUST_PASS, if he wants to write the key to the key-slot. ecy_hsm_CSAI_KEYPROP_SECURE_BOOT_MUST_PASS: The symetric key can only be used when the validation of Secure-Boot resp. Trusted-Boot has been sucessfull.
          boolean ecy_hsm_DATA_ATTR_ALLOW_DEBUG [0..1]: multiplicity set at pre-compile, origin=RB:0.1.0:2018-01-01, set at pre-compile  # debugging capable Data/Key? | True: A key allowing usage with attached debuger, can be written to this slot. False: A key allowing usage with attached debuger, can not be written to this slot. Recommended Value: True. Details: True: A user is allowed to use the key-slot, if a debugger is attached. False: A user must set the property ecy_hsm_CSAI_KEYPROP_LOCKED_ON_DEBUG, if he wants to write the key to the key-slot. ecy_hsm_CSAI_KEYPROP_LOCKED_ON_DEBUG: The key can not be used if a debugger is attached Important: This attribute does not specify the effective properties of the key-slot, but determines which properties of a given key can be written to this key-slot.
          boolean ecy_hsm_DATA_ATTR_ALLOW_WILDCARD [0..1]: multiplicity set at pre-compile, origin=RB:0.1.0:2018-01-01, set at pre-compile  # wildcard key usable for SHE overwriting? | Always set to True. The current version expects this data attribute to be set to true even if there is no effect.
          boolean ecy_hsm_DATA_ATTR_PUBLIC [0..1]: multiplicity set at pre-compile, origin=RB:0.1.0:2018-01-01, set at pre-compile  # does Data/Key contain public info? | Data/Key contains public information (may be exported)
          boolean ecy_hsm_DATA_ATTR_PRIVATE [0..1]: multiplicity set at pre-compile, origin=RB:0.1.0:2018-01-01, set at pre-compile  # does Data/Key contain private info? | Data/Key contains private information (shall NOT be exported)
          boolean ecy_hsm_DATA_ATTR_MULTISESSION [0..1]: multiplicity set at pre-compile, origin=RB:0.1.0:2018-01-01, set at pre-compile  # is Data/Key multisession capable? | Always set to True. The current version expects this data attribute to be set to true even if there is no effect.
          boolean ecy_hsm_DATA_ATTR_SSS [0..1]: multiplicity set at pre-compile, origin=RB:0.1.0:2018-01-01, set at pre-compile  # is Data/Key SSS only? | Data/Key is only usable by the SSS (Secure Space Script) middleware/applet
    container ecy_hsm_ECC_KEY [0..1]: multiplicity set at pre-compile  # ECC_KEY related configurations
      container DYNAMIC [0..1]
        container CONFIG_PROP_SET_3773990853 [0..2]
          enumeration ecy_hsm_RESOURCE_OBJECTS [0..1]: {DYNAMIC_ECC_KEY_PAIR, DYNAMIC_ECC_KEY_PAIR_ECDSA}
          integer ecy_hsm_MAX_NUM_UPDATES [0..1]: 0.., multiplicity set at pre-compile, origin=RB:0.1.0:2018-01-01, set at pre-compile  # maximum number of updates | number of times that a resource in DFLASH can be updated or 0xFFFFFFFF if infinity
          integer ecy_hsm_USER_ID [0..1]: 0.., multiplicity set at pre-compile, origin=RB:0.1.0:2018-01-01, set at pre-compile  # User ID | User defined data object ID. The value must be an unique numeric value between 0 and 4294967295. The value itself is not used by the application.
          enumeration ecy_hsm_MIRROR [0..1]: {USER_DEMAND, BACKGROUND, STARTUP_HSM, STARTUP_HOST}
          boolean ecy_hsm_DATA_ATTR_USE_AUTH_GEN [0..1]: multiplicity set at pre-compile, origin=RB:0.1.0:2018-01-01, set at pre-compile  # authentication generation capable data/key? | True: A key restricted to verification and generation usage can be written to this slot. False: A key restricted to verification and generation usage can not be written to this slot. Recommended Value: True. Details: If you want to write a key with property ecy_hsm_CSAI_KEYPROP_MAC_ONLY to this key-slot, set True. ecy_hsm_CSAI_KEYPROP_MAC_ONLY: The key can not be used for encryption and decryption. Important: This attribute does not specify the effective properties of the key-slot, but determines which properties of a given key can be written to this key-slotData/Key may be used for authentication generation.
          boolean ecy_hsm_DATA_ATTR_USE_AUTH_VERIFY [0..1]: multiplicity set at pre-compile, origin=RB:0.1.0:2018-01-01, set at pre-compile  # authentication verification capable data/key? | True: A key restricted to verification and generation usage can be written to this slot. False: A key restricted to verification and generation usage can not be written to this slot. Recommended Value: True. Details: If you want to write a key with property ecy_hsm_CSAI_KEYPROP_MAC_ONLY or ecy_hsm_CSAI_KEYPROP_IS_VERIFY_ONLY to this key-slot, set True. ecy_hsm_CSAI_KEYPROP_MAC_ONLY: The key can not be used for encryption and decryption. ecy_hsm_CSAI_KEYPROP_IS_VERIFY_ONLY: The key can not be used for encryption, decryption and MAC-Generation Important: This attribute does not specify the csai-properties of the key-slot, but determines which csai properties of a given key can be written to this key-slot.
          boolean ecy_hsm_DATA_ATTR_USE_ENCRYPT [0..1]: multiplicity set at pre-compile, origin=RB:0.1.0:2018-01-01, set at pre-compile  # encryption capable data/key? | True: A key restricted to encryption and decryption usage can be written to this slot. False: A key restricted to encryption and decryption usage can not be written to this slot. Recommended Value: True. Details: If you want to write a key with property. ecy_hsm_CSAI_KEYPROP_ENCDEC_ONLY to this key-slot, set True. ecy_hsm_CSAI_KEYPROP_ENCDEC_ONLY: The user can not use the key for the verification or generation of MACs. Important: This attribute does not specify the effective properties of the key-slot, but determines which properties of a given key can be written to this key-slot.
          boolean ecy_hsm_DATA_ATTR_USE_DECRYPT [0..1]: multiplicity set at pre-compile, origin=RB:0.1.0:2018-01-01, set at pre-compile  # decryption capable Data/Key? | True: A key restricted to encryption and decryption usage can be written to this slot. False: A key restricted to encryption and decryption usage can not be written to this slot. Recommended Value: True. Details: If you want to write a key with property . ecy_hsm_CSAI_KEYPROP_ENCDEC_ONLY to this key-slot, set True. ecy_hsm_CSAI_KEYPROP_ENCDEC_ONLY: The user can not use the key for the verification or generation of MACs. Important: This attribute does not specify the effective properties of the key-slot, but determines which properties of a given key can be written to this key-slot.
          boolean ecy_hsm_DATA_ATTR_ALLOW_WRITE [0..1]: multiplicity set at pre-compile, origin=RB:0.1.0:2018-01-01, set at pre-compile  # updatable and/or erasable Data/Key? | True: You can write to this key-slot multiple times. False: You can write to this key-slot only once. Details: True: A user is able to write a key with following properties to the key-slot: ecy_hsm_CSAI_KEYPROP_IS_READONLY_KEY, ecy_hsm_CSAI_KEYPROP_IS_DELETABLE_KEY. False: A user must assign following property to the key, if the key shall be written to the key-slot: ecy_hsm_CSAI_KEYPROP_IS_READONLY_KEY.. Property description: ecy_hsm_CSAI_KEYPROP_IS_READONLY_KEY: The key can only be written once to the slot. Every additional write attempt is rejected. ecy_hsm_CSAI_KEYPROP_IS_DELETABLE_KEY: The user can update the key slot by invoking ecy_hsm_Csai_WriteKeyToNvmKeyStore. Important: This attribute does not specify the effective properties of the key-slot, but determines which properties of a given key can be written to this key-slot.
          boolean ecy_hsm_DATA_ATTR_ALLOW_SECBOOT [0..1]: multiplicity set at pre-compile, origin=RB:0.1.0:2018-01-01, set at pre-compile  # secure boot capable Data/Key? | True: You can write a key to this slot, which can be used if secure boot has failed. False: You can not write a key to this slot, which can be used if secure boot has failed. Details: True: A user is able to write a key without property ecy_hsm_CSAI_KEYPROP_SECURE_BOOT_MUST_PASS to this key-slot. A key can be used even if Secure Boot has failed. False: A user must set the property ecy_hsm_CSAI_KEYPROP_SECURE_BOOT_MUST_PASS, if he wants to write the key to the key-slot. ecy_hsm_CSAI_KEYPROP_SECURE_BOOT_MUST_PASS: The symetric key can only be used when the validation of Secure-Boot resp. Trusted-Boot has been sucessfull.
          boolean ecy_hsm_DATA_ATTR_ALLOW_DEBUG [0..1]: multiplicity set at pre-compile, origin=RB:0.1.0:2018-01-01, set at pre-compile  # debugging capable Data/Key? | True: A key allowing usage with attached debuger, can be written to this slot. False: A key allowing usage with attached debuger, can not be written to this slot. Recommended Value: True. Details: True: A user is allowed to use the key-slot, if a debugger is attached. False: A user must set the property ecy_hsm_CSAI_KEYPROP_LOCKED_ON_DEBUG, if he wants to write the key to the key-slot. ecy_hsm_CSAI_KEYPROP_LOCKED_ON_DEBUG: The key can not be used if a debugger is attached Important: This attribute does not specify the effective properties of the key-slot, but determines which properties of a given key can be written to this key-slot.
          boolean ecy_hsm_DATA_ATTR_ALLOW_WILDCARD [0..1]: multiplicity set at pre-compile, origin=RB:0.1.0:2018-01-01, set at pre-compile  # wildcard key usable for SHE overwriting? | Always set to True. The current version expects this data attribute to be set to true even if there is no effect.
          boolean ecy_hsm_DATA_ATTR_PUBLIC [0..1]: multiplicity set at pre-compile, origin=RB:0.1.0:2018-01-01, set at pre-compile  # does Data/Key contain public info? | Data/Key contains public information (may be exported)
          boolean ecy_hsm_DATA_ATTR_PRIVATE [0..1]: multiplicity set at pre-compile, origin=RB:0.1.0:2018-01-01, set at pre-compile  # does Data/Key contain private info? | Data/Key contains private information (shall NOT be exported)
          boolean ecy_hsm_DATA_ATTR_MULTISESSION [0..1]: multiplicity set at pre-compile, origin=RB:0.1.0:2018-01-01, set at pre-compile  # is Data/Key multisession capable? | Always set to True. The current version expects this data attribute to be set to true even if there is no effect.
          boolean ecy_hsm_DATA_ATTR_SSS [0..1]: multiplicity set at pre-compile, origin=RB:0.1.0:2018-01-01, set at pre-compile  # is Data/Key SSS only? | Data/Key is only usable by the SSS (Secure Space Script) middleware/applet
        container CONFIG_PROP_SET_3927828726 [0..2]
          enumeration ecy_hsm_RESOURCE_OBJECTS [0..1]: {DYNAMIC_ECC_PUBLIC_KEY, DYNAMIC_ECC_PUBLIC_KEY_ECDSA}
          integer ecy_hsm_MAX_NUM_UPDATES [0..1]: 0.., multiplicity set at pre-compile, origin=RB:0.1.0:2018-01-01, set at pre-compile  # maximum number of updates | number of times that a resource in DFLASH can be updated or 0xFFFFFFFF if infinity
          integer ecy_hsm_USER_ID [0..1]: 0.., multiplicity set at pre-compile, origin=RB:0.1.0:2018-01-01, set at pre-compile  # User ID | User defined data object ID. The value must be an unique numeric value between 0 and 4294967295. The value itself is not used by the application.
          enumeration ecy_hsm_MIRROR [0..1]: {USER_DEMAND, BACKGROUND, STARTUP_HSM, STARTUP_HOST}
          boolean ecy_hsm_DATA_ATTR_USE_AUTH_GEN [0..1]: multiplicity set at pre-compile, origin=RB:0.1.0:2018-01-01, set at pre-compile  # authentication generation capable data/key? | True: A key restricted to verification and generation usage can be written to this slot. False: A key restricted to verification and generation usage can not be written to this slot. Recommended Value: True. Details: If you want to write a key with property ecy_hsm_CSAI_KEYPROP_MAC_ONLY to this key-slot, set True. ecy_hsm_CSAI_KEYPROP_MAC_ONLY: The key can not be used for encryption and decryption. Important: This attribute does not specify the effective properties of the key-slot, but determines which properties of a given key can be written to this key-slotData/Key may be used for authentication generation.
          boolean ecy_hsm_DATA_ATTR_USE_AUTH_VERIFY [0..1]: multiplicity set at pre-compile, origin=RB:0.1.0:2018-01-01, set at pre-compile  # authentication verification capable data/key? | True: A key restricted to verification and generation usage can be written to this slot. False: A key restricted to verification and generation usage can not be written to this slot. Recommended Value: True. Details: If you want to write a key with property ecy_hsm_CSAI_KEYPROP_MAC_ONLY or ecy_hsm_CSAI_KEYPROP_IS_VERIFY_ONLY to this key-slot, set True. ecy_hsm_CSAI_KEYPROP_MAC_ONLY: The key can not be used for encryption and decryption. ecy_hsm_CSAI_KEYPROP_IS_VERIFY_ONLY: The key can not be used for encryption, decryption and MAC-Generation Important: This attribute does not specify the csai-properties of the key-slot, but determines which csai properties of a given key can be written to this key-slot.
          boolean ecy_hsm_DATA_ATTR_USE_ENCRYPT [0..1]: multiplicity set at pre-compile, origin=RB:0.1.0:2018-01-01, set at pre-compile  # encryption capable data/key? | True: A key restricted to encryption and decryption usage can be written to this slot. False: A key restricted to encryption and decryption usage can not be written to this slot. Recommended Value: True. Details: If you want to write a key with property. ecy_hsm_CSAI_KEYPROP_ENCDEC_ONLY to this key-slot, set True. ecy_hsm_CSAI_KEYPROP_ENCDEC_ONLY: The user can not use the key for the verification or generation of MACs. Important: This attribute does not specify the effective properties of the key-slot, but determines which properties of a given key can be written to this key-slot.
          boolean ecy_hsm_DATA_ATTR_USE_DECRYPT [0..1]: multiplicity set at pre-compile, origin=RB:0.1.0:2018-01-01, set at pre-compile  # decryption capable Data/Key? | True: A key restricted to encryption and decryption usage can be written to this slot. False: A key restricted to encryption and decryption usage can not be written to this slot. Recommended Value: True. Details: If you want to write a key with property . ecy_hsm_CSAI_KEYPROP_ENCDEC_ONLY to this key-slot, set True. ecy_hsm_CSAI_KEYPROP_ENCDEC_ONLY: The user can not use the key for the verification or generation of MACs. Important: This attribute does not specify the effective properties of the key-slot, but determines which properties of a given key can be written to this key-slot.
          boolean ecy_hsm_DATA_ATTR_ALLOW_WRITE [0..1]: multiplicity set at pre-compile, origin=RB:0.1.0:2018-01-01, set at pre-compile  # updatable and/or erasable Data/Key? | True: You can write to this key-slot multiple times. False: You can write to this key-slot only once. Details: True: A user is able to write a key with following properties to the key-slot: ecy_hsm_CSAI_KEYPROP_IS_READONLY_KEY, ecy_hsm_CSAI_KEYPROP_IS_DELETABLE_KEY. False: A user must assign following property to the key, if the key shall be written to the key-slot: ecy_hsm_CSAI_KEYPROP_IS_READONLY_KEY.. Property description: ecy_hsm_CSAI_KEYPROP_IS_READONLY_KEY: The key can only be written once to the slot. Every additional write attempt is rejected. ecy_hsm_CSAI_KEYPROP_IS_DELETABLE_KEY: The user can update the key slot by invoking ecy_hsm_Csai_WriteKeyToNvmKeyStore. Important: This attribute does not specify the effective properties of the key-slot, but determines which properties of a given key can be written to this key-slot.
          boolean ecy_hsm_DATA_ATTR_ALLOW_SECBOOT [0..1]: multiplicity set at pre-compile, origin=RB:0.1.0:2018-01-01, set at pre-compile  # secure boot capable Data/Key? | True: You can write a key to this slot, which can be used if secure boot has failed. False: You can not write a key to this slot, which can be used if secure boot has failed. Details: True: A user is able to write a key without property ecy_hsm_CSAI_KEYPROP_SECURE_BOOT_MUST_PASS to this key-slot. A key can be used even if Secure Boot has failed. False: A user must set the property ecy_hsm_CSAI_KEYPROP_SECURE_BOOT_MUST_PASS, if he wants to write the key to the key-slot. ecy_hsm_CSAI_KEYPROP_SECURE_BOOT_MUST_PASS: The symetric key can only be used when the validation of Secure-Boot resp. Trusted-Boot has been sucessfull.
          boolean ecy_hsm_DATA_ATTR_ALLOW_DEBUG [0..1]: multiplicity set at pre-compile, origin=RB:0.1.0:2018-01-01, set at pre-compile  # debugging capable Data/Key? | True: A key allowing usage with attached debuger, can be written to this slot. False: A key allowing usage with attached debuger, can not be written to this slot. Recommended Value: True. Details: True: A user is allowed to use the key-slot, if a debugger is attached. False: A user must set the property ecy_hsm_CSAI_KEYPROP_LOCKED_ON_DEBUG, if he wants to write the key to the key-slot. ecy_hsm_CSAI_KEYPROP_LOCKED_ON_DEBUG: The key can not be used if a debugger is attached Important: This attribute does not specify the effective properties of the key-slot, but determines which properties of a given key can be written to this key-slot.
          boolean ecy_hsm_DATA_ATTR_ALLOW_WILDCARD [0..1]: multiplicity set at pre-compile, origin=RB:0.1.0:2018-01-01, set at pre-compile  # wildcard key usable for SHE overwriting? | Always set to True. The current version expects this data attribute to be set to true even if there is no effect.
          boolean ecy_hsm_DATA_ATTR_PUBLIC [0..1]: multiplicity set at pre-compile, origin=RB:0.1.0:2018-01-01, set at pre-compile  # does Data/Key contain public info? | Data/Key contains public information (may be exported)
          boolean ecy_hsm_DATA_ATTR_PRIVATE [0..1]: multiplicity set at pre-compile, origin=RB:0.1.0:2018-01-01, set at pre-compile  # does Data/Key contain private info? | Data/Key contains private information (shall NOT be exported)
          boolean ecy_hsm_DATA_ATTR_MULTISESSION [0..1]: multiplicity set at pre-compile, origin=RB:0.1.0:2018-01-01, set at pre-compile  # is Data/Key multisession capable? | Always set to True. The current version expects this data attribute to be set to true even if there is no effect.
          boolean ecy_hsm_DATA_ATTR_SSS [0..1]: multiplicity set at pre-compile, origin=RB:0.1.0:2018-01-01, set at pre-compile  # is Data/Key SSS only? | Data/Key is only usable by the SSS (Secure Space Script) middleware/applet
        container CONFIG_PROP_SET_2101482744 [0..2]
          enumeration ecy_hsm_RESOURCE_OBJECTS [0..1]: {DYNAMIC_ECC_PRIVATE_KEY, DYNAMIC_ECC_PRIVATE_KEY_ECDSA}
          integer ecy_hsm_MAX_NUM_UPDATES [0..1]: 0.., multiplicity set at pre-compile, origin=RB:0.1.0:2018-01-01, set at pre-compile  # maximum number of updates | number of times that a resource in DFLASH can be updated or 0xFFFFFFFF if infinity
          integer ecy_hsm_USER_ID [0..1]: 0.., multiplicity set at pre-compile, origin=RB:0.1.0:2018-01-01, set at pre-compile  # User ID | User defined data object ID. The value must be an unique numeric value between 0 and 4294967295. The value itself is not used by the application.
          enumeration ecy_hsm_MIRROR [0..1]: {USER_DEMAND, BACKGROUND, STARTUP_HSM, STARTUP_HOST}
          boolean ecy_hsm_DATA_ATTR_USE_AUTH_GEN [0..1]: multiplicity set at pre-compile, origin=RB:0.1.0:2018-01-01, set at pre-compile  # authentication generation capable data/key? | True: A key restricted to verification and generation usage can be written to this slot. False: A key restricted to verification and generation usage can not be written to this slot. Recommended Value: True. Details: If you want to write a key with property ecy_hsm_CSAI_KEYPROP_MAC_ONLY to this key-slot, set True. ecy_hsm_CSAI_KEYPROP_MAC_ONLY: The key can not be used for encryption and decryption. Important: This attribute does not specify the effective properties of the key-slot, but determines which properties of a given key can be written to this key-slotData/Key may be used for authentication generation.
          boolean ecy_hsm_DATA_ATTR_USE_AUTH_VERIFY [0..1]: multiplicity set at pre-compile, origin=RB:0.1.0:2018-01-01, set at pre-compile  # authentication verification capable data/key? | True: A key restricted to verification and generation usage can be written to this slot. False: A key restricted to verification and generation usage can not be written to this slot. Recommended Value: True. Details: If you want to write a key with property ecy_hsm_CSAI_KEYPROP_MAC_ONLY or ecy_hsm_CSAI_KEYPROP_IS_VERIFY_ONLY to this key-slot, set True. ecy_hsm_CSAI_KEYPROP_MAC_ONLY: The key can not be used for encryption and decryption. ecy_hsm_CSAI_KEYPROP_IS_VERIFY_ONLY: The key can not be used for encryption, decryption and MAC-Generation Important: This attribute does not specify the csai-properties of the key-slot, but determines which csai properties of a given key can be written to this key-slot.
          boolean ecy_hsm_DATA_ATTR_USE_ENCRYPT [0..1]: multiplicity set at pre-compile, origin=RB:0.1.0:2018-01-01, set at pre-compile  # encryption capable data/key? | True: A key restricted to encryption and decryption usage can be written to this slot. False: A key restricted to encryption and decryption usage can not be written to this slot. Recommended Value: True. Details: If you want to write a key with property. ecy_hsm_CSAI_KEYPROP_ENCDEC_ONLY to this key-slot, set True. ecy_hsm_CSAI_KEYPROP_ENCDEC_ONLY: The user can not use the key for the verification or generation of MACs. Important: This attribute does not specify the effective properties of the key-slot, but determines which properties of a given key can be written to this key-slot.
          boolean ecy_hsm_DATA_ATTR_USE_DECRYPT [0..1]: multiplicity set at pre-compile, origin=RB:0.1.0:2018-01-01, set at pre-compile  # decryption capable Data/Key? | True: A key restricted to encryption and decryption usage can be written to this slot. False: A key restricted to encryption and decryption usage can not be written to this slot. Recommended Value: True. Details: If you want to write a key with property . ecy_hsm_CSAI_KEYPROP_ENCDEC_ONLY to this key-slot, set True. ecy_hsm_CSAI_KEYPROP_ENCDEC_ONLY: The user can not use the key for the verification or generation of MACs. Important: This attribute does not specify the effective properties of the key-slot, but determines which properties of a given key can be written to this key-slot.
          boolean ecy_hsm_DATA_ATTR_ALLOW_WRITE [0..1]: multiplicity set at pre-compile, origin=RB:0.1.0:2018-01-01, set at pre-compile  # updatable and/or erasable Data/Key? | True: You can write to this key-slot multiple times. False: You can write to this key-slot only once. Details: True: A user is able to write a key with following properties to the key-slot: ecy_hsm_CSAI_KEYPROP_IS_READONLY_KEY, ecy_hsm_CSAI_KEYPROP_IS_DELETABLE_KEY. False: A user must assign following property to the key, if the key shall be written to the key-slot: ecy_hsm_CSAI_KEYPROP_IS_READONLY_KEY.. Property description: ecy_hsm_CSAI_KEYPROP_IS_READONLY_KEY: The key can only be written once to the slot. Every additional write attempt is rejected. ecy_hsm_CSAI_KEYPROP_IS_DELETABLE_KEY: The user can update the key slot by invoking ecy_hsm_Csai_WriteKeyToNvmKeyStore. Important: This attribute does not specify the effective properties of the key-slot, but determines which properties of a given key can be written to this key-slot.
          boolean ecy_hsm_DATA_ATTR_ALLOW_SECBOOT [0..1]: multiplicity set at pre-compile, origin=RB:0.1.0:2018-01-01, set at pre-compile  # secure boot capable Data/Key? | True: You can write a key to this slot, which can be used if secure boot has failed. False: You can not write a key to this slot, which can be used if secure boot has failed. Details: True: A user is able to write a key without property ecy_hsm_CSAI_KEYPROP_SECURE_BOOT_MUST_PASS to this key-slot. A key can be used even if Secure Boot has failed. False: A user must set the property ecy_hsm_CSAI_KEYPROP_SECURE_BOOT_MUST_PASS, if he wants to write the key to the key-slot. ecy_hsm_CSAI_KEYPROP_SECURE_BOOT_MUST_PASS: The symetric key can only be used when the validation of Secure-Boot resp. Trusted-Boot has been sucessfull.
          boolean ecy_hsm_DATA_ATTR_ALLOW_DEBUG [0..1]: multiplicity set at pre-compile, origin=RB:0.1.0:2018-01-01, set at pre-compile  # debugging capable Data/Key? | True: A key allowing usage with attached debuger, can be written to this slot. False: A key allowing usage with attached debuger, can not be written to this slot. Recommended Value: True. Details: True: A user is allowed to use the key-slot, if a debugger is attached. False: A user must set the property ecy_hsm_CSAI_KEYPROP_LOCKED_ON_DEBUG, if he wants to write the key to the key-slot. ecy_hsm_CSAI_KEYPROP_LOCKED_ON_DEBUG: The key can not be used if a debugger is attached Important: This attribute does not specify the effective properties of the key-slot, but determines which properties of a given key can be written to this key-slot.
          boolean ecy_hsm_DATA_ATTR_ALLOW_WILDCARD [0..1]: multiplicity set at pre-compile, origin=RB:0.1.0:2018-01-01, set at pre-compile  # wildcard key usable for SHE overwriting? | Always set to True. The current version expects this data attribute to be set to true even if there is no effect.
          boolean ecy_hsm_DATA_ATTR_PUBLIC [0..1]: multiplicity set at pre-compile, origin=RB:0.1.0:2018-01-01, set at pre-compile  # does Data/Key contain public info? | Data/Key contains public information (may be exported)
          boolean ecy_hsm_DATA_ATTR_PRIVATE [0..1]: multiplicity set at pre-compile, origin=RB:0.1.0:2018-01-01, set at pre-compile  # does Data/Key contain private info? | Data/Key contains private information (shall NOT be exported)
          boolean ecy_hsm_DATA_ATTR_MULTISESSION [0..1]: multiplicity set at pre-compile, origin=RB:0.1.0:2018-01-01, set at pre-compile  # is Data/Key multisession capable? | Always set to True. The current version expects this data attribute to be set to true even if there is no effect.
          boolean ecy_hsm_DATA_ATTR_SSS [0..1]: multiplicity set at pre-compile, origin=RB:0.1.0:2018-01-01, set at pre-compile  # is Data/Key SSS only? | Data/Key is only usable by the SSS (Secure Space Script) middleware/applet
    container ecy_hsm_CERT [0..1]: multiplicity set at pre-compile  # CERT related configurations
      container STATIC [0..1]
        container CONFIG_PROP_SET_3779413612 [0..7]
          enumeration ecy_hsm_RESOURCE_OBJECTS [0..1]: {STATIC_CFG_CERT_BASE_0, STATIC_CFG_CERT_INST_1, STATIC_CFG_CERT_INST_2, STATIC_CFG_CERT_INST_3, STATIC_CFG_CERT_INST_4, STATIC_CFG_CERT_INST_5, STATIC_CFG_CERT_INST_6}
          integer ecy_hsm_USER_ID [0..1]: 0.., multiplicity set at pre-compile, origin=RB:0.1.0:2018-01-01, set at pre-compile  # User ID | User defined data object ID. The value must be an unique numeric value between 0 and 4294967295. The value itself is not used by the application.
          boolean ecy_hsm_DATA_ATTR_USE_AUTH_GEN [0..1]: multiplicity set at pre-compile, origin=RB:0.1.0:2018-01-01, set at pre-compile  # authentication generation capable data/key? | True: A key restricted to verification and generation usage can be written to this slot. False: A key restricted to verification and generation usage can not be written to this slot. Recommended Value: True. Details: If you want to write a key with property ecy_hsm_CSAI_KEYPROP_MAC_ONLY to this key-slot, set True. ecy_hsm_CSAI_KEYPROP_MAC_ONLY: The key can not be used for encryption and decryption. Important: This attribute does not specify the effective properties of the key-slot, but determines which properties of a given key can be written to this key-slotData/Key may be used for authentication generation.
          boolean ecy_hsm_DATA_ATTR_USE_AUTH_VERIFY [0..1]: multiplicity set at pre-compile, origin=RB:0.1.0:2018-01-01, set at pre-compile  # authentication verification capable data/key? | True: A key restricted to verification and generation usage can be written to this slot. False: A key restricted to verification and generation usage can not be written to this slot. Recommended Value: True. Details: If you want to write a key with property ecy_hsm_CSAI_KEYPROP_MAC_ONLY or ecy_hsm_CSAI_KEYPROP_IS_VERIFY_ONLY to this key-slot, set True. ecy_hsm_CSAI_KEYPROP_MAC_ONLY: The key can not be used for encryption and decryption. ecy_hsm_CSAI_KEYPROP_IS_VERIFY_ONLY: The key can not be used for encryption, decryption and MAC-Generation Important: This attribute does not specify the csai-properties of the key-slot, but determines which csai properties of a given key can be written to this key-slot.
          boolean ecy_hsm_DATA_ATTR_USE_ENCRYPT [0..1]: multiplicity set at pre-compile, origin=RB:0.1.0:2018-01-01, set at pre-compile  # encryption capable data/key? | True: A key restricted to encryption and decryption usage can be written to this slot. False: A key restricted to encryption and decryption usage can not be written to this slot. Recommended Value: True. Details: If you want to write a key with property. ecy_hsm_CSAI_KEYPROP_ENCDEC_ONLY to this key-slot, set True. ecy_hsm_CSAI_KEYPROP_ENCDEC_ONLY: The user can not use the key for the verification or generation of MACs. Important: This attribute does not specify the effective properties of the key-slot, but determines which properties of a given key can be written to this key-slot.
          boolean ecy_hsm_DATA_ATTR_USE_DECRYPT [0..1]: multiplicity set at pre-compile, origin=RB:0.1.0:2018-01-01, set at pre-compile  # decryption capable Data/Key? | True: A key restricted to encryption and decryption usage can be written to this slot. False: A key restricted to encryption and decryption usage can not be written to this slot. Recommended Value: True. Details: If you want to write a key with property . ecy_hsm_CSAI_KEYPROP_ENCDEC_ONLY to this key-slot, set True. ecy_hsm_CSAI_KEYPROP_ENCDEC_ONLY: The user can not use the key for the verification or generation of MACs. Important: This attribute does not specify the effective properties of the key-slot, but determines which properties of a given key can be written to this key-slot.
          boolean ecy_hsm_DATA_ATTR_ALLOW_SECBOOT [0..1]: multiplicity set at pre-compile, origin=RB:0.1.0:2018-01-01, set at pre-compile  # secure boot capable Data/Key? | True: You can write a key to this slot, which can be used if secure boot has failed. False: You can not write a key to this slot, which can be used if secure boot has failed. Details: True: A user is able to write a key without property ecy_hsm_CSAI_KEYPROP_SECURE_BOOT_MUST_PASS to this key-slot. A key can be used even if Secure Boot has failed. False: A user must set the property ecy_hsm_CSAI_KEYPROP_SECURE_BOOT_MUST_PASS, if he wants to write the key to the key-slot. ecy_hsm_CSAI_KEYPROP_SECURE_BOOT_MUST_PASS: The symetric key can only be used when the validation of Secure-Boot resp. Trusted-Boot has been sucessfull.
          boolean ecy_hsm_DATA_ATTR_ALLOW_DEBUG [0..1]: multiplicity set at pre-compile, origin=RB:0.1.0:2018-01-01, set at pre-compile  # debugging capable Data/Key? | True: A key allowing usage with attached debuger, can be written to this slot. False: A key allowing usage with attached debuger, can not be written to this slot. Recommended Value: True. Details: True: A user is allowed to use the key-slot, if a debugger is attached. False: A user must set the property ecy_hsm_CSAI_KEYPROP_LOCKED_ON_DEBUG, if he wants to write the key to the key-slot. ecy_hsm_CSAI_KEYPROP_LOCKED_ON_DEBUG: The key can not be used if a debugger is attached Important: This attribute does not specify the effective properties of the key-slot, but determines which properties of a given key can be written to this key-slot.
          boolean ecy_hsm_DATA_ATTR_ALLOW_WILDCARD [0..1]: multiplicity set at pre-compile, origin=RB:0.1.0:2018-01-01, set at pre-compile  # wildcard key usable for SHE overwriting? | Always set to True. The current version expects this data attribute to be set to true even if there is no effect.
          boolean ecy_hsm_DATA_ATTR_PUBLIC [0..1]: multiplicity set at pre-compile, origin=RB:0.1.0:2018-01-01, set at pre-compile  # does Data/Key contain public info? | Data/Key contains public information (may be exported)
          boolean ecy_hsm_DATA_ATTR_PRIVATE [0..1]: multiplicity set at pre-compile, origin=RB:0.1.0:2018-01-01, set at pre-compile  # does Data/Key contain private info? | Data/Key contains private information (shall NOT be exported)
          boolean ecy_hsm_DATA_ATTR_MULTISESSION [0..1]: multiplicity set at pre-compile, origin=RB:0.1.0:2018-01-01, set at pre-compile  # is Data/Key multisession capable? | Always set to True. The current version expects this data attribute to be set to true even if there is no effect.
          boolean ecy_hsm_DATA_ATTR_CERTTYPE_X509 [0..1]: multiplicity set at pre-compile, origin=RB:0.1.0:2018-01-01, set at pre-compile  # is Cert x509? | Cert is X509
          boolean ecy_hsm_DATA_ATTR_SSS [0..1]: multiplicity set at pre-compile, origin=RB:0.1.0:2018-01-01, set at pre-compile  # is Data/Key SSS only? | Data/Key is only usable by the SSS (Secure Space Script) middleware/applet
          multiline string ecy_hsm_CERT_CONTENT [0..1]: multiplicity set at pre-compile, origin=RB:0.1.0:2018-01-01, set at pre-compile  # Certificate content | Certificate content (DER encoded hex string).
    container ecy_hsm_OID [0..1]: multiplicity set at pre-compile  # OID related configurations
      container STATIC [0..1]
        container CONFIG_PROP_SET_1536297746 [0..14]
          enumeration ecy_hsm_RESOURCE_OBJECTS [0..1]: {STATIC_CFG_OID_0_BASE_0, STATIC_CFG_OID_0_INST_1, STATIC_CFG_OID_0_INST_2, STATIC_CFG_OID_0_INST_3, STATIC_CFG_OID_0_INST_4, STATIC_CFG_OID_0_INST_5, STATIC_CFG_OID_0_INST_6, STATIC_CFG_OID_0_INST_7, STATIC_CFG_OID_0_INST_8, STATIC_CFG_OID_0_INST_9, STATIC_CFG_OID_0_INST_10, STATIC_CFG_OID_0_INST_11, STATIC_CFG_OID_0_INST_12, STATIC_CFG_OID_0_INST_13}
          integer ecy_hsm_USER_ID [0..1]: 0.., multiplicity set at pre-compile, origin=RB:0.1.0:2018-01-01, set at pre-compile  # User ID | User defined data object ID. The value must be an unique numeric value between 0 and 4294967295. The value itself is not used by the application.
          boolean ecy_hsm_DATA_ATTR_USE_AUTH_GEN [0..1]: multiplicity set at pre-compile, origin=RB:0.1.0:2018-01-01, set at pre-compile  # authentication generation capable data/key? | True: A key restricted to verification and generation usage can be written to this slot. False: A key restricted to verification and generation usage can not be written to this slot. Recommended Value: True. Details: If you want to write a key with property ecy_hsm_CSAI_KEYPROP_MAC_ONLY to this key-slot, set True. ecy_hsm_CSAI_KEYPROP_MAC_ONLY: The key can not be used for encryption and decryption. Important: This attribute does not specify the effective properties of the key-slot, but determines which properties of a given key can be written to this key-slotData/Key may be used for authentication generation.
          boolean ecy_hsm_DATA_ATTR_USE_AUTH_VERIFY [0..1]: multiplicity set at pre-compile, origin=RB:0.1.0:2018-01-01, set at pre-compile  # authentication verification capable data/key? | True: A key restricted to verification and generation usage can be written to this slot. False: A key restricted to verification and generation usage can not be written to this slot. Recommended Value: True. Details: If you want to write a key with property ecy_hsm_CSAI_KEYPROP_MAC_ONLY or ecy_hsm_CSAI_KEYPROP_IS_VERIFY_ONLY to this key-slot, set True. ecy_hsm_CSAI_KEYPROP_MAC_ONLY: The key can not be used for encryption and decryption. ecy_hsm_CSAI_KEYPROP_IS_VERIFY_ONLY: The key can not be used for encryption, decryption and MAC-Generation Important: This attribute does not specify the csai-properties of the key-slot, but determines which csai properties of a given key can be written to this key-slot.
          boolean ecy_hsm_DATA_ATTR_USE_ENCRYPT [0..1]: multiplicity set at pre-compile, origin=RB:0.1.0:2018-01-01, set at pre-compile  # encryption capable data/key? | True: A key restricted to encryption and decryption usage can be written to this slot. False: A key restricted to encryption and decryption usage can not be written to this slot. Recommended Value: True. Details: If you want to write a key with property. ecy_hsm_CSAI_KEYPROP_ENCDEC_ONLY to this key-slot, set True. ecy_hsm_CSAI_KEYPROP_ENCDEC_ONLY: The user can not use the key for the verification or generation of MACs. Important: This attribute does not specify the effective properties of the key-slot, but determines which properties of a given key can be written to this key-slot.
          boolean ecy_hsm_DATA_ATTR_USE_DECRYPT [0..1]: multiplicity set at pre-compile, origin=RB:0.1.0:2018-01-01, set at pre-compile  # decryption capable Data/Key? | True: A key restricted to encryption and decryption usage can be written to this slot. False: A key restricted to encryption and decryption usage can not be written to this slot. Recommended Value: True. Details: If you want to write a key with property . ecy_hsm_CSAI_KEYPROP_ENCDEC_ONLY to this key-slot, set True. ecy_hsm_CSAI_KEYPROP_ENCDEC_ONLY: The user can not use the key for the verification or generation of MACs. Important: This attribute does not specify the effective properties of the key-slot, but determines which properties of a given key can be written to this key-slot.
          boolean ecy_hsm_DATA_ATTR_ALLOW_SECBOOT [0..1]: multiplicity set at pre-compile, origin=RB:0.1.0:2018-01-01, set at pre-compile  # secure boot capable Data/Key? | True: You can write a key to this slot, which can be used if secure boot has failed. False: You can not write a key to this slot, which can be used if secure boot has failed. Details: True: A user is able to write a key without property ecy_hsm_CSAI_KEYPROP_SECURE_BOOT_MUST_PASS to this key-slot. A key can be used even if Secure Boot has failed. False: A user must set the property ecy_hsm_CSAI_KEYPROP_SECURE_BOOT_MUST_PASS, if he wants to write the key to the key-slot. ecy_hsm_CSAI_KEYPROP_SECURE_BOOT_MUST_PASS: The symetric key can only be used when the validation of Secure-Boot resp. Trusted-Boot has been sucessfull.
          boolean ecy_hsm_DATA_ATTR_ALLOW_DEBUG [0..1]: multiplicity set at pre-compile, origin=RB:0.1.0:2018-01-01, set at pre-compile  # debugging capable Data/Key? | True: A key allowing usage with attached debuger, can be written to this slot. False: A key allowing usage with attached debuger, can not be written to this slot. Recommended Value: True. Details: True: A user is allowed to use the key-slot, if a debugger is attached. False: A user must set the property ecy_hsm_CSAI_KEYPROP_LOCKED_ON_DEBUG, if he wants to write the key to the key-slot. ecy_hsm_CSAI_KEYPROP_LOCKED_ON_DEBUG: The key can not be used if a debugger is attached Important: This attribute does not specify the effective properties of the key-slot, but determines which properties of a given key can be written to this key-slot.
          boolean ecy_hsm_DATA_ATTR_ALLOW_WILDCARD [0..1]: multiplicity set at pre-compile, origin=RB:0.1.0:2018-01-01, set at pre-compile  # wildcard key usable for SHE overwriting? | Always set to True. The current version expects this data attribute to be set to true even if there is no effect.
          boolean ecy_hsm_DATA_ATTR_PUBLIC [0..1]: multiplicity set at pre-compile, origin=RB:0.1.0:2018-01-01, set at pre-compile  # does Data/Key contain public info? | Data/Key contains public information (may be exported)
          boolean ecy_hsm_DATA_ATTR_PRIVATE [0..1]: multiplicity set at pre-compile, origin=RB:0.1.0:2018-01-01, set at pre-compile  # does Data/Key contain private info? | Data/Key contains private information (shall NOT be exported)
          boolean ecy_hsm_DATA_ATTR_MULTISESSION [0..1]: multiplicity set at pre-compile, origin=RB:0.1.0:2018-01-01, set at pre-compile  # is Data/Key multisession capable? | Always set to True. The current version expects this data attribute to be set to true even if there is no effect.
          boolean ecy_hsm_DATA_ATTR_SSS [0..1]: multiplicity set at pre-compile, origin=RB:0.1.0:2018-01-01, set at pre-compile  # is Data/Key SSS only? | Data/Key is only usable by the SSS (Secure Space Script) middleware/applet
          multiline string ecy_hsm_OID_CONTENT [0..1]: multiplicity set at pre-compile, origin=RB:0.1.0:2018-01-01, set at pre-compile  # OID content | OID content (as hex string or dotted notation).
    container ecy_hsm_SECRET_DATA [0..1]: multiplicity set at pre-compile  # SECRET_DATA related configurations
      container DYNAMIC [0..1]
        container CONFIG_PROP_SET_307655018 [0..20]
          enumeration ecy_hsm_RESOURCE_OBJECTS [0..1]: {DYNAMIC_CFG_SECRET_DATA_MONOTONIC_0_BASE_0, DYNAMIC_CFG_SECRET_DATA_MONOTONIC_0_INST_1, DYNAMIC_CFG_SECRET_DATA_MONOTONIC_0_INST_2, DYNAMIC_CFG_SECRET_DATA_MONOTONIC_0_INST_3, DYNAMIC_CFG_SECRET_DATA_SMALL_0_BASE_0, DYNAMIC_CFG_SECRET_DATA_SMALL_0_INST_1, DYNAMIC_CFG_SECRET_DATA_SMALL_0_INST_2, DYNAMIC_CFG_SECRET_DATA_SMALL_0_INST_3, DYNAMIC_CFG_SECRET_DATA_SMALL_0_INST_4, DYNAMIC_CFG_SECRET_DATA_SMALL_0_INST_5, DYNAMIC_CFG_SECRET_DATA_SMALL_0_INST_6, DYNAMIC_CFG_SECRET_DATA_SMALL_0_INST_7, DYNAMIC_CFG_SECRET_DATA_SMALL_0_INST_8, DYNAMIC_CFG_SECRET_DATA_SMALL_0_INST_9, DYNAMIC_CFG_SECRET_DATA_READONLY_0, DYNAMIC_CFG_SECRET_DATA_MAXUPDATE3_0, DYNAMIC_CFG_SECRET_DATA_LARGE_0_BASE_0, DYNAMIC_CFG_SECRET_DATA_LARGE_0_INST_1, DYNAMIC_CFG_SECRET_DATA_LARGE_0_INST_2, DYNAMIC_CFG_SECRET_DATA_LARGE_0_INST_3}
          integer ecy_hsm_MAX_NUM_UPDATES [0..1]: 0.., multiplicity set at pre-compile, origin=RB:0.1.0:2018-01-01, set at pre-compile  # maximum number of updates | number of times that a resource in DFLASH can be updated or 0xFFFFFFFF if infinity
          integer ecy_hsm_USER_ID [0..1]: 0.., multiplicity set at pre-compile, origin=RB:0.1.0:2018-01-01, set at pre-compile  # User ID | User defined data object ID. The value must be an unique numeric value between 0 and 4294967295. The value itself is not used by the application.
          enumeration ecy_hsm_MIRROR [0..1]: {USER_DEMAND, BACKGROUND, STARTUP_HSM, STARTUP_HOST}
          boolean ecy_hsm_DATA_ATTR_ALLOW_WRITE [0..1]: multiplicity set at pre-compile, origin=RB:0.1.0:2018-01-01, set at pre-compile  # updatable and/or erasable Data/Key? | True: You can write to this key-slot multiple times. False: You can write to this key-slot only once. Details: True: A user is able to write a key with following properties to the key-slot: ecy_hsm_CSAI_KEYPROP_IS_READONLY_KEY, ecy_hsm_CSAI_KEYPROP_IS_DELETABLE_KEY. False: A user must assign following property to the key, if the key shall be written to the key-slot: ecy_hsm_CSAI_KEYPROP_IS_READONLY_KEY.. Property description: ecy_hsm_CSAI_KEYPROP_IS_READONLY_KEY: The key can only be written once to the slot. Every additional write attempt is rejected. ecy_hsm_CSAI_KEYPROP_IS_DELETABLE_KEY: The user can update the key slot by invoking ecy_hsm_Csai_WriteKeyToNvmKeyStore. Important: This attribute does not specify the effective properties of the key-slot, but determines which properties of a given key can be written to this key-slot.
          boolean ecy_hsm_DATA_ATTR_ALLOW_SECBOOT [0..1]: multiplicity set at pre-compile, origin=RB:0.1.0:2018-01-01, set at pre-compile  # secure boot capable Data/Key? | True: You can write a key to this slot, which can be used if secure boot has failed. False: You can not write a key to this slot, which can be used if secure boot has failed. Details: True: A user is able to write a key without property ecy_hsm_CSAI_KEYPROP_SECURE_BOOT_MUST_PASS to this key-slot. A key can be used even if Secure Boot has failed. False: A user must set the property ecy_hsm_CSAI_KEYPROP_SECURE_BOOT_MUST_PASS, if he wants to write the key to the key-slot. ecy_hsm_CSAI_KEYPROP_SECURE_BOOT_MUST_PASS: The symetric key can only be used when the validation of Secure-Boot resp. Trusted-Boot has been sucessfull.
          boolean ecy_hsm_DATA_ATTR_ALLOW_DEBUG [0..1]: multiplicity set at pre-compile, origin=RB:0.1.0:2018-01-01, set at pre-compile  # debugging capable Data/Key? | True: A key allowing usage with attached debuger, can be written to this slot. False: A key allowing usage with attached debuger, can not be written to this slot. Recommended Value: True. Details: True: A user is allowed to use the key-slot, if a debugger is attached. False: A user must set the property ecy_hsm_CSAI_KEYPROP_LOCKED_ON_DEBUG, if he wants to write the key to the key-slot. ecy_hsm_CSAI_KEYPROP_LOCKED_ON_DEBUG: The key can not be used if a debugger is attached Important: This attribute does not specify the effective properties of the key-slot, but determines which properties of a given key can be written to this key-slot.
          boolean ecy_hsm_DATA_ATTR_ALLOW_WILDCARD [0..1]: multiplicity set at pre-compile, origin=RB:0.1.0:2018-01-01, set at pre-compile  # wildcard key usable for SHE overwriting? | Always set to True. The current version expects this data attribute to be set to true even if there is no effect.
          boolean ecy_hsm_DATA_ATTR_PUBLIC [0..1]: multiplicity set at pre-compile, origin=RB:0.1.0:2018-01-01, set at pre-compile  # does Data/Key contain public info? | Data/Key contains public information (may be exported)
          boolean ecy_hsm_DATA_ATTR_PRIVATE [0..1]: multiplicity set at pre-compile, origin=RB:0.1.0:2018-01-01, set at pre-compile  # does Data/Key contain private info? | Data/Key contains private information (shall NOT be exported)
          boolean ecy_hsm_DATA_ATTR_MULTISESSION [0..1]: multiplicity set at pre-compile, origin=RB:0.1.0:2018-01-01, set at pre-compile  # is Data/Key multisession capable? | Always set to True. The current version expects this data attribute to be set to true even if there is no effect.
          boolean ecy_hsm_DATA_ATTR_SSS [0..1]: multiplicity set at pre-compile, origin=RB:0.1.0:2018-01-01, set at pre-compile  # is Data/Key SSS only? | Data/Key is only usable by the SSS (Secure Space Script) middleware/applet
          boolean ecy_hsm_DATA_CFG_INCREMENT [0..1]: multiplicity set at pre-compile, origin=RB:0.1.0:2018-01-01, set at pre-compile  # only incrementable data? | Data may be only incremented (i.e. mileage)
    container ecy_hsm_INT_DATA [0..1]: multiplicity set at pre-compile  # INT_DATA related configurations
      container STATIC [0..1]
        container CONFIG_PROP_SET_1018551969 [0..1]
          enumeration ecy_hsm_RESOURCE_OBJECTS [0..1]: {STATIC_CFG_INT_DATA_0}
          integer ecy_hsm_USER_ID [0..1]: 0.., multiplicity set at pre-compile, origin=RB:0.1.0:2018-01-01, set at pre-compile  # User ID | User defined data object ID. The value must be an unique numeric value between 0 and 4294967295. The value itself is not used by the application.
          boolean ecy_hsm_DATA_ATTR_MULTISESSION [0..1]: multiplicity set at pre-compile, origin=RB:0.1.0:2018-01-01, set at pre-compile  # is Data/Key multisession capable? | Always set to True. The current version expects this data attribute to be set to true even if there is no effect.
          boolean ecy_hsm_DATA_ATTR_SSS [0..1]: multiplicity set at pre-compile, origin=RB:0.1.0:2018-01-01, set at pre-compile  # is Data/Key SSS only? | Data/Key is only usable by the SSS (Secure Space Script) middleware/applet
          integer ecy_hsm_SW_INFO_TABLE_VERSION [0..1]: 0.., multiplicity set at pre-compile, origin=RB:0.1.0:2018-01-01, set at pre-compile  # The version id of the reference table structure | The version id of the reference table structure. The value should be unique for different configurations of the Trusted Boot Table. Set to 1000 for current version.
          container ecy_hsm_SW_INFO_TABLE_INFO_ARRAY [0..12]
            integer ecy_hsm_SW_PART_ADDRESS [0..1]: 0.., multiplicity set at pre-compile, origin=RB:0.1.0:2018-01-01, set at pre-compile  # The start address of the host SW part to be verified | The start address of the host SW P-Flash segment to be verified during boot / RTMD.
            integer ecy_hsm_SW_PART_LENGTH [0..1]: 0.., multiplicity set at pre-compile, origin=RB:0.1.0:2018-01-01, set at pre-compile  # The length of the host SW part to be verified | The length of the host SW part to be verified in bytes.
            integer ecy_hsm_SW_PART_TABS_SIGNATURE_ADDRESS [0..1]: 0.., multiplicity set at pre-compile, origin=RB:0.1.0:2018-01-01, set at pre-compile  # SW part TABS signature address | Start address of the signature of the host SW part to be verified in TABS
            integer ecy_hsm_SW_PART_TABS_CERTIFICATE_ADDRESS [0..1]: 0.., multiplicity set at pre-compile, origin=RB:0.1.0:2018-01-01, set at pre-compile  # SW part TABS certificate address | Start address of the certificate for the SW part verification in TABS
            enumeration ecy_hsm_SW_PART_TABS_SIGNATURE_TYPE [0..1]: {SIG_TYPE_NONE, SIG_TYPE_RSA_SSA_PKCS1_1V5_SHA256, SIG_TYPE_RSA_SSA_PSS_SHA256, SIG_TYPE_ED25519_SHA_512_PURE, SIG_TYPE_ED25519_SHA_512_DOM2_PH, SIG_TYPE_SECP224_SHA_224, SIG_TYPE_SECP256_SHA_256, SIG_TYPE_SECP384_SHA_384, SIG_TYPE_SECP256_SHA_512, SIG_TYPE_SECP384_SHA_512, SIG_TYPE_SECP384_SHA_256, SIG_TYPE_SM2_DSA_SM3, SIG_TYPE_RSA_SSA_PSS_SHA384}
            integer ecy_hsm_SW_PART_TABS_KEY_ID [0..1]: 0.., multiplicity set at pre-compile, origin=RB:0.1.0:2018-01-01, set at pre-compile  # SW part TABS Key ID | Key ID of the certificate or public key to use when checking the signature of the host SW part in TABS
            integer ecy_hsm_SW_PART_ID [0..1]: 0.., multiplicity set at pre-compile, origin=RB:0.1.0:2018-01-01, set at pre-compile  # The ID of the host SW part to be verified by the HSM
            integer ecy_hsm_SW_PART_VERIF_BOOTMODE [0..1]: 0.., multiplicity set at pre-compile, origin=RB:0.1.0:2018-01-01, set at pre-compile  # The TB boot verification mode | The TB boot verification mode. For entry in the trusted boot table, a number of flags indicate how the entry is to be treated. Multiple flags can be combined by OR-ing the corresponding values: Possible Values are: 0x01 = SW part is for Host boot responsible, 0x02 = SW part is marked for secure boot, 0x04 = SW part is marked for authentic boot, 0x08 = SW part is marked for a first run of RTMD, 0x0A = SW part is marked for a continuous RTMD.
            integer ecy_hsm_SW_PART_VERIF_RTMD_ORDER [0..1]: 0.., multiplicity set at pre-compile, origin=RB:0.1.0:2018-01-01, set at pre-compile  # The RTMD order nr for first run | The RTMD order nr for first run. All configured SW parts are processed in ascending order based on this number. The order number for all follow-up RTMD runs is randomly choosen by the HSM.
            enumeration ecy_hsm_SW_PART_TABS_SIGN_MODE [0..1]: {VERIFMODE_NONE, VERIFMODE_MEMMAPPED_CERT, VERIFMODE_KEYSTORE_PUBKEY, VERIFMODE_KEYSTORE_CERT, VERIFMODE_MANUAL_HEADER_BASED_VERIFICATION_V1}
        container CONFIG_PROP_SET_3198430460 [0..1]
          enumeration ecy_hsm_RESOURCE_OBJECTS [0..1]: {STATIC_CFG_HSM_SUSPEND_TIME}
          integer ecy_hsm_USER_ID [0..1]: 0.., multiplicity set at pre-compile, origin=RB:0.1.0:2018-01-01, set at pre-compile  # User ID | User defined data object ID. The value must be an unique numeric value between 0 and 4294967295. The value itself is not used by the application.
          boolean ecy_hsm_DATA_ATTR_MULTISESSION [0..1]: multiplicity set at pre-compile, origin=RB:0.1.0:2018-01-01, set at pre-compile  # is Data/Key multisession capable? | Always set to True. The current version expects this data attribute to be set to true even if there is no effect.
          boolean ecy_hsm_DATA_ATTR_SSS [0..1]: multiplicity set at pre-compile, origin=RB:0.1.0:2018-01-01, set at pre-compile  # is Data/Key SSS only? | Data/Key is only usable by the SSS (Secure Space Script) middleware/applet
          integer ecy_hsm_CFG_HSM_SUSPEND_TIME_DATA [0..1]: 0.., multiplicity set at pre-compile, origin=RB:0.1.0:2018-01-01, set at pre-compile  # The HSM suspend time out limit | The HSM suspend time out limit. Maximum time in ms the HSM stays in Suspended-Mode unless the user calls ecy_hsm_Mgmt_SuspendKeep(). Range is between 0 and 4294967295.
    container ecy_hsm_SECLOG_DATA [0..1]: multiplicity set at pre-compile  # SECLOG_DATA related configurations
    container ecy_hsm_DOWNGRADE_PROTECTION_DATA [0..1]: multiplicity set at pre-compile  # DOWNGRADE_PROTECTION_DATA related configurations
    container ecy_hsm_CUSTOMCODE [0..1]: multiplicity set at pre-compile  # CUSTOMCODE related configurations
    container ecy_hsm_OTP_CERT [0..1]: multiplicity set at pre-compile  # OTP_CERT related configurations
    container ecy_hsm_OTP_OID [0..1]: multiplicity set at pre-compile  # OTP_OID related configurations
    container ecy_hsm_OTP_UPDATE_KEY [0..1]: multiplicity set at pre-compile  # OTP_UPDATE_KEY related configurations
    container ecy_hsm_SMART_TB_DATA [0..1]: multiplicity set at pre-compile  # SMART_TB_DATA related configurations
