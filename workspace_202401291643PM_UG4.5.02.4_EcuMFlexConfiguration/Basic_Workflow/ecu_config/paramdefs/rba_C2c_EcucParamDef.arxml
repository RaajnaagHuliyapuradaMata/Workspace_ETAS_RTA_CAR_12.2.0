AUTOSAR XML (schema 00048)
package /RB/RBA/rba_C2c/EcucModuleDefs
  module definition rba_C2c [0..1]: category=VENDOR_SPECIFIC_MODULE_DEFINITION, post-build-variant-support=true, refined-module-def=rba_C2c, variants pre-compile  # MCAL Chip To Chip Communication | Configuration of the C2c MCAL module.
    container rba_C2c_ConfigSet  # Configuration data set | This is the base container that contains the post-build selectable configuration parameters
      container rba_C2c_HwUnit [1..*]: multiplicity set at pre-compile, post-build-variant-multiplicity=true  # HW unit | This container contains HW-Unit specific parameters.
        string rba_C2c_CallbackHeaderFile: origin=RB, post-build-variant-value=true, set at pre-compile  # Callback header file | The name of the header file were the callback function for all hardware unit specific callbacks are declared.
        string rba_C2c_DmaSingleTransferCopyData [0..1]: multiplicity set at pre-compile, origin=RB, post-build-variant-multiplicity=true, post-build-variant-value=true, set at pre-compile  # Copy data DMA (Single transfer) | IFX: Necessary for Streaming ST SR6X7: Necessary only for dma triggered single write transfers DMA that copies the data to the single transfer channel registers. (DMA Operated Command Queue). For example to initialize the stream registers on the target side. Prefix "rba_Dma_" must not be added to the configured shortname from the DMA.
        string rba_C2c_DmaSingleTransferReloadAddress [0..1]: multiplicity set at pre-compile, origin=RB, post-build-variant-multiplicity=true, post-build-variant-value=true, set at pre-compile  # Address Reload DMA (Single transfer) | IFX: Necessary for Streaming ST SR6X7: Necessary only for dma triggered single write transfers DMA that reloads the destination address of the copy data DMA. Prefix "rba_Dma_" must not be added to the configured shortname from the DMA. Address reload DMA must have higher priority than copy data DMA.
        string rba_C2c_DmaSingleTransferTriggerTransfer [0..1]: multiplicity set at pre-compile, origin=RB, post-build-variant-multiplicity=true, post-build-variant-value=true, set at pre-compile  # Trigger transfer DMA (Single transfer) | IFX: Necessary for Streaming ST SR6X7: Necessary only for dma triggered single write transfers This is the DMA channel which triggers the stream transfer after initialization of target stream registers. Prefix "rba_Dma_" must not be added to the configured shortname from the DMA.
        string rba_C2c_DmaStreamCopyData [0..1]: multiplicity set at pre-compile, origin=RB, post-build-variant-multiplicity=true, post-build-variant-value=true, set at pre-compile  # Copy data DMA (Stream) | Must only be configured for ST controllers. DMA that copies the data from the buffer to the SIPI registers. Prefix "rba_Dma_" must not be added to the configured shortname from the DMA. Copy data DMA should have the lowest priority.
        string rba_C2c_DmaStreamReloadAddress [0..1]: multiplicity set at pre-compile, origin=RB, post-build-variant-multiplicity=true, post-build-variant-value=true, set at pre-compile  # Address reload DMA (Stream) | Must only be configured for ST controllers. DMA that reloads the destination address of the copy data dma to point to the first data register of the SIPI module. Prefix "rba_Dma_" must not be added to the configured shortname from the DMA. Address reload DMA should have the highest priority.
        string rba_C2c_DmaStreamTriggerTransfer [0..1]: multiplicity set at pre-compile, origin=RB, post-build-variant-multiplicity=true, post-build-variant-value=true, set at pre-compile  # Trigger transfer DMA (Stream) | Must only be configured for ST controllers. This is the DMA channel which triggers the transfer. Prefix "rba_Dma_" must not be added to the configured shortname from the DMA.
        string rba_C2c_ErrorCallback: origin=RB, post-build-variant-value=true, set at pre-compile  # Error callback | The name of the function that will be called if a hardware unit related error (E.g. crc-error) occurs. This function must have a parameter of type rba_C2c_QueueEntryUserInfo_tst. Before evaluating values from this structure it must be checked by application software if the username given in this structure is valid.
        string rba_C2c_GtmTimeout [0..1]: multiplicity set at pre-compile, origin=RB, post-build-variant-multiplicity=true, post-build-variant-value=true, set at pre-compile  # GTM (TOM) for timeout | GTM (TOM) used for timeout to be able to detect if queue is stuck. If not configured application software must ensure that detection of a stuck queue is ensured in another way. Prefix "rba_Gtm_" must not be added to the configured shortname from the GTM.
        integer rba_C2c_GtmTimeoutValue [0..1]: 1..1000, multiplicity set at pre-compile, origin=RB, post-build-variant-multiplicity=true, post-build-variant-value=true, set at pre-compile  # Timeout value for GTM (TOM) in ms | Value of the timeout that is triggered by the GTM in ms. Possible accuracy depends on the actual hardware. As the configured value may not be supported by the GTM exactly it will be rounded up. Check the report of rba_C2c to see which value is actually used.
        string rba_C2c_GtmWorkaroundB2b [0..1]: multiplicity set at pre-compile, origin=RB, post-build-variant-multiplicity=true, post-build-variant-value=true, set at pre-compile  # GTM (TOM) for B2B Workaround | Only for ST (Except X7). GTM (TOM) used for workaround in streaming mode. Prefix "rba_Gtm_" must not be added to the configured shortname from the GTM.
        enumeration rba_C2c_HwUnit: origin=RB, post-build-variant-value=true, set at pre-compile  # Hardware unit | Number of the hardware unit. Unit 1 is only available for IFX Dev5
          UNIT_0  # Unit 0
          UNIT_1  # Unit 1
        integer rba_C2c_MaxSingleWriteBufferSize [0..1]: 3..50, origin=RB, set at pre-compile  # Max single write buffer size | IFX only. Max. number of single write buffer entries for DMA triggered single writes including the dummy entry that must be provided at the end of each buffer. Max. amount of DMA triggered transfers during runtime is rba_C2c_MaxSingleWriteBufferSize-1! User has to take care about this as this cannot be checked in the c2c driver! The data in the last entry (dummy entry) does not matter and is just necessary for a workaround that does not care about the actual data but it does read from this address.
        enumeration rba_C2c_Mode: origin=RB, post-build-variant-value=true, set at pre-compile  # Mode | Selects the mode (master or slave) for rba_C2c. If multiple hardware units are used on one controller all of them must be configured either as master or as slave. Using some as master and some as slave is not allowed.
          RBA_C2C_PRV_MODE_MASTER  # Master
          RBA_C2C_PRV_MODE_SLAVE  # Slave
        integer rba_C2c_NumberOfPrios: 1..4, origin=RB, set at pre-compile  # Number of prios | Number of priorities for the queue
        integer rba_C2c_QueueSize: 1..4096, origin=RB, set at pre-compile  # Queue size | Number of queue entries. It is recommended to use a size that is a power of two (2,4,8,16,…). All other sizes lead to higher runtime of the code.
        boolean rba_C2c_StopQueueOnError: origin=RB, post-build-variant-value=true, set at pre-compile  # Stop queue on error | With this parameter the further processing of the queue in case of an error could be configured. TRUE: Queue will be stopped if an error occured and instead of the user dependent error isr the unit error isr (rba_C2c_ErrorCallback) will be called because all users are affected. In this case informations about the current queue entry can be evaluated by the error functions parameter of type rba_C2c_QueueEntryUserInfo_tst). FALSE: Error callback of the user whos transfer failed will be called (if configured) and the next queue entry will be processed (if available).
        enumeration rba_C2c_TargetDevice: {ST, IFX}, origin=RB, post-build-variant-value=true, set at pre-compile  # Target device | Target device to communicate with.
        integer rba_C2c_TimeoutValue: 50..500, origin=RB, post-build-variant-value=true, set at pre-compile  # Timeout value | Value for the timeout counter inside SIPI/HSSL in µS if transfer is not successfull. IFX: According to Infineon 500µS is a worst case value that covers all use cases. Dependend on the use case lower values may be sufficient but you must ensure that it is high enough that it does not trigger during a functional transfer. According to Infineon timeout may vary by one predevider clock period. Therefore and as not all timeout values can be represented 1:1 in the registers the timeout value is always rounded up. ST: Did not provide any values for the timeout. General: The actual timeout value is present in the report of rba_C2c.
        container rba_C2c_StreamTargetRegAddressesIfx [0..1]: multiplicity set at pre-compile, post-build-variant-multiplicity=true  # Stream target register addresses IFX | This container contains addresses of target registers that shall be initialized for streaming
          integer rba_C2c_MflagsclAddress: 0..‭4294967295‬, origin=RB, post-build-variant-value=true, set at pre-compile  # MFLAGSCL Address | Address of the MFLAGSCL register of the target
          integer rba_C2c_MflagssetAddress: 0..‭4294967295‬, origin=RB, post-build-variant-value=true, set at pre-compile  # MFLAGSSET Address | Address of the MFLAGSSET register of the target
          integer rba_C2c_TsfcAddress: 0..‭4294967295‬, origin=RB, post-build-variant-value=true, set at pre-compile  # TSFC Address | Address of the TSFC register of the target
          integer rba_C2c_Tssa0Address: 0..‭4294967295‬, origin=RB, post-build-variant-value=true, set at pre-compile  # TSSA0 Address | Address of the TSSA0 register of the target
        container rba_C2c_StreamTargetRegAddressesSt [0..1]: multiplicity set at pre-compile, post-build-variant-multiplicity=true  # Stream target register addresses ST | This container contains addresses of target registers that shall be initialized for streaming
          integer rba_C2c_AcrAddress: 0..‭4294967295‬, origin=RB, post-build-variant-value=true, set at pre-compile  # ACR Address | Address of the ACR register of the target
        container rba_C2c_User [1..*]: multiplicity set at pre-compile, post-build-variant-multiplicity=true  # User | This container contains user specific parameters
          string rba_C2c_AckCallback [0..1]: multiplicity set at pre-compile, origin=RB, post-build-variant-multiplicity=true, post-build-variant-value=true, set at pre-compile  # Ack callback | Configures the name of the function that is called if an ack is received. This function must have a parameter of type rba_C2c_QueueEntryUserInfo_tst.
          string rba_C2c_CallbackHeaderFile [0..1]: multiplicity set at pre-compile, origin=RB, post-build-variant-multiplicity=true, post-build-variant-value=true, set at pre-compile  # Callback header file | The name of the header file were the callback functions for all channel specific errors are declared.
          string rba_C2c_ErrorCallback [0..1]: multiplicity set at pre-compile, origin=RB, post-build-variant-multiplicity=true, post-build-variant-value=true, set at pre-compile  # Error callback | Configures the name of the function that is called if an error occurs. This function must have a parameter of type rba_C2c_QueueEntryUserInfo_tst.
          integer rba_C2c_NumberOfRetries [0..1]: 0..10, multiplicity set at pre-compile, origin=RB, post-build-variant-multiplicity=true, post-build-variant-value=true, set at pre-compile, default-value=0  # Number of retries | Configure how often a failing transfer shall be retried. ST (Except X7): The number of retries must be configured to at least three because of Errata DAN-0057362
          string rba_C2c_ReadAnswerCallback [0..1]: multiplicity set at pre-compile, origin=RB, post-build-variant-multiplicity=true, post-build-variant-value=true, set at pre-compile  # Read answer callback | Configures the name of the function that is called if the response to a read data frame is received. This function must have a parameter of type rba_C2c_QueueEntryUserInfo_tst.
          string rba_C2c_TriggerEventCallback [0..1]: multiplicity set at pre-compile, origin=RB, post-build-variant-multiplicity=true, post-build-variant-value=true, set at pre-compile  # Trigger event callback | Configures the name of the function that is called for trigger event. This callback function is called when a trigger command is received on the configured channel (rba_C2c_TriggerEventChannel). Must only be configured if trigger commands shall be recieved, not if they shall only be send.
          enumeration rba_C2c_TriggerEventChannel [0..1]: multiplicity set at pre-compile, origin=RB, post-build-variant-multiplicity=true, post-build-variant-value=true, set at pre-compile  # Trigger event channel | Configures the channel to use for this trigger event. Must be the same on master and on slave for the same user. This channel is used to send a trigger command to the target and/or to receive a trigger command from the other device.
            CHANNEL_{0..3}  # Channel {0..3}
    container rba_C2c_General  # General settings | General configuration settings for the rba_C2c handler/driver.
      boolean rba_C2c_DevErrorDetect: origin=RB, set at pre-compile  # Development error detection | Enables/disables the detection and notification of development errors. If this parameter is enabled, then extended error checking is performed during runtime. Any errors detected by these checks are reported to the Det module.
