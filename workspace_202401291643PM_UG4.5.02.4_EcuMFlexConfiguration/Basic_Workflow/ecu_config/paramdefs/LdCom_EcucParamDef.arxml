AUTOSAR XML (schema 00048)
package /AUTOSAR_LdCom/EcucModuleDefs
  module definition LdCom [0..1]: category=VENDOR_SPECIFIC_MODULE_DEFINITION, post-build-variant-support=true, refined-module-def=LdCom, variants pre-compile/post-build  # Configuration of the AUTOSAR LdCom module.
    container LdComConfig  # This container contains the configuration parameters and sub containers of the AUTOSAR LdCom module.
      container LdComIPdu [0..*]: multiplicity set at link in variant link-time / post-build in variant post-build / pre-compile in variant pre-compile, post-build-variant-multiplicity=true  # Contains the configuration parameters of the LdComs signal (IPdu) inside LdCom.
        enumeration LdComApiType: {LDCOM_IF, LDCOM_TP}, scope=ECU, set at link in variant link-time+post-build / pre-compile in variant pre-compile  # Defines if this I-PDU is a normal I-PDU that shall be sent unfragmented or if this is a large I-PDU that shall be sent via the Transport Protocol of the underlying bus. | This setting is used by RTE to invoke the proper API.
        integer LdComHandleId: 0..65535, scope=ECU, set at pre-compile, symbolic-name-value=true, with-auto=true  # This is the ID used by the LdCom users (e.g. RTE) to invoke LdCom. | A corresponding shortName is created, which is used for the invocations of the users (e.g. RTE). The same ID is used for invocations by PduR.
        enumeration LdComIPduDirection: {LDCOM_RECEIVE, LDCOM_SEND}, set at link in variant link-time+post-build / pre-compile in variant pre-compile  # The direction defines if this IPdu, and therefore the contributing signal, shall be sent or received.
        function name LdComRxCopyRxData [0..1]: scope=ECU, multiplicity set at link in variant link-time+post-build / pre-compile in variant pre-compile, set at link in variant link-time+post-build / pre-compile in variant pre-compile  # Only on receiver side: Name of Rte_LdComCbkCopyRxData callback function to be called.
        function name LdComRxIndication [0..1]: scope=ECU, multiplicity set at link in variant link-time+post-build / pre-compile in variant pre-compile, set at link in variant link-time+post-build / pre-compile in variant pre-compile  # Only on receiver side: Name of Rte_LdComCbkRxIndication callback function to be called.
        function name LdComRxStartOfReception [0..1]: scope=ECU, multiplicity set at link in variant link-time+post-build / pre-compile in variant pre-compile, set at link in variant link-time+post-build / pre-compile in variant pre-compile  # Only on receiver side: Name of Rte_LdComCbkStartOfReception callback function to be called.
        function name LdComTpRxIndication [0..1]: scope=ECU, multiplicity set at link in variant link-time+post-build / pre-compile in variant pre-compile, set at link in variant link-time+post-build / pre-compile in variant pre-compile  # Only on receiver side: Name of Rte_LdComCbkTpRxIndication callback function to be called.
        function name LdComTpTxConfirmation [0..1]: scope=ECU, multiplicity set at link in variant link-time+post-build / pre-compile in variant pre-compile, set at link in variant link-time+post-build / pre-compile in variant pre-compile  # Only on sender side: Name of Rte_LdComCbkTpTxConfirmation callback function to be called.
        function name LdComTxConfirmation [0..1]: scope=ECU, multiplicity set at link in variant link-time+post-build / pre-compile in variant pre-compile, set at link in variant link-time+post-build / pre-compile in variant pre-compile  # Only on sender side: Name of Rte_LdComCbkTxConfirmation callback function to be called.
        function name LdComTxCopyTxData [0..1]: scope=ECU, multiplicity set at link in variant link-time+post-build / pre-compile in variant pre-compile, set at link in variant link-time+post-build / pre-compile in variant pre-compile  # Only on sender side: Name of Rte_LdComCbkCopyTxData callback function to be called.
        function name LdComTxTriggerTransmit [0..1]: scope=ECU, multiplicity set at link in variant link-time+post-build / pre-compile in variant pre-compile, set at link in variant link-time+post-build / pre-compile in variant pre-compile  # Only on sender side: Name of Rte_LdComCbkTriggerTransmit callback function to be called. If defined TriggerTransmit has to be supported for this signal.
        reference LdComPduRef: scope=ECU, set at link in variant link-time+post-build / pre-compile in variant pre-compile, destination=Pdu  # Reference to the global Pdu.
        foreign reference LdComSystemTemplateSignalRef [0..1]: scope=ECU, multiplicity set at link in variant link-time / post-build in variant post-build / pre-compile in variant pre-compile, post-build-variant-multiplicity=true, post-build-variant-value=true, set at link in variant link-time / post-build in variant post-build / pre-compile in variant pre-compile, destination-type=I-SIGNAL-TO-I-PDU-MAPPING  # Reference to the ISignalToIPduMapping that contains a reference to the ISignal (System Template).
      container LdComUserModule [0..*]: multiplicity set at pre-compile  # Contains the configuration parameters of the LdCom user modules.
        uri reference LdComUserModuleCnfRef: scope=ECU, set at pre-compile, destination-uri=LdComUser  # Reference to the LdCom user module configuration.
    container LdComGeneral  # Contains the general configuration parameters of the LdCom module.
      boolean LdComDevErrorDetect: set at pre-compile, default-value=false  # Switches the development error detection and notification on or off. | * true: detection and notification is enabled. * false: detection and notification is disabled.
      boolean LdComVersionInfoApi: set at pre-compile, default-value=false  # Activate/Deactivate the version information API (LdCom_GetVersionInfo). | * True: version information API activated * False: version information API deactivated
