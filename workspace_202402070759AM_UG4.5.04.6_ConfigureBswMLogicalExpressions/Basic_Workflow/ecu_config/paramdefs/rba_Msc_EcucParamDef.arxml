AUTOSAR XML (schema 00048)
package /RB/RBA/rba_Msc/EcucModuleDefs
  module definition rba_Msc [0..1]: category=VENDOR_SPECIFIC_MODULE_DEFINITION, post-build-variant-support=true, variants pre-compile  # MCAL Micro Second Channel | Configuration of the MSC MCAL module.
    container rba_Msc_ConfigSet  # Configuration data set | Defines one data set of post-build configuration. Which of these data sets is actually active is controlled by EcuM. Data sets can only be switched at initialization time.
      container rba_Msc_Cmd [1..*]: multiplicity set at pre-compile, post-build-variant-multiplicity=true  # Command | Configuration of MSC commands. The command name is specified by the containers short name.
        string rba_Msc_CmdDev: origin=RB:0.3.0:2012-07-27, post-build-variant-value=true, set at pre-compile  # Device | Name of the MSC device which owns this command.
        string rba_Msc_CmdInit [0..1]: multiplicity set at pre-compile, origin=RB:0.3.0:2012-07-27, post-build-variant-multiplicity=true, post-build-variant-value=true, set at pre-compile  # Init value | Value used to initialize the command. Must be an integer or a string which can be interpreted by the C pre-processor.
        function name rba_Msc_CmdNotif [0..1]: multiplicity set at pre-compile, origin=RB:0.3.0:2012-07-27, post-build-variant-multiplicity=true, post-build-variant-value=true, set at pre-compile, default-value=NULL_PTR  # Command complete notification | Optional reference to a notification (callback) function. The signature of the function shall be void(void).
        string rba_Msc_CmdNotifHeaderName [0..1]: multiplicity set at pre-compile, origin=RB:0.3.0:2019-01-30, post-build-variant-multiplicity=true, post-build-variant-value=true, set at pre-compile  # Command complete notification header | Optional reference of the notification (callback) function header name.
        integer rba_Msc_CmdNrUsFrms [0..1]: 0..8, multiplicity set at pre-compile, origin=RB:0.3.0:2012-07-27, post-build-variant-multiplicity=true, post-build-variant-value=true, set at pre-compile, default-value=0  # Number of upstream frames | Number of upstream frames which will be sent by the device after the command has been received. Possible values for upstream frames without address field: 0 := No upstream frames are expected 1 - 8 := Receive 1 - 8 upstream frames (limited due to time needed for upstream reception) Possible values for upstream frames with address field: 0 := No upstream frames are expected 1 := Single upstream frame (e.g. for L9779) 4 := Block read (always 4 upstream frames)
        integer rba_Msc_CmdPrio [0..1]: 0..3, multiplicity set at pre-compile, origin=RB:0.3.0:2012-07-27, post-build-variant-multiplicity=true, post-build-variant-value=true, set at pre-compile, default-value=0  # Priority | Priority of the command: 0 := lowest to 3 := highest priority. The lowest priority shall be used for most cases.
      container rba_Msc_Dev [1..*]: multiplicity set at pre-compile, post-build-variant-multiplicity=true  # Device | Configuration of MSC devices. The device is specified by the containers short name.
        boolean rba_Msc_DevBootCtrlFwd [0..1]: multiplicity set at pre-compile, origin=RB:1.0.0:2013-07-31, post-build-variant-multiplicity=true, post-build-variant-value=true, set at pre-compile, default-value=false  # Forward device info to rba_BootCtrl | Configuration item to cause forwarding of device info to rba_BootCtrl for the requesting device.
        integer rba_Msc_DevDftInit [0..1]: multiplicity set at pre-compile, origin=RB:0.3.0:2012-07-27, post-build-variant-multiplicity=true, post-build-variant-value=true, set at pre-compile, default-value=0  # Default init value for data frame | Bit coded value with default init value for each data frame bit. This value is used to initialize the data frame in case no signal is configured for the corresponding data frame bit.
        integer rba_Msc_DevDftShOff [0..1]: multiplicity set at pre-compile, origin=RB:0.3.0:2012-07-27, post-build-variant-multiplicity=true, post-build-variant-value=true, set at pre-compile, default-value=0  # Default shutoff value for data frame | Bit coded value with default shutoff value for each data frame bit. This value is used for shutoff in case no signal is configured for the corresponding data frame bit.
        integer rba_Msc_DevLenCmd [0..1]: 0..16, multiplicity set at pre-compile, origin=RB:0.3.0:2012-07-27, post-build-variant-multiplicity=true, post-build-variant-value=true, set at pre-compile  # Length of command frame | Length of command frames in number of bits (excluding selection bit). Valid entries are 0 and 4 to 16. Default value is 0.
        integer rba_Msc_DevLenData: 4..32, origin=RB:0.3.0:2012-07-27, post-build-variant-value=true, set at pre-compile  # Length of data frame | Length of data frames in number of bits (excluding selection bit) Valid entries are 4 to 32.
        integer rba_Msc_DevLenUs [0..1]: 0..17, multiplicity set at pre-compile, origin=RB:0.3.0:2012-07-27, post-build-variant-multiplicity=true, post-build-variant-value=true, set at pre-compile  # Length of upstream frame | Bit length of upstream frames (incl. start, stop and parity). Valid entries are 0, 12, 13, 16 and 17. 12 and 13 are for upstream frames without address field while 16 and 17 are for upstream frames with address field. 12 and 16 include 2 stop bits while 13 and 17 include 3 stop bits. 0 disables upstream reception. Default value is 0.
        integer rba_Msc_DevMaxDsBaudRate [0..1]: multiplicity set at pre-compile, origin=RB:1.33.0:2018-03-08, post-build-variant-multiplicity=true, post-build-variant-value=true, set at pre-compile  # Maximum downstream baud rate | Maximum downstream baud rate in kHz. If the parameter is not set, then 20MHz is taken as default.
        integer rba_Msc_DevMinUsBaudRate [0..1]: multiplicity set at pre-compile, origin=RB:1.0.0:2013-07-31, post-build-variant-multiplicity=true, post-build-variant-value=true, set at pre-compile  # Minimum upstream baud rate | Minimum upstream baud rate in kHz. Optional tag to define the minimum upstream baud rate which will be cross checked. In case the actual upstream baud rate determined by the MSC baud rate divided by the upstream divisor is lower than the minimum upstream baud rate the MSC configuration processor will abort with an error. If the tag is missing no check will be done.
        integer rba_Msc_DevUsDiv [0..1]: 0..128, multiplicity set at pre-compile, origin=RB:0.3.0:2012-07-27, post-build-variant-multiplicity=true, post-build-variant-value=true, set at pre-compile, default-value=64  # Upstream divisor | Divisor for upstream baud rate. The upstream baud rate is the MSC baud rate (downstream) divided by the upstream divisor. Valid entries are 0, 2, 4, 8, 16, 32, 64 and 128. Typical value for MDG1 is 64. 0 disables upstream reception.
        enumeration rba_Msc_DevUsPar [0..1]: multiplicity set at pre-compile, origin=RB:2.1.0:2014-04-30, post-build-variant-multiplicity=true, post-build-variant-value=true, set at pre-compile, default-value=EVEN  # Parity type for upstream frame | Optional tag to configure the type of parity checking of upstream frames. Valid entries are Even or Odd. Default value is Even.
          EVEN  # Even
          ODD  # Odd
        function name rba_Msc_DevVirtFunc [0..1]: multiplicity set at pre-compile, origin=RB:1.0.0:02.09.2020, post-build-variant-multiplicity=true, post-build-variant-value=true, set at pre-compile  # Virtualization function | Virtualization function.
      container rba_Msc_HwUnit [1..*]: multiplicity set at pre-compile, post-build-variant-multiplicity=true  # HW unit | This container is used to configure a MSC HW unit. The short name of the container rba_Msc_HwUnit is the name of the MSC HW unit. Possible values: MSC0, MSC1 and MSC2. For Centauri MSC is implemented using DSPI and LINFlexD HW modules with the following mapping: MSC0 := DSPI6 and LINFlexD8 MSC1 := DSPI7 and LINFlexD9 MSC2 := DSPI8 and LINFlexD10
        integer rba_Msc_HwUnitBaudRate [0..1]: multiplicity set at pre-compile, origin=RB:2.0.0:2014-01-31, post-build-variant-multiplicity=true, post-build-variant-value=true, set at pre-compile, default-value=20000  # Baud rate | MSC baud rate in kHz. Optional tag to define the MSC baud rate. This tag should only be configured in exceptional cases. The default baud rate is 20MHz if maximum downstream baud rate of the connected device is not mentioned. If the Msc unit has more than one device connected, then compromised baudrate will be taken.
        enumeration rba_Msc_HwUnitInpSeln [0..1]: multiplicity set at pre-compile, origin=RB:2.0.0:2014-01-31, post-build-variant-multiplicity=true, post-build-variant-value=true, set at pre-compile  # Input selection | MSC input selection. This tag defines the input signal for IFX devices used to receive upstream frames. It is optional and defaults to input 0. For more information on how to configure this tag please have a look at the integration manual of rba_Msc. For other devices than IFX this tag is not used.
          IN{0..3}  # Input {0..3}
        container rba_Msc_HwUnitCs [0..*]: multiplicity set at pre-compile, post-build-variant-multiplicity=true  # Chip select configuration | This container is used to configure a MSC chip select. The short name of the container rba_Msc_HwUnitCs is the name of the chip select. The name shall be composed of the generic part "CS" and the actual chip select number. E.g. for a EN1 of an IFX µC1 the resulting name of the chip select would be CS1.
          string rba_Msc_HwUnitCsDev: origin=RB:2.0.0:2014-01-31, post-build-variant-value=true, set at pre-compile  # Device | Device connected to this chip select.
          enumeration rba_Msc_HwUnitCsFrmPos: origin=RB:2.0.0:2014-01-31, post-build-variant-value=true, set at pre-compile  # Data frame position | Position of the device in the MSC data frame. Possible values: First and Second. For Centauri a "First" device must be present to be able to configure a "Second" device.
            FIRST  # First (SRL)
            SECOND  # Second (SRH)
      container rba_Msc_Seq [0..*]: multiplicity set at pre-compile, post-build-variant-multiplicity=true  # Sequence | Configuration of Msc Sequence. The sequence name is specified by the containers short name.
        function name rba_Msc_SeqNotif [0..1]: multiplicity set at pre-compile, origin=RB:1.35.1:2018-10-06, post-build-variant-multiplicity=true, post-build-variant-value=true, set at pre-compile, default-value=NULL_PTR  # Sequence Complete notification | Optional reference to a sequence end notification (callback) function. The signature of the function shall be void(void).
        string rba_Msc_SeqNotifHeaderName [0..1]: multiplicity set at pre-compile, origin=RB:0.3.0:2019-01-30, post-build-variant-multiplicity=true, post-build-variant-value=true, set at pre-compile  # Sequence Complete notification header | Optional reference to a sequence end notification (callback) header
        reference rba_Msc_Cmd_Assignment [1..*]: origin=RB:1.35.0:2018-08-21, post-build-variant-value=true, set at pre-compile, destination=rba_Msc_Cmd  # Sequence commands | Commands to be sent in sequence.
      container rba_Msc_Sig [0..*]: multiplicity set at pre-compile, post-build-variant-multiplicity=true  # Signal | Configuration of MSC signals which are part of a data frame. The signal name (signal ID) is specified by the container short name.
        string rba_Msc_SigAltvGtm [0..1]: multiplicity set at pre-compile, origin=RB:0.3.0:2012-07-27, post-build-variant-multiplicity=true, post-build-variant-value=true, set at pre-compile  # Alternative GTM signal | Optional alternative GTM signal name used for forward to GTM. This can be used to connect multiple MSC power stages / signals to a single GTM resource.
        integer rba_Msc_SigBit [0..*]: 0..31, multiplicity set at pre-compile, origin=RB:0.3.0:2012-07-27, post-build-variant-multiplicity=true, post-build-variant-value=true, set at pre-compile  # Bit position | Bit position(s) in MSC data frame (which again determines the output power stage). For parallel connections several bits can be specified by multiple definition of this tag, one for each bit position.
        string rba_Msc_SigBitVia [0..*]: multiplicity set at pre-compile, origin=RB:1.29.0:2017-04-28, post-build-variant-multiplicity=true, post-build-variant-value=true, set at pre-compile  # Bit position Via | For Centauri: Bit position in the MSC data frame specified with Tag rba_Msc_SigBit, which should be connected to another input pin in parallel. e.g. "5_via_7"
        string rba_Msc_SigDev: origin=RB:0.3.0:2012-07-27, post-build-variant-value=true, set at pre-compile  # Device | MSC device which outputs the signal.
        boolean rba_Msc_SigInit [0..1]: multiplicity set at pre-compile, origin=RB:0.3.0:2012-07-27, post-build-variant-multiplicity=true, post-build-variant-value=true, set at pre-compile, default-value=false  # Init value | Initial value.
        boolean rba_Msc_SigShOff [0..1]: multiplicity set at pre-compile, origin=RB:0.3.0:2012-07-27, post-build-variant-multiplicity=true, post-build-variant-value=true, set at pre-compile, default-value=false  # Shut-off value | Shut-off value.
        enumeration rba_Msc_SigSrc: {GPIO, PWMOUT}, origin=RB:0.3.0:2012-07-27, post-build-variant-value=true, set at pre-compile  # Source | Source of the signal.
    container rba_Msc_General  # General settings | Configuration of general aspects of the MSC module.
      boolean rba_Msc_DevErrDet: origin=RB:0.3.0:2012-07-27, set at pre-compile  # Development error detection | Enables/disables the detection and notification of development errors. If this parameter is enabled, then extended error checking is performed during runtime. Any error detected by these checks is reported to the Dem module. This feature should be switched off in series software.
      boolean rba_Msc_EnaAsyncMode [0..1]: multiplicity set at pre-compile, origin=RB:2.1.0:2014-04-30, set at pre-compile, default-value=true  # Enable asynchronous mode | Enables/disables the interrupt driven asynchronous mode. In case asynchronous mode is disabled all code related to the handler is removed. Also dependencies to rba_Dma are removed. Default value is true which enables the interrupt driven asynchronous mode.
      boolean rba_Msc_EnaMonMaxCmdLtcy [0..1]: multiplicity set at pre-compile, origin=RB:3.1.0:2014-08-15, set at pre-compile, default-value=false  # Enable maximum command latency monitoring | Enables/disables the maximum command latency monitoring. For each queue of each HW unit the maximum command latency is monitored. The latency is defined to be the time from activation of the command (call of rba_Msc_Transmit()) to completion of the command (including upstream if used). Default value is false which disables the maximum command latency monitoring.
      integer rba_Msc_MonLvl [0..1]: 0..2, multiplicity set at pre-compile, origin=RB:0.3.0:2012-07-27, set at pre-compile, default-value=0  # Monitoring level | Select monitoring level for command pending and upstream error monitoring: 0: Monitoring is disabled (default) 1: Common monitoring per HW unit 2: Additional command specific monitoring
