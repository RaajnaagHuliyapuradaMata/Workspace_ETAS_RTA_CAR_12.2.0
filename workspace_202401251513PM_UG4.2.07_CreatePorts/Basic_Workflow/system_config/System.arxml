AUTOSAR XML (schema 00051)
package /System
  composition sw component type TopLevelComposition
    component CPT_MySWC: type=MySWC
