AUTOSAR XML (schema 4-2-2)
package /AUTOSAR_MemIf/BswImplementations
  bsw implementation MemIf: programming-language=C, sw-version=22.0.1, vendor-id=6, ar-release-version=4.5.0, behavior=BswInternalBehavior
    code-descriptors:
      code CodeDescriptor: artifact-descriptors=autosar-engineering-object={short-label=ArEngObj, category=SWSRC}
    resource consumption MemIf_ResourceConsumption
      18 x memory section, all with prefix=MEMIF:
        MEMIF_VAR_CLEARED_8: alignment=8, sw-addrmethod=VAR_CLEARED, symbol=VAR_CLEARED_8
        MEMIF_VAR_CLEARED_16: alignment=16, sw-addrmethod=VAR_CLEARED, symbol=VAR_CLEARED_16
        MEMIF_VAR_CLEARED_32: alignment=32, sw-addrmethod=VAR_CLEARED, symbol=VAR_CLEARED_32
        MEMIF_VAR_CLEARED_UNSPECIFIED: alignment=UNSPECIFIED, sw-addrmethod=VAR_CLEARED, symbol=VAR_CLEARED_UNSPECIFIED
        MEMIF_VAR_INIT_BOOLEAN: alignment=BOOLEAN, sw-addrmethod=VAR_INIT, symbol=VAR_INIT_BOOLEAN
        MEMIF_VAR_INIT_8: alignment=8, sw-addrmethod=VAR_INIT, symbol=VAR_INIT_8
        MEMIF_VAR_INIT_16: alignment=16, sw-addrmethod=VAR_INIT, symbol=VAR_INIT_16
        MEMIF_VAR_INIT_32: alignment=32, sw-addrmethod=VAR_INIT, symbol=VAR_INIT_32
        MEMIF_VAR_INIT_UNSPECIFIED: alignment=UNSPECIFIED, sw-addrmethod=VAR_INIT, symbol=VAR_INIT_UNSPECIFIED
        MEMIF_VAR_SAVED_ZONE_8: alignment=8, sw-addrmethod=VAR_SAVED_ZONE, symbol=VAR_SAVED_ZONE_8
        MEMIF_VAR_SAVED_ZONE_16: alignment=16, sw-addrmethod=VAR_SAVED_ZONE, symbol=VAR_SAVED_ZONE_16
        MEMIF_VAR_SAVED_ZONE_32: alignment=32, sw-addrmethod=VAR_SAVED_ZONE, symbol=VAR_SAVED_ZONE_32
        MEMIF_VAR_SAVED_ZONE_UNSPECIFIED: alignment=UNSPECIFIED, sw-addrmethod=VAR_SAVED_ZONE, symbol=VAR_SAVED_ZONE_UNSPECIFIED
        MEMIF_CONST_8: alignment=8, sw-addrmethod=CONST, symbol=CONST_8
        MEMIF_CONST_16: alignment=16, sw-addrmethod=CONST, symbol=CONST_16
        MEMIF_CONST_32: alignment=32, sw-addrmethod=CONST, symbol=CONST_32
        MEMIF_CONST_UNSPECIFIED: alignment=UNSPECIFIED, sw-addrmethod=CONST, symbol=CONST_UNSPECIFIED
        MEMIF_CODE: sw-addrmethod=CODE, symbol=CODE
      section name prefix MEMIF
package /AUTOSAR_MemIf/BswModuleDescriptions
  bsw module description MemIf: category=BSW_MODULE, module-id=22  # Memory Abstraction Interface
    provided-entrys:
      MemIf_Read
      MemIf_Write
      MemIf_InvalidateBlock
      MemIf_GetStatus
      MemIf_GetJobResult
      MemIf_Cancel
      MemIf_EraseImmediateBlock
      MemIf_GetVersionInfo
      MemIf_Rb_MainFunction
      MemIf_Rb_GetStatus
      MemIf_Rb_BlockMaintenance
      MemIf_Rb_VarLenRead
      MemIf_Rb_VarLenWrite
      MemIf_Rb_GetMigrationResult
      MemIf_Rb_GetDetailedBlkInfo
      MemIf_Rb_MainFunctionAndDependency
      MemIf_CheckDeviceIndex
    5 x bsw module dependency:
      Det: target-module-id=15
      Ea: target-module-id=40
      Eep: target-module-id=90
      Fee: target-module-id=21
      Fls: target-module-id=92
    bsw internal behavior BswInternalBehavior
      bsw schedulable entity MemIf_Rb_MainFunction: implemented-entry=MemIf_Rb_MainFunction
      bsw timing event EV_MemIf_Rb_MainFunction: starts-on-event=MemIf_Rb_MainFunction, period=0.001
package /AUTOSAR_MemIf/BswModuleEntrys
  17 x bsw module entry, all with is-synchronous=true, sw-service-impl-policy=STANDARD:
    MemIf_Read: service-id=0x02, is-reentrant=false, call-type=REGULAR, execution-context=UNSPECIFIED  # Read Data Service (AutoSAR) | Invokes the "Read" function of the underlying memory abstraction module selected by the parameter DeviceIndex. This function places a read job to the FEE or EA by calling the Fee_Read() or the Ea_Read() function.
      return type ReturnValue: direction=OUT, implementation-data-type=Std_ReturnType  # Function success: | E_OK: Order was successfully placed E_NOT_OK: Order was not placed because the respective order queue entry is not empty or the module has not been initialized yet
      5 x sw service arg, all with category=TYPE_REFERENCE, direction=IN:
        DeviceIndex: implementation-data-type=uint8  # Index of requested device
        BlockNumber: implementation-data-type=uint16  # NVM index (based on this index the corresponding Fee index will be searched and placed into the order queue)
        BlockOffset: implementation-data-type=uint16  # Offset of block
        DataBufferPtr: implementation-data-type=uint8  # Pointer to data buffer
        Length: implementation-data-type=uint16  # Length of block
    MemIf_Write: service-id=0x03, is-reentrant=false, call-type=REGULAR, execution-context=UNSPECIFIED  # Write Data Service (AutoSAR) | Invokes the "Write" function of the underlying memory abstraction module selected by the parameter DeviceIndex. This function places a write job to the FEE or EA by calling the Fee_Write() or the Ea_Write() function.
      return type ReturnValue: direction=OUT, implementation-data-type=Std_ReturnType  # Function success: | E_OK: Order was successfully placed E_NOT_OK: Order was not placed because the respective order queue entry is not empty or the module has not been initialized yet
      sw service arg DeviceIndex: direction=IN, implementation-data-type=uint8  # Index of requested device
      sw service arg BlockNumber: direction=IN, implementation-data-type=uint16  # Nvm index (based on this index the corresponding Fee index will be searched and placed into the order queue)
      sw service arg DataBufferPtr: direction=IN, implementation-data-type=uint8  # Pointer to data buffer
    MemIf_InvalidateBlock: service-id=0x07, is-reentrant=false, call-type=REGULAR, execution-context=UNSPECIFIED  # Invalidate Block Service (AutoSAR) | Invokes the "InvalidateBlock" function of the underlying memory abstraction module selected by the parameter DeviceIndex. Calls the Fee_InvalidateBlock() or the Ea_InvalidateBlock() function.
      return type ReturnValue: direction=OUT, implementation-data-type=Std_ReturnType  # Function success: | E_OK: Order was successfully placed E_NOT_OK: Order was not placed because the respective order queue entry is not empty or the module has not been initialized yet
      sw service arg DeviceIndex: direction=IN, implementation-data-type=uint8  # Index of requested device
      sw service arg BlockNumber: direction=IN, implementation-data-type=uint16  # Nvm index (based on this index the corresponding Fee index will be searched and placed into the order queue)
    MemIf_GetStatus: service-id=0x05, is-reentrant=false, call-type=REGULAR, execution-context=UNSPECIFIED  # Get Status Service (AutoSAR) | Invokes the "GetStatus" function of the underlying memory abstraction module selected by the parameter DeviceIndex. Calls the Fee_GetStatus() or the Ea_GetStatus() function.
      return type ReturnValue: direction=OUT, implementation-data-type=MemIf_StatusType  # Current status of the underlying abstraction module and device drive.
      sw service arg DeviceIndex: direction=IN, implementation-data-type=uint8  # Index of requested device
    MemIf_GetJobResult: service-id=0x06, is-reentrant=false, call-type=REGULAR, execution-context=UNSPECIFIED  # Get Job Result Service (AutoSAR) | Invokes the "GetJobResult" function of the underlying memory abstraction module selected by the parameter DeviceIndex. Calls the Fee_GetJobResult() or the Ea_GetJobResult() function.
      return type ReturnValue: direction=OUT, implementation-data-type=MemIf_JobResultType  # Result of the last job.
      sw service arg DeviceIndex: direction=IN, implementation-data-type=uint8  # Index of requested device
    MemIf_Cancel: service-id=0x04, is-reentrant=false, call-type=REGULAR, execution-context=UNSPECIFIED  # Cancel Job Service (AutoSAR) | Invokes the "Cancel" function of the underlying memory abstraction module selected by the parameter DeviceIndex. Calls the Fee_Cancel() or the Ea_Cancel() function.
      return type ReturnValue: direction=OUT, implementation-data-type=MemIf_StatusType  # None
      sw service arg DeviceIndex: direction=IN, implementation-data-type=uint8  # Index of requested device
    MemIf_EraseImmediateBlock: service-id=0x09, is-reentrant=false, call-type=REGULAR, execution-context=UNSPECIFIED  # Erase Block Immediate Service (AutoSAR) | Invokes the "EraseImmediateBlock" function of the underlying memory abstraction module selected by the parameter DeviceIndex. Calls the Fee_EraseImmediateBlock() or the Ea_EraseImmediateBlock() function.
      return type ReturnValue: direction=OUT, implementation-data-type=Std_ReturnType  # Function success: | E_OK: Order was successfully placed E_NOT_OK: Order was not placed because the respective order queue entry is not empty or the module has not been initialized yet
      sw service arg DeviceIndex: direction=IN, implementation-data-type=uint8  # Index of requested device
      sw service arg BlockNumber: direction=IN, implementation-data-type=uint16  # Nvm index (based on this index the corresponding Fee index will be searched and placed into the order queue)
    MemIf_GetVersionInfo: service-id=0x08, is-reentrant=true, call-type=REGULAR, execution-context=UNSPECIFIED  # Get Version Info Service (AutoSAR) | Returns the MemIf version information within the argument, separately for: | MemIf vendor ID MemIf module ID MemIf SW major version MemIf SW minor version MemIf SW patch version
      sw service arg VersionInfoPtr: direction=INOUT, implementation-data-type=Std_VersionInfoType  # Pointer to return the version information of this module (Std_VersionInfoType):
    MemIf_Rb_MainFunction: is-reentrant=true, call-type=SCHEDULED, execution-context=TASK  # Main function (RB extension) | Main function (included via SchM_MemIf.h if Rte is used) which encapsulates the main function of the underlaying modules: | Fee_MainFunction() Fls_MainFunction() Ea_MainFunction() Eep_MainFunction()
    MemIf_Rb_GetStatus: is-reentrant=false, call-type=REGULAR, execution-context=UNSPECIFIED  # Get Status Service (RB extension) | Checks the status of the underlaying modules: | Fee_GetStatus() Ea_GetStatus()
      return type ReturnValue: direction=OUT, implementation-data-type=MemIf_StatusType  # Current status of the underlying Fee and Ea module, depending if Fee and Ea are configured
    MemIf_Rb_BlockMaintenance: is-reentrant=false, call-type=REGULAR, execution-context=UNSPECIFIED  # Block Maintenance Service (RB extension) | Repair redundant copy of blocks to ensure that the double storage of a specified block number is intact. Calls the underlaying module API's depending on configured device: | Fee_Rb_BlockMaintenance() Ea_Rb_BlockMaintenance()
      return type ReturnValue: direction=OUT, implementation-data-type=Std_ReturnType  # Function success: | E_OK: Order was successfully placed E_NOT_OK: Order was not placed because the respective order queue entry is not empty or the module has not been initialized yet
      sw service arg DeviceIndex: direction=IN, implementation-data-type=uint8  # Index of requested device
      sw service arg BlockNumber: direction=IN, implementation-data-type=uint16  # Block number
    MemIf_Rb_VarLenRead: is-reentrant=false, call-type=REGULAR, execution-context=UNSPECIFIED  # Variable Block Length Read Service (RB extension) | Starts a read job to the Fee when the block length is variable and calculated on runtime (runtime RAM block configuration feature enabled). Calls the underlaying module API's depending on configured device: | Fee_Rb_VarLenRead() In case of bock configuration for Ea: Feature not implemented (E_NOT_OK returned by default)
      return type ReturnValue: direction=OUT, implementation-data-type=Std_ReturnType  # Function success: | E_OK: Order was successfully placed E_NOT_OK: Order was not placed because the respective order queue entry is not empty or the module has not been initialized yet
      5 x sw service arg:
        DeviceIndex: direction=IN, implementation-data-type=uint8  # Index of requested device
        BlockNumber: direction=IN, implementation-data-type=uint16  # NvM index (based on this index the corresponding Fee index will be searched and placed into the order queue)
        BlockOffset: direction=IN, implementation-data-type=uint16  # Offset of block where the read shall start from
        DataBufferPtr: category=DATA_REFERENCE, direction=OUT, implementation-data-type=uint8, sw-pointer-target-props={target-category=VALUE, implementation-data-type=uint8}  # Pointer to buffer to read data to
        Length: direction=IN, implementation-data-type=uint16  # Length of block to be read
    MemIf_Rb_VarLenWrite: is-reentrant=false, call-type=REGULAR, execution-context=UNSPECIFIED  # Variable Block Length Write Service (RB extension) | Starts a write job to the Fee when the block length is variable and calculated on runtime (runtime RAM block configuration feature enabled). Calls the underlaying module API's depending on configured device: | Fee_Rb_VarLenWrite() In case of bock configuration for Ea: Feature not implemented (E_NOT_OK returned by default)
      return type ReturnValue: direction=OUT, implementation-data-type=Std_ReturnType  # Function success: | E_OK: Order was successfully placed E_NOT_OK: Order was not placed because the respective order queue entry is not empty or the module has not been initialized yet
      4 x sw service arg, all with category=TYPE_REFERENCE, direction=IN:
        DeviceIndex: implementation-data-type=uint8  # Index of requested device
        BlockNumber: implementation-data-type=uint16  # NvM index (based on this index the corresponding Fee index will be searched and placed into the order queue)
        DataBufferPtr: implementation-data-type=uint8, sw-pointer-target-props={target-category=VALUE, implementation-data-type=uint8}  # Pointer to buffer to write data from
        Length: implementation-data-type=uint16  # NV block length
    MemIf_Rb_GetMigrationResult: is-reentrant=false, call-type=REGULAR, execution-context=UNSPECIFIED  # Get Migration Result Service (RB extension) | Service returns the migration result of the last data reading during initialisation (calling the API after subsequent read jobs in the same driving cycle does not change the initially returned value anymore). Calls the underlaying module API's depending on configured device: | Fee_Rb_GetMigrationResult() In case of bock configuration for Ea: Feature not implemented (MEMIF_RB_MIGRATION_RESULT_INIT_E returned by default)
      return type ReturnValue: direction=OUT, implementation-data-type=MemIf_Rb_MigrationResult_ten  # Migration result of the last data reading during.
      sw service arg DeviceIndex: direction=IN, implementation-data-type=uint8  # Index of requested device
      sw service arg BlockNumber: direction=IN, implementation-data-type=uint16  # Corresponding Fee block number
    MemIf_Rb_GetDetailedBlkInfo: is-reentrant=false, call-type=REGULAR, execution-context=UNSPECIFIED  # Get detailed block info service (RB extension) | Service returns the detailed block information. Calls the underlaying module API's depending on configured device: | Fee_Rb_GetDetailedBlkInfo() In case of bock configuration for Ea: Feature not implemented (MEMIF_RB_DETAILED_BLK_INFO_INIT_E returned by default)
      return type ReturnValue: direction=OUT, implementation-data-type=MemIf_Rb_DetailedBlkInfo_ten  # Detailed block information result.
      sw service arg DeviceIndex: direction=IN, implementation-data-type=uint8  # Index of requested device
      sw service arg BlockNumber: direction=IN, implementation-data-type=uint16  # Corresponding Fee block number
    MemIf_Rb_MainFunctionAndDependency: is-reentrant=true, call-type=REGULAR, execution-context=UNSPECIFIED  # Main function And Dependency Functions(RB extension) | Main function and Dependency which encapsulates the main function and dependency of the underlaying Mem modules (all instances): | Fee_Rb_MainFunctionAndDependency() Ea_Rb_MainFunctionAndDependency()
    MemIf_CheckDeviceIndex: is-reentrant=false, call-type=REGULAR, execution-context=UNSPECIFIED  # Device Index Check Service (MemIf internal) | This function checks the device index and reports a DET error in case the device index is greater then the configured maximum of devices.
      sw service arg DeviceIndex: direction=IN, implementation-data-type=uint8  # Index of requested device
package /AUTOSAR_MemIf/ImplementationDataTypes
  5 x impl type, all with category=TYPE_REFERENCE, implementation-data-type=Mem_enum8, type-emitter=HEADER_FILE:
    MemIf_ModeType: compu {0=MEMIF_MODE_SLOW (EA and the underlying device driver could be switched into slow mode), 1=MEMIF_MODE_FAST (EA and the underlying device driver could be switched into fast mode)}  # Type used for storing the mode info of the module | Mode type SLOW/FAST processing
    MemIf_StatusType: compu {0=MEMIF_IDLE (All underlying devices have returned this state), 1=MEMIF_UNINIT (At least one device returned this state, all other returned states shall be ignored), 2=MEMIF_BUSY (At least one configured device returned this state and no other device returned MEMIF_UNINIT), 3=MEMIF_BUSY_INTERNAL (At least one configured device returned this state and no other device returned MEMIF_BUSY or MEMIF_UNINIT)}  # Enumeration type for current status of the underlying abstraction module and device drive | The MemIf_GetStatus() and MemIf_Rb_GetStatus() services provide information based on this type.
    MemIf_JobResultType: compu {0=MEMIF_JOB_OK (The job has been finished successfully), 1=MEMIF_JOB_FAILED (The job has not been finished successfully), 2=MEMIF_JOB_PENDING (The job has not yet been finished.MEMIF_JOB_CANCELED: The job has been canceled), 3=MEMIF_BLOCK_INCONSISTENT (The requested block is inconsistent (it may contain corrupted data) or block is NOT found), 4=MEMIF_BLOCK_INVALID (The requested block has been marked as invalid, the requested operation can not be performed)}  # Enumeration type for result of the last job | The MemIf_GetJobResult() service provides information based on this type.
    MemIf_Rb_MigrationResult_ten: compu {0=MEMIF_RB_MIGRATION_RESULT_INIT_E (Initialization value, result not yet available), 1=MEMIF_RB_MIGRATION_RESULT_NOT_NECESSARY_E (RAM size equals size on medium (no migration necessary)), 2=MEMIF_RB_MIGRATION_RESULT_TO_SMALLER_SIZE_E (RAM size lesser than size on medium (remaining data discarded)), 3=MEMIF_RB_MIGRATION_RESULT_TO_BIGGER_SIZE_E (RAM size greater than size on medium (remaining data filled with zero)), 4=MEMIF_RB_MIGRATION_RESULT_NOT_DONE_E (Migration not done, because data was not read), 5=MEMIF_RB_MIGRATION_RESULT_DEACTIVATED_E (Migration is deactivated by configuration)}  # Enumeration type for the migration result of the last data reading during initialisation | The MemIf_Rb_GetMigrationResult() service provides information based on this type.
    MemIf_Rb_DetailedBlkInfo_ten: compu {0=MEMIF_RB_DETAILED_BLK_INFO_NOT_AVAILABLE_E (Job not supported by Fee/Ea), 1=MEMIF_RB_DETAILED_BLK_INFO_INIT_E (Job supported but no result available), 2=MEMIF_RB_DETAILED_BLK_INFO_INCONSISTENT_MISSING_E (MEMIF_BLOCK_INCONSISTENT: Valid block (header) was not found on the medium), 3=MEMIF_RB_DETAILED_BLK_INFO_INCONSISTENT_DATA_E (MEMIF_BLOCK_INCONSISTENT: Data CRC of block is wrong), 4=MEMIF_RB_DETAILED_BLK_INFO_INCONSISTENT_LENGTH_E (MEMIF_BLOCK_INCONSISTENT: Block length is not consistent with config)}  # Enumeration type for detailed block information | The MemIf_Rb_GetDetailedBlkInfo() service provides information based on this type.
