AUTOSAR XML (schema 00051)
package /ApplicationECU_FlatView
  flat map ApplicationECU_FlatMap
    5 x flat instance descriptor:
      CPT_MyReceivingSWC_ApplicationEcu: upstream-reference=RootSwCompositionPrototype.CPT_MyReceivingSWC_ApplicationEcu, ecu-extract-reference=CPT_ApplicationECU_FlatView.CPT_MyReceivingSWC_ApplicationEcu
      CPT_MyTransmittingSWC_ApplicationEcu: upstream-reference=RootSwCompositionPrototype.CPT_MyTransmittingSWC_ApplicationEcu, ecu-extract-reference=CPT_ApplicationECU_FlatView.CPT_MyTransmittingSWC_ApplicationEcu
      DE_MyDataElement: sw-refresh-timing={cse-code=5, cse-code-factor=1}, upstream-reference=RootSwCompositionPrototype.CPT_MyReceivingSWC_ApplicationEcu.RPortPrototype_0.DE_MyDataElement, ecu-extract-reference=CPT_ApplicationECU_FlatView.CPT_MyReceivingSWC_ApplicationEcu.RPortPrototype_0.DE_MyDataElement
      Unconnected_DE_MyDataElement_0: sw-refresh-timing={cse-code=5, cse-code-factor=1}, upstream-reference=RootSwCompositionPrototype.CPT_MyTransmittingSWC_ApplicationEcu.PPortPrototype_0.DE_MyDataElement, ecu-extract-reference=CPT_ApplicationECU_FlatView.CPT_MyTransmittingSWC_ApplicationEcu.PPortPrototype_0.DE_MyDataElement
      CPT_ComM: upstream-reference=RootSwCompositionPrototype.CPT_ComM, ecu-extract-reference=CPT_ApplicationECU_FlatView.CPT_ComM
