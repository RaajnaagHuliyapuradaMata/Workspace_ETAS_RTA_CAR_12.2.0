AUTOSAR XML (schema 00048)
package /AUTOSAR_KeyM/EcucModuleDefs
  module definition KeyM [0..1]: category=VENDOR_SPECIFIC_MODULE_DEFINITION, post-build-variant-support=true, refined-module-def=KeyM, variants post-build/pre-compile  # Configuration of the KeyM (Key Manager) module.
    container KeyMCertificate [0..65535]: multiplicity set at pre-compile  # This container contains the certificate configuration.
      enumeration KeyMCertAlgorithmType: {ECC, RSA}, set at pre-compile  # Specify in which format the certificate will be provided.
      enumeration KeyMCertFormatType: {CRL, OCSP, CVC, X509}, set at pre-compile  # Specify in which format the certificate will be provided.
      enumeration KeyMCertPublicKeyAlgorithmType [0..1]: {ECC, RSA, ECC_COMPRESS_INFO_FROM_KEY, ECC_COMPRESS_INFO_FROM_KEY_EVEN}, set at pre-compile  # Specify in which format the certificates public key will be provided.
      integer KeyMCertificateId: 0..65535, set at pre-compile, symbolic-name-value=true  # Identifier of the certificate. The set of configured identifiers shall be consecutive and gapless.
      integer KeyMCertificateMaxLength: 1..65535, set at pre-compile  # Specify the maximum length in bytes of the certificate.
      string KeyMCertificateName: set at pre-compile  # Provides a unique name of the certificate for identification. The certificate provisional will reference certificates by this unique name.
      enumeration KeyMCertificateStorage: {KEYM_STORAGE_IN_CSM, KEYM_STORAGE_IN_NVM, KEYM_STORAGE_IN_RAM}, multiplicity set at pre-compile, set at pre-compile  # Specify the storage location of the certificate.
      function name KeyMCertificateVerifyCallbackNotificationFunc [0..1]: multiplicity set at pre-compile, set at pre-compile  # This parameter provides the function name for the callback <KeyM_CertificateVerifyCallbackNotification>. It indicates if a certificate verification operation was finished and provides its status. If this parameter is omitted, no callback will be provided.
      boolean KeyMRbCertificateCallbackUsePort [0..1]: multiplicity set at pre-compile, set at pre-compile, default-value=false  # If this parameter is set to true, the KeyM uses a port requiring a PortInterface CerificateCallbackServices_{CertificateCallbackName}. If this is false, the KeyM expects to find the names of the functions to be used in KeyMCertificateVerifyCallbackNotificationFunc or KeyMServiceCertificateCallbackNotificationFunc.
      function name KeyMServiceCertificateCallbackNotificationFunc [0..1]: multiplicity set at pre-compile, set at pre-compile  # This parameter provides the function name for the service certificate callback <KeyM_ServiceCertificateCallbackNotification>. It indicates if a certificate service operation was finished and provides its status. If this parameter is not set, no callback will be provided.
      reference KeyMCertCertificateElementRuleRef [0..65535]: multiplicity set at pre-compile, set at pre-compile, destination=KeyMCertificateElementRule  # Reference to certificate element rules which should be verified within the certification validation step.
      reference KeyMCertCsmSignatureGenerateJobRef [0..1]: multiplicity set at pre-compile, set at pre-compile, requires-symbolic-name-value=true, destination=CsmJob  # Reference to a CSM job to calculate a signature. Note:This parameter is only required if for this certificate CSR is to be genarated. For CSR usecase it is to be made sure that KeyMCertPrivateKeyStorageCryptoKeyRef parameteter is configured in such a way that corresponding key in Crypto driver can hold the key pair. (private and public key part in same key. i.e. CRYPTO_ELEMENT_TYPE_ECDSA_EDD25519_KEYPAIR) Currently for other types it is not supported.
      reference KeyMCertCsmSignatureVerifyJobRef [0..1]: set at pre-compile, requires-symbolic-name-value=true, destination=CsmJob  # Reference to the CSM job that is used to verify the signature
      reference KeyMCertCsmSignatureVerifyKeyRef [0..1]: multiplicity set at pre-compile, set at pre-compile, requires-symbolic-name-value=true, destination=CsmKey  # Reference to the CSM key associated to the CSM signature verify job. The Public Key of this certificate shall be set to the key element (CRYPTO_KE_SIGNATURE_KEY) where the key references to. | The Public Key of this certificate shall be set to the key element (CRYPTO_KE_SIGNATURE_KEY) where the key references to.
      reference KeyMCertPrivateKeyStorageCryptoKeyRef [0..1]: multiplicity set at pre-compile, set at pre-compile, destination=KeyMCryptoKey  # Defines a storage location of the private key of a certificate. This parameter is only required for CSR usecase.
      reference KeyMCertTimebaseRef [0..1]: multiplicity set at pre-compile, set at pre-compile, requires-symbolic-name-value=true, destination=StbMSynchronizedTimeBase  # This is a reference to an StbM time base to validate the validity period. Alternatively, KeyMCertificateElementVerification with the KeyMCertificateElement of CertificateValidityPeriodNotBefore or CertificateValidityPeriodNotAfter could be used.
      reference KeyMCertUpperHierarchicalCertRef: set at pre-compile, destination=KeyMCertificate  # Identifier of the certificate that is the next higher in the PKI hierarchical structure. The reference points to itself for root certificates.
      reference KeyMCertificateCsmKeyTargetRef [0..1]: multiplicity set at pre-compile, set at pre-compile, requires-symbolic-name-value=true, destination=CsmKey  # Defines a reference to the associated CSM key where the certificate shall be stored to.
      reference KeyMCertificateNvmBlockRef [0..1]: multiplicity set at pre-compile, set at pre-compile, destination=KeyMNvmBlock  # Defines a reference to the NvMblock where the certificate is going to be stored.
      container KeyMCertificateElement [0..65535]: multiplicity set at pre-compile  # This container contains the certificate element configuration.
        boolean KeyMCertificateElementHasIteration: set at pre-compile, default-value=false  # Defines if the certificate element can occur more than one time. If so, the iterator can be used to retrieve the individual data values of this certificate element.
        integer KeyMCertificateElementId: 0..65535, set at pre-compile, symbolic-name-value=true  # Identifier of a certificate element.
        integer KeyMCertificateElementMaxLength: 1..65535, set at pre-compile  # Maximum length in bytes
        string KeyMCertificateElementObjectId [0..1]: multiplicity set at pre-compile, set at pre-compile  # This is the object identifier (OID) that is used to identify the certificate element within its element structure.
        integer KeyMCertificateElementObjectType [0..1]: 0..255, multiplicity set at pre-compile, set at pre-compile  # Certificate elements are stored in ASN.1 format. In this item the type of ASN.1 TLV can be specified (e.g. INTEGER has the value '2'). This can be used to identify only such certificate elements. If the type is different, the element is not included in the search. This parameter also helps identifying suitable logical operation in the KeyMCertElementConditionType parameter w.r.t. corresponding KeyMCertificateElementRef. | If KeyMCertificateElementObjectType is not specified, any ASN.1 encoding datatype is used to read the value.
        enumeration KeyMCertificateElementOfStructure: {CertificateAttributeName, CertificateExtension, CertificateIssuerName, CertificateIssuerUniqueIdentifier, CertificateSerialNumber, CertificateSignature, CertificateSignatureAlgorithm, CertificateSignatureAlgorithmID, CertificateSubjectAuthorization, CertificateSubjectName, CertificateSubjectPublicKeyInfo_PublicKeyAlgorithm, CertificateSubjectPublicKeyInfo_SubjectPublicKey, CertificateSubjectUniqueIdentifier, CertificateValidityPeriodNotAfter, CertificateValidityPeriodNotBefore, CertificateVersionNumber, RevokedCertificates}, set at pre-compile  # This defines in which structure the certificate element is located.
        boolean KeyMRbCertificateElementIsCritical [0..1]: multiplicity set at pre-compile, origin=RB:1.0.0:2022-01-31, set at pre-compile, default-value=true  # For CSR usecase KeyM sets the isCritical bit to true if this parameter is configured with value true and corresponding CSR Element is set. For Certificate usecase if this parameter is not configured or configured TRUE and actual certificate does not have this extension, in that case KeyM parsing will fail with negative result. User has to explicitly configure this parameter to FALSE for optonal certificate elements.
        integer KeyMRbCertificateElementMaxIterations [0..1]: 1..65535, multiplicity set at pre-compile, set at pre-compile, default-value=1  # Maximum number of Iterative Items which a certificate element can have. This parameter is applicable only when KeyMCertificateElementHasIteration is configured with value true. If not configured it will have size as 1. This parameter affects the internal buffer needs for Certificate elements with iterations..
    container KeyMCertificateElementVerification [0..65535]: multiplicity set at pre-compile  # This container defines if and how certificate elements are to be verified.
      container KeyMCertificateElementCondition [1..*]: multiplicity set at pre-compile  # This container contains the configuration of KeyElement compare conditions which can be used as arguments for a KeyMCertificateElementRule. | One KeyMCertificateElementCondition shall contain either one KeyMCertificateElementConditionArray or one KeyMCertificateElementConditionCerificateElement or one KeyMCertificateElementConditionPrimitive or one KeyMCertificateElementConditionSenderReceiver.
        enumeration KeyMCertElementConditionType: {KEYM_EQUALS, KEYM_EQUALS_NOT, KEYM_GREATER_OR_EQUAL, KEYM_LESS_OR_EQUAL, KEYM_LESS_THAN}, set at pre-compile  # This parameter specifies what kind of comparison that is made for the evaluation of the mode condition.
        reference KeyMCertificateElementRef: multiplicity set at pre-compile, set at pre-compile, destination=KeyMCertificateElement  # Reference to a certificate element used for the condition. According to Autosar this parameter has multiplicity 0-1. But 1 multiplicity only makes sense.
        container KeyMCertificateElementConditionValue  # This container contains the configuration of a compare value.
          container KeyMCertificateElementConditionArray [0..1]: multiplicity set at pre-compile  # This container contains the configuration of a array compare value.
            container KeyMCertificateElementConditionArrayElement [0..*]: multiplicity set at pre-compile  # This container contains the configuration of a array compare value.
              integer KeyMCertificateElementConditionArrayElementIndex: 0..65535, set at pre-compile  # Index to an element of the compare value array.
              integer KeyMCertificateElementConditionArrayElementValue: 0..18446744073709551615, set at pre-compile  # Value of an array element compare value.
          container KeyMCertificateElementConditionCerificateElement [0..1]: multiplicity set at pre-compile  # This container contains the configuration of a certificate element as a compare value.
            reference KeyMCertificateElementRef: set at pre-compile, destination=KeyMCertificateElement  # Reference to another certificate element.
          container KeyMCertificateElementConditionPrimitive [0..1]: multiplicity set at pre-compile  # This container contains the configuration of a primitive compare value.
            integer KeyMCertificateElementConditionPrimitiveValue: 0..18446744073709551615, set at pre-compile  # Primitive compare value
          container KeyMCertificateElementConditionSenderReceiver [0..1]: multiplicity set at pre-compile  # This container contains the configuration of a dynamic compare value in a sender-/receiver interface.
            instance reference KeyMCertificateElementConditionSenderReceiver: set at pre-compile, destination-context=ROOT-SW-COMPOSITION-PROTOTYPE SW-COMPONENT-PROTOTYPE PORT-PROTOTYPE, destination-type=AUTOSAR-DATA-PROTOTYPE  # This parameter references a mode in a particular mode request port of a software component that is used for the condition.
      container KeyMCertificateElementRule [1..*]: multiplicity set at pre-compile  # This container contains the configuration of a mode rule which represents a logical expression with KeyMCertificateElementCondition or other KeyMCertificateElementRule as arguments. | All arguments are processed with the operator defined by KeyMLogicalOperator, for instance: Argument_A AND Argument_B AND Argument_C.
        enumeration KeyMLogicalOperator [0..1]: {KEYM_AND, KEYM_OR}, multiplicity set at pre-compile, set at pre-compile  # This parameter specifies the logical operator to be used in the logical expression. If the expression only consists of a single condition this parameter shall not be used.
        choice reference KeyMArgumentRef [1..*]: multiplicity set at pre-compile, set at pre-compile, destination=[KeyMCertificateElementCondition, KeyMCertificateElementRule]  # This is a choice reference either to a condition or another rule serving as sub-expression.
    container KeyMCryptoKey [0..65535]: multiplicity set at pre-compile  # This container contains the crypto keys that can be updated.
      enumeration KeyMCryptoCsmVerifyJobType [0..1]: {KEYM_VERIFY_AEADDECRYPT, KEYM_VERIFY_AEADENCRYPT, KEYM_VERIFY_DECRYPT, KEYM_VERIFY_ENCRYPT, KEYM_VERIFY_MACGENERATE, KEYM_VERIFY_MACVERIFY}, multiplicity set at pre-compile, set at pre-compile  # Specifies what type of function for key verification operation is used.
      string KeyMCryptoKeyCryptoProps [0..1]: multiplicity set at pre-compile, set at pre-compile  # If set, it will provide additional hints to the crypto key that is used by KeyM to identify the key. | Typical approach is to set the value to the SHE-Slot ID where the key was placed to. If present, the KeyM will take the information and identify the key by its slot ID. The slot information will be extracted from the corresponding field of the M1M2M3 data.
      string KeyMCryptoKeyGenerationInfo [0..1]: multiplicity set at pre-compile, set at pre-compile  # This data may contain static data for key derivation. If a key is configured to be derived from another key and this configuration item is set, the data will be added as salt.
      enumeration KeyMCryptoKeyGenerationType: {KEYM_DERIVED_KEY, KEYM_STORED_KEY}, set at pre-compile  # Specifies how the CryptoKey will be generated. If it is derived from another key or simply stored with KeyElementSet.
      integer KeyMCryptoKeyId: 0..65535, set at pre-compile, symbolic-name-value=true  # Identifier of the crypto key. The set of configured identifiers shall be consecutive and gapless.
      integer KeyMCryptoKeyMaxLength: 1..4294967295, set at pre-compile  # The maximum size in bytes of a CryptoKey.
      string KeyMCryptoKeyName: set at pre-compile  # Provides a unique name of the key for identification. The key master will reference keys by this unique key name.
      enumeration KeyMCryptoKeyStorage: {KEYM_STORAGE_IN_CSM, KEYM_STORAGE_IN_NVM, KEYM_STORAGE_IN_RAM}, set at pre-compile  # Specify the storage location of the certificate.
      reference KeyMCryptoKeyCsmKeySourceDeriveRef [0..1]: multiplicity set at pre-compile, set at pre-compile, requires-symbolic-name-value=true, destination=CsmKey  # Defines a reference to the associated CSM key that is used as source for the key derivation of this key.
      reference KeyMCryptoKeyCsmKeyTargetRef: set at pre-compile, requires-symbolic-name-value=true, destination=CsmKey  # Defines a reference to the associated CSM key that shall be generated.
      reference KeyMCryptoKeyCsmVerifyJobRef [0..1]: multiplicity set at pre-compile, set at pre-compile, requires-symbolic-name-value=true, destination=CsmJob  # Defines the crypto job that the key verify function can use for verification of a certain key.
      reference KeyMCryptoKeyNvmBlockRef [0..1]: multiplicity set at pre-compile, set at pre-compile, destination=KeyMNvmBlock  # Defines a reference to the NvM block where the key is going to be stored.
      reference KeyMRbCryptoKeyCsmSheJobRef [0..1]: multiplicity set at pre-compile, origin=RB:1.0.0:2021-07-31, set at pre-compile, requires-symbolic-name-value=true, destination=CsmJob  # Defines the crypto job that key update function can use for updating of the SHE key. If KeyMCryptoKeyCryptoProps parameter is configured then KeyM will assume that the key is SHE key and KeyMRbCryptoKeyCsmSheJobRef should refer a SHE job
    container KeyMGeneral  # This container holds general configuration (parameters) for key manager.
      integer KeyMCertificateChainMaxDepth: 1..255, set at pre-compile  # Maximum number of certificates defined in a certificate chain.
      boolean KeyMCertificateManagerEnabled: set at pre-compile, default-value=false  # Enables (TRUE) or disables (FALSE) the part that manages certificates.
      boolean KeyMCryptoKeyHandlerPrepareEnabled: set at pre-compile, default-value=false  # Enables (TRUE) or disables (FALSE) the key handler prepare function call. If set to true, the corresponding key handler function shall be provided.
      boolean KeyMCryptoKeyHandlerServiceCertificateEnabled: set at pre-compile, default-value=false  # Enables (TRUE) or disables (FALSE) the key handler service function call. If set to true, the certificate submodule function KeyM_KH_ServiceCertificate() shall be provided.
      boolean KeyMCryptoKeyHandlerStartFinalizeEnabled: set at pre-compile, default-value=false  # Enables (TRUE) or disables (FALSE) the key handler start and finalize function call. If set to true, the key handler functions KeyM_KH_Start() and KeyM_KH_Finalize() shall be provided.
      boolean KeyMCryptoKeyHandlerUpdateEnabled: set at pre-compile, default-value=false  # Enables (TRUE) or disables (FALSE) the call to the key handler update function KeyM_KH_Update(). If set to true, the corresponding key handler function shall be provided.
      boolean KeyMCryptoKeyHandlerVerifyEnabled: set at pre-compile, default-value=false  # Enables (TRUE) or disables (FALSE) the call to the key handler verify function KeyM_KH_Verify(). If set to true, the corresponding key handler function shall be provided.
      boolean KeyMCryptoKeyManagerEnabled: set at pre-compile, default-value=false  # Enables (TRUE) or disables (FALSE) the part that manages crypto key operations.
      boolean KeyMCryptoKeyPrepareFunctionEnabled [0..1]: multiplicity set at pre-compile, set at pre-compile, default-value=false  # Enables (TRUE) or disables (FALSE) the prepare function of the key manager. If set to true, the KeyM_Prepare() function has to be called accordingly.
      boolean KeyMCryptoKeyStartFinalizeFunctionEnabled [0..1]: multiplicity set at pre-compile, set at pre-compile, default-value=false  # Enables (TRUE) or disables (FALSE) the start and Finish function of the key manager. If set to true, the KeyM_Start() and KeyM_Finalize() functions have to be called.
      boolean KeyMCryptoKeyVerifyAsyncMode [0..1]: multiplicity set at pre-compile, set at pre-compile, default-value=false  # This parameter defines if the function KeyM_Verify() runs in synchronous or asynchronous mode
      boolean KeyMCryptoKeyVerifyFunctionEnabled [0..1]: multiplicity set at pre-compile, set at pre-compile, default-value=false  # Enables (TRUE) or disables (FALSE) the verify function of the key manager. If set to true, the KeyM_Verify() function can be called.
      boolean KeyMDevErrorDetect: set at pre-compile, default-value=false  # Switches the development error detection and notification on or off. | * true: detection and notification is enabled. * false: detection and notification is disabled.
      integer KeyMKeyCertNameMaxLength: 1..255, set at pre-compile  # Maximum length in bytes of certificate or key names used for the service interface.
      float KeyMMainFunctionPeriod: 0..INF, set at pre-compile  # Specifies the period of main function KeyM_MainFunction in seconds.
      integer KeyMRbCclIterationCount [0..1]: 1..65535, multiplicity set at pre-compile, origin=RB:1.0.0:2021-07-31, set at pre-compile, default-value=1  # This parameter defines the number of calls of ccl iterative functions in background per activation. This will reduce certificate verification interval.
      boolean KeyMRbCryptoKeyCallbackUsePort [0..1]: multiplicity set at pre-compile, origin=RB:1.0.0:2021-07-31, set at pre-compile, default-value=false  # If this parameter is set to true, the KeyM uses a port requiring a PortInterface KeyMCryptoKeyNotification. If this is false, the KeyM will use the Crypto key callback functions.
      boolean KeyMRbCsrKeyGenerationDisabled [0..1]: multiplicity set at pre-compile, origin=RB:1.0.0:2021-07-31, set at pre-compile, default-value=false  # KeyM generates the Key pair each time KeyM_ServiceCertificate() service is called with KEYM_SERVICE_CERT_REQUEST_CSR. This parameter is to disable this behaviour. If configured True, KeyM will assume that the key pair is already generated by application and is already set valid for use.
      integer KeyMRbQueueAddOn [0..1]: 1..255, multiplicity set at pre-compile, origin=RB:1.0.0:2021-07-31, set at pre-compile  # KeyM internal Queue size add on for increased queueing capacity of service requests. If not configured KeyM will have queue size as 2.
      integer KeyMRbRequestDataMaxLength [0..1]: 1..65535, multiplicity set at pre-compile, origin=RB:4.0.0:2022-11-16, set at pre-compile, default-value=1024  # Maximum length in bytes of the request data. This parameter is introduced to provide the maximum size of request data and a provision for giving array size via configuration (e.g. for arrays like KeyM_ServiceCertificate_ArrayDataType) for APIs such as KeyM_Start, KeyM_Prepare, KeyM_Verify, KeyM_Finalize and KeyM_ServiceCertificate. If this parameter is not configured then the default value of 1024 shall be used. If other than 1024 is required, it can be configured as needed by the user.
      integer KeyMRbResponseDataMaxLength [0..1]: 1..65535, multiplicity set at pre-compile, origin=RB:4.0.0:2022-11-16, set at pre-compile, default-value=1024  # Maximum length in bytes of the response data. This parameter is introduced to provide the maximum size of response data and a provision for giving array size via configuration (e.g. for arrays like KeyM_KeyMCryptoKeyNotification_CryptoKeyFinalizeCallbackNotification) for APIs like KeyM_Start, KeyM_Prepare, KeyM_Verify, KeyM_Finalize. If this parameter is not configured then the default value of 1024 shall be used. If other than 1024 is required, it can be configured as needed by the user.
      boolean KeyMRbVersionInfoApi [0..1]: multiplicity set at pre-compile, origin=RB:1.0.0:2019-11-13, set at pre-compile, default-value=false  # Enables (TRUE) or disables (FALSE) the version Info Api of the key manager. If set to true, the KeyM_VersionIno() function is available.
      boolean KeyMRbX509CsmSignatureVerifyEnabled [0..1]: multiplicity set at pre-compile, origin=RB:3.0.0:2022-02-28, set at pre-compile, default-value=true  # Enables (TRUE) or disables (FALSE) the Signature Verification via csm for x509 certificate.
      boolean KeyMServiceCertificateFunctionEnabled [0..1]: multiplicity set at pre-compile, origin=RB:1.0.0:2021-01-01, set at pre-compile, default-value=false  # Enables (TRUE) or disables (FALSE) the certificate service function of the key manager. If set to true, the KeyM_ServiceCertificate() function has to be called accordingly.
      container KeyMSecurityEventRefs [0..1]: multiplicity set at pre-compile  # Container for the references to IdsMEvent elements representing the security events that the KeyM module shall report to the IdsM in case the coresponding security related event occurs. The standardized security events in this container can be extended by vendor-specific security events. Tags: atp.Status=draft
        reference KEYM_SEV_CERT_VERIF_FAILED [0..1]: multiplicity set at pre-compile, set at pre-compile, requires-symbolic-name-value=true, destination=IdsMEvent  # A request to verify a certificate against a certificate chain was not successful. Tags: atp.Status=draft
        reference KEYM_SEV_INST_INTERMEDIATE_CERT_OP [0..1]: multiplicity set at pre-compile, set at pre-compile, requires-symbolic-name-value=true, destination=IdsMEvent  # Attempt to install an intermediate certificate. Tags: atp.Status=draft
        reference KEYM_SEV_INST_ROOT_CERT_OP [0..1]: multiplicity set at pre-compile, set at pre-compile, requires-symbolic-name-value=true, destination=IdsMEvent  # Attempt to install a root certificate. Tags: atp.Status=draft
        reference KEYM_SEV_UPD_INTERMEDIATE_CERT_OP [0..1]: multiplicity set at pre-compile, set at pre-compile, requires-symbolic-name-value=true, destination=IdsMEvent  # Attempt to update an existing intermediate certificate. Tags: atp.Status=draft
        reference KEYM_SEV_UPD_ROOT_CERT_OP [0..1]: multiplicity set at pre-compile, set at pre-compile, requires-symbolic-name-value=true, destination=IdsMEvent  # Attempt to update an existing root certificate. Tags: atp.Status=draft
        reference KeyMRbCertCsmHashJobRef: multiplicity set at pre-compile, origin=RB:5.0.0:2023-07-31, set at pre-compile, requires-symbolic-name-value=true, destination=CsmJob  # Reference to a CSM job to calculate a Hash. Note:This parameter is only required if Security event reporting is enabled by configuring at least one of security event.
    container KeyMNvmBlock [0..65535]: multiplicity set at pre-compile  # Configuration of optional usage of Nvm in case the KeyM module requires non volatile memory in the Ecu to store information (e.g. crypto keys or certificates).
      integer KeyMNvmBlockWriteDelayed: 0..65535, multiplicity set at pre-compile, set at pre-compile  # This is the delay time in ms to write a key to NVM after it has been updated. | A value of 0 means, that the key is written immediately after it has been updated. If several keys are update that are assigned to the same container, the first delay time expiration shall be used. All keys that have been updated during that time shall be updated and its delay timer shall be stopped.
      reference KeyMNvmBlockDescriptorRef [0..1]: scope=ECU, multiplicity set at pre-compile, set at pre-compile, requires-symbolic-name-value=true, destination=NvMBlockDescriptor  # Reference to the Nvm block description in the Nvm module configuration.
