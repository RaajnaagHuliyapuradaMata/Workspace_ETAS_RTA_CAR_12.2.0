AUTOSAR XML (schema 4-2-2)
package /AUTOSAR_ComM/ImplementationDataTypes
  impl type ComM_ModeType: compu {0=COMM_NO_COMMUNICATION, 1=COMM_SILENT_COMMUNICATION, 2=COMM_FULL_COMMUNICATION, 3=COMM_FULL_COMMUNICATION_WITH_WAKEUP_REQUEST}, implementation-data-type=uint8
  impl type ComM_UserHandleType: implementation-data-type=uint8
  impl type ComM_InhibitionStatusType: implementation-data-type=uint8
package /AUTOSAR_ComM/CompuMethods
  compu method OneToOne: identical
package /AUTOSAR_ComM/PortInterfaces
  mode switch interface ComM_CurrentMode: is-service=true
    mode group currentMode: type=ComMMode
  4 x client server interface, all with is-service=true:
    ComM_ChannelLimitation
      operation GetInhibitionStatus: possible-error=ComM_ChannelLimitation/E_NOT_OK
        arg Status: sw-calibration-access=READ-ONLY, implementation-data-type=ComM_InhibitionStatusType, type=ComM_InhibitionStatusType, direction=OUT
      operation LimitChannelToNoComMode: possible-error=ComM_ChannelLimitation/E_NOT_OK
        arg Status: sw-calibration-access=READ-ONLY, type=boolean, direction=IN
      error E_NOT_OK: error-code=1
    ComM_ECUModeLimitation
      4 x operation, all with possible-error=ComM_ECUModeLimitation/E_NOT_OK:
        LimitECUToNoComMode
          arg Status: sw-calibration-access=READ-ONLY, type=boolean, direction=IN
        ReadInhibitCounter
          arg CounterValue: sw-calibration-access=READ-ONLY, type=uint16, direction=OUT
        ResetInhibitCounter
        SetECUGroupClassification
          arg Status: sw-calibration-access=READ-ONLY, type=ComM_InhibitionStatusType, direction=IN
      error E_NOT_OK: error-code=1
    ComM_ChannelWakeup
      operation PreventWakeUp: possible-error=ComM_ChannelWakeup/E_NOT_OK
        arg Status: sw-calibration-access=READ-ONLY, type=boolean, direction=IN
      operation GetInhibitionStatus: possible-error=ComM_ChannelWakeup/E_NOT_OK
        arg Status: type=ComM_InhibitionStatusType, direction=OUT
      error E_NOT_OK: error-code=1
    ComM_UserRequest
      5 x operation:
        GetCurrentComMode: possible-error=ComM_UserRequest/E_NOT_OK
          arg ComMode: type=ComM_ModeType, direction=OUT
        GetCurrentPNCComMode: possible-error=[ComM_UserRequest/E_NOT_OK, E_MULTIPLE_PNC_ASSIGNED, E_NO_PNC_ASSIGNED]
          arg ComMode: type=ComM_ModeType, direction=OUT
        GetMaxComMode: possible-error=ComM_UserRequest/E_NOT_OK
          arg ComMode: type=ComM_ModeType, direction=OUT
        GetRequestedComMode: possible-error=ComM_UserRequest/E_NOT_OK
          arg ComMode: type=ComM_ModeType, direction=OUT
        RequestComMode: possible-error=[E_MODE_LIMITATION, ComM_UserRequest/E_NOT_OK]
          arg ComMode: type=ComM_ModeType, direction=IN
      4 x error:
        E_NOT_OK: error-code=1
        E_MODE_LIMITATION: error-code=2
        E_MULTIPLE_PNC_ASSIGNED: error-code=3
        E_NO_PNC_ASSIGNED: error-code=4
package /AUTOSAR_ComM/ModeDeclarationGroups
  mode declaration group ComMMode: category=EXPLICIT_ORDER, initial-mode=COMM_NO_COMMUNICATION
    mode COMM_FULL_COMMUNICATION: value=2
    mode COMM_NO_COMMUNICATION: value=0
    mode COMM_SILENT_COMMUNICATION: value=1
package /AUTOSAR_ComM/DataTypeMappingSets
  data type mapping set ComMModeMapping: mode-request-type-map{implementation-data-type=uint8, mode-group=ComMMode}
