AUTOSAR XML (schema 00051)
package /ETAS_Project/EcucModuleConfigurationValuess
  module config EcuM: implementation-config-variant=VARIANT-PRE-COMPILE
    EcuMConfiguration_0 (EcuMConfiguration)
      EcuMCommonConfiguration: EcuMIgnoreWakeupEvValOffPreOS=true, EcuMDefaultAppMode=OSDEFAULTAPPMODE
        EcuMDefaultShutdownTarget: EcuMDefaultState=EcuMStateOff
        5 x EcuMWakeupSource, all with EcuMValidationTimeout=0.0:
          ECUM_WKSOURCE_POWER: EcuMWakeupSourceId=0
          ECUM_WKSOURCE_RESET: EcuMWakeupSourceId=1
          ECUM_WKSOURCE_INTERNAL_RESET: EcuMWakeupSourceId=2
          ECUM_WKSOURCE_INTERNAL_WDG: EcuMWakeupSourceId=3
          ECUM_WKSOURCE_EXTERNAL_WDG: EcuMWakeupSourceId=4
        EcuMDriverInitListOne
          3 x EcuMDriverInitItem:
            Dem_PreInit: EcuMModuleID=Dem, EcuMModuleParameter=NULL_PTR, EcuMModuleService=PreInit
            Mcu_Init: EcuMModuleID=Mcu, EcuMModuleParameter=POSTBUILD_PTR, EcuMModuleService=Init
            Wdg_Init: EcuMModuleParameter=NULL_PTR, EcuMModuleID=Wdg, EcuMModuleService=Init
      EcuMFlexConfiguration
        EcuMFlexUserConfig_0 (EcuMFlexUserConfig): EcuMFlexUser=0
        EcuMGoDownAllowedUsers: EcuMGoDownAllowedUserRef=EcuMFlexUserConfig_0
        3 x EcuMResetMode:
          ECUM_RESET_MCU: EcuMResetModeId=0
          ECUM_RESET_WDGM: EcuMResetModeId=1
          ECUM_RESET_IO: EcuMResetModeId=2
        3 x EcuMShutdownCause:
          ECUM_CAUSE_ECU_STATE: EcuMShutdownCauseId=1
          ECUM_CAUSE_WDGM: EcuMShutdownCauseId=2
          ECUM_CAUSE_DCM: EcuMShutdownCauseId=3
    EcuMGeneral: EcuMDevErrorDetect=false, EcuMIncludeDet=false, EcuMMainFunctionPeriod=0.01, EcuMVersionInfoApi=true
      EcuMRbIncludeHeaderList: EcuMRbModuleHeader=EcuM_User
