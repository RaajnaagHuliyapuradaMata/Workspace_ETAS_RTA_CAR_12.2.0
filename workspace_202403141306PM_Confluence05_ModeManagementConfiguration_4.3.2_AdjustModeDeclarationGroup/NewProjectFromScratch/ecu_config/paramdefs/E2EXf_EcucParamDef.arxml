AUTOSAR XML (schema 4-2-2)
package /AUTOSAR_E2EXf/EcucModuleDefs
  module definition E2EXf [0..1]: category=VENDOR_SPECIFIC_MODULE_DEFINITION, refined-module-def=E2EXf, variants pre-compile  # RB specific configuration of the E2EXf (E2E transformer) module.
    container E2EXfRb_General  # E2EXf general configurations | General configuration of component E2EXf. The parameters contain defines for the component behaviour and provided APIs.
      enumeration E2EXfRb_Variant: {E2EXF_STANDARD_V01}, origin=RB, set at pre-compile, default-value=E2EXF_STANDARD_V01  # Variant selection | With this parameter the implementation variant can be selected. Currently only a single variant implemented so this parameter has no effect on the generated code.
    container E2EXfRb_Transformer [0..*]: multiplicity set at pre-compile  # E2EXf transformer configuration | E2EXf transformer configuration parameters
      enumeration E2EXfRb_CommunicationDirection: {in, out}, origin=RB, set at pre-compile  # CommunicationDirection | Describes the communication direction.
      boolean E2EXfRb_DisableEndToEndCheck [0..1]: multiplicity set at pre-compile, origin=RB, set at pre-compile, default-value=false  # DisableEndToEndCheck | Disables/Enables the E2E check. if True then E2E Transformer shall skip the invocation of the E2E Library - it shall only perform buffer processing
      integer E2EXfRb_HeaderLength: origin=RB, set at pre-compile  # HeaderLength | Defines the length of the header (in bits) this transformer will add in front of the data.
      boolean E2EXfRb_InPlace: origin=RB, set at pre-compile  # InPlace | Selects the buffer handling mode.If true: the transformer uses the input buffer as output buffer.If false: the transformer uses separate buffer for the input and output.
      integer E2EXfRb_UpperHeaderBitsToShift: origin=RB, set at pre-compile  # Upper Header Bits To Shift | This attribute describes the number of upper-header bits to be shifted.
      choice container E2EXfRb_ProfileConfiguration  # Profile configuration | Select profile type by choosing one of the configuration container
        container E2EXfRb_Profile1 [0..1]: multiplicity set at pre-compile  # Profile 1 | Profile 1 configuration
          integer E2EXfRb_CounterOffset: origin=RB, set at pre-compile  # Counter Offset | Offset of the counter in the Data[] array in bits.
          integer E2EXfRb_CrcOffset: origin=RB, set at pre-compile  # CRC Offset | Offset of the CRC in the Data[] array in bits.
          integer E2EXfRb_DataID: origin=RB, set at pre-compile  # DataId | This represents a unique numerical identifier. Note: ID is used for protection against masquerading. The details concerning the maximum number of values (this information is specific for each E2E profile) applicable for this attribute are controlled by a semantic constraint that depends on the category of the EndToEndProtection.
          enumeration E2EXfRb_DataIdMode: {E2E_P01_DATAID_BOTH, E2E_P01_DATAID_ALT, E2E_P01_DATAID_LOW, E2E_P01_DATAID_NIBBLE}, origin=RB, set at pre-compile  # Data ID Mode | This attribute describes the inclusion mode that is used to include the implicit two-byte Data ID in the one-byte CRC.
          integer E2EXfRb_DataIdNibbleOffset: origin=RB, set at pre-compile  # Data ID Nibble Offset | Offset of the Data ID nibble in the Data[] array in bits.
          integer E2EXfRb_DataLength: origin=RB, set at pre-compile  # DataLength | Length of Data in bits
          integer E2EXfRb_MaxDeltaCounter [0..1]: origin=RB:42.9.0.0:2021-07-02, set at pre-compile  # MaxDeltaCounter | Maximum allowed gap between two counter values of two consecutive checks
          integer E2EXfRb_MaxNoNewOrRepeatedData [0..1]: origin=RB:42.9.0.0:2021-07-02, set at pre-compile  # MaxNoNewOrRepeatedData | The maximum allowed amount of consecutive failed counter checks
          enumeration E2EXfRb_ProfileBehavior [0..1]: {PRE_R4_2, R4_2}, origin=RB:42.9.0.0:2021-07-02, set at pre-compile, default-value=R4_2  # ProfileBehavior | Behavior of the check functionality (Only valid for Profile1 and Profile2).This parameter is provided to select the profile behaviour. This is an enumeration parameter. It contains two values : R4_2 and PRE_R4_2. If selected R4_2, the SM behaves according to AR42 E2E SWS. If selected PRE_R4_2, the SM behavior is prior to AR42.
          integer E2EXfRb_SyncCounterInit [0..1]: origin=RB:42.9.0.0:2021-07-02, set at pre-compile  # SyncCounterInit | Number of checks required for validating the consistency of the counter that must be received with a valid counter (i.e. counter within the allowed lock-in range) after the detection of an unexpected behavior of a received counter
        container E2EXfRb_Profile11 [0..1]: multiplicity set at pre-compile  # Profile 11 | Profile 11 configuration
          integer E2EXfRb_CounterOffset: origin=RB, set at pre-compile  # Counter Offset | Offset of the counter in the Data[] array in bits.
          integer E2EXfRb_CrcOffset: origin=RB, set at pre-compile  # CRC Offset | Offset of the CRC in the Data[] array in bits.
          integer E2EXfRb_DataID: origin=RB, set at pre-compile  # DataId | This represents a unique numerical identifier. Note: ID is used for protection against masquerading. The details concerning the maximum number of values (this information is specific for each E2E profile) applicable for this attribute are controlled by a semantic constraint that depends on the category of the EndToEndProtection.
          enumeration E2EXfRb_DataIdMode: {E2E_P11_DATAID_BOTH, E2E_P11_DATAID_NIBBLE}, origin=RB, set at pre-compile  # Data ID Mode | This attribute describes the inclusion mode that is used to include the implicit two-byte Data ID in the one-byte CRC.
          integer E2EXfRb_DataIdNibbleOffset: origin=RB, set at pre-compile  # Data ID Nibble Offset | Offset of the Data ID nibble in the Data[] array in bits.
          integer E2EXfRb_DataLength: origin=RB, set at pre-compile  # DataLength | Length of Data in bits
          integer E2EXfRb_MaxDeltaCounter [0..1]: origin=RB:42.9.0.0:2021-07-02, set at pre-compile  # MaxDeltaCounter | Maximum allowed gap between two counter values of two consecutive checks
        container E2EXfRb_Profile2 [0..1]: multiplicity set at pre-compile  # Profile 2 | Profile 2 configuration
          integer E2EXfRb_DataID [16..16]: origin=RB, set at pre-compile  # DataId | This represents a unique numerical identifier. Note: ID is used for protection against masquerading. For this profile type (Profile 2) exactly 16 DataIds required to be defined.
          integer E2EXfRb_DataLength: origin=RB, set at pre-compile  # DataLength | Length of Data in bits
          integer E2EXfRb_MaxDeltaCounter [0..1]: origin=RB:42.9.0.0:2021-07-02, set at pre-compile  # MaxDeltaCounter | Maximum allowed gap between two counter values of two consecutive checks
          integer E2EXfRb_MaxNoNewOrRepeatedData [0..1]: origin=RB:42.9.0.0:2021-07-02, set at pre-compile  # MaxNoNewOrRepeatedData | The maximum allowed amount of consecutive failed counter checks
          integer E2EXfRb_Offset: origin=RB, set at pre-compile  # Offset | Offset of the Data ID nibble in the Data[] array in bits.
          enumeration E2EXfRb_ProfileBehavior [0..1]: {PRE_R4_2, R4_2}, origin=RB:42.9.0.0:2021-07-02, set at pre-compile, default-value=R4_2  # ProfileBehavior | Behavior of the check functionality (Only valid for Profile1 and Profile2).This parameter is provided to select the profile behaviour. This is an enumeration parameter. It contains two values : R4_2 and PRE_R4_2. If selected R4_2, the SM behaves according to AR42 E2E SWS. If selected PRE_R4_2, the SM behavior is prior to AR42.
          integer E2EXfRb_SyncCounterInit [0..1]: origin=RB:42.9.0.0:2021-07-02, set at pre-compile  # SyncCounterInit | Number of checks required for validating the consistency of the counter that must be received with a valid counter (i.e. counter within the allowed lock-in range) after the detection of an unexpected behavior of a received counter
        container E2EXfRb_GM_Profile02 [0..1]: multiplicity set at pre-compile  # GM Profile02 | GM Custom Profile 2 configuration
          integer E2EXfRb_DataID: origin=RB, set at pre-compile  # DataID | Data ID for the given message which is used for Checksum computation
          integer E2EXfRb_ChecksumOffset: origin=RB, set at pre-compile  # ChecksumOffset | Offset of the Checksum in the Data[] array in bits.
          integer E2EXfRb_CounterOffset: origin=RB, set at pre-compile  # CounterOffset | Offset of the counter in the Data[] array in bits.
          integer E2EXfRb_DataLength: origin=RB, set at pre-compile  # DataLength | Length of Data in bits
          integer E2EXfRb_MaxDeltaCounter [0..1]: origin=RB:42.9.0.0:2021-07-02, set at pre-compile  # MaxDeltaCounter | Maximum allowed gap between two counter values of two consecutive checks
          integer E2EXfRb_MaxDeltaCounterInit [0..1]: origin=RB:42.9.0.0:2021-07-02, set at pre-compile  # MaxDeltaCounterInit | Initial maximum allowed gap between two counter values of two consecutive checks
        container E2EXfRb_GM_Profile03 [0..1]: multiplicity set at pre-compile  # GM Profile03 | GM Custom Profile 3 configuration
          integer E2EXfRb_DataID: origin=RB:45.5.0.0:2023-06-28, set at pre-compile  # DataID | Data ID for the given message which is used for CRC computation
          integer E2EXfRb_CrcOffset: origin=RB:45.5.0.0:2023-06-28, set at pre-compile  # CrcOffset | Offset of the CRC in the Data[] array in bits.
          integer E2EXfRb_CounterOffset: origin=RB:45.5.0.0:2023-06-28, set at pre-compile  # CounterOffset | Offset of the counter in the Data[] array in bits.
          integer E2EXfRb_DataLength: origin=RB:45.5.0.0:2023-06-28, set at pre-compile  # DataLength | Length of Data in bits
          integer E2EXfRb_MaxDeltaCounter [0..1]: origin=RB:45.5.0.0:2023-06-28, set at pre-compile  # MaxDeltaCounter | Maximum allowed gap between two counter values of two consecutive checks
          integer E2EXfRb_MaxDeltaCounterInit [0..1]: origin=RB:45.5.0.0:2023-06-28, set at pre-compile  # MaxDeltaCounterInit | Initial maximum allowed gap between two counter values of two consecutive checks
        container E2EXfRb_GM_Profile04 [0..1]: multiplicity set at pre-compile  # GM Profile04 | GM Custom Profile 4 configuration
          integer E2EXfRb_PVOffset: origin=RB:45.5.0.0:2023-06-28, set at pre-compile  # Protection value Offset | Offset of the Protection value in the Data[] array in bits.
          integer E2EXfRb_CounterOffset: origin=RB:45.5.0.0:2023-06-28, set at pre-compile  # CounterOffset | Offset of the counter in the Data[] array in bits.
          integer E2EXfRb_DataLength: origin=RB:45.5.0.0:2023-06-28, set at pre-compile  # DataLength | Length of Data in bits
          integer E2EXfRb_MaxDeltaCounter [0..1]: origin=RB:45.5.0.0:2023-06-28, set at pre-compile  # MaxDeltaCounter | Maximum allowed gap between two counter values of two consecutive checks
          integer E2EXfRb_MaxDeltaCounterInit [0..1]: origin=RB:45.5.0.0:2023-06-28, set at pre-compile  # MaxDeltaCounterInit | Initial maximum allowed gap between two counter values of two consecutive checks
        container E2EXfRb_Profile22 [0..1]: multiplicity set at pre-compile  # Profile 22 | Profile 22 configuration
          integer E2EXfRb_DataID [16..16]: origin=RB, set at pre-compile  # DataId | This represents a unique numerical identifier. Note: ID is used for protection against masquerading. The details concerning the maximum number of values (this information is specific for each E2E profile) applicable for this attribute are controlled by a semantic constraint that depends on the category of the EndToEndProtection.
          integer E2EXfRb_DataLength: origin=RB, set at pre-compile  # DataLength | Length of Data in bits
          integer E2EXfRb_MaxDeltaCounter [0..1]: origin=RB:42.9.0.0:2021-07-02, set at pre-compile  # MaxDeltaCounter | Maximum allowed gap between two counter values of two consecutive checks
          integer E2EXfRb_Offset: origin=RB, set at pre-compile  # Offset | Offset of the Data ID nibble in the Data[] array in bits.
        container E2EXfRb_Profile4 [0..1]: multiplicity set at pre-compile  # Profile 4 | Profile 4 configuration
          integer E2EXfRb_DataID: origin=RB, set at pre-compile  # DataId | This represents a unique numerical identifier. Note: ID is used for protection against masquerading. The details concerning the maximum number of values (this information is specific for each E2E profile) applicable for this attribute are controlled by a semantic constraint that depends on the category of the EndToEndProtection.
          integer E2EXfRb_MaxDataLength: origin=RB, set at pre-compile  # MaxDataLength | Maximum length of Data in bits.
          integer E2EXfRb_MaxDeltaCounter [0..1]: origin=RB:42.9.0.0:2021-07-02, set at pre-compile  # MaxDeltaCounter | Maximum allowed gap between two counter values of two consecutive checks
          integer E2EXfRb_MinDataLength: origin=RB, set at pre-compile  # MinDataLength | Minimum length of Data in bits.
          integer E2EXfRb_Offset: origin=RB, set at pre-compile  # Offset | Offset of the Data ID nibble in the Data[] array in bits.
        container E2EXfRb_Profile44 [0..1]: multiplicity set at pre-compile  # Profile 44 | Profile 44 configuration
          integer E2EXfRb_DataID: origin=RB, set at pre-compile  # DataId | This represents a unique numerical identifier. Note: ID is used for protection against masquerading. The details concerning the maximum number of values (this information is specific for each E2E profile) applicable for this attribute are controlled by a semantic constraint that depends on the category of the EndToEndProtection.
          integer E2EXfRb_MaxDataLength: origin=RB, set at pre-compile  # MaxDataLength | Maximum length of Data in bits.
          integer E2EXfRb_MaxDeltaCounter [0..1]: origin=RB:42.9.0.0:2021-07-02, set at pre-compile  # MaxDeltaCounter | Maximum allowed gap between two counter values of two consecutive checks
          integer E2EXfRb_MinDataLength: origin=RB, set at pre-compile  # MinDataLength | Minimum length of Data in bits.
          integer E2EXfRb_Offset: origin=RB, set at pre-compile  # Offset | Offset of the Data ID nibble in the Data[] array in bits.
        container E2EXfRb_Profile5 [0..1]: multiplicity set at pre-compile  # Profile 5 | Profile 5 configuration
          integer E2EXfRb_DataID: origin=RB, set at pre-compile  # DataId | This represents a unique numerical identifier. Note: ID is used for protection against masquerading. The details concerning the maximum number of values (this information is specific for each E2E profile) applicable for this attribute are controlled by a semantic constraint that depends on the category of the EndToEndProtection.
          integer E2EXfRb_DataLength: origin=RB, set at pre-compile  # DataLength | Length of Data in bits
          integer E2EXfRb_MaxDeltaCounter [0..1]: origin=RB:42.9.0.0:2021-07-02, set at pre-compile  # MaxDeltaCounter | Maximum allowed gap between two counter values of two consecutive checks
          integer E2EXfRb_Offset: origin=RB, set at pre-compile  # Offset | Offset of the Data ID nibble in the Data[] array in bits.
        container E2EXfRb_Profile6 [0..1]: multiplicity set at pre-compile  # Profile 6 | Profile 6 configuration
          integer E2EXfRb_DataID: origin=RB, set at pre-compile  # DataId | This represents a unique numerical identifier. Note: ID is used for protection against masquerading. The details concerning the maximum number of values (this information is specific for each E2E profile) applicable for this attribute are controlled by a semantic constraint that depends on the category of the EndToEndProtection.
          integer E2EXfRb_MaxDataLength: origin=RB, set at pre-compile  # MaxDataLength | Maximum length of Data in bits.
          integer E2EXfRb_MaxDeltaCounter [0..1]: origin=RB:42.9.0.0:2021-07-02, set at pre-compile  # MaxDeltaCounter | Maximum allowed gap between two counter values of two consecutive checks
          integer E2EXfRb_MinDataLength: origin=RB, set at pre-compile  # MinDataLength | Minimum length of Data in bits.
          integer E2EXfRb_Offset: origin=RB, set at pre-compile  # Offset | Offset of the Data ID nibble in the Data[] array in bits.
        container E2EXfRb_Profile7 [0..1]: multiplicity set at pre-compile  # Profile 7 | Profile 7 configuration
          integer E2EXfRb_DataID: origin=RB, set at pre-compile  # DataId | This represents a unique numerical identifier. Note: ID is used for protection against masquerading. The details concerning the maximum number of values (this information is specific for each E2E profile) applicable for this attribute are controlled by a semantic constraint that depends on the category of the EndToEndProtection.
          integer E2EXfRb_MaxDataLength: origin=RB, set at pre-compile  # MaxDataLength | Maximum length of Data in bits.
          integer E2EXfRb_MaxDeltaCounter [0..1]: origin=RB:42.9.0.0:2021-07-02, set at pre-compile  # MaxDeltaCounter | Maximum allowed gap between two counter values of two consecutive checks
          integer E2EXfRb_MinDataLength: origin=RB, set at pre-compile  # MinDataLength | Minimum length of Data in bits.
          integer E2EXfRb_Offset: origin=RB, set at pre-compile  # Offset | Offset of the Data ID nibble in the Data[] array in bits.
        container E2EXfRb_GM_Profile01 [0..1]: multiplicity set at pre-compile  # GM Profile01 | GM Custom Profile 1 configuration
          integer E2EXfRb_CounterLength: origin=RB, set at pre-compile  # CounterLength | Length of Active Rolling Counter as 2, 4 or 8 bits
          integer E2EXfRb_CounterOffset: origin=RB, set at pre-compile  # CounterOffset | Offset of the counter in the Data[] array in bits.
          integer E2EXfRb_DataLength: origin=RB, set at pre-compile  # DataLength | Length of Data in bits
          integer E2EXfRb_MaxDeltaCounter [0..1]: origin=RB:42.9.0.0:2021-07-02, set at pre-compile  # MaxDeltaCounter | Maximum allowed gap between two counter values of two consecutive checks
          integer E2EXfRb_MaxDeltaCounterInit [0..1]: origin=RB:42.9.0.0:2021-07-02, set at pre-compile  # MaxDeltaCounterInit | Initial maximum allowed gap between two counter values of two consecutive checks
      container E2EXfRb_StateMachineConfiguration [0..1]: multiplicity set at pre-compile  # State machine configuration
        boolean E2EXfRb_ClearToInvalid [0..1]: multiplicity set at pre-compile, origin=RB, set at pre-compile, default-value=FALSE  # ClearToInvalid | Clear monitoring window data on transition to state INVALID.
        boolean E2EXfRb_transitToInvalidExtended [0..1]: multiplicity set at pre-compile, origin=RB:45.4.0.0:2023-01-17, set at pre-compile, default-value=FALSE  # transitToInvalidExtended | Restrict/allow tranistion from states INIT/NODATA to INVALID state
        integer E2EXfRb_MaxErrorStateInit: 0.., origin=RB, set at pre-compile  # MaxErrorStateInit | Maximal number of checks in which ProfileStatus equal to E2E_P_ERROR was determined, within the last WindowSize checks, for the state E2E_SM_INIT.
        integer E2EXfRb_MaxErrorStateInvalid: 0.., origin=RB, set at pre-compile  # MaxErrorStateInvalid | Maximal number of checks in which ProfileStatus equal to E2E_P_ERROR was determined, within the last WindowSize checks, for the state E2E_SM_INVALID.
        integer E2EXfRb_MaxErrorStateValid: 0.., origin=RB, set at pre-compile  # MaxErrorStateValid | Maximal number of checks in which ProfileStatus equal to E2E_P_ERROR was determined, within the last WindowSize checks, for the state E2E_SM_VALID.
        integer E2EXfRb_MinOkStateInit: 0.., origin=RB, set at pre-compile  # MinOkStateInit | Minimal number of checks in which ProfileStatus equal to E2E_P_OK was determined, within the last WindowSize checks, for the state E2E_SM_INIT.
        integer E2EXfRb_MinOkStateInvalid: 0.., origin=RB, set at pre-compile  # MinOkStateInvalid | Minimal number of checks in which ProfileStatus equal to E2E_P_OK was determined, within the last WindowSize checks, for the state E2E_SM_INVALID.
        integer E2EXfRb_MinOkStateValid: 0.., origin=RB, set at pre-compile  # MinOkStateValid | Minimal number of checks in which ProfileStatus equal to E2E_P_OK was determined, within the last WindowSize checks, for the state E2E_SM_VALID.
        enumeration E2EXfRb_ProfileBehavior [0..1]: {PRE_R4_2, R4_2}, origin=RB:42.9.0.0:2021-07-02, set at pre-compile, default-value=R4_2  # ProfileBehavior | Behavior of the check functionality (Only valid for Profile1 and Profile2).This parameter is provided to select the profile behaviour. This is an enumeration parameter. It contains two values : R4_2 and PRE_R4_2. If selected R4_2, the SM behaves according to AR42 E2E SWS. If selected PRE_R4_2, the SM behavior is prior to AR42.
        integer E2EXfRb_WindowSize [0..1]: 1.., origin=RB, set at pre-compile  # WindowSize | Size of the monitoring window for the E2E state machine
        integer E2EXfRb_WindowSizeInit [0..1]: 1.., origin=RB, set at pre-compile  # WindowSizeInit | Size of the monitoring windows for the state machine during state INIT
        integer E2EXfRb_WindowSizeInvalid [0..1]: 1.., origin=RB, set at pre-compile  # WindowSizeInvalid | Size of the monitoring window for the state machine during state INVALID.
        integer E2EXfRb_WindowSizeValid [0..1]: 1.., origin=RB, set at pre-compile  # WindowSizeValid | Size of the monitoring window for the state machine during state VALID.
