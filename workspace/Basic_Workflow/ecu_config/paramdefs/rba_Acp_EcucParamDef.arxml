AUTOSAR XML (schema 00048)
package /RB/RBA/rba_Acp/EcucModuleDefs
  module definition rba_Acp [0..1]: category=VENDOR_SPECIFIC_MODULE_DEFINITION, variants pre-compile  # MCAL Auxiliary Control Processor | Configuration of the MCAL module for the Auxiliary Control Processor (Acp)
    container rba_Acp_ConfigSet: multiplicity set at pre-compile  # Configuration data set | Acp configuration container
      container rba_Acp_Application [1..*]: multiplicity set at pre-compile  # Acp application | This container contains the configuration for an Acp application
        enumeration rba_Acp_Target: {DME, DSPH}, multiplicity set at pre-compile, origin=RB, set at pre-compile  # Target | The target controller of the Acp application
    container rba_Acp_General  # General settings | General configuration (parameters) of the rba_Acp driver software module.
      boolean rba_Acp_DevErrorDetect: multiplicity set at pre-compile, origin=RB, set at pre-compile  # Development error detection | Switches the Development Error Detection and Notification ON or OFF.true: Enabled. false: Disabled.
