AUTOSAR XML (schema 00051)
package /ETAS_Project/EcucModuleConfigurationValuess
  module config CanIf
    CanIfInitCfg
      ApplicationECU_To_TestECU_Can_Network_CANNODE_0_OUT (CanIfTxPduCfg): CanIfTxPduId=0
      TestECU_To_ApplicationECU_Can_Network_CANNODE_0_IN (CanIfRxPduCfg): CanIfRxPduId=0
    CanIfCtrlDrvCfg
      Can_Network_CANNODE_0 (CanIfCtrlCfg): CanIfCtrlId=0
  module config ComM
    ComMConfigSet
      ComMUser_Can_Network_Channel_Can_Network (ComMUser): ComMUserIdentifier=0
      Can_Network_Channel_Can_Network (ComMChannel): ComMChannelId=0
  module config EcuM
    EcuMConfiguration_0 (EcuMConfiguration)
      EcuMCommonConfiguration_0 (EcuMCommonConfiguration)
        10 x EcuMWakeupSource:
          ECUM_WKSOURCE_POWER
          ECUM_WKSOURCE_RESET
          ECUM_WKSOURCE_INTERNAL_RESET
          ECUM_WKSOURCE_INTERNAL_WDG
          ECUM_WKSOURCE_EXTERNAL_WDG
          ECUM_WKSOURCE_POWER: EcuMWakeupSourceId=0, EcuMValidationTimeout=0.0
          ECUM_WKSOURCE_RESET: EcuMWakeupSourceId=1, EcuMValidationTimeout=0.0
          ECUM_WKSOURCE_INTERNAL_RESET: EcuMWakeupSourceId=2, EcuMValidationTimeout=0.0
          ECUM_WKSOURCE_INTERNAL_WDG: EcuMWakeupSourceId=3, EcuMValidationTimeout=0.0
          ECUM_WKSOURCE_EXTERNAL_WDG: EcuMWakeupSourceId=4, EcuMValidationTimeout=0.0
      EcuMFlexConfiguration_0 (EcuMFlexConfiguration)
        6 x EcuMResetMode:
          ECUM_RESET_MCU
          ECUM_RESET_WDGM
          ECUM_RESET_IO
          ECUM_RESET_MCU: EcuMResetModeId=0
          ECUM_RESET_WDGM: EcuMResetModeId=1
          ECUM_RESET_IO: EcuMResetModeId=2
        8 x EcuMShutdownCause:
          ECUM_CAUSE_UNKNOWN
          ECUM_CAUSE_ECU_STATE
          ECUM_CAUSE_WDGM
          ECUM_CAUSE_DCM
          ECUM_CAUSE_UNKNOWN: EcuMShutdownCauseId=0
          ECUM_CAUSE_ECU_STATE: EcuMShutdownCauseId=1
          ECUM_CAUSE_WDGM: EcuMShutdownCauseId=2
          ECUM_CAUSE_DCM: EcuMShutdownCauseId=3
  module config CanSM
    CanSMConfiguration
      Can_Network_CANNODE_0 (CanSMManagerNetwork): CanSMNetworkIndex=0
  module config Com
    ComConfig
      IP_TestECU_To_ApplicationECU_Can_Network_Channel_CAN_Rx (ComIPdu): ComIPduHandleId=0
      IP_ApplicationECU_To_TestECU_Can_Network_Channel_CAN_Tx (ComIPdu): ComIPduHandleId=0
      S_TestECU_To_ApplicationECU_Data_Can_Network_Channel_CAN_Rx (ComSignal): ComHandleId=0
      S_ApplicationECU_To_TestECU_Data_Can_Network_Channel_CAN_Tx (ComSignal): ComHandleId=0
      ComIPduGroup_Rx (ComIPduGroup): ComIPduGroupHandleId=0
      ComIPduGroup_Tx (ComIPduGroup): ComIPduGroupHandleId=1
  module config PduR
    PduRRoutingPaths
      TestECU_To_ApplicationECU_CanIf2PduR_Can_Network_Channel_CAN (PduRSrcPdu): PduRSourcePduHandleId=0
      ApplicationECU_To_TestECU_PduR2CanIf_Can_Network_Channel_CAN (PduRDestPdu): PduRDestPduHandleId=0
      ApplicationECU_To_TestECU_Com2PduR_Can_Network_Channel_CAN (PduRSrcPdu): PduRSourcePduHandleId=0
      TestECU_To_ApplicationECU_PduR2Com_Can_Network_Channel_CAN (PduRDestPdu): PduRDestPduHandleId=0
package /RB/UBK/Project/EcucModuleConfigurationValuess
  module config rba_ArxmlGen
    5 x rba_ArxmlGen_Comp:
      PduR
        PduR_Init (rba_ArxmlGen_BswModuleEntry):
          rba_ArxmlGen_IsReentrant = false
          rba_ArxmlGen_IsSynchronus = true
          rba_ArxmlGen_BswCallType = REGULAR
          rba_ArxmlGen_BswExecutionContext = UNSPECIFIED
          rba_ArxmlGen_swServiceImplPolicy = STANDARD
        PduR_GetVersionInfo (rba_ArxmlGen_BswModuleEntry):
          rba_ArxmlGen_IsReentrant = false
          rba_ArxmlGen_IsSynchronus = true
          rba_ArxmlGen_BswCallType = CALLBACK
          rba_ArxmlGen_BswExecutionContext = UNSPECIFIED
          rba_ArxmlGen_swServiceImplPolicy = STANDARD
        CE_Init (rba_ArxmlGen_ExecEntity): rba_ArxmlGen_ExecEntityCategory=Called, rba_ArxmlGen_ExecEntityImplEntryRef=PduR_Init
      ComM: rba_ArxmlGen_CompVersionSw=5.0.0
        SE_MainFunction_Can_Network_Channel_Can_Network (rba_ArxmlGen_ExecEntity):
          rba_ArxmlGen_ExecEntityCategory = Schedulable
          rba_ArxmlGen_ExecEntityPeriod = 0.01
          rba_ArxmlGen_ExecEntityImplEntryRef = ComM_MainFunction_Can_Network_Channel_Can_Network
        ComM_Init (rba_ArxmlGen_BswModuleEntry):
          rba_ArxmlGen_IsReentrant = false
          rba_ArxmlGen_IsSynchronus = true
          rba_ArxmlGen_BswCallType = REGULAR
          rba_ArxmlGen_BswExecutionContext = UNSPECIFIED
          rba_ArxmlGen_swServiceImplPolicy = STANDARD
        ComM_MainFunction_Can_Network_Channel_Can_Network (rba_ArxmlGen_BswModuleEntry):
          rba_ArxmlGen_IsReentrant = false
          rba_ArxmlGen_IsSynchronus = true
          rba_ArxmlGen_BswCallType = SCHEDULED
          rba_ArxmlGen_BswExecutionContext = TASK
          rba_ArxmlGen_swServiceImplPolicy = STANDARD
        ComM_UserStruct_Array_App (rba_ArxmlGen_ApplDataType): rba_ArxmlGen_ApplDataTypeNumElements=1
        ComM_ChannelStruct_Array_App (rba_ArxmlGen_ApplDataType): rba_ArxmlGen_ApplDataTypeNumElements=1
        ComM_UserStruct_Array_Impl (rba_ArxmlGen_ImplDataType): rba_ArxmlGen_ImplDataTypeNumElements=1
        ComM_ChannelStruct_Array_Impl (rba_ArxmlGen_ImplDataType): rba_ArxmlGen_ImplDataTypeNumElements=1
      CanSM
        CanSM_Au8_app (rba_ArxmlGen_ApplDataType): rba_ArxmlGen_ApplDataTypeNumElements=1, rba_ArxmlGen_ApplDataTypeImplOwnRef=CanSM_Au8_impl
        CanSM_Au8_impl (rba_ArxmlGen_ImplDataType): rba_ArxmlGen_ImplDataTypeNumElements=1
        CanSM_Aboolean_app (rba_ArxmlGen_ApplDataType): rba_ArxmlGen_ApplDataTypeNumElements=1, rba_ArxmlGen_ApplDataTypeImplOwnRef=CanSM_Aboolean_impl
        CanSM_Aboolean_impl (rba_ArxmlGen_ImplDataType): rba_ArxmlGen_ImplDataTypeNumElements=1
        CanSM_currBOR_State_a_Aenum_app (rba_ArxmlGen_ApplDataType): rba_ArxmlGen_ApplDataTypeNumElements=1, rba_ArxmlGen_ApplDataTypeImplOwnRef=CanSM_currBOR_State_a_Aenum_impl
        CanSM_currComM_Mode_a_Aenum_app (rba_ArxmlGen_ApplDataType): rba_ArxmlGen_ApplDataTypeNumElements=1, rba_ArxmlGen_ApplDataTypeImplOwnRef=CanSM_currComM_Mode_a_Aenum_impl
        CanSM_currBOR_State_a_Aenum_impl (rba_ArxmlGen_ImplDataType): rba_ArxmlGen_ImplDataTypeNumElements=1
        CanSM_currComM_Mode_a_Aenum_impl (rba_ArxmlGen_ImplDataType): rba_ArxmlGen_ImplDataTypeNumElements=1
        CanSM_TimerConfig_ast_Astruct_app (rba_ArxmlGen_ApplDataType): rba_ArxmlGen_ApplDataTypeNumElements=1, rba_ArxmlGen_ApplDataTypeImplOwnRef=CanSM_TimerConfig_ast_Astruct_impl
        CanSM_TimerConfig_ast_Astruct_impl (rba_ArxmlGen_ImplDataType): rba_ArxmlGen_ImplDataTypeNumElements=1
        SE_MainFunction (rba_ArxmlGen_ExecEntity): rba_ArxmlGen_ExecEntityPeriod=0.01
      CanIf
        CanIf_ControllerState_Astruct_impl (rba_ArxmlGen_ImplDataType):
          rba_ArxmlGen_ImplDataTypeCategory = Array
          rba_ArxmlGen_ImplDataTypeLongName = Implementation datatype for array of struct
          rba_ArxmlGen_ImplDataTypeNumElements = 1
          CanIf_struct_impl (rba_ArxmlGen_ImplDataTypeSub): rba_ArxmlGen_ImplDataTypeSubOwnRef=CanIf_ControllerStateType_struct_impl
        CanIf_ControllerState_Astruct_app (rba_ArxmlGen_ApplDataType):
          rba_ArxmlGen_ApplDataTypeCategory = Array
          rba_ArxmlGen_ApplDataTypeLongName = Structure datatype in CanIf
          rba_ArxmlGen_ApplDataTypeNumElements = 1
          rba_ArxmlGen_ApplDataTypeImplOwnRef = CanIf_ControllerState_Astruct_impl
          CanIf_ControllerStateType (rba_ArxmlGen_ApplDataTypeSub): rba_ArxmlGen_ApplDataTypeSubOwnRef=CanIf_ControllerStateType_struct_app
        CanIf_Prv_ControllerState_ast (rba_ArxmlGen_Measurement):
          rba_ArxmlGen_MeasCategory = Array
          rba_ArxmlGen_MeasDispFormat = %5.0f
          rba_ArxmlGen_MeasLongName = Can Interface controller State
          rba_ArxmlGen_MeasAddrMethodRef = INTERNAL_VAR_CLEARED
          rba_ArxmlGen_MeasApplDataTypeOwnRef = CanIf_ControllerState_Astruct_app
        CanIf_NotifStatusType_Aenum_impl (rba_ArxmlGen_ImplDataType):
          rba_ArxmlGen_ImplDataTypeCategory = Array
          rba_ArxmlGen_ImplDataTypeLongName = implementation data type for array of enum
          rba_ArxmlGen_ImplDataTypeNumElements = 1
          CanIf_Enum_impl (rba_ArxmlGen_ImplDataTypeSub): rba_ArxmlGen_ImplDataTypeSubOwnRef=CanIf_NotifStatusType_Enum_impl
        CanIf_NotifStatusType_Aenum_app (rba_ArxmlGen_ApplDataType):
          rba_ArxmlGen_ApplDataTypeCategory = Array
          rba_ArxmlGen_ApplDataTypeLongName = application data type for array of enum
          rba_ArxmlGen_ApplDataTypeNumElements = 1
          rba_ArxmlGen_ApplDataTypeImplOwnRef = CanIf_NotifStatusType_Aenum_impl
          CanIf_NotifStatusType (rba_ArxmlGen_ApplDataTypeSub): rba_ArxmlGen_ApplDataTypeSubOwnRef=CanIf_NotifStatusType_Enum_app
        CanIf_Prv_TxNotification_aen (rba_ArxmlGen_Measurement):
          rba_ArxmlGen_MeasCategory = Array
          rba_ArxmlGen_MeasDispFormat = %5.0f
          rba_ArxmlGen_MeasLongName = Can Interface Transmit Notification
          rba_ArxmlGen_MeasAddrMethodRef = INTERNAL_VAR_CLEARED
          rba_ArxmlGen_MeasApplDataTypeOwnRef = CanIf_NotifStatusType_Aenum_app
      Com: rba_ArxmlGen_CompVersionSw=5.0.0
        Com_SigBufComMainFunctionRx_au8_impl (rba_ArxmlGen_ImplDataType):
          rba_ArxmlGen_ImplDataTypeCategory = Array
          rba_ArxmlGen_ImplDataTypeNumElements = 1
          rba_ArxmlGen_ImplDataTypeLongName = Implementation data type for Signals of type - uint8,sint8,boolean,uint8_n
          Com_SubimplComMainFunctionRx_u8 (rba_ArxmlGen_ImplDataTypeSub): rba_ArxmlGen_ImplDataTypeSubOwnRef=Com_impl_u8
        Com_SigBufComMainFunctionRx_au8 (rba_ArxmlGen_ApplDataType):
          rba_ArxmlGen_ApplDataTypeCategory = Array
          rba_ArxmlGen_ApplDataTypeNumElements = 1
          rba_ArxmlGen_ApplDataTypeLongName = Application data type for Signals of type - uint8,sint8,boolean,uint8_n
          rba_ArxmlGen_ApplDataTypeImplOwnRef = Com_SigBufComMainFunctionRx_au8_impl
          Com_SubappComMainFunctionRx_u8 (rba_ArxmlGen_ApplDataTypeSub): rba_ArxmlGen_ApplDataTypeSubOwnRef=Com_uint8
        Com_RxSigBuf_ComMainFunctionRx_au8 (rba_ArxmlGen_Measurement):
          rba_ArxmlGen_MeasCategory = Array
          rba_ArxmlGen_MeasDispFormat = %5.0f
          rba_ArxmlGen_MeasLongName = Measurement variable for Signals of type - uint8,sint8,boolean,uint8_n. To refer Individual element in the Buffer array, Fetch Buffer Index from Com_PBcfg.c for each signal.
          rba_ArxmlGen_MeasAddrMethodRef = INTERNAL_VAR_CLEARED
          rba_ArxmlGen_MeasApplDataTypeOwnRef = Com_SigBufComMainFunctionRx_au8
        Com_implDataType_au8_Size8 (rba_ArxmlGen_ImplDataType):
          rba_ArxmlGen_ImplDataTypeCategory = Array
          rba_ArxmlGen_ImplDataTypeLongName = Implementation data type for Ipdu buffer of Size8
          rba_ArxmlGen_ImplDataTypeNumElements = 8
          Com_Subimpl8 (rba_ArxmlGen_ImplDataTypeSub): rba_ArxmlGen_ImplDataTypeSubOwnRef=Com_impl_u8
        Com_applDataType_au8_Size8 (rba_ArxmlGen_ApplDataType):
          rba_ArxmlGen_ApplDataTypeCategory = Array
          rba_ArxmlGen_ApplDataTypeLongName = Application data type for Ipdu buffer of Size8
          rba_ArxmlGen_ApplDataTypeNumElements = 8
          rba_ArxmlGen_ApplDataTypeImplOwnRef = Com_implDataType_au8_Size8
          Com_Subapp8 (rba_ArxmlGen_ApplDataTypeSub): rba_ArxmlGen_ApplDataTypeSubOwnRef=Com_uint8
        Com_dIP_ApplicationECU_To_TestECU_Can_Network_Channel_CAN_TxByte (rba_ArxmlGen_Measurement):
          rba_ArxmlGen_MeasCategory = Array
          rba_ArxmlGen_MeasDispFormat = %5.0f
          rba_ArxmlGen_MeasLongName = Tx Ipdu buffer of IPdu -IP_ApplicationECU_To_TestECU_Can_Network_Channel_CAN_Tx- as a Measurement parameter
          rba_ArxmlGen_MeasAddrMethodRef = INTERNAL_VAR_CLEARED
          rba_ArxmlGen_MeasApplDataTypeOwnRef = Com_applDataType_au8_Size8
        Com_dIP_TestECU_To_ApplicationECU_Can_Network_Channel_CAN_RxByte (rba_ArxmlGen_Measurement):
          rba_ArxmlGen_MeasCategory = Array
          rba_ArxmlGen_MeasDispFormat = %5.0f
          rba_ArxmlGen_MeasLongName = Rx Local Ipdu buffer of IPdu -IP_TestECU_To_ApplicationECU_Can_Network_Channel_CAN_Rx- as a Measurement parameter
          rba_ArxmlGen_MeasAddrMethodRef = INTERNAL_VAR_CLEARED
          rba_ArxmlGen_MeasApplDataTypeOwnRef = Com_applDataType_au8_Size8
        Com_MainFunctionRx_ComMainFunctionRx (rba_ArxmlGen_BswModuleEntry):
          rba_ArxmlGen_IsReentrant = false
          rba_ArxmlGen_IsSynchronus = true
          rba_ArxmlGen_BswCallType = SCHEDULED
          rba_ArxmlGen_BswExecutionContext = TASK
          rba_ArxmlGen_swServiceImplPolicy = STANDARD
        Com_MainFunctionTx_ComMainFunctionTx (rba_ArxmlGen_BswModuleEntry):
          rba_ArxmlGen_IsReentrant = false
          rba_ArxmlGen_IsSynchronus = true
          rba_ArxmlGen_BswCallType = SCHEDULED
          rba_ArxmlGen_BswExecutionContext = TASK
          rba_ArxmlGen_swServiceImplPolicy = STANDARD
        SE_MainFunctionRx_ComMainFunctionRx (rba_ArxmlGen_ExecEntity):
          rba_ArxmlGen_ExecEntityCategory = Schedulable
          rba_ArxmlGen_ExecEntityPeriod = 0.01
          rba_ArxmlGen_ExecEntityImplEntryRef = Com_MainFunctionRx_ComMainFunctionRx
        SE_MainFunctionTx_ComMainFunctionTx (rba_ArxmlGen_ExecEntity):
          rba_ArxmlGen_ExecEntityCategory = Schedulable
          rba_ArxmlGen_ExecEntityPeriod = 0.01
          rba_ArxmlGen_ExecEntityImplEntryRef = Com_MainFunctionTx_ComMainFunctionTx
        4 x rba_ArxmlGen_Memsection:
          CODE: rba_ArxmlGen_MemsectionAddrMethodRef=CODE
          CONST: rba_ArxmlGen_MemsectionDatatype_UNSPECIFIED=true, rba_ArxmlGen_MemsectionAddrMethodRef=CONST
          CONFIG_DATA: rba_ArxmlGen_MemsectionDatatype_64=true, rba_ArxmlGen_MemsectionDatatype_32=true, rba_ArxmlGen_MemsectionDatatype_16=true, rba_ArxmlGen_MemsectionDatatype_08=true, rba_ArxmlGen_MemsectionDatatype_UNSPECIFIED=true, rba_ArxmlGen_MemsectionAddrMethodRef=CONFIG_DATA
          VAR_CLEARED: rba_ArxmlGen_MemsectionDatatype_08=true, rba_ArxmlGen_MemsectionDatatype_16=true, rba_ArxmlGen_MemsectionDatatype_32=true, rba_ArxmlGen_MemsectionDatatype_64=true, rba_ArxmlGen_MemsectionDatatype_UNSPECIFIED=true, rba_ArxmlGen_MemsectionAddrMethodRef=VAR_CLEARED
