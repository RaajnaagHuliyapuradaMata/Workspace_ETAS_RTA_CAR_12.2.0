AUTOSAR XML (schema 00048)
package /RB/RBA/rba_McalSrv/EcucModuleDefs
  module definition rba_McalSrv [0..1]: category=VENDOR_SPECIFIC_MODULE_DEFINITION, variants pre-compile  # MCAL Services | Configuration of the MCAL module rba_McalSrv
    container rba_McalSrv_GeneralSettings  # General settings | General configuration
      enumeration rba_McalSrv_ArVersion [0..1]: {AR42_Rev2, AR45_Rev0, AR46_Rev0, AR47_Rev0, AR48_Rev0}, multiplicity set at pre-compile, origin=RB, set at pre-compile  # AR Version | Autosar version. Must be configured if no CUCEL package or CUCEL package without AR version information is in use.
      boolean rba_McalSrv_EnablePrototype [0..1]: multiplicity set at pre-compile, origin=RB, set at pre-compile, default-value=false  # EnablePrototype | By default all prototype SW will be disabled. In case prototype SW will be used, the SW is only for testing purposes – IT IS NOT RELEASED FOR PRODUCTION! To enable the prototype SW, following steps must be done: Configuration: - Enable the prototype by configuring EcuCRbEnablePrototype to TRUE - In case EcuCRbEnablePrototype is not present: Enable prototype by configuring rba_McalSrv_EnablePrototype to TRUE Coding: - Remove all prototype related #errors within the Mcal package
      boolean rba_McalSrv_EnableSystemCalls [0..1]: multiplicity set at pre-compile, origin=RB, set at pre-compile, default-value=false  # Enable System Calls | Enable/Disable system calls for supported components. See component specific documentation to see if it supports system calls.
      enumeration rba_McalSrv_Generation [0..1]: {MCAL_UNICON}, multiplicity set at pre-compile, origin=RB, set at pre-compile  # Generation | Configuration of Mcal generation
