AUTOSAR XML (schema 00050)
package /AUTOSAR_Rte/EcucModuleDefs
  module definition Rte [0..1]: category=VENDOR_SPECIFIC_MODULE_DEFINITION, post-build-variant-support=true, refined-module-def=Rte, variants post-build/pre-compile  # Configuration of the Rte (Runtime Environment) module.
    container CommonPublishedInformation [0..1]
      integer ArMajorVersion [0..1]: 0..1, origin=ETAS-RTA-RTE_v12.2.0, set at pre-compile  # AUTOSAR major version
      integer ArMinorVersion [0..1]: 0..1, origin=ETAS-RTA-RTE_v12.2.0, set at pre-compile  # AUTOSAR minor version
      integer ArPatchVersion [0..1]: 0..1, origin=ETAS-RTA-RTE_v12.2.0, set at pre-compile  # AUTOSAR patch version
      integer SwMajorVersion [0..1]: 0..1, origin=ETAS-RTA-RTE_v12.2.0, set at pre-compile  # Tool major version
      integer SwMinorVersion [0..1]: 0..1, origin=ETAS-RTA-RTE_v12.2.0, set at pre-compile  # Tool minor version
      integer SwPatchVersion [0..1]: 0..1, origin=ETAS-RTA-RTE_v12.2.0, set at pre-compile  # Tool patch version
    container RteBswGeneral  # General configuration parameters of the Bsw Scheduler section.
      boolean RteSchMVersionInfoApi: set at pre-compile, default-value=false  # Enables the generation of the SchM_GetVersionInfo() API.
      boolean RteUseComShadowSignalApi: origin=ETAS-RTA-RTE_v12.2.0, set at pre-compile, default-value=false  # This parameter defines whether the ComShadowSignalAPIs ((Com_UpdateShadowSignal, Com_InvalidateShadowSignal, Com_ReceiveShadowSignal) are used or not.
    container RteBswModuleInstance [0..*]  # Represents one instance of a Bsw-Module configured on one ECU.
      foreign reference RteBswImplementationRef: set at pre-compile, destination-type=BSW-IMPLEMENTATION  # Reference to the BswImplementation for which the Rte /SchM is configured.
      foreign reference RteBswModuleConfigurationRef [0..1]: multiplicity set at pre-compile, set at pre-compile, destination-type=ECUC-MODULE-CONFIGURATION-VALUES  # Reference to the ECU Configuration Values provided for this BswImplementation.
      container RteBswEventToIsrMapping [0..*]  # Maps a BswModuleEntity onto an OsIsr based on the activating BswExternalTriggerOccurredEvent or BswTimingEvent.
        integer RteBswPositionInIsr: 0..65535, set at pre-compile  # Each BswSchedulableEntity activation mapped to an OsIsr has a specific position within the ISR2 execution.
        foreign reference RteBswIsrEventRef: set at pre-compile, destination-type=BSW-EVENT  # Reference to the BswExternalTriggerOccurredEvent or BswTimingEvent.
        reference RteBswMappedToIsrRef: set at pre-compile, destination=OsIsr  # Reference to the OsISR the BswSchedulableEntity activated by the RteBswEventRef is mapped to.
        uri reference RteBswRipsFillRoutineRef [0..*]: multiplicity set at pre-compile, requires-index=true, set at pre-compile, destination-uri=RteRipsPluginFillFlushRoutine  # Reference to a Buffer-Fill Routine implemented by an RTE Implementation Plug-In. This routine gets invoked directly before the ExecutableEntity is started.
        uri reference RteBswRipsFlushRoutineRef [0..*]: multiplicity set at pre-compile, requires-index=true, set at pre-compile, destination-uri=RteRipsPluginFillFlushRoutine  # Reference to a Buffer-Flush Routine implemented by an RTE Implementation Plug-In. This routine gets invoked directly after the ExecutableEntity has terminated.
      container RteBswEventToTaskMapping [0..*]  # Maps a BswModuleEntity onto an OsTask based on the activating BswEvent. A BswModuleEntity can be activated by more than one BswEvent and thus be mapped to more than one OsTask. In the case of a BswSchedulableEntity executed via a direct or trusted function call this RteBswEventToTaskMapping is still specified but no RteBswMappedToTaskRef element is included. The RteBswPositionInTask parameter is necessary to provide an ordering of events invoked by the same RTE API.
        float RteBswActivationOffset [0..1]: 0..INF, multiplicity set at pre-compile, set at pre-compile  # Activation offset in seconds.
        float RteBswEventPeriod [0..1]: multiplicity set at pre-compile, set at pre-compile  # This parameter is used to override the value attribute "Period" on the associated BswTimingEvent.
        boolean RteBswImmediateRestart: set at pre-compile, default-value=false  # When RteBswImmediateRestart is set to true the BswSchedulableEntitiy shall be immediately re-started after termination if it was activated by this BswEvent while it was already started. | This parameter shall not be set to true when the mapped BswEvent refers to a BswSchedulableEntitiy which minimumStartInterval attribute is > 0.
        integer RteBswPositionInTask [0..1]: 0..65535, multiplicity set at pre-compile, set at pre-compile  # Each BswSchedulableEntity activation mapped to an OsTask has a specific position within the task execution. | For periodic activation this is the order of execution. For event driver activation this is the order of evaluation which actual BswSchedulableEntity has to be executed. In case of direct or trusted function calls this parameter is necessary to provide an ordering of events when several ExecutableEntities are invoked by the same RTE API.
        integer RteBswServerNumberOfRequestProcessing [0..1]: 1..65535, multiplicity set at pre-compile, set at pre-compile  # Specifies the maximum number of queued requests that can be handled within one OsTask execution.
        integer RteBswServerQueueLength [0..1]: 0..65535, multiplicity set at pre-compile, set at pre-compile  # Specifies the length of the queue for the server call serialization.
        enumeration RteOsSchedulePoint [0..1]: {CONDITIONAL, NONE, UNCONDITIONAL}, multiplicity set at pre-compile, set at pre-compile  # Introduce a schedule point by explicitly calling Os Schedule service after the execution of the ExecutableEntity. The Rte generator is allowed to optimize several consecutive calls to Os schedule into one single call if the ExecutableEntity executions in between have been skipped. | The absence of this parameter is interpreted as "NONE". It shall be considered an invalid configuration if the task is preemptable and the value of this parameter is not set to "NONE" or the parameter is absent.
        reference RteBswEventPredecessorSyncPointRef [0..1]: multiplicity set at pre-compile, set at pre-compile, destination=RteSyncPoint  # The RteBswEventPredecessorSyncPointRef is necessary to provide a cross core synchronization in case of BswEvents triggered by the same event source but mapped to tasks belonging to different partitions on different cores. | The synchronization point must be reached by all referencing BswEvents before the execution in all related tasks is continued. In case of RteBswEventPredecessorSyncPointRef the BswModuleEntity activated by the mapped BswEvent is executed after the synchronization point is passed.
        foreign reference RteBswEventRef [1..*]: set at pre-compile, destination-type=BSW-EVENT  # Reference to the BswEvent.
        reference RteBswEventSuccessorSyncPointRef [0..1]: multiplicity set at pre-compile, set at pre-compile, destination=RteSyncPoint  # The RteBswEventSuccessorSyncPointRef is necessary to provide a cross core synchronization in case of BswEvents triggered by the same event source but mapped to tasks belonging to different partitions on different cores. | The synchronization point must be reached by all referencing BswEvents before the execution in all related tasks is continued. In case of RteBswEventSuccessorSyncPointRef the BswModuleEntity activated by the mapped BswEvent is executed before the synchronization point is entered.
        reference RteBswMappedToTaskRef [0..1]: multiplicity set at pre-compile, set at pre-compile, destination=OsTask  # Reference to the OsTask the BswSchedulableEntity activated by the RteBswEventRef is mapped to. | If no reference to the OsTask is specified the BswSchedulableEntity activated by this BswEvent is executed in the context of the caller.
        reference RteBswUsedOsAlarmRef [0..1]: multiplicity set at pre-compile, set at pre-compile, destination=OsAlarm  # If an OsAlarm is used to activate the OsTask this BswEvent is mapped to it shall be referenced here.
        reference RteBswUsedOsEventRef [0..1]: multiplicity set at pre-compile, set at pre-compile, destination=OsEvent  # If an OsEvent is used to activate the OsTask this BswEvent is mapped to it shall be referenced here.
        reference RteBswUsedOsSchTblExpiryPointRef [0..1]: multiplicity set at pre-compile, set at pre-compile, destination=OsScheduleTableExpiryPoint  # If an OsScheduleTableExpiryPoint is used to activate the OsTask this BswEvent is mapped to it shall be referenced here.
        uri reference RteRipsFillRoutineRef [0..*]: multiplicity set at pre-compile, requires-index=true, set at pre-compile, destination-uri=RteRipsPluginFillFlushRoutine  # Reference to a Buffer-Fill Routine implemented by an RTE Implementation Plug-In. | This routine gets invoked directly before the ExecutableEntity is started.
        uri reference RteRipsFlushRoutineRef [0..*]: multiplicity set at pre-compile, requires-index=true, set at pre-compile, destination-uri=RteRipsPluginFillFlushRoutine  # Reference to a Buffer-Flush Routine implemented by an RTE Implementation Plug-In. | This routine gets invoked directly after the ExecutableEntity has terminated.
      container RteBswExclusiveAreaImpl [0..*]  # Represents one ExclusiveArea of one BswImplementation. Used to specify the implementation means of this ExclusiveArea.
        enumeration RteExclusiveAreaImplMechanism: {ALL_INTERRUPT_BLOCKING, NONE, OS_INTERRUPT_BLOCKING, OS_RESOURCE, OS_SPINLOCK, RTE_PLUGIN}, set at pre-compile  # To be used implementation mechanism for the specified ExclusiveArea.
        reference RteBswExclusiveAreaOsResourceRef [0..1]: multiplicity set at pre-compile, set at pre-compile, destination=OsResource  # Optional reference to an OsResource in case RteExclusiveAreaImplMechanism is configured to OS_RESOURCE for this ExclusiveArea.
        reference RteBswExclusiveAreaOsSpinlockRef [0..1]: multiplicity set at pre-compile, set at pre-compile, destination=OsSpinlock  # Optional reference to an OsSpinlock in case RteExclusiveAreaImplMechanism is configured to OS_SPINLOCK for this ExclusiveArea.
        foreign reference RteBswExclusiveAreaRef: set at pre-compile, destination-type=EXCLUSIVE-AREA  # Reference to the ExclusiveArea for which the implementation mechanism shall be specified.
        uri reference RteBswExclusiveAreaResponsibleRipsPluginRef [0..1]: multiplicity set at pre-compile, set at pre-compile, destination-uri=RteRipsPlugin  # Optional reference to the configuration container of the RTE Implementation Plug-in implementing the ExclusiveArea. | It's required in case RteExclusiveAreaImplMechanism is configured to RTE_PLUGIN for this ExclusiveArea.
      container RteBswExternalTriggerConfig [0..*]  # Defines the configuration of Inter Basic Software Module Entity Triggering
        integer RteBswTriggerSourceQueueLength: 0..4294967295, set at pre-compile, default-value=0  # Length of trigger queue on the trigger source side. | The queue is implemented by the RTE. A value greater or equal to 1 requests an queued behavior. Setting the value of RteTriggerSourceQueueLength to 0 requests an none queued implementation of the trigger communication. If there is no RteBswTriggerSourceQueueLength configured for a Trigger Emitter the default value of 0 applies as well.
        foreign reference RteBswTriggerSourceRef: set at pre-compile, destination-type=TRIGGER  # Reference to a Trigger instance in the role releasedTrigger of the related BSW Module instance. | The referenced Trigger has to belong to the same BSW Module instance as the RteBswModuleInstance owning this parameter configures.
      container RteBswInternalTriggerConfig [0..*]  # Defines the configuration of internal Basic Software Module Entity Triggering
        integer RteBswTriggerSourceQueueLength: 0..4294967295, set at pre-compile, default-value=0  # Length of trigger queue on the trigger source side. | The queue is implemented by the RTE. A value greater or equal to 1 requests an queued behavior. Setting the value of RteTriggerSourceQueueLength to 0 requests an none queued implementation of the trigger communication. If there is no RteBswTriggerSourceQueueLength configured for a Trigger Emitter the default value of 0 applies as well.
        foreign reference RteBswTriggerSourceRef: set at pre-compile, destination-type=BSW-INTERNAL-TRIGGERING-POINT  # Reference to a BswInternalTriggeringPoint of the related BSW Module instance. | The referenced BswInternalTriggeringPoint has to belong to the same BSW Module instance as the RteBswModuleInstance owning this parameter configures.
      container RteBswModeMachineInstanceConfig [0..*]  # Defines the configuration of Basic Software Scheduler assigned (SWS_Rte_07534) mode machine instances.
        integer RteBswModeMachineQueueLength: 0..4294967295, set at pre-compile, default-value=1  # Length of mode machine instance queue on the trigger source side. | If there is no RteBswModeMachineQueueLength configured for a mode machine instance the value given in the BswModeSenderPolicy.queueLength applies.
        foreign reference RteBswModeManagerRef: set at pre-compile, destination-type=MODE-DECLARATION-GROUP-PROTOTYPE  # Reference to a ModeDeclarationGroupPrototype of the related BSW Module instance. | The referenced ModeDeclarationGroupPrototype has to belong to the same BSW Module instance as the RteBswModuleInstance owning this parameter configures.
        uri reference RteModeMachineInstanceResponsibleRipsPluginRef [0..1]: multiplicity set at pre-compile, set at pre-compile, destination-uri=RteRipsPlugin  # Optional reference to the configuration container of the RTE Implementation Plug-in implementing the protection of the mode machine instance.
      container RteBswRequiredClientServerConnection [0..*]  # Defines the connection between one requiredClientServerEntry and one providedClientServerEntry of a BswModuleDescription. This container shall be provided on the client side of the connection.
        reference RteBswProvidedClientServerEntryModInstRef: set at pre-compile, destination=RteBswModuleInstance  # Reference to the RteBswModuleInstance configuration container which identifies the instance of the BSW Module. | Used with the RteBswProvidedClientServerEntryRef to unambiguously identify the BswModuleClientServerEntry instance.
        foreign reference RteBswProvidedClientServerEntryRef: set at pre-compile, destination-type=BSW-MODULE-CLIENT-SERVER-ENTRY  # Reference the providedClientServerEntry for this connection.
        foreign reference RteBswRequiredClientServerEntryRef: set at pre-compile, destination-type=BSW-MODULE-CLIENT-SERVER-ENTRY  # Reference the requiredClientServerEntry for this connection.
      container RteBswRequiredModeGroupConnection [0..*]  # Defines the connection between one requiredModeGroup of this BSW Module instance and one providedModeGroup instance.
        foreign reference RteBswProvidedModeGroupRef: set at pre-compile, destination-type=MODE-DECLARATION-GROUP-PROTOTYPE  # References the providedModeGroupPrototype to which this requiredModeGroup shall be connected.
        reference RteBswProvidedModeGrpModInstRef: set at pre-compile, destination=RteBswModuleInstance  # Reference to the RteBswModuleInstance configuration container which identifies the instance of the BSW Module. | Used with the RteBswProvidedModeGroupRef to unambiguously identify the ModeDeclarationGroupPrototype instance.
        foreign reference RteBswRequiredModeGroupRef: set at pre-compile, destination-type=MODE-DECLARATION-GROUP-PROTOTYPE  # References requiredModeGroupPrototype which shall be connected to the providedModeGroupPrototype.
        foreign reference RteModeDeclarationMappingSetRef [0..1]: multiplicity set at pre-compile, set at pre-compile, destination-type=MODE-DECLARATION-MAPPING-SET  # This defines the effective ModeDeclarationMappingSet in the case that the provided ModeDeclarationGroupPrototype and the required ModeDeclarationGroupPrototype are not compatible.
      container RteBswRequiredSenderReceiverConnection [0..*]  # Defines the connection between one requiredData and one providedData of a BswModuleDescription. This container shall be provided on the receiver side of the connection.
        reference RteBswProvidedDataModInstRef: set at pre-compile, destination=RteBswModuleInstance  # Reference to the RteBswModuleInstance configuration container which identifies the instance of the BSW Module. | Used with the RteBswProvidedVariableDataPrototypeRef to unambiguously identify the VariableDataPrototype instance.
        foreign reference RteBswProvidedVariableDataPrototypeRef: set at pre-compile, destination-type=VARIABLE-DATA-PROTOTYPE  # Reference the providedData for this connection.
        foreign reference RteBswRequiredVariableDataPrototypeRef: set at pre-compile, destination-type=VARIABLE-DATA-PROTOTYPE  # Reference the requiredData for this connection.
      container RteBswRequiredTriggerConnection [0..*]  # Defines the connection between one requiredTrigger of this BSW Module instance and one releasedTrigger instance.
        reference RteBswReleasedTriggerModInstRef: set at pre-compile, destination=RteBswModuleInstance  # Reference to the RteBswModuleInstance configuration container which identifies the instance of the BSW Module. | Used with the RteBswReleasedTriggerRef to unambiguously identify the Trigger instance.
        foreign reference RteBswReleasedTriggerRef: set at pre-compile, destination-type=TRIGGER  # References the releasedTrigger to which this requiredTrigger shall be connected.
        foreign reference RteBswRequiredTriggerRef: set at pre-compile, destination-type=TRIGGER  # References one requiredTrigger which shall be connected to the releasedTrigger.
    container RteComUser [0..*]: multiplicity set at pre-compile  # Defines a ComUser instance in the Rte. Tags: atp.Status=draft | One ComUser instance can either server for ComSignals and ComSignalGroups on multiple EcucPartitons or exactly one EcucPartiton. How many ComUser instances an Rte requires is vendor specific.
      reference RteComUserEcucPartitionRef [0..*]: scope=ECU, multiplicity set at post-build in variant post-build / pre-compile in variant pre-compile, post-build-variant-multiplicity=true, post-build-variant-value=true, set at link in variant post-build / pre-compile in variant pre-compile, destination=EcucPartition  # Reference(s) to the EcucPartitions for which this RteComUser instance is applicable. Tags: atp.Status=draft
      container ComUserModuleCnf [0..1]: destination-uri=ComUser, multiplicity set at pre-compile  # Contains the configuration parameters of the Com user module. Tags: atp.Status=draft
        string ComUserHeaderInclude [0..1]: set at pre-compile  # Defines the header file where the Com user provides the function declarations for configured callbacks. Tags: atp.Status=draft
        container ComUserCallback [0..*]: multiplicity set at link in variant post-build / pre-compile in variant pre-compile, post-build-variant-multiplicity=true  # This container defines a Com callback function for signals and signal groups. Tags: atp.Status=draft
          function name ComUserCallbackName: scope=ECU, multiplicity set at link in variant post-build / pre-compile in variant pre-compile, set at link in variant post-build / pre-compile in variant pre-compile  # The name of the callback function to be called. Tags: atp.Status=draft
          enumeration ComUserCallbackType: scope=ECU, multiplicity set at link in variant post-build / pre-compile in variant pre-compile, set at link in variant post-build / pre-compile in variant pre-compile  # The type of the Com callback Tags: atp.Status=draft
            COM_RX_ACK  # Tags: atp.Status=draft
            COM_RX_INV  # Tags: atp.Status=draft
            COM_RX_TOUT  # Tags: atp.Status=draft
            COM_TX_ACK  # Tags: atp.Status=draft
            COM_TX_ERR  # Tags: atp.Status=draft
            COM_TX_TOUT  # Tags: atp.Status=draft
        container ComUserSignal [0..*]: multiplicity set at post-build in variant post-build / pre-compile in variant pre-compile, post-build-variant-multiplicity=true  # Contains the configuration parameters of a signal inside a Com user module. Tags: atp.Status=draft | Please note that it is valid to define ComUserSignal without any callback function.
          integer ComUserCbkHandleId [0..1]: 0..65535, scope=ECU, multiplicity set at pre-compile, set at pre-compile, symbolic-name-value=true  # The numerical value used as the Com user callback handle Id. Tags: atp.Status=draft | This ID identifies signals and signal groups in the COM callbacks using ComUserCbkHandleId parameter respectively.
          reference ComUserCallbackRef [0..*]: scope=ECU, multiplicity set at post-build in variant post-build / pre-compile in variant pre-compile, post-build-variant-multiplicity=true, post-build-variant-value=true, set at link in variant post-build / pre-compile in variant pre-compile, destination=ComUserCallback  # Reference(s) to all callback(s) of this signal or signal group. Tags: atp.Status=draft
          foreign reference ComUserSystemTemplateSystemSignalRef [0..1]: scope=ECU, multiplicity set at post-build in variant post-build / pre-compile in variant pre-compile, post-build-variant-multiplicity=true, post-build-variant-value=true, set at post-build in variant post-build / pre-compile in variant pre-compile, destination-type=I-SIGNAL-TO-I-PDU-MAPPING  # Reference to the ISignalToIPduMapping that contains a reference to the ISignal (System Template) which this ComUserSignal (or ComUserGroupSignal) represents. Tags: atp.Status=draft
        container ComUserSignalGroup [0..*]: multiplicity set at post-build in variant post-build / pre-compile in variant pre-compile, post-build-variant-multiplicity=true  # Contains the configuration parameters of a signal group inside a Com user module. Tags: atp.Status=draft | Please note that it is valid to define ComUserSignalGroup without any callback function.
          integer ComUserCbkHandleId [0..1]: 0..65535, scope=ECU, multiplicity set at pre-compile, set at pre-compile, symbolic-name-value=true  # The numerical value used as the Com user callback handle Id. Tags: atp.Status=draft | This ID identifies signals and signal groups in the COM callbacks using ComUserCbkHandleId parameter respectively.
          reference ComUserCallbackRef [0..*]: scope=ECU, multiplicity set at post-build in variant post-build / pre-compile in variant pre-compile, post-build-variant-multiplicity=true, post-build-variant-value=true, set at link in variant post-build / pre-compile in variant pre-compile, destination=ComUserCallback  # Reference(s) to all callback(s) of this signal or signal group. Tags: atp.Status=draft
          foreign reference ComUserSystemTemplateSignalGroupRef [0..1]: scope=ECU, multiplicity set at post-build in variant post-build / pre-compile in variant pre-compile, post-build-variant-multiplicity=true, post-build-variant-value=true, set at post-build in variant post-build / pre-compile in variant pre-compile, destination-type=I-SIGNAL-TO-I-PDU-MAPPING  # Reference to the ISignalToIPduMapping that contains a reference to the ISignalGroup (SystemTemplate) which this ComUserSignalGroup represents. Tags: atp.Status=draft
    container RteDistributedSharedModeQueue [0..*]  # This container holds the configuration of a distributed shared mode queue.
      choice reference RteDSMQModeMachineInstanceRef [1..*]: multiplicity set at pre-compile, set at pre-compile, destination=[RteBswModeMachineInstanceConfig, RteModeMachineInstanceConfig]  # Reference to the mode machine instances which participate in this distributed shared mode queue.
      reference RteDSMQOsTaskRef [1..*]: multiplicity set at pre-compile, set at pre-compile, destination=OsTask  # Reference to the DSMQ transition OsTasks which are used to exclusively schedule on-entry ExecutableEntitys, on-transition ExecutableEntitys, on-exit ExecutableEntitys, and ModeSwitchAck ExecutableEntity activated by mode machine instances of this distributed shared mode queue.
      uri reference RteDSMQResponsibleRipsPluginRef [0..1]: multiplicity set at pre-compile, set at pre-compile, destination-uri=RteRipsPlugin  # Optional reference to the configuration container of the RTE Implementation Plug-in implementing the protection of all mode machine instances assigned to this distributed shared mode queue.
    container RteExclusiveAccessOptimization [0..*]  # Configuration of the optimized access behavior to be generated. In other words, access shall be mutually exclusive. How this is realized e.g. non preemptive task mapping, exclusive areas, mode management, exclusive access during ECU startup and shutdown or scheduling in exclusive time slots is up to the ECU integrator.
      foreign reference RteAccessingEntityRef [0..*]: destination-type=EXECUTABLE-ENTITY  # Reference to executable entities (e.g. NvM main function) that access the CommunicationGraph with non-modeled standardized interfaces.
      instance reference RteSoftwareComponentReadRef [0..1]: destination-context=ROOT-SW-COMPOSITION-PROTOTYPE SW-COMPONENT-PROTOTYPE, destination-type=VARIABLE-ACCESS  # Reference to the read variableAccess role.
      instance reference RteSoftwareComponentWriteRef [0..1]: destination-context=ROOT-SW-COMPOSITION-PROTOTYPE SW-COMPONENT-PROTOTYPE, destination-type=VARIABLE-ACCESS  # Reference to the VariableAccess in the dataSendPoint role of the writing software-component.
    container RteGeneration  # This container holds the parameters for the configuration of the RTE Generation.
      enumeration RteBypassSupport: {COMPONENT_WRAPPER, EXTENDED_BUFFER_ACCESS, NONE}, set at pre-compile, default-value=NONE  # General switch to enable and select the bypass support method.
      enumeration RteCalibrationSupport: {DOUBLE_POINTERED, INITIALIZED_RAM, NONE, SINGLE_POINTERED}, set at pre-compile, default-value=NONE  # The RTE generator shall have the option to switch off support for calibration for generated RTE code. This option shall influence complete RTE code at once.
      integer RteCodeVendorId: 0..65535, set at pre-compile, default-value=11  # Holds the vendor ID of the generated Rte code.
      boolean RteDevErrorDetect: set at pre-compile, default-value=false  # Switches the development error detection and notification on or off. | * true: detection and notification is enabled. * false: detection and notification is disabled.
      boolean RteDevErrorDetectUninit: set at pre-compile, default-value=false  # The Rte shall detect if it is started when its APIs are called, and the BSW Scheduler shall check if it is initialized when its APIs are called.
      enumeration RteGenerationMode: {COMPATIBILITY_MODE, VENDOR_MODE}, set at pre-compile, default-value=COMPATIBILITY_MODE  # Switch between the two available generation modes of the RTE generator.
      boolean RteInExclusiveAreaCheckEnabled: set at pre-compile, default-value=true  # Enables the check for RTE_E_IN_EXCLUSIVE_AREA (for blocking APIs).
      boolean RteMeasurementSupport: set at pre-compile, default-value=false  # The RTE generator shall have the option to switch off support for measurement for generated RTE code. This option shall influence complete RTE code at once.
      enumeration RteOptimizationMode: {MEMORY, RUNTIME}, set at pre-compile, default-value=RUNTIME  # Switch between the two available optimization modes of the RTE generator.
      integer RteToolChainSignificantCharacters [0..1]: 0..65535, multiplicity set at pre-compile, set at pre-compile, default-value=31  # If present, the RTE generator shall provide the list of C RTE identifiers whose name is not unique when only the first RteToolChainSignificantCharacters characters are considered.
      boolean RteValueRangeCheckEnabled: set at pre-compile, default-value=false  # If set to true the RTE generator shall enable the value range checking for the specified VariableDataPrototypes.
      boolean RteVfbTraceAnonymousClientEnabled: set at pre-compile, default-value=false  # The RTE generator shall globally enable VFB trace functions without client prefix when RteVfbTraceAnonymousClientEnabled is set to "true".
      boolean RteVfbTraceEnabled: set at pre-compile, default-value=false  # The RTE generator shall globally enable VFB tracing when RteVfbTrace is set to "true".
      container RteVfbTraceClient [0..*]: multiplicity set at pre-compile  # The RTE shall add the VFB Trace client with the ShortName of this container as the client's prefix.
        integer RteVfbTraceClientPosition [0..1]: 0..65535, multiplicity set at pre-compile, set at pre-compile  # Defines the position within all trace clients at which to call the trace functions of this trace client. The bigger the number the later the start trace functions and the sooner the stop trace functions will be called.
        function name RteVfbTraceFunction [0..*]: multiplicity set at pre-compile, set at pre-compile  # The RTE generator shall enable VFB tracing for a given hook function when its name starts with the string configured here. | Example: If Rte_Dbg_WriteHook_i2 is configured, Rte_Dbg_WriteHook_i1_p1_a_Start will be enabled.
        uri reference RteVfbTraceHooksRef [0..1]: multiplicity set at pre-compile, set at pre-compile, destination-uri=RteVfbTraceHooks  # Reference to the container in the VFB Trace client's configuration to which the RTE shall add the descriptions of the trace hooks created for this client.
      container RteForceBasicTask [0..*]  # Description of force-basic semantics for an OsTask.
        boolean OverrideValue: origin=ETAS-RTA-RTE_v12.2.0, set at pre-compile, default-value=false  # When true referenced task has force-basic semantics.
        reference TaskRef: origin=ETAS-RTA-RTE_v12.2.0, set at pre-compile, destination=OsTask  # A reference to the OsTask.
      container RteDsmq [0..1]  # Enable and configure the optional Distributed Shared Mode Queue.
        reference TaskRef [0..*]: origin=ETAS-RTA-RTE_v12.2.0, set at pre-compile, destination=OsTask  # A reference to an OsTask having ModeSwitchEvent runnables participating in the Distributed Shared Mode Queue.
      container RteFillFlushHookEnabledOSTasks [0..1]  # A list of OSTasks in which the Output Fill Flush OSTask Hooks are enabled.
        reference TaskRef [0..*]: origin=ETAS-RTA-RTE_v12.2.0, set at pre-compile, destination=OsTask  # A reference to an OsTask that may be configured to have (OsTask.ShortName)_TaskStartHook() and (OsTask.ShortName)_TaskEndHook() functions.
    container RteImplicitCommunication [0..*]  # Configuration of the Implicit Communication behavior to be generated.
      boolean RteCoherentAccess: set at pre-compile, default-value=false  # If set to true the referenced VariableAccess'es of this RteImplicitCommunication container are in one CoherencyGroup. | Data values for Coherent Implicit Read Access'es are read before the first reading RunnbaleEntity starts and are stable during the execution of all the reading RunnableEntitys; except Coherent Implicit Write Access'es belongs to the same Coherency Group. Data values written by Coherent Implicit Write Access'es are available for readers not belonging to the Coherency Group after the last writing RunnableEntity has terminated. Please note that a Coherent Implicit Data Access can be defined for VariableAccess'es to same and different data element. Nevertheless all Coherent Implicit Data Access'es of one Coherency Group have to be executed in the same task.
      boolean RteImmediateBufferUpdate: set at pre-compile, default-value=false  # If set to true the RTE will perform preemption area specific buffer update immediately before (for VariableAccess in the role dataReadAccess) resp. after (for VariableAccess in the role dataWriteAccess) Runnable execution.
      instance reference RteSoftwareComponentInstanceRef [1..*]: multiplicity set at pre-compile, set at pre-compile, destination-context=ROOT-SW-COMPOSITION-PROTOTYPE, destination-type=SW-COMPONENT-PROTOTYPE  # Reference to a SwComponentPrototype. | This denotes the instances of the VariableAccess belonging to the RteImplicitCommunication.
      foreign reference RteVariableReadAccessRef [0..*]: multiplicity set at pre-compile, set at pre-compile, destination-type=VARIABLE-ACCESS  # Reference to the VariableAccess in the dataReadAccess role.
      foreign reference RteVariableWriteAccessRef [0..*]: multiplicity set at pre-compile, set at pre-compile, destination-type=VARIABLE-ACCESS  # Reference to the VariableAccess in the dataWriteAccess role.
    container RteInitializationBehavior [1..*]  # Specifies the initialization strategy for variables allocated by RTE with the purpose to implement VariableDataPrototypes. | The container defines a set of RteSectionInitializationPolicys and one RteInitializationStrategy which is applicable for this set.
      enumeration RteInitializationStrategy: {RTE_INITIALIZATION_STRATEGY_AT_DATA_DECLARATION, RTE_INITIALIZATION_STRATEGY_AT_DATA_DECLARATION_AND_PARTITION_RESTART, RTE_INITIALIZATION_STRATEGY_AT_RTE_START_AND_PARTITION_RESTART, RTE_INITIALIZATION_STRATEGY_NONE}, set at pre-compile  # Definition of the initialization strategy applicable for the SectionInitializationPolicys selected by RteSectionInitializationPolicy.
      string RteSectionInitializationPolicy [1..*]: multiplicity set at pre-compile, set at pre-compile  # This parameter describes the SectionInitializationPolicys for which a particular RTE initialization strategy applies. | The SectionInitializationPolicy describes the intended initialization of MemorySections. The values are defined according to AUTOSAR Methodology defined "SectionInitializationPolicyType": * '''INIT''': To be used for data that are initialized by every reset to the specified value (initValue). * '''CLEARED''': To be used for data that are initialized by every reset to zero. * '''POWER-ON-CLEARED''': To be used for data that are initialized by "Power On" to zero. Note: there might be several resets between power on resets.
    container RteInitializationRunnableBatch [0..*]  # This container corresponds to an Rte_Init_<shortName of this container> function invoking the mapped RunnableEntities.
    container RteLdComUser [0..*]: multiplicity set at pre-compile  # Defines a LdComUser instance in the Rte. Tags: atp.Status=draft | One LdComUser instance can either server for LdComIPdu on multiple EcucPartitons or exactly one EcucPartiton. How many LdComUser instances an Rte requires is vendor specific.
      reference RteLdComUserEcucPartitionRef [0..*]: scope=ECU, multiplicity set at pre-compile, set at pre-compile, destination=EcucPartition  # Reference(s) to the EcucPartitions for which this RteLdComUser instance is applicable. Tags: atp.Status=draft
      container LdComUserModuleCnf [0..1]: destination-uri=LdComUser, multiplicity set at pre-compile  # Contains the configuration parameters of the LdCom user module. Tags: atp.Status=draft
        string LdComUserHeaderInclude [0..1]: multiplicity set at pre-compile, set at pre-compile  # Defines the header file where the LdLom user provides the function declarations for configured callbacks. Tags: atp.Status=draft
        container LdComUserCallback [0..*]: multiplicity set at link in variant post-build / pre-compile in variant pre-compile, post-build-variant-multiplicity=true  # This container defines a LdCom callback function for a LdComIPdu. Tags: atp.Status=draft
          function name LdComUserCallbackName: scope=ECU, multiplicity set at link in variant post-build / pre-compile in variant pre-compile, set at link in variant post-build / pre-compile in variant pre-compile  # The name of the callback function to be called. Tags: atp.Status=draft
          enumeration LdComUserCallbackType: scope=ECU, multiplicity set at link in variant post-build / pre-compile in variant pre-compile, set at link in variant post-build / pre-compile in variant pre-compile  # The type of the LdCom callback Tags: atp.Status=draft
            LDCOM_RX_INDICATION  # Tags: atp.Status=draft
            LDCOM_RX_START_OF_RECEPTION  # Tags: atp.Status=draft
            LDCOM_TP_COPY_RX_DATA  # Tags: atp.Status=draft
            LDCOM_TP_COPY_TX_DATA  # Tags: atp.Status=draft
            LDCOM_TP_RX_INDICATION  # Tags: atp.Status=draft
            LDCOM_TP_TX_CONFIRMATION  # Tags: atp.Status=draft
            LDCOM_TX_CONFIRMATION  # Tags: atp.Status=draft
            LDCOM_TX_TRIGGER_TRANSMIT  # Tags: atp.Status=draft
        container LdComUserIPdu [0..*]: multiplicity set at post-build in variant post-build / pre-compile in variant pre-compile, post-build-variant-multiplicity=true  # Contains the configuration parameters for the LdCom's signal (LdComIPdu) inside a LdCom user module. Tags: atp.Status=draft
          integer LdComUserCbkHandleId [0..1]: 0..65535, scope=ECU, set at pre-compile, symbolic-name-value=true  # The numerical value used as the LdCom user callback handle Id. Tags: atp.Status=draft | This is the ID used by LdCom to invoke callbacks of a LdCom user (Rte, ScCluC LdCom Low Proxy or CDDs) using LdComUserCbkHandleId parameter respectively. A corresponding symbolic name reference is created, which may be used for the invocations of the user.
          reference LdComUserCallbackRef [0..*]: scope=ECU, multiplicity set at post-build in variant post-build / pre-compile in variant pre-compile, post-build-variant-multiplicity=true, post-build-variant-value=true, set at link in variant post-build / pre-compile in variant pre-compile, destination=LdComUserCallback  # Reference(s) to all callback(s) of this LdComIPdu. Tags: atp.Status=draft
          foreign reference LdComUserSystemTemplateSignalRef: scope=ECU, multiplicity set at post-build in variant post-build / pre-compile in variant pre-compile, post-build-variant-multiplicity=true, post-build-variant-value=true, set at post-build in variant post-build / pre-compile in variant pre-compile, destination-type=I-SIGNAL-TO-I-PDU-MAPPING  # Reference to the ISignalToIPduMapping that contains a reference to the ISignal (System Template). Tags: atp.Status=draft
    container RteOsInteraction [1..*]  # Interaction of the Rte with the Os.
      container RteModeToScheduleTableMapping [0..*]  # Provides configuration input in which Modes of a ModeDeclarionGroupPrototype of a Mode Manager a OsScheudleTable shall be active. | The Mode Manager is either specified as a SwComponentPrototype (RteModeSchtblMapSwc) or as a BSW-Module (RteModeSchtblMapBsw).
        reference RteModeScheduleTableRef: set at pre-compile, destination=OsScheduleTable  # Reference to the OsScheduleTable which shall be active in the specified RteModeSchblMapModeDeclarationRefs.
        foreign reference RteModeSchtblMapModeDeclarationRef [1..*]: multiplicity set at pre-compile, set at pre-compile, destination-type=MODE-DECLARATION  # Reference to the ModeDeclarations.
        container RteModeSchtblMapBsw [0..1]  # Specifies an instance of a ModeDeclarationGroupPrototype of a Bsw-Module.
          reference RteModeSchtblMapBswInstanceRef: set at pre-compile, destination=RteBswModuleInstance  # Reference to an instance specification of a Bsw-Module.
          foreign reference RteModeSchtblMapBswProvidedModeGroupRef: set at pre-compile, destination-type=MODE-DECLARATION-GROUP-PROTOTYPE  # Reference to an instance of a ModeDeclarationGroupPrototype of a Bsw-Module.
        container RteModeSchtblMapSwc [0..1]  # Specifies an instance of a ModeDeclarationGroupPrototype of a SwComponentPrototype.
          reference RteModeSchtblMapSwcInstanceRef: set at pre-compile, destination=RteSwComponentInstance  # Reference to an instance specification of a SwComponentPrototype.
          foreign reference RteModeSchtblMapSwcPortRef: set at pre-compile, destination-type=ABSTRACT-PROVIDED-PORT-PROTOTYPE  # Reference to the PPortPrototype of a SwComponentPrototype.
      container RteOsTaskChain [0..*]  # This container holds the configuration of one task chain configuration.
        reference RtePredecessorOsTaskRef: scope=ECU, set at pre-compile, destination=OsTask  # OsTask which shall chain another OsTask when it terminates.
        reference RteSuccessorOsTaskRef: scope=ECU, set at pre-compile, destination=OsTask  # OsTask which shall be chained from the predecessor OsTask.
      container RteSyncPoint [0..*]  # The RteSyncPoint is necessary to provide an cross core synchronization in case of RteEvents triggered by the same event source but mapped to tasks belonging to different partitions on different cores. | The synchronization point must be reached by all referencing RteEvents before the execution in all related tasks is continued. In case of Rte(Bsw)EventSuccessorSyncPointRef the ExecutableEntity activated by the mapped event is executed before the synchronization point is entered. In case of Rte(Bsw)EventPredecessorSyncPointRef the ExecutableEntity activated by the mapped event is executed after the synchronization point is passed.
      container RteUsedOsActivation [0..*]  # Attributes used in the activation of OsTasks and Runnable Entities.
        float RteExpectedActivationOffset: 0..INF, set at pre-compile  # Activation offset in seconds. | Important: This is a requirement from the Rte towards the Os/Mcu setup. The Rte Generator shall assume this activation offset to be fulfilled.
        float RteExpectedTickDuration: 0..INF, set at pre-compile  # The expected tick duration in seconds which shall be configured to drive the OsScheduleTables or OsAlarm. | Important: This is a requirement from the Rte towards the Os/Mcu setup. The Rte Generator shall assume this tick duration to be fulfilled.
        reference RteActivationOsAlarmRef [0..1]: multiplicity set at pre-compile, set at pre-compile, destination=OsAlarm  # Reference to an OsAlarm.
        reference RteActivationOsSchTblRef [0..1]: multiplicity set at pre-compile, set at pre-compile, destination=OsScheduleTable  # Reference to an OsScheduleTable.
        reference RteActivationOsTaskRef [0..1]: multiplicity set at pre-compile, set at pre-compile, destination=OsTask  # Reference to an OsTask.
    container RteRips [0..1]: multiplicity set at pre-compile  # This container provides the configuration of the Rte Implementation Plug-In support by RTE. | If the container is NOT defined, the support for Rte Implementation Plug-Ins (RIPS) is globally disabled.
      enumeration RteRipsSupport: {RTE_RIPS_OFF, RTE_RIPS_ON}, set at pre-compile, default-value=RTE_RIPS_OFF  # Globally enables or disables the support for Rte Implementation Plug-Ins (RIPS)
      uri reference RteRipsPluginConfigurationRef [0..*]: multiplicity set at pre-compile, requires-index=true, set at pre-compile, destination-uri=RteRipsPlugin  # Reference to the configuration container of the RTE Implementation Plug-in holding the RTE relevant settings. | All referenced RTE Implementation Plug-ins are considered for the RTE generation.
    container RteSwComponentInstance [0..*]  # Representation of one SwComponentPrototype located on the to be configured ECU. All subcontainer configuration aspects are in relation to this SwComponentPrototype. | The RteSwComponentInstance can be associated with either a AtomicSwComponentType or ParameterSwComponentType.
      foreign reference RteSoftwareComponentInstanceRef [0..1]: multiplicity set at pre-compile, set at pre-compile, destination-type=SW-COMPONENT-PROTOTYPE  # Reference to a SwComponentPrototype.
      container RteEventToIsrMapping [0..*]  # Maps a RunnableEntity onto one OsIsr based on the activating ExternalTriggerOccurredEvent or TimingEvent.
        integer RtePositionInIsr: 0..65535, set at pre-compile  # Each RunnableEntity mapped to an OsIsr has a specific position within the ISR2 execution. For event driven activation this is the order of evaluation which actual RunnableEntity has to be executed.
        foreign reference RteIsrEventRef: set at pre-compile, destination-type=RTE-EVENT  # Reference to the description of the ExternalTriggerOccurredEvent or TimingEvent which is pointing to the RunnableEntity being mapped. This allows a fine grained mapping of RunnableEntites based on the activating RTEEvent.
        reference RteMappedToIsrRef: set at pre-compile, destination=OsIsr  # Reference to the OsISR the RunnableEntity activated by the RteEventRef is mapped to.
        uri reference RteRipsFillRoutineRef [0..*]: multiplicity set at pre-compile, requires-index=true, set at pre-compile, destination-uri=RteRipsPluginFillFlushRoutine  # Reference to a Buffer-Fill Routine implemented by an RTE Implementation Plug-In. This routine gets invoked directly before the ExecutableEntity is started.
        uri reference RteRipsFlushRoutineRef [0..*]: multiplicity set at pre-compile, requires-index=true, set at pre-compile, destination-uri=RteRipsPluginFillFlushRoutine  # Reference to a Buffer-Flush Routine implemented by an RTE Implementation Plug-In. This routine gets invoked directly after the ExecutableEntity has terminated.
      container RteEventToTaskMapping [0..*]  # Maps an instance of a RunnableEntity onto one OsTask based on the activating RTEEvent. | In the case of a RunnableEntity executed via a direct or trusted function call this RteEventToTaskMapping is still specified but no RteMappedToTask element is included. The RtePositionInTask parameter is necessary to provide an ordering of events invoked by the same RTE API.
        float RteActivationOffset [0..1]: 0..INF, multiplicity set at pre-compile, set at pre-compile  # Activation offset in seconds.
        boolean RteImmediateRestart: set at pre-compile, default-value=false  # When RteImmediateRestart is set to true the RunnableEntitiy shall be immediately re-started after termination if it was activated by this RTEEvent while it was already started. | This parameter shall not be set to true when the mapped RTEEvent refers to a RunnableEntity which minimumStartInterval attribute is > 0.
        enumeration RteOsSchedulePoint [0..1]: {CONDITIONAL, NONE, UNCONDITIONAL}, multiplicity set at pre-compile, set at pre-compile  # Introduce a schedule point by explicitly calling Os Schedule service after the execution of the ExecutableEntity. The Rte generator is allowed to optimize several consecutive calls to Os schedule into one single call if the ExecutableEntity executions in between have been skipped. | The absence of this parameter is interpreted as "NONE". It shall be considered an invalid configuration if the task is preemptable and the value of this parameter is not set to "NONE" or the parameter is absent.
        integer RtePositionInTask [0..1]: 0..65535, multiplicity set at pre-compile, set at pre-compile  # Each RunnableEntity mapped to an OsTask has a specific position within the task execution. | For periodic activation this is the order of execution. For event driver activation this is the order of evaluation which actual RunnableEntity has to be executed. In case of direct or trusted function calls this parameter is necessary to provide an ordering of events when several ExecutableEntities are invoked by the same RTE API.
        integer RteServerNumberOfRequestProcessing [0..1]: 1..65535, multiplicity set at pre-compile, set at pre-compile  # Specifies the maximum number of queued requests that can be handled within one OsTask execution.
        integer RteServerQueueLength [0..1]: 0..65535, multiplicity set at pre-compile, set at pre-compile  # Specifies the length of the queue for the server call serialization. This value overwrites the queueLength specified at the ServerComSpec.
        reference RteEventPredecessorSyncPointRef [0..1]: multiplicity set at pre-compile, set at pre-compile, destination=RteSyncPoint  # The RteEventPredecessorSyncPointRef is necessary to provide a cross core synchronization in case of RteEvents triggered by the same event source but mapped to tasks belonging to different partitions on different cores. | The synchronization point must be reached by all referencing RteEvents before the execution in all related tasks is continued. In case of RteEventPredecessorSyncPointRef the RunnableEntity activated by the mapped RteEvent is executed after the synchronization point is passed.
        foreign reference RteEventRef [1..*]: set at pre-compile, destination-type=RTE-EVENT  # Reference to the description of the RTEEvent which is pointing to the RunnableEntity being mapped. This allows a fine grained mapping of RunnableEntites based on the activating RTEEvent.
        reference RteEventSuccessorSyncPointRef [0..1]: multiplicity set at pre-compile, set at pre-compile, destination=RteSyncPoint  # The RteEventSuccessorSyncPointRef is necessary to provide a cross core synchronization in case of RteEvents triggered by the same event source but mapped to tasks belonging to different partitions on different cores. | The synchronization point must be reached by all referencing RteEvents before the execution in all related tasks is continued. In case of RteEventSuccessorSyncPointRef the RunnableEntity activated by the mapped RteEvent is executed before the synchronization point is entered.
        reference RteMappedToTaskRef [0..1]: multiplicity set at pre-compile, set at pre-compile, destination=OsTask  # Reference to the OsTask the RunnableEntity activated by the RteEventRef is mapped to. | If no reference to the OsTask is specified the RunnableEntity shall be executed via a direct or trusted function call. The fact that no reference to an OsTask is specified for a RunnableEntity does not necessarily imply that every RTE generator has to support the implementation of this RunnableEntity as a direct or trusted function call. The standard set of use cases for direct or trusted function calls that has to be supported by every RTE generator is explicitly stated as requirements in this document. For further optimization RTE vendors are free to support additional scenarios of direct or trusted function call implementations that are not explicitly required in this document.
        uri reference RteRipsFillRoutineRef [0..*]: multiplicity set at pre-compile, requires-index=true, set at pre-compile, destination-uri=RteRipsPluginFillFlushRoutine  # Reference to a Buffer-Fill Routine implemented by an RTE Implementation Plug-In. | This routine gets invoked directly before the ExecutableEntity is started.
        uri reference RteRipsFlushRoutineRef [0..*]: multiplicity set at pre-compile, requires-index=true, set at pre-compile, destination-uri=RteRipsPluginFillFlushRoutine  # Reference to a Buffer-Flush Routine implemented by an RTE Implementation Plug-In. | This routine gets invoked directly after the ExecutableEntity has terminated.
        uri reference RteRipsInvocationHandlerRef [0..1]: multiplicity set at pre-compile, set at pre-compile, destination-uri=RteRipsInvocationHandler  # Reference to a Buffer-Fill Routine implemented by an RTE Implementation Plug-In. | This routine gets invoked directly before the ExecutableEntity is started.
        reference RteUsedInitFnc [0..1]: multiplicity set at pre-compile, set at pre-compile, destination=RteInitializationRunnableBatch  # The RunnableEntity is executed during initialization in the context of the Rte_Init_<InitContainer> function.
        reference RteUsedOsAlarmRef [0..1]: multiplicity set at pre-compile, set at pre-compile, destination=OsAlarm  # If an OsAlarm is used to activate the OsTask this RteEvent is mapped to it shall be referenced here.
        reference RteUsedOsEventRef [0..1]: multiplicity set at pre-compile, set at pre-compile, destination=OsEvent  # If an OsEvent is used to activate the OsTask this RteEvent is mapped to it shall be referenced here.
        reference RteUsedOsSchTblExpiryPointRef [0..1]: multiplicity set at pre-compile, set at pre-compile, destination=OsScheduleTableExpiryPoint  # If an OsScheduleTableExpiryPoint is used to activate the OsTask this RteEvent is mapped to it shall be referenced here.
        reference RteVirtuallyMappedToTaskRef [0..1]: multiplicity set at pre-compile, set at pre-compile, destination=OsTask  # Optional reference to an OsTask where the activation of this RteEvent shall be evaluated. The actual execution of the Runnable Entity shall happen in the OsTask referenced by RteMappedToTaskRef.
      container RteExclusiveAreaImplementation [0..*]  # Specifies the implementation to be used for the data consistency of this ExclusiveArea.
        enumeration RteExclusiveAreaImplMechanism: {ALL_INTERRUPT_BLOCKING, NONE, OS_INTERRUPT_BLOCKING, OS_RESOURCE, OS_SPINLOCK, RTE_PLUGIN}, set at pre-compile  # To be used implementation mechanism for the specified ExclusiveArea.
        reference RteExclusiveAreaOsResourceRef [0..1]: multiplicity set at pre-compile, set at pre-compile, destination=OsResource  # Optional reference to an OsResource in case RteExclusiveAreaImplMechanism is configured to OS_RESOURCE for this ExclusiveArea.
        reference RteExclusiveAreaOsSpinlockRef [0..1]: origin=ETAS-RTA-RTE_v12.2.0, set at pre-compile, destination=OsSpinlock  # Optional reference to an OsSpinlock in case RteExclusiveAreaImplMechanism is configured to OS_SPINLOCK for this ExclusiveArea.
        foreign reference RteExclusiveAreaRef: set at pre-compile, destination-type=EXCLUSIVE-AREA  # Reference to the ExclusiveArea.
        uri reference RteExclusiveAreaResponsibleRipsPluginRef [0..1]: multiplicity set at pre-compile, set at pre-compile, destination-uri=RteRipsPlugin  # Optional reference to the configuration container of the RTE Implementation Plug-in implementing the ExclusiveArea. | It's required in case RteExclusiveAreaImplMechanism is configured to RTE_PLUGIN for this ExclusiveArea.
      container RteExternalTriggerConfig [0..*]  # Defines the configuration of External Trigger Event Communication for Software Components
        integer RteTriggerSourceQueueLength: 0..4294967295, set at pre-compile, default-value=0  # Length of trigger queue on the trigger source side. | The queue is implemented by the RTE. A value greater or equal to 1 requests an queued behavior. Setting the value of RteTriggerSourceQueueLength to 0 requests an none queued implementation of the trigger communication. If there is no RteTriggerSourceQueueLength configured for a Trigger Emitter the default value of 0 applies as well.
        instance reference RteSwcTriggerSourceRef: set at pre-compile, destination-context=ABSTRACT-PROVIDED-PORT-PROTOTYPE, destination-type=TRIGGER  # Reference to a Trigger instance in the pPortPrototype of the related component instance. | The referenced Trigger instance has to belong to the same software component instance as the RteSwComponentInstance owning this parameter configures.
      container RteInternalTriggerConfig [0..*]  # Defines the configuration of Inter Runnable Triggering for Software Components
        integer RteTriggerSourceQueueLength: 0..4294967295, set at pre-compile, default-value=0  # Length of trigger queue on the trigger source side. | The queue is implemented by the RTE. A value greater or equal to 1 requests an queued behavior. Setting the value of RteTriggerSourceQueueLength to 0 requests an none queued implementation of the trigger communication. If there is no RteTriggerSourceQueueLength configured for a Trigger Emitter the default value of 0 applies as well.
        foreign reference RteSwcTriggerSourceRef: set at pre-compile, destination-type=INTERNAL-TRIGGERING-POINT  # Reference to an InternalTriggeringPoint of the related component instance. | The referenced InternalTriggeringPoint has to belong to the same software component instance as the RteSwComponentInstance owning this parameter configures.
      container RteModeMachineInstanceConfig [0..*]  # Defines the configuration of RTE assigned (SWS_Rte_07533) mode machine instances.
        integer RteModeMachineQueueLength: 0..4294967295, set at pre-compile, default-value=1  # Length of mode machine instance queue on the trigger source side. | If there is no RteModeMachineQueueLength configured for a mode machine instance the value given in the ModeSwitchSenderComSpec.queueLength applies.
        uri reference RteModeMachineInstanceResponsibleRipsPluginRef [0..1]: multiplicity set at pre-compile, set at pre-compile, destination-uri=RteRipsPlugin  # Optional reference to the configuration container of the RTE Implementation Plug-in implementing the protection of the mode machine instance.
        instance reference RteSwcModeManagerRef: set at pre-compile, destination-context=ABSTRACT-PROVIDED-PORT-PROTOTYPE, destination-type=MODE-DECLARATION-GROUP-PROTOTYPE  # Reference to a ModeDeclarationGroupPrototype instance in the provided PortPrototype (AbstractProvidedPortPrototype) of the related component instance. | The referenced ModeDeclarationGroupPrototype instance has to belong to the same software component instance as the RteSwComponentInstance owning this parameter configures.
      container RteNvRamAllocation [0..*]  # Specifies the relationship between the AtomicSwComponentType's NVRAMMapping / NVRAM needs and the NvM module configuration.
        linker symbol RteNvmRamBlockLocationSymbol [0..1]: multiplicity set at pre-compile, set at pre-compile  # This is the name of the linker object name where the NVRam Block will be mirrored by the Nvm. | This symbol will be resolved into the parameter "NvmRamBlockDataAddress" from the "NvmBlockDescriptor".
        linker symbol RteNvmRomBlockLocationSymbol [0..1]: multiplicity set at pre-compile, set at pre-compile  # This is the name of the linker object name where the NVRom Block will be accessed by the Nvm. | This symbol will be resolved into the parameter "NvmRomBlockDataAddress" from the "NvmBlockDescriptor".
        reference RteNvmBlockRef: set at pre-compile, requires-symbolic-name-value=true, destination=NvMBlockDescriptor  # Reference to the used NvM block for storage of the NVRAMMapping information.
        foreign reference RteSwNvBlockDescriptorRef [0..1]: multiplicity set at pre-compile, set at pre-compile, destination-type=NV-BLOCK-DESCRIPTOR  # Reference to the NvBlockDescriptor in case the RTE needs to call the NvM directly (e.g. for the supportDirtyFlag feature, storeCyclic feature, server invocation for NV data management or mode switch based invocation NvM services).
        foreign reference RteSwNvRamMappingRef [0..1]: multiplicity set at pre-compile, set at pre-compile, destination-type=SWC-SERVICE-DEPENDENCY  # Reference to the SwSeriveDependency which is used to specify the NvBlockNeeds.
    container RteSwComponentType [0..*]  # Representation of one SwComponentType for the base of all configuration parameter which are affecting the whole type and not a specific instance.
      boolean RteBypassSupportEnabled [0..1]: multiplicity set at pre-compile, set at pre-compile, default-value=false  # Individual switch to enable the bypass support for this software component type.
      foreign reference RteComponentTypeRef: set at pre-compile, destination-type=SW-COMPONENT-TYPE  # Reference to either AtomicSwComponentType or ParameterSwComponentType.
      foreign reference RteImplementationRef [0..1]: multiplicity set at pre-compile, set at pre-compile, destination-type=SWC-IMPLEMENTATION  # The Implementation which shall be assigned to the SwComponentType.
      container RteComponentTypeCalibration [0..1]  # Specifies for each ParameterSwComponentType or AtomicSwComponentType whether calibration is enabled. | If references to SwAddrMethod are provided in RteCalibrationSwAddrMethodRef only ParameterDataPrototypes with the referenced SwAddrMethod shall have software calibration support enabled.
        boolean RteCalibrationSupportEnabled: set at pre-compile  # Enables calibration support for the specified ParameterSwComponentType or AtomicSwComponentType.
        foreign reference RteCalibrationSwAddrMethodRef [0..*]: multiplicity set at pre-compile, set at pre-compile, destination-type=SW-ADDR-METHOD  # Reference to the SwAddrMethod for which software calibration support shall be enabled.
      container RteComponentTypeParameterGroup [0..*]  # Specifies the sequence order of ParameterDataPrototypes in a ParameterElementGroup for a given SwAddrMethod.
        foreign reference RteParameterGroupSwAddrMethodRef [0..*]: multiplicity set at pre-compile, set at pre-compile, destination-type=SW-ADDR-METHOD  # Reference to the SwAddrMethod for which the ParameterElementGroup shall be associated.
        container RteParameterToGroupMapping [1..*]  # Maps ParameterDataPrototypes into one group. The RtePositionInGroup parameter is used to provide an ordering of ParameterDataPrototypes inside the group.
          integer RtePositionInGroup [0..1]: 0..65535, multiplicity set at pre-compile, set at pre-compile  # Provides the position in the group for a given ParameterDataPrototype.
          foreign reference RteParameterRef [0..1]: multiplicity set at pre-compile, set at pre-compile, destination-type=PARAMETER-DATA-PROTOTYPE  # Reference to the ParameterDataPrototype which is being mapped to the group.
