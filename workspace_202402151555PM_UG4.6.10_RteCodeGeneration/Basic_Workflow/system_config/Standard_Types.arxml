AUTOSAR XML (schema 4-2-2)
standard types defined: Std_ReturnType
package /AUTOSAR_Std/ImplementationDataTypes  # AUTOSAR Standard types
  6 x impl type, all with type-emitter=HEADER_FILE:
    Std_VersionInfoType: category=STRUCTURE  # Standard Version Info Type | This type shall be used to request the version of a BSW module using the <Module name>_GetVersionInfo()function.
      5 x element, all with category=TYPE_REFERENCE:
        vendorID: implementation-data-type=uint16
        moduleID: implementation-data-type=uint16
        sw_major_version: implementation-data-type=uint8
        sw_minor_version: implementation-data-type=uint8
        sw_patch_version: implementation-data-type=uint8
    Std_TransformerErrorCode: implementation-data-type=uint8  # Transformer error Code | The values are specified for each transformer class in ASWS_TransformerGeneral.
    Std_TransformerClass: compu {0=STD_TRANSFORMER_UNSPECIFIED (Transformer of a unspecified transformer class.), 1=STD_TRANSFORMER_SERIALIZER (Transformer of a serializer class.), 2=STD_TRANSFORMER_SAFETY (Transformer of a safety class.), 3=STD_TRANSFORMER_SECURITY (Transformer of a security class.), 255=STD_TRANSFORMER_CUSTOM (Transformer of a custom class not standardized by AUTOSAR.)}, implementation-data-type=uint8  # Transformer Error | The Std_TransformerClass represents the transformer class in which the error occurred.
    Std_TransformerError: category=STRUCTURE  # Transformer error | The structure contains the error code and the transformer class to which the error belongs.
      element errorCode: implementation-data-type=Std_TransformerErrorCode  # The specific meaning of the values is to be seen for the specific transformer chain for which the data type represents the transformer error.
      element transformerClass: implementation-data-type=Std_TransformerClass  # Represents the transformer class in which the error occurred.
    Std_MessageTypeType: compu {0=STD_MESSAGETYPE_REQUEST (Message type for a request message.), 1=STD_MESSAGETYPE_RESPONSE (Message type for a response message.)}, implementation-data-type=uint8  # Message Type | This type is used to encode the different type of messages.
    Std_MessageResultType: compu {0=STD_MESSAGERESULT_OK (Message result for an OK response.), 1=STD_MESSAGERESULT_ERROR (Message result for an ERROR response.)}, implementation-data-type=uint8  # Message ResultType | This type is used to encode different types of results for response messages.
package /AUTOSAR_Std/CompuMethods
  compu method Std_High_Low: 0=STD_LOW (no error occurred), 1=STD_HIGH (generic indication that an error occurred)
  compu method Std_Active_Idle: 0=STD_IDLE (no error occurred), 1=STD_ACTIVE (generic indication that an error occurred)
  compu method Std_On_Off: 0=STD_OFF (no error occurred), 1=STD_ON (generic indication that an error occurred)
