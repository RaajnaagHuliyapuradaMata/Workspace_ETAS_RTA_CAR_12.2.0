AUTOSAR XML (schema 00051)
package /RTE
  module config Rte
    RteBswGeneral: RteSchMVersionInfoApi=0, RteUseComShadowSignalApi=0
    RteGeneration:
      RteBypassSupport = NONE
      RteCalibrationSupport = NONE
      RteCodeVendorId = 11
      RteDevErrorDetect = 0
      RteDevErrorDetectUninit = 0
      RteGenerationMode = COMPATIBILITY_MODE
      RteInExclusiveAreaCheckEnabled = 1
      RteMeasurementSupport = 0
      RteOptimizationMode = RUNTIME
      RteValueRangeCheckEnabled = 0
      RteVfbTraceAnonymousClientEnabled = 0
      RteVfbTraceEnabled = 0
    NoneSectionPolicies (RteInitializationBehavior): RteInitializationStrategy=RTE_INITIALIZATION_STRATEGY_NONE, RteSectionInitializationPolicy=NO-INIT
    RteOsInteraction
    DataDeclarationSectionPolicies (RteInitializationBehavior):
      RteInitializationStrategy = RTE_INITIALIZATION_STRATEGY_AT_DATA_DECLARATION
      RteSectionInitializationPolicy = INIT
      RteSectionInitializationPolicy = CLEARED
    RteStartSectionPolicies (RteInitializationBehavior):
      RteInitializationStrategy = RTE_INITIALIZATION_STRATEGY_AT_RTE_START_AND_PARTITION_RESTART
      RteSectionInitializationPolicy = POWER-ON-INIT
      RteSectionInitializationPolicy = POWER-ON-CLEARED
    CPT_MySWC_ApplicationECU (RteSwComponentInstance): RteSoftwareComponentInstanceRef=CPT_MySWC_ApplicationECU
      TimingEvent_0 (RteEventToTaskMapping): RtePositionInTask=1, RteImmediateRestart=0, RteActivationOffset=0.0, RteMappedToTaskRef=OsTask_ASW, RteEventRef=TimingEvent_0
    9 x RteBswModuleInstance:
      BSWIMPL_Can: RteBswImplementationRef=BSWIMPL_Can
        4 x RteBswEventToTaskMapping, all with RteImmediateRestart=0, RteBswActivationOffset=0.0, RteBswMappedToTaskRef=OsTask_BSW:
          BSWTE_MainFunction_Write: RteBswPositionInTask=10, RteBswEventRef=BSWTE_MainFunction_Write
          BSWTE_MainFunction_BusOff: RteBswPositionInTask=9, RteBswEventRef=BSWTE_MainFunction_BusOff
          BSWTE_MainFunction_Read: RteBswPositionInTask=8, RteBswEventRef=BSWTE_MainFunction_Read
          BSWTE_MainFunction_Mode: RteBswPositionInTask=7, RteBswEventRef=BSWTE_MainFunction_Mode
      CanSM: RteBswImplementationRef=CanSM
        EV_SE_MainFunction (RteBswEventToTaskMapping): RteBswPositionInTask=6, RteImmediateRestart=0, RteBswActivationOffset=0.0, RteBswMappedToTaskRef=OsTask_BSW, RteBswEventRef=EV_SE_MainFunction
      ComM: RteBswImplementationRef=ComM
        EV_SE_MainFunction_Can_Network_Channel_Can_Network (RteBswEventToTaskMapping):
          RteBswPositionInTask = 5
          RteImmediateRestart = 0
          RteBswActivationOffset = 0.0
          RteBswMappedToTaskRef = OsTask_BSW
          RteBswEventRef = EV_SE_MainFunction_Can_Network_Channel_Can_Network
      Com: RteBswImplementationRef=Com
        EV_SE_MainFunctionTx_ComMainFunctionTx (RteBswEventToTaskMapping):
          RteBswPositionInTask = 4
          RteImmediateRestart = 0
          RteBswActivationOffset = 0.0
          RteBswMappedToTaskRef = OsTask_BSW
          RteBswEventRef = EV_SE_MainFunctionTx_ComMainFunctionTx
        EV_SE_MainFunctionRx_ComMainFunctionRx (RteBswEventToTaskMapping):
          RteBswPositionInTask = 3
          RteImmediateRestart = 0
          RteBswActivationOffset = 0.0
          RteBswMappedToTaskRef = OsTask_BSW
          RteBswEventRef = EV_SE_MainFunctionRx_ComMainFunctionRx
      EcuM: RteBswImplementationRef=EcuM
        TE_EcuM_MainFunction (RteBswEventToTaskMapping): RteBswPositionInTask=2, RteImmediateRestart=0, RteBswActivationOffset=0.0, RteBswMappedToTaskRef=OsTask_BSW, RteBswEventRef=TE_EcuM_MainFunction
      BSWIMPL_BswM: RteBswImplementationRef=BSWIMPL_BswM
        5 x RteBswEventToTaskMapping:
          TE_BswM_MainFunction: RteBswPositionInTask=1, RteImmediateRestart=0, RteBswActivationOffset=0.0, RteBswMappedToTaskRef=OsTask_BSW, RteBswEventRef=TE_BswM_MainFunction
          MSE_BswM_Cfg_DfrdBswNotification_BswM_MRP_BswM_MDG_ECUM_STATE_RUN: RteBswPositionInTask=1, RteBswEventRef=MSE_BswM_Cfg_DfrdBswNotification_BswM_MRP_BswM_MDG_ECUM_STATE_RUN
          MSE_BswM_Cfg_DfrdBswNotification_BswM_MRP_BswM_MDG_ECUM_STATE_APP_RUN: RteBswPositionInTask=2, RteBswEventRef=MSE_BswM_Cfg_DfrdBswNotification_BswM_MRP_BswM_MDG_ECUM_STATE_APP_RUN
          MSE_BswM_Cfg_DfrdBswNotification_BswM_MRP_BswM_MDG_ECUM_STATE_APP_POST_RUN: RteBswPositionInTask=3, RteBswEventRef=MSE_BswM_Cfg_DfrdBswNotification_BswM_MRP_BswM_MDG_ECUM_STATE_APP_POST_RUN
          MSE_BswM_Cfg_DfrdBswNotification_BswM_MRP_BswM_MDG_ECUM_STATE_PREP_SHUTDOWN: RteBswPositionInTask=4, RteBswEventRef=MSE_BswM_Cfg_DfrdBswNotification_BswM_MRP_BswM_MDG_ECUM_STATE_PREP_SHUTDOWN
        RteBswRequiredModeGroupConnection:
          RteBswProvidedModeGroupRef = MDGP_ModeDeclarationGroups_MDG_ECUM_STATE
          RteBswProvidedModeGrpModInstRef = BSWIMPL_BswM
          RteBswRequiredModeGroupRef = MDGR_BswM_MRP_BswM_MDG
      Bfx: RteBswImplementationRef=Bfx
      CanIf: RteBswImplementationRef=CanIf
      PduR: RteBswImplementationRef=PduR
