AUTOSAR XML (schema 00048)
package /RB/RBA/rba_Amu/EcucModuleDefs
  module definition rba_Amu [0..1]: category=VENDOR_SPECIFIC_MODULE_DEFINITION, post-build-variant-support=true, variants pre-compile  # MCAL ASC Modelling Unit | Configuration of the MCAL module for the ASC (advanced simulation for calibration) modelling unit.
    container rba_AmuConfigSet [0..1]: multiplicity set at pre-compile  # Configuration data set | This is the base container that contains the post-build selectable configuration parameters
      container rba_AmuModel [1..*]: multiplicity set at pre-compile, post-build-variant-multiplicity=true  # AMU Model | This container for the model specific parameters.
        enumeration rba_AmuInstance: origin=RB:2.0.0:2014-01-21, post-build-variant-value=true, set at pre-compile  # Use AMU Instance | Use Amu Instance for calculating of this model This applies for Sync-Mode only (rba_AmuInterruptMode is disabled)
          RBA_AMU_HW_UNIT{0..3}  # use AMU{0..3}
        enumeration rba_AmuMode [0..1]: multiplicity set at pre-compile, origin=RB:1.25.0:2016-04-29, set at pre-compile  # Mode | Select in which mode this Model is to be calculated: A: Sync Mode B: Async Mode C: Async / Sync Mode
          SYNC  # Sync Mode
          ASYNC  # Async Mode
          SYNC_ASYNC  # Async / Sync Mode
        boolean rba_AmuModelAmuRam [0..1]: multiplicity set at pre-compile, origin=RB:2.0.0:2014-01-21, post-build-variant-multiplicity=true, post-build-variant-value=true, set at pre-compile, default-value=true  # Use AMU Ram | Enables / disables usage of Amu Ram for this model. If there is not enough Ram within AMU Ram available this model will not be copied to Amu Ram, even if is enabled for Amu Ram. true: This model is copied to Amu Ram false: This Model is NOT copied to Amu Ram
        enumeration rba_AmuModelCalculationSpeed: origin=RB:3.0.0:2014-07-16, post-build-variant-value=true, set at pre-compile  # Model calculation speed | Allows to configure the calculation speed of the amu hardware, to slow down the hardware state machine which controls the algorithm. 1/1: calculation is performed in Full speed 1/2: calculation is performed in Halfe speed 1/4: calculation is performed in Quarter speed 1/8: calculation is performed in 1/8th speed
          RBA_AMU_CALCSPEED_FULL_E  # calculation speed 1/1
          RBA_AMU_CALCSPEED_HALF_E  # calculation speed 1/2
          RBA_AMU_CALCSPEED_QUARTER_E  # calculation speed 1/4
          RBA_AMU_CALCSPEED_ONE_8TH_E  # calculation speed 1/8
        integer rba_AmuModelDataDimension: 1..32, multiplicity set at pre-compile, origin=RB:1.23.0:2015-10-30, post-build-variant-multiplicity=true, post-build-variant-value=true, set at pre-compile  # Model Dimension | Dimension of the AMU Model
        integer rba_AmuModelDataErrorModelsMax: 0..4, multiplicity set at pre-compile, origin=RB:1.23.0:2015-10-30, post-build-variant-multiplicity=true, post-build-variant-value=true, set at pre-compile  # Max Error Models | Maximum number of correction Models
        string rba_AmuModelDataHeaderName [0..1]: multiplicity set at pre-compile, origin=RB:0.7.0:2013-05-14, post-build-variant-multiplicity=true, post-build-variant-value=true, set at pre-compile, max-length=40, min-length=1  # Model data header name | Name of header with external declaration of the model data to be used.
        integer rba_AmuModelDataLength [0..1]: 0..32768, multiplicity set at pre-compile, origin=RB:0.7.0:2013-05-14, post-build-variant-multiplicity=true, post-build-variant-value=true, set at pre-compile  # Model data length | Length of the model data in 32-Bit Words (required for memory allocation/handling).
        string rba_AmuModelDataName: multiplicity set at pre-compile, origin=RB:0.7.0:2013-05-14, post-build-variant-multiplicity=true, post-build-variant-value=true, set at pre-compile, max-length=30, min-length=1  # Model data name | Name of the model data to be used.
        integer rba_AmuModelDataTrainingPointsBaseModelMax: 0..1500, multiplicity set at pre-compile, origin=RB:1.23.0:2015-10-30, post-build-variant-multiplicity=true, post-build-variant-value=true, set at pre-compile  # ModelDataTrainingPointsBaseModelMax | Maximum number of the Base Models Training Points
        integer rba_AmuModelDataTrainingPointsErrorModelMax: 0..1500, multiplicity set at pre-compile, origin=RB:1.23.0:2015-10-30, post-build-variant-multiplicity=true, post-build-variant-value=true, set at pre-compile  # ModelDataTrainingPointsErrorModelMax | Maximum number of the Correction Models Training Points
        integer rba_AmuModelGradientsMax: 0..4294967295, multiplicity set at pre-compile, origin=RB:3.0.0:2014-07-16, post-build-variant-multiplicity=true, post-build-variant-value=true, set at pre-compile  # Available Gradients (bit coded) | Number of availabe gradients of this model configured in ASCMO This applies for Async-Mode only (rba_AmuInterruptMode is enabled)
        integer rba_AmuModelTimeout: 0..5000, multiplicity set at pre-compile, origin=RB:3.0.0:2014-07-16, post-build-variant-multiplicity=true, post-build-variant-value=true, set at pre-compile  # Model Calculation timeout | Time (us) after which the calculation is stopped This applies for Sync-Mode only (rba_AmuInterruptMode is disabled)
        container rba_AmuModelInRasters [0..*]: multiplicity set at pre-compile  # Models in Raster | To configure the Raster(s) the model shall be calculated
          integer rba_AmuModelGradientsToCalc: 0..4294967295, origin=R_AR40_2015_3_0:2015-07-31, post-build-variant-value=true, set at pre-compile  # Gradients to calc (bit coded) | Requested gradient(s) for this model calculation (bit coded) This applies for Async-Mode only (rba_AmuInterruptMode is enabled)
          integer rba_AmuModelPriority: origin=R_AR40_2015_3_0:2015-07-31, post-build-variant-value=true, set at pre-compile  # Model Priority | Model Priority. Hint: The number should be derived from the OS Task priority of the raster
          string rba_Amu_ModelInRasterIdentifier: origin=R_AR40_2015_3_0:2015-07-31, post-build-variant-value=true, set at pre-compile, max-length=40, min-length=1  # RasterIdentifier | Raster Identifier
          integer rba_Amu_ModelInoutVectorsMax: 1..10, origin=R_AR40_2015_3_0:2015-07-31, post-build-variant-value=true, set at pre-compile  # Max. number of Input Vectors | Maximum number of Input Vectors for this model calculation
    container rba_AmuGeneral [0..1]: multiplicity set at pre-compile  # General settings | Container with general configuration (parameters) of the Amu Driver software module.
      boolean rba_AmuDevErrorDetect: origin=RB:0.7.0:2013-05-14, set at pre-compile  # Development error detection | Enables/disables the detection and notification of development errors. If this parameter is enabled, then extended error checking is performed during runtime; any errors detected by these checks are reported to the Det module. This feature should be switched off in series software.
      boolean rba_AmuModelParallelUse: origin=RB:3.2.0:2014-10-31, set at pre-compile, default-value=true  # Model Parallel Use | To speed up calculation use 2 AMUs in parallel to calculate a Model: true: 2 AMU channels are used to calculate 1 Model false: 1 AMU channel is used to calculate 1 Model This applies for Sync-Mode only (rba_AmuInterruptMode is disabled)
      boolean rba_Amu_EnableRbaResetUsage [0..1]: origin=RB:3.2.0:2021-09-10, set at pre-compile, default-value=true  # rba_Reset usage | Enables/disables the usage of rba_Reset. Per default, if nothing is configured here, rba_Reset is used. If rba_Reset is not used, all resets are mapped within rba_Amu_Cfg_SchM.h to Mcu_PerformReset() per default, but can be remapped to any project specific reset, if needed
