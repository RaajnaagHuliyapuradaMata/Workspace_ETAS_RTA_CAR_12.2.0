AUTOSAR XML (schema 00048)
package /RB/RBA/rba_AdcDs/EcucModuleDefs
  module definition rba_AdcDs [0..1]: category=VENDOR_SPECIFIC_MODULE_DEFINITION, post-build-variant-support=true, variants pre-compile  # MCAL Delta-Sigma Analog/Digital Converter | Configuration for the delta-sigma analog-digital-converter (AdcDs).
    container rba_AdcDs_ConfigSet  # Configuration data set | This is the base container that contains the post-build selectable configuration parameters
      container rba_AdcDs_HwUnit [1..*]: multiplicity set at pre-compile, post-build-variant-multiplicity=true  # HW unit | This container contains HW-Unit specific parameters.
        boolean rba_AdcDs_AutoStart [0..1]: multiplicity set at pre-compile, origin=RB, post-build-variant-multiplicity=true, post-build-variant-value=true, set at pre-compile, default-value=false  # Automatic start | Set to true for automatic start of conversion immediately after initialization. For synchronous start use unit group configuration. Default is auto start disabled.
        enumeration rba_AdcDs_CalibrationMode: origin=RB, post-build-variant-value=true, set at pre-compile  # Calibration mode | Selects which type of calibration is required for this AdcDs unit. ST: For calibration a DMA is necessary even if no DMA transfer for conversion results will be used. IFX: At least startup calibration is mandatory.
          RBA_ADCDS_PRV_CALIBRATION_NONE  # No calibration
          RBA_ADCDS_PRV_CALIBRATION_STARTUP  # Startup calibration
          RBA_ADCDS_PRV_CALIBRATION_TRIGGERED  # Triggered calibration during runtime
          RBA_ADCDS_PRV_CALIBRATION_ALL  # Startup and triggered calibration
        string rba_AdcDs_CallbackHeaderName [0..1]: multiplicity set at pre-compile, origin=RB, post-build-variant-multiplicity=true, post-build-variant-value=true, set at pre-compile, default-value=NULL_PTR, max-length=60, min-length=1  # Callback function header name | Name of header with external decalaration of callback function.
        function name rba_AdcDs_CallbackName [0..1]: multiplicity set at pre-compile, origin=RB, post-build-variant-multiplicity=true, post-build-variant-value=true, set at pre-compile, default-value=NULL_PTR  # Callback function | Name of callback function: This function must not have any parameters or return value.
        string rba_AdcDs_DsadcDmaName [0..1]: multiplicity set at pre-compile, origin=RB, post-build-variant-multiplicity=true, post-build-variant-value=true, set at pre-compile, default-value=RBA_DMA_NUM_IDS_E, max-length=60, min-length=1  # Dma to transfer AdcDs results | DMA to transfer AdcDs conversion results. If calibration is configured this DMA must be provided even if no DMA transfer to a result buffer is configrued. Prefix "rba_Dma_" must be added to the configured shortname from the DMA (rba_Dma_Ch).
        string rba_AdcDs_DsadcResBufHeaderName [0..1]: multiplicity set at pre-compile, origin=RB, post-build-variant-multiplicity=true, post-build-variant-value=true, set at pre-compile, default-value=NULL_PTR, max-length=60, min-length=1  # AdcDs result buffer header name | Name of header with external decalaration of result buffer to be used as destination for the AdcDs results.
        string rba_AdcDs_DsadcResBufName [0..1]: multiplicity set at pre-compile, origin=RB, post-build-variant-multiplicity=true, post-build-variant-value=true, set at pre-compile, default-value=NULL_PTR, max-length=60, min-length=1  # AdcDs result buffer name | Name of result buffer to be used as destination for the AdcDs result transfer.
        boolean rba_AdcDs_Ena32BitTransfer [0..1]: multiplicity set at pre-compile, origin=RB, post-build-variant-multiplicity=true, post-build-variant-value=true, set at pre-compile, default-value=false  # Enable 32-bit AdcDs result transfer | Set to true to enable 32-bit DMA transfer for AdcDs conversion results. This is important for memory regions which can only be accessed by 32-bit write commands. Disabled by default.
        boolean rba_AdcDs_EnaDmaTransfer: origin=RB, post-build-variant-value=true, set at pre-compile  # Enable DMA transfer | Enable or disable DMA Transfer.
        boolean rba_AdcDs_EnaGate [0..1]: multiplicity set at pre-compile, origin=RB, post-build-variant-multiplicity=true, post-build-variant-value=true, set at pre-compile, default-value=false  # Enable gating | Enable or disable Gating. Disabled by default.
        boolean rba_AdcDs_EnaPrivateBus [0..1]: multiplicity set at pre-compile, origin=RB, post-build-variant-multiplicity=true, post-build-variant-value=true, set at pre-compile, default-value=false  # Enable private bus | Enable/Disable the private bus of the AdcDs (Connection to the DSPL modules). Only available for ST Centauri cut 2 and following cuts. Disabled by default.
        boolean rba_AdcDs_EnaRuntimeBufLinkage [0..1]: multiplicity set at pre-compile, origin=RB, post-build-variant-multiplicity=true, post-build-variant-value=true, set at pre-compile, default-value=false  # Enable runtime result buffer linkage | Set to true to enable linkage of result buffers during initialisation of the AdcDs driver.
        string rba_AdcDs_FilterName: origin=RB, post-build-variant-value=true, set at pre-compile, max-length=60, min-length=1  # Filter name | Set the name of the filter settings container that should be used for this hw unit
        enumeration rba_AdcDs_GainFactor: origin=RB, post-build-variant-value=true, set at pre-compile  # Gain | Set the gain factor. Following gain factors can be configured: ST: 1, 2, 4 IFX: 1, 2
          GAIN_1  # Input gain factor 1
          GAIN_2  # Input gain factor 2
          GAIN_4  # Input gain factor 4
        enumeration rba_AdcDs_GateLevel [0..1]: multiplicity set at pre-compile, origin=RB, post-build-variant-multiplicity=true, post-build-variant-value=true, set at pre-compile  # Gate Level | Set the gate level (high/low) to use for gating the DMA transfers Setting is only available for Infineon controllers
          GATE_LEVEL_LOW  # Triggering transfer active during low level of gate signal
          GATE_LEVEL_HIGH  # Triggering transfer active during high level of gate signal
        enumeration rba_AdcDs_GateLine [0..1]: multiplicity set at pre-compile, origin=RB, post-build-variant-multiplicity=true, post-build-variant-value=true, set at pre-compile  # Gate Line | Set the gate line to use for gating the DMA transfers Setting is only available for Infineon controllers
          GTM_LINE_{0..3}  # Gating signal from GTM line {0..3}
        string rba_AdcDs_GtmDmaName [0..1]: multiplicity set at pre-compile, origin=RB, post-build-variant-multiplicity=true, post-build-variant-value=true, set at pre-compile, default-value=RBA_DMA_NUM_IDS_E, max-length=60, min-length=1  # Dma to transfer GTM values | DMA to transfer angle/time capture from GTM. Prefix "rba_Dma_" must be added to the configured shortname from the DMA (rba_Dma_Ch).
        string rba_AdcDs_GtmName [0..1]: multiplicity set at pre-compile, origin=RB, post-build-variant-multiplicity=true, post-build-variant-value=true, set at pre-compile, default-value=RBA_GTM_TIM_INVALID_E, max-length=60, min-length=1  # Gtm Name | Name of GTM Tim which is used for timestamp/angle capturing. Prefix "rba_Gtm_Tim_" must be added to the configured shortname from the GTM (rba_Gtm_Tim).
        string rba_AdcDs_GtmResBufHeaderName [0..1]: multiplicity set at pre-compile, origin=RB, post-build-variant-multiplicity=true, post-build-variant-value=true, set at pre-compile, default-value=NULL_PTR, max-length=60, min-length=1  # GTM result buffer header name | Name of header with external decalaration of result buffer to be used for the GTM value (time/angle).
        string rba_AdcDs_GtmResBufName [0..1]: multiplicity set at pre-compile, origin=RB, post-build-variant-multiplicity=true, post-build-variant-value=true, set at pre-compile, default-value=NULL_PTR, max-length=60, min-length=1  # GTM result buffer name | Name of result buffer to be used as destination for the GTM value (time/angle).
        enumeration rba_AdcDs_HwUnitId: {AdcDs_0, AdcDs_1, AdcDs_2, AdcDs_3, AdcDs_4, AdcDs_5, AdcDs_6, AdcDs_7, AdcDs_8, AdcDs_9, AdcDs_10, AdcDs_11, AdcDs_12, AdcDs_13}, origin=RB, post-build-variant-value=true, set at pre-compile  # Hardware unit ID | ID of the HW unit (physical).
        string rba_AdcDs_InputSignal: origin=RB, post-build-variant-value=true, set at pre-compile, max-length=60, min-length=1  # Input signal | Initial signal to be used for initialization
        integer rba_AdcDs_OutputEventCounter [0..1]: 2..16383, multiplicity set at pre-compile, origin=RB, post-build-variant-multiplicity=true, post-build-variant-value=true, set at pre-compile  # Number of conversions before a callback | Number of results (AdcDs/Gtm) to be transfered to the result buffer before a callback. The value that can be used depends on which buffer mode is used and whether values are to be transferred from the GTM. If the GTM is not used the value has to be in the following ranges: Ringbuffer: 2..8192 Linear buffer: 2..16383 If the GTM is used the value has to be in the follwing range: 2..511
        integer rba_AdcDs_ResultBufferLength [0..1]: 1..16383, multiplicity set at pre-compile, origin=RB, post-build-variant-multiplicity=true, post-build-variant-value=true, set at pre-compile  # Result buffer length | Length of result buffers for AdcDs (and Gtm) values. For circular buffer mode (ring buffer) the size must be 2 to the power of n. Max. possible values: Ringbuffer: 8192 linear buffer (without GTM transfer): 16383 linear buffer (with GTM transfer): 511
        enumeration rba_AdcDs_ResultBufferMode [0..1]: multiplicity set at pre-compile, origin=RB, post-build-variant-multiplicity=true, post-build-variant-value=true, set at pre-compile  # Result buffer mode | Mode for result buffer, must either be circular (ring buffer) or linear (stop after configured amount of transfers).
          RBA_ADCDS_BUFFER_MODE_CIRCULAR  # circular buffer
          RBA_ADCDS_BUFFER_MODE_LINEAR  # linear buffer
        enumeration rba_AdcDs_TriggerGtm [0..1]: multiplicity set at pre-compile, origin=RB, post-build-variant-multiplicity=true, post-build-variant-value=true, set at pre-compile, default-value=RBA_ADCDS_OUTPUT_TRIGGER_GTM_NONE  # Trigger GTM | Enable or disable triggering of GTM to be able to get timestamps/angles
          RBA_ADCDS_OUTPUT_TRIGGER_GTM_TIMER  # Output for timer trigger (TBU_TS0)
          RBA_ADCDS_OUTPUT_TRIGGER_GTM_ANGLE  # Output for angle trigger (TBU_TS1)
          RBA_ADCDS_OUTPUT_TRIGGER_GTM_TIMER2  # Output for timer trigger (TBU_TS2)
          RBA_ADCDS_OUTPUT_TRIGGER_GTM_NONE  # Disable trigger
        container rba_AdcDs_Signal [1..*]: multiplicity set at pre-compile, post-build-variant-multiplicity=true  # Signal | This container contains the Signal of the AdcDs.
          boolean rba_AdcDs_BiasChannel [0..1]: multiplicity set at pre-compile, origin=RB, post-build-variant-multiplicity=true, post-build-variant-value=true, set at pre-compile, default-value=false  # Bias active | Input biasing for the related signal can be activated. True will activate the biasing. For high impedance input set this value to false. Default value is false.
          integer rba_AdcDs_ExternalResistor [0..1]: 1..10000, multiplicity set at pre-compile, origin=RB, post-build-variant-multiplicity=true, post-build-variant-value=true, set at pre-compile, default-value=0  # External resistor | This feature is currently not supported for ST controllers. External resistor value (in Ohm). This setting is only necessary if the correction values (gain, offset) for an external resistor should be calculated by the AdcDs driver.
          enumeration rba_AdcDs_InputMode: origin=RB, post-build-variant-value=true, set at pre-compile  # Input mode | Input Mode: single ended (positive/negative input) or differential input
            RBA_ADCDS_INPUT_MODE_SINGLE_ENDED_POS  # Single-ended mode, positive input
            RBA_ADCDS_INPUT_MODE_SINGLE_ENDED_NEG  # Single-ended mode, negative input
            RBA_ADCDS_INPUT_MODE_DIFFERENTIAL  # Differential input mode
          enumeration rba_AdcDs_InputReferenceVoltage [0..1]: multiplicity set at pre-compile, origin=RB, post-build-variant-multiplicity=true, post-build-variant-value=true, set at pre-compile  # Input reference voltage | Reference voltage to be used by the AdcDs. Valid values are: - Reference to ground - Reference to 2.5V Default is ground. If signal is configured for differential input mode this configuration will only be used when switching to single ended input mode during runtime.
            RBA_ADCDS_PRV_REFERENCE_GND  # Ground
            RBA_ADCDS_PRV_REFERENCE_2_5  # Common mode voltage (2.5V)
          enumeration rba_AdcDs_MuxChannelId: {Channel_0, Channel_1, Channel_2, Channel_3}, origin=RB, post-build-variant-value=true, set at pre-compile  # Multiplexer channel | Set multiplexer input channel. For single ended signals the input pin connected to the AdcDs is the combination of the mux channel id and the input mode setting (positive or negative) For AdcDs converters without input multiplexer use channel 0.
      container rba_AdcDs_UnitGroup [0..*]: multiplicity set at pre-compile, post-build-variant-multiplicity=true  # Unit group | This container contains one group of AdcDs Units. This units can be started synchron. Note that any call to rba_AdcDs_EnableUnitGroup/rba_AdcDs_DisableUnitGroup will end synchronous operation of this unit in relation to other units in this group.
        boolean rba_AdcDs_AutoSyncStart [0..1]: multiplicity set at pre-compile, origin=RB, post-build-variant-multiplicity=true, post-build-variant-value=true, set at pre-compile, default-value=false  # Automatic synchron start | Set to true for automatic start of conversion for all units in this group immediately after initialization.
        string rba_AdcDs_UnitName [2..*]: multiplicity set at pre-compile, origin=RB, post-build-variant-multiplicity=true, post-build-variant-value=true, set at pre-compile, max-length=60, min-length=1  # AdcDs unit name | Logical name of the unit
    container rba_AdcDs_FilterIfx [0..*]: multiplicity set at pre-compile, post-build-variant-multiplicity=true  # Filter IFX | This container contains one set of filter parameters that can be used by all AdcDs units. This filter set can only be used for ST controllers.
      enumeration rba_AdcDs_OutputSampleRate: origin=RB, post-build-variant-value=true, set at pre-compile  # Output sample rate
        OSR_333_33kHz  # Output sample rate 333.333333333333kHz
        OSR_250_00kHz  # Output sample rate 250kHz
        OSR_200_00kHz  # Output sample rate 200kHz
        OSR_166_67kHz  # Output sample rate 166.666666666667kHz
        OSR_142_86kHz  # Output sample rate 142.857142857143kHz
        OSR_125_00kHz  # Output sample rate 125kHz
        OSR_111_11kHz  # Output sample rate 111.111111111111kHz
        OSR_100_00kHz  # Output sample rate 100kHz
        OSR_90_91kHz  # Output sample rate 90.9090909090909kHz
        OSR_83_33kHz  # Output sample rate 83.3333333333333kHz
        OSR_71_43kHz  # Output sample rate 71.4285714285714kHz
        OSR_62_50kHz  # Output sample rate 62.5kHz
        OSR_55_56kHz  # Output sample rate 55.5555555555556kHz
        OSR_50_00kHz  # Output sample rate 50kHz
        OSR_45_45kHz  # Output sample rate 45.4545454545455kHz
        OSR_41_67kHz  # Output sample rate 41.6666666666667kHz
        OSR_35_71kHz  # Output sample rate 35.7142857142857kHz
        OSR_31_25kHz  # Output sample rate 31.25kHz
        OSR_15_63kHz  # Output sample rate 15.625kHz
        OSR_7_81kHz  # Output sample rate 7.8125kHz
    container rba_AdcDs_FilterSt [0..*]: multiplicity set at pre-compile, post-build-variant-multiplicity=true  # Filter ST | This container contains one set of filter parameters that can be used by all AdcDs units. This filter set can only be used for ST controllers.
      enumeration rba_AdcDs_FilterModeSt [0..1]: multiplicity set at pre-compile, origin=RB, post-build-variant-multiplicity=true, post-build-variant-value=true, set at pre-compile, default-value=FIR_ACTIVE_FS_3  # Filter mode | Filter mode selection FIR_BYPASS filter mode currently not supported
        FIR_ACTIVE_FS_3  # FIR Filter active (Fs/3 mode - default mode)
        FIR_BYPASS  # FIR Bypass
      enumeration rba_AdcDs_OutputSampleRate: origin=RB, post-build-variant-value=true, set at pre-compile  # Output sample rate
        OSR_333_33kHz  # Output sample rate 333.333333333333kHz
        OSR_250_00kHz  # Output sample rate 250kHz
        OSR_200_00kHz  # Output sample rate 200kHz
        OSR_166_67kHz  # Output sample rate 166.666666666667kHz
        OSR_142_86kHz  # Output sample rate 142.857142857143kHz
        OSR_125_00kHz  # Output sample rate 125kHz
        OSR_111_11kHz  # Output sample rate 111.111111111111kHz
        OSR_100_00kHz  # Output sample rate 100kHz
        OSR_90_91kHz  # Output sample rate 90.9090909090909kHz
        OSR_83_33kHz  # Output sample rate 83.3333333333333kHz
        OSR_71_43kHz  # Output sample rate 71.4285714285714kHz
        OSR_62_50kHz  # Output sample rate 62.5kHz
        OSR_55_56kHz  # Output sample rate 55.5555555555556kHz
        OSR_50_00kHz  # Output sample rate 50kHz
        OSR_45_45kHz  # Output sample rate 45.4545454545455kHz
        OSR_41_67kHz  # Output sample rate 41.6666666666667kHz
        OSR_35_71kHz  # Output sample rate 35.7142857142857kHz
        OSR_31_25kHz  # Output sample rate 31.25kHz
        OSR_15_63kHz  # Output sample rate 15.625kHz
        OSR_7_81kHz  # Output sample rate 7.8125kHz
    container rba_AdcDs_General  # General settings | Container with general configuration parameters of the AdcDs driver.
      boolean rba_AdcDs_DevErrorDetect: origin=RB, set at pre-compile  # Development error detection | Switches the Development Error Detection on or off. true: Enabled. false: Disabled.
