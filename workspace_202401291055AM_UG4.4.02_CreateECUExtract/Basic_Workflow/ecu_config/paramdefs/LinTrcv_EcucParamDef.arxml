AUTOSAR XML (schema 00048)
package /AUTOSAR_LinTrcv/EcucModuleDefs
  module definition LinTrcv [0..*]: category=VENDOR_SPECIFIC_MODULE_DEFINITION, refined-module-def=LinTrcv, variants pre-compile  # Lin Transceiver Module | Configuration of LIN Transceiver Driver module
    container LinTrcvChannel [1..*]  # Container gives LIN transceiver driver information about a single LIN transceiver channel. Any LIN transceiver driver has such LIN transceiver channels.
      integer LinTrcvChannelId: 0..255, set at pre-compile, symbolic-name-value=true  # Unique identifier of the LIN Transceiver Channel. ! Parameter set with "Generate ID" !
      boolean LinTrcvChannelUsed: set at pre-compile, default-value=true  # Shall the related LIN transceiver channel be used? ! Parameter not used ! | True: Is used False Is not used
      enumeration LinTrcvHardwareType: {NCV7321, TJA1021, TJA1027, SIP2x0_TJA1901_TJA1902_TJA1029, TLE7259, NCV7424, TLIN1021A, TLIN1024A}, origin=RB:v1.0.0:2016-9-30, set at pre-compile  # Type of the used Hardware | ImplementationType: LinTrcv_TrcvModeType
      boolean LinTrcvWakeupByBusUsed: set at pre-compile, default-value=false  # Is wake up by bus supported? If LIN transceiver hardware does not support wake up by bus value is always FALSE. If LIN transceiver hardware supports wake up by bus value is TRUE or FALSE depending whether it is used or not. | TRUE = Is used. FALSE = Is not used.
      reference LinTrcvChannelEcucPartitionRef [0..1]: scope=ECU, multiplicity set at pre-compile, set at pre-compile, destination=EcucPartition  # Maps one single Lin transceiver channel to zero or one ECUC partitions. The ECUC partition referenced is a subset of the ECUC partitions where the Lin transceiver driver is mapped to.
      reference LinTrcvIcuChannelRef [0..1]: scope=ECU, multiplicity set at pre-compile, set at pre-compile, requires-symbolic-name-value=true, destination=IcuChannel  # Reference to the IcuChannel to enable/disable the interrupts for wakeups.This Parameter is not used !
      reference LinTrcvWakeupSourceRef [0..1]: scope=ECU, multiplicity set at pre-compile, set at pre-compile, requires-symbolic-name-value=true, destination=EcuMWakeupSource  # Reference to a wakeup source in the EcuM configuration. This reference is only needed if LinTrcvWakeupByBusUsed is true. Implementation Type: reference to EcuM_WakeupSourceType. ! Parameter not used !
      choice container LinTrcvAccess  # Container gives LIN transceiver driver access about a single LIN transceiver channel.
        container LinTrcvDioAccess [0..1]  # Container gives LIN transceiver driver information about accessing ports and port pins. In addition relation between LIN transceiver hardware pin names and Dio port access information is given. If a LIN transceiver hardware has no Dio interface, there is no instance of this container.
          container LinTrcvDioChannelAccess [1..*]  # Container gives DIO channel access by single Lin transceiver channel.
            enumeration LinTrcvDioHardwareInterfaceType: {Enable, WakeupSignalisation}, origin=RB:v1.0.0:2016-9-30, set at pre-compile, default-value=Enable  # Type of functionalty of this pin. The trcv-software uses this parameter to know what functionality is located at the referenced Dio Pin conneted to the Trcv-HW.
            string LinTrcvHardwareInterfaceName: set at pre-compile  # LIN transceiver hardware interface name. It is typically the name of a pin. From a Dio point of view it is either a port, a single channel or a channel group. Depending on this fact either LINTRCV_DIO_PORT_SYMBOLIC_NAME or LINTRCV_DIO_CHANNEL_SYMBOLIC_NAME or LINTRCV_DIO_CHANNEL_GROUP_SYMBOLIC_NAME shall reference a Dio configuration. The LIN transceiver driver implementation description shall list up this name for the appropriate LIN transceiver hardware.
            string LinTrcvRbDioSymName [0..1]: origin=RB:v4.1.0:2018-02-28, set at pre-compile, default-value=false  # This parameter have to be configured only if Dio component is not available in the Project. In this case Macro to access Dio will be generated based on the name given here. Macro is generated by attaching the symbolic name pattern. If third party macro is not matching with the generated macro , then a mapping macro should by created by integrator. If project has Autosar Dio then no need to configure this parameter.
            boolean LinTrcvRbHardwarePinInvert [0..1]: multiplicity set at pre-compile, origin=RB, set at pre-compile, default-value=false  # Parameter depends on hardware: Describes, if a inverter is between transceiver pin and micro controller. If the transceiver is directly connected to the Controller, 'false' should be configured. If there is an inverter between transceiver and micro controller, 'yes' should be configured. | false: No inverter between Micro Controller and transceiver yes: Inverter between Micro Controller and transceiver
            choice reference LinTrcvDioSymRefName: set at pre-compile, destination=[DioChannel, DioChannelGroup, DioPort]  # Choice Reference to a DIO Port, DIO Channel or DIO Channel Group. This reference replaces the LINTRCV_DIO_PORT_SYM_NAME, LINTRCV_DIO_CHANNEL_SYM_NAME and LINTRCV_DIO_GROUP_SYM_NAME references in the Lin Trcv SWS.
        container LinTrcvSpiSequence [0..1]  # Container gives LIN transceiver driver information about one SPI sequence. Parameter not used as No LinTrcv support SPI | One SPI sequence used by LIN transceiver driver is in exclusive use for it. No other driver is allowed to access this sequence. LIN transceiver driver may use one sequence to access n LIN transceiver hardwares chips of the same type or n sequences are used to access one single LIN transceiver hardware chip. If a LIN transceiver hardware has no SPI interface, there is no instance of this container.
          reference LinTrcvSpiSequenceName: set at pre-compile, destination=SpiSequence  # Reference to a Spi sequence configuration container.
    container LinTrcvDemEventParameterRefs [0..1]  # Container for the references to DemEventParameter elements which shall be invoked using the API Dem_SetEventStatus API in case the corresponding error occurs. The EventId is taken from the referenced DemEventParameters DemEventId value. The standardized errors are provided in the container and can be extended by vendor specific error references.
      enumeration LinTrcvRbDynCreate_LINTRCV_E_NO_TRCV_CONTROL [0..1]: {Disabled, Standard}, multiplicity set at pre-compile, origin=RB:v1.0.0:2016-9-30, set at pre-compile, default-value=Disabled  # Dynamically create DemEvent | Selects the way how the example DemEvent is created. If not set or set to "Disabled", no such DemEvent is automatically created. If the dynamic creation of this DemEvent is enabled, the reference to this DemEvent (in parameter rba_Example_DemEventRef) is also automatically created and shall therefore not be set manually.
      reference LINTRCV_E_NO_TRCV_CONTROL [0..1]: scope=ECU, multiplicity set at pre-compile, origin=RB:v1.0.0:2016-9-30, set at pre-compile, requires-symbolic-name-value=true, destination=DemEventParameter  # Reference to the DemEventParameter which shall be issued when the error "No/incorrect communication to transceiver" has occured.
      reference LINTRCV_E_UNEXPECTED_MODE_PROP [0..1]: scope=ECU, multiplicity set at pre-compile, origin=RB:v4.1.0:2018-2-28, set at pre-compile, requires-symbolic-name-value=true, destination=DemEventParameter  # Reference to the DemEventParameter which shall be issued when the unexpected mode propogation is detcted in Transceiver HW. If this Parameter is configured then MainFunction period should be configured in parameter LinTrcvRbMainFunctionPeriod to monitor the unexpected mode transaction
    container LinTrcvGeneral  # Container gives LIN transceiver driver basic information.
      enumeration LinTrcvAutosarVersion: {Legacy, AR4_0_2, AR4_0_3}, origin=RB:v1.0.0:2016-9-30, set at pre-compile  # Naming convention for symbolic names are generated according autosar version: Lecacy: no prefix AR4.0.2: Dio_ (ecuc_sws_2108) AR4.0.3: DioConf_DioChannel_ | Naming convention for symbolic names are generated according autosar version: Lecacy: no prefix AR4.0.2: Dio_ AR4.0.3: DioConf_DioChannel_
      boolean LinTrcvClearWupReasonInSetWakeupMode: origin=RB:v1.0.0:2016-9-30, set at pre-compile, default-value=false  # On true, the wakeup reason is cleared in function LinTrcv_SetWakeupMode with Parameter LINTRCV_TRCV_WU_CLEAR. With other parameters or 'false' at this configuration parameter, the wakeup reason is not cleared in function LinTrcv_SetWakeupMode. The wakeup reason is cleard always init-function and on transition to sleep mode. If this parameter is set to true in one Lin Trcv it will be used in all LinTrcv | True: WakeupReason is cleared False: WakeupReason is not cleared
      boolean LinTrcvDevErrorDetect: set at pre-compile, default-value=false  # Switches the development error detection and notification on or off. | * true: detection and notification is enabled. * false: detection and notification is disabled.
      integer LinTrcvIndex: 0..255, set at pre-compile  # Specifies the InstanceId of this module instance. If only one instance is present it shall have the Id 0. ! Parameter not used !
      boolean LinTrcvInformEcumInCheckWakeup: origin=RB:v1.0.0:2016-9-30, set at pre-compile, default-value=false  # If enabled, the EcuM EcuM_SetWakeupEvent is called in function LinTrcv_CheckWakeup if wakeup occured. The #define LINTRCV_ECUM_WAKEUPCONFIGURAION_USED is generated according configuration value | True: Is used False: Is not used
      boolean LinTrcvInformLinIfInCheckWakeup: origin=RB:v1.0.0:2016-9-30, set at pre-compile, default-value=false  # This value should always be off! If enabled, the LinIf LinIf_WakeupConfirmationt is called in function LinTrcv_CheckWakeup if wakeup occured. The #define LINTRCV_LINIF_WAKEUPCONFIGURAION_USED is generated according configuration value. | True: Is used False: Is not used
      enumeration LinTrcvRbBswmdBooleanSize [0..1]: {LINTRCV_BSWMDVALUESIZE_1BIT, LINTRCV_BSWMDVALUESIZE_8BIT, LINTRCV_BSWMDVALUESIZE_16BIT, LINTRCV_BSWMDVALUESIZE_32BIT}, multiplicity set at pre-compile, origin=RB:v1.0.0:2016-9-30, set at pre-compile, default-value=LINTRCV_BSWMDVALUESIZE_8BIT  # At BSWMD generation the bit-size of boolean type has to be forwarded to rba_Arxml_Gen and can be configured here.
      enumeration LinTrcvRbBswmdEnumSize [0..1]: {LINTRCV_BSWMDVALUESIZE_8BIT, LINTRCV_BSWMDVALUESIZE_16BIT, LINTRCV_BSWMDVALUESIZE_32BIT}, multiplicity set at pre-compile, origin=RB:v1.0.0:2016-9-30, set at pre-compile, default-value=LINTRCV_BSWMDVALUESIZE_8BIT  # At BSWMD generation the bit-size of enums has to be forwarded to rba_Arxml_Gen and can be configured here.
      enumeration LinTrcvRbBswmdSpiSize [0..1]: {LINTRCV_BSWMDVALUESIZE_8BIT, LINTRCV_BSWMDVALUESIZE_16BIT, LINTRCV_BSWMDVALUESIZE_32BIT}, multiplicity set at pre-compile, origin=RB:v1.0.0:2016-9-30, set at pre-compile, default-value=LINTRCV_BSWMDVALUESIZE_16BIT  # At BSWMD generation the bit-size of Spi_DataType has to be forwarded to rba_Arxml_Gen and can be configured here.
      float LinTrcvRbMainFunctionPeriod [0..1]: 0.001..65535, origin=RB:v4.1.0:2018-2-28, set at pre-compile  # This parameter describes the period for cyclic call to LinTrcv_RbMainFunction. Unit is seconds. This parameter need to be configured if DEM parameter LINTRCV_E_UNEXPECTED_MODE_PROP is configured
      enumeration LinTrcvTimerType [0..1]: {None, Timer_1us16bit}, multiplicity set at pre-compile, set at pre-compile  # Type of the Time Service Predefined Timer. This Parameter is not used !
      boolean rba_TLIN1024AEnablePrototype [0..1]: multiplicity set at pre-compile, origin=RB:AR45.5.0.0:2023-06-16, set at pre-compile  # Switch to enable(true)/disable(false) Prototype. For prototype: true or false or not available can be selected | This configuration parameter rba_TLIN1024AEnablePrototype is a Switch to enable(true)/disable(false) the possibility to use prototype elements within component when the Hardware TLIN1024A is chosen.
      boolean LinTrcvUseAsr3Api: origin=RB:v1.0.0:2016-9-30, set at pre-compile, default-value=false  # Switches development error detection and notification on and off. If switched on, #define LINTRCV_DEV_ERROR_DETECT ON shall be generated. If switched off, #define LINTRCV_DEV_ERROR_DETECT OFF shall be generated. Define shall be part of file LinTrcv_Cfg.h. | True: Is used False: Is not used
      boolean LinTrcvVersionInfoApi: set at pre-compile, default-value=false  # Switches version information API on and off. If switched off, function need not be present in compiled code. | True: Is used False: Is not used
      float LinTrcvWaitTime [0..1]: 0..2.55E-4, multiplicity set at pre-compile, set at pre-compile  # Wait time for transceiver state changes in seconds.
      boolean LinTrcvWakeUpSupport: set at pre-compile  # Informs whether wake up is supported or not. In case wake up is not supported by LIN transceiver hardware the setting shall be false. The wake up ability may be switched on or off for each channel of one LIN transceiver by LinTrcvWakeupSourceRef. | True: Is used False: Is not used
      reference LinTrcvEcucPartitionRef [0..*]: scope=ECU, multiplicity set at pre-compile, set at pre-compile, destination=EcucPartition  # Maps the Lin transceiver driver to zero or multiple ECUC partitions to make the modules API available in this partition. The Lin transceiver driver will operate as an independent instance in each of the partitions.
