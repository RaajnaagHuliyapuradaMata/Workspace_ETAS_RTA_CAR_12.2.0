AUTOSAR XML (schema 00049)
package /AUTOSAR_StbM/EcucModuleDefs
  module definition StbM [0..1]: category=VENDOR_SPECIFIC_MODULE_DEFINITION, post-build-variant-support=true, refined-module-def=StbM, variants pre-compile  # EbOs StbM | The purpose of the Synchronized Time-Base Manager is to provide synchronized time bases to its customers, i.e., time bases, which are synchronized with time bases on other nodes of a distributed system.
    container StbMGeneral  # This container holds the general parameters of the Synchronized Time-base Manager
      boolean StbMDevErrorDetect: set at pre-compile, default-value=false  # Switches the development error detection and notification on or off. | * true: detection and notification is enabled. * false: detection and notification is disabled.
      boolean StbMGetCurrentTimeExtendedAvailable [0..1]: multiplicity set at pre-compile, set at pre-compile  # This allows to define whether an additional variant of the API GetCurrentTime with a 64 bit argument is provided.
      float StbMMainFunctionPeriod: 0..INF, set at pre-compile  # Schedule period of the main function StbM_MainFunction. Unit: [s].
      boolean StbMTimeRecordingSupport: set at pre-compile  # Enables/Disables the usage of the recording functionality for Synchronized and Offset timebases for Global Time precision measurement purpose.
      float StbMTimerStartThreshold [0..1]: 0..INF, multiplicity set at pre-compile, set at pre-compile  # This interval defines, when a GPT Timer shall be started for Time Notification Customers for which the corresponding Customer Timer is running [unit: seconds].
      boolean StbMVersionInfoApi: set at pre-compile, default-value=false  # Activate/Deactivate the version information API (StbM_GetVersionInfo). True: version information API activated False: version information API deactivated.
      reference StbMEcucPartitionRef [0..0]: multiplicity set at pre-compile, set at pre-compile, destination=EcucPartition  # Reference to EcucPartition, where StbM module is assigned to. Tags: atp.Status=draft
      reference StbMGptTimerRef [0..1]: multiplicity set at pre-compile, set at pre-compile, requires-symbolic-name-value=true, destination=GptChannelConfiguration  # This represents an optional sub-container in case any Time Notification Customer is configured. | The designated GPT timer has to be configured to have a tick duration of one micro second.
      reference StbMRbNvMBlockReference [0..1]: multiplicity set at pre-compile, origin=RB:AR42.12.0.0:2016-11-18, set at pre-compile, destination=NvMBlockDescriptor  # Reference of the Nvm block that should be configured for the timebase. | In this case, the designated NvM block has to be configured correctly, meaning: For each timebase one NvM block has to be configured.
    container StbMRbExternalCounter [0..*]: multiplicity set at pre-compile  # References the External Counter for a SynchronizedTimeBase
      function name StbMRbExternalCounterGetCounterValueCallback: multiplicity set at pre-compile, origin=RB:AR42.12.0.0:2016-12-10, set at pre-compile  # Name of the Hardware counter callback routine which shall be invoked to fetch the current counter value if external counter is configured as true. User needs to enter a valid name e.g GPT_Get_CounterValue_Cbk
      function name StbMRbExternalCounterGetElapsedValueCallback: multiplicity set at pre-compile, origin=RB:AR42.12.0.0:2016-12-10, set at pre-compile  # Name of the Hardware counter callback routine which shall be invoked to fetch the elapsed counter value if external counter is configured as true. User needs to enter a valid name e.g GPT_Get_ElapsedValue_Cbk
      function name StbMRbExternalCounterTicksTonsCallback: multiplicity set at pre-compile, origin=RB:AR42.12.0.0:2016-12-10, set at pre-compile  # Name of the Hardware counter callback routine which shall be invoked for conversion of the ticks to nanoseconds if external counter is configured as true. User needs to enter a valid name e.g GPT_Tick_To_Ns_Cbk
    container StbMSynchronizedTimeBase [1..*]: multiplicity set at pre-compile  # Synchronized time.base collects the information about a specific time-base provider within the system.
      boolean StbMAllowSystemWideGlobalTimeMaster [0..1]: multiplicity set at pre-compile, set at pre-compile  # For postbuild variant of the StbM this parameter has to be set to true for a Global Time Master that may act as a system-wide source of time. Otherwise no corresponding service ports/interfaces is provided. | The Global Time Master functionality behind the service ports/interfaces has to be enabled/disabled separately via parameter StbMIsSystemWideGlobalTimeMaster.
      integer StbMClearTimeleapCount [0..1]: 1..65535, multiplicity set at pre-compile, set at pre-compile, default-value=1  # This attribute describes the required number of updates to the Time Base where the time difference to the previous value has to remain below StbMTimeLeapPastThreshold/StbMTimeLeapFutureThreshold until the TIMELEAP_PAST/TIMELEAP_FUTURE bit within timeBaseStatus of the Time Base is cleared.
      boolean StbMIsSystemWideGlobalTimeMaster: post-build-variant-value=true, set at pre-compile  # This parameter shall be set to true for a Global Time Master that acts as a system-wide source of time information with respect to Global Time. | It is possible that several Global Time Masters exist that have set this parameter set to true because the Global Time Masters exist once per Global Time Domain and one ECU may own several Global Time Domains on different buses it is connected to.
      enumeration StbMNotificationInterface: {CALLBACK, CALLBACK_AND_SR_INTERFACE, NO_NOTIFICATION, SR_INTERFACE}, multiplicity set at pre-compile, set at pre-compile  # The parameter defines what type of interface shall be used to notify a customer of a status event.
      function name StbMStatusNotificationCallback [0..1]: multiplicity set at pre-compile, set at pre-compile  # Name of the customer specific status notification callback function, which shall be called, if a non-masked status event occurs.
      integer StbMStatusNotificationMask [0..1]: 0..4294967295, multiplicity set at pre-compile, set at pre-compile, default-value=0  # The parameter defines the initial value for NotificationMask mask, which defines the events for which the event notification callback function shall be called.
      enumeration StbMStoreTimebaseNonVolatile [0..1]: {NO_STORAGE, STORAGE_AT_SHUTDOWN}, multiplicity set at pre-compile, set at pre-compile  # This allows for specifying that the Time Base shall be stored in the NvRam.
      float StbMSyncLossTimeout [0..1]: 0..INF, multiplicity set at pre-compile, set at pre-compile  # This attribute describes the timeout for the situation that the time synchronization gets lost in the scope of the time domain. Unit: seconds
      integer StbMSynchronizedTimeBaseIdentifier: 0..65535, set at pre-compile, symbolic-name-value=true  # Identification of a Synchronized TimeBase via a unique identifier. | Range: * 0 .. 15: Synchronized Time Bases * 16 .. 31: Offset Time Bases * 32 .. 127: Pure Local Time Bases * 128 .. 65535: Reserved
      float StbMTimeLeapFutureThreshold [0..1]: 0..INF, multiplicity set at pre-compile, set at pre-compile  # This represents the maximum allowed positive difference between a newly received Global Time Base value and the current Local Time Base value [unit: seconds].
      float StbMTimeLeapPastThreshold [0..1]: 0..INF, multiplicity set at pre-compile, set at pre-compile  # This represents the maximum allowed negative difference between the current Local Time Base value and a newly received Global Time Base value [unit: seconds].
      reference StbMOffsetTimeBase [0..1]: multiplicity set at pre-compile, set at pre-compile, destination=StbMSynchronizedTimeBase  # This is the reference to the Synchronized Time-Base this Offset Time-Base is based on. This reference makes the containing StbMSynchronizedTimeBase an Offset Time-Base.
      reference StbMSourceTimeBase [0..1]: multiplicity set at pre-compile, set at pre-compile, destination=StbMSynchronizedTimeBase  # This is a reference to a Time Base, which the current Time Base is cloned from. This makes the referenced Time Base the source Time Base for cloning and the current Time the destination Time Base for cloning.
      container StbMLocalTimeClock [0..1]: multiplicity set at pre-compile  # References the hardware reference clock of this Synchronized Time Base.
        integer StbMClockFrequency [0..1]: 0..4294967295, multiplicity set at pre-compile, set at pre-compile  # Represents the frequency [Hz] of the HW reference clock used by the StbM.
        integer StbMClockPrescaler [0..1]: 0..4294967295, multiplicity set at pre-compile, set at pre-compile  # Represents the prescaler to calculate the resulting frequency of the HW reference clock used by the StbM.
        choice reference StbMLocalTimeHardware: multiplicity set at pre-compile, set at pre-compile, destination=[EthTSynGlobalTimeDomain, GptChannelConfiguration, OsCounter, CanTSynGlobalTimeDomain, StbMRbExternalCounter]  # Reference to the local time hardware.
      container StbMNotificationCustomer [0..*]: multiplicity set at pre-compile  # This container holds the configuration of a notification customer, which is notified is informed about the occurance of a Time-base related event.
        integer StbMNotificationCustomerId: 0..65535, set at pre-compile, symbolic-name-value=true  # Identification of a event notification customer.
        function name StbMTimeNotificationCallback [0..1]: multiplicity set at pre-compile, set at pre-compile  # Name of the customer specific notification callback function, which shall be called, if the time previously set by the customer is reached.
      container StbMTimeCorrection [0..1]: multiplicity set at pre-compile  # Collects the information relevant for the rate- and offset correction of a Time Base.
        boolean StbMAllowMasterRateCorrection [0..1]: multiplicity set at pre-compile, set at pre-compile, default-value=false  # This attribute describes whether the rate correction value of a Time Base can be set by StbM_SetRateCorrection(): | * false: the rate correction value can not be set by StbM_SetRateCorrection() * true: the rate correction value can be set by StbM_SetRateCorrection()
        integer StbMMasterRateDeviationMax [0..1]: 0..32000, multiplicity set at pre-compile, set at pre-compile, default-value=0  # This attribute describes the maximum allowed absolute value of the rate deviation value to be set by StbM_SetRateCorrection() [unit: ppm].
        float StbMOffsetCorrectionAdaptionInterval [0..1]: 0..INF, multiplicity set at pre-compile, set at pre-compile  # Defines the interval during which the adaptive rate correction cancels out the rate- and time deviation [unit: seconds].
        float StbMOffsetCorrectionJumpThreshold [0..1]: 0..INF, multiplicity set at pre-compile, set at pre-compile  # Threshold for the correction method. Deviations below this value will be corrected by a linear reduction over a defined timespan. Values equal- and greater than this value will be corrected by immediately setting the correct time- and rate in form of a jump [unit: seconds].
        float StbMRateCorrectionMeasurementDuration [0..1]: 0..INF, multiplicity set at pre-compile, set at pre-compile, default-value=1  # Definition of the time span [s] which is used to calculate the rate deviation.
        integer StbMRateCorrectionsPerMeasurementDuration [0..1]: 1..65535, multiplicity set at pre-compile, set at pre-compile, default-value=1  # Number of simultaneous rate measurements to determine the current rate deviation.
      container StbMTimeRecording [0..1]: multiplicity set at pre-compile  # Collects the information relevant for configuration of the precision measurement of a Time Base.
        function name StbMOffsetTimeRecordBlockCallback [0..1]: multiplicity set at pre-compile, set at pre-compile  # Name of the customer specific callback function, which shall be called, if a measurement data for a Offset Time Base are available.
        integer StbMOffsetTimeRecordTableBlockCount: 0..65535, set at pre-compile  # Represents the number of Blocks used for queing time measurement events for the Offset Time Base Record Table.
        function name StbMSyncTimeRecordBlockCallback [0..1]: multiplicity set at pre-compile, set at pre-compile  # Name of the customer specific callback function, which shall be called, if a measurement data for a Synchronized Time Base are available.
        integer StbMSyncTimeRecordTableBlockCount: 0..65535, set at pre-compile  # Represents the number of Blocks used for queing time measurement events for the Synchronized Time Base Record Table.
      container StbMTimeValidation [0..0]: multiplicity set at pre-compile  # Container with Time Validation configuration for Time Base
        integer StbMTimeValidationRecordTableBlockCount [0..0]: 0..65535, multiplicity set at pre-compile, set at pre-compile  # Size of record table for Time Validation (number of blocks)
    container StbMTriggeredCustomer [0..*]: multiplicity set at pre-compile  # The triggered customer is directly triggered by the Synchronized Time-base Manager by getting synchronized with the current (global) definition of time and passage of time.
      integer StbMTriggeredCustomerPeriod: 0..4294967295, set at pre-compile  # The triggering period of the triggered customer, called by the StbM_MainFunction. | The period is documented in microseconds.
      reference StbMOSScheduleTableRef: set at pre-compile, destination=OsScheduleTable  # Mandatory reference to synchronized OS ScheduleTable, which will be explicitly synchronized by the StbM.
      reference StbMSynchronizedTimeBaseRef: set at pre-compile, destination=StbMSynchronizedTimeBase  # Mandatory reference to the required synchronized time-base.
