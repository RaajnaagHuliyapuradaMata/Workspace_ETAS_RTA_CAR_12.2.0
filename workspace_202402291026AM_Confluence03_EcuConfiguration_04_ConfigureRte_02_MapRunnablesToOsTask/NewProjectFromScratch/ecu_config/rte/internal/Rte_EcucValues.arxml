AUTOSAR XML (schema 00051)
package /RTE
  module config Rte
    RteBswGeneral: RteSchMVersionInfoApi=0, RteUseComShadowSignalApi=0
    RteGeneration:
      RteBypassSupport = NONE
      RteCalibrationSupport = NONE
      RteCodeVendorId = 11
      RteDevErrorDetect = 0
      RteDevErrorDetectUninit = 0
      RteGenerationMode = COMPATIBILITY_MODE
      RteInExclusiveAreaCheckEnabled = 1
      RteMeasurementSupport = 0
      RteOptimizationMode = RUNTIME
      RteValueRangeCheckEnabled = 0
      RteVfbTraceAnonymousClientEnabled = 0
      RteVfbTraceEnabled = 0
    NoneSectionPolicies (RteInitializationBehavior): RteInitializationStrategy=RTE_INITIALIZATION_STRATEGY_NONE, RteSectionInitializationPolicy=NO-INIT
    RteOsInteraction
    DataDeclarationSectionPolicies (RteInitializationBehavior):
      RteInitializationStrategy = RTE_INITIALIZATION_STRATEGY_AT_DATA_DECLARATION
      RteSectionInitializationPolicy = INIT
      RteSectionInitializationPolicy = CLEARED
    RteStartSectionPolicies (RteInitializationBehavior):
      RteInitializationStrategy = RTE_INITIALIZATION_STRATEGY_AT_RTE_START_AND_PARTITION_RESTART
      RteSectionInitializationPolicy = POWER-ON-INIT
      RteSectionInitializationPolicy = POWER-ON-CLEARED
    CPT_MyReceivingSWC_ApplicationEcu (RteSwComponentInstance): RteSoftwareComponentInstanceRef=CPT_MyReceivingSWC_ApplicationEcu
      TE_RX (RteEventToTaskMapping): RtePositionInTask=1, RteImmediateRestart=0, RteActivationOffset=0.0, RteMappedToTaskRef=OsTask_ASW, RteEventRef=TE_RX
    CPT_MyTransmittingSWC_ApplicationEcu (RteSwComponentInstance): RteSoftwareComponentInstanceRef=CPT_MyTransmittingSWC_ApplicationEcu
      TE_TX (RteEventToTaskMapping): RtePositionInTask=2, RteImmediateRestart=0, RteActivationOffset=0.0, RteMappedToTaskRef=OsTask_ASW, RteEventRef=TE_TX
