AUTOSAR XML (schema 00048)
package /RB/RBA/rba_Emm/EcucModuleDefs
  module definition rba_Emm [0..1]: category=VENDOR_SPECIFIC_MODULE_DEFINITION, variants pre-compile  # MCAL Error Management Modul | Error management
    container rba_Emm_BistConfigSet [0..1]: multiplicity set at pre-compile  # BIST configuration
      container rba_Emm_BistSequence [1..*]: multiplicity set at pre-compile, requires-index=true  # BIST sequence | BIST sequence configuration
        string rba_Emm_BistCrcSeed [0..1]: multiplicity set at pre-compile, origin=RB, set at pre-compile, regular-expression=0[xX][0-9a-fA-F]{8}  # BIST CRC seed | The seed value for the BIST sequence CRC check
        container rba_Emm_BistJob [1..*]: multiplicity set at pre-compile, requires-index=true  # BIST job | BIST job configuration
          integer rba_Emm_BistController: 0.., multiplicity set at pre-compile, origin=RB, set at pre-compile  # BIST controller number | The number of the BIST contoller that shall run this job
          string rba_Emm_BistMemoryCut [0..1]: multiplicity set at pre-compile, origin=RB, set at pre-compile, regular-expression=[0-9,]+  # BIST memory cut | The memory cuts in case of MBIST job
          enumeration rba_Emm_BistMode: multiplicity set at pre-compile, origin=RB, set at pre-compile  # BIST mode | Select the type of BIST mode for this job
            SEQUENTIAL  # Sequential
            CONCURRENT  # Concurrent
          enumeration rba_Emm_BistType: {LBIST, MBIST, CBIST, ABIST, NBIST}, multiplicity set at pre-compile, origin=RB, set at pre-compile  # BIST type | Select the type of BIST for this job
    container rba_Emm_ConfigSet [0..1]: multiplicity set at pre-compile  # Error Handling Configuration | Error configuration for devices short name of this container must be always: rba_Emm_ConfigSet
      container rba_Emm_Error [1..*]: multiplicity set at pre-compile  # Error | Error Reaction Container See output folder (where rba_Emm_Report.txt is located) for the following files: rba_Emm_IfxErrorList40nmDevices.txt In these files you can find the supported error short names for your device.
        enumeration rba_Emm_ErrorAction: origin=RB, set at pre-compile  # Error Action | - for error description see hardware manual - for Reset action the ErrorPin set to true is needed
          NoActn  # No Action
          IRQ  # InterruptRequest (ST)
          IRQ{0..2}  # InterruptRequest{0..2} (IFX)
          NMI  # NMI (IFX)
          SEI  # SEI (ST)
          VSEI  # VSEI (ST)
          Reset
        enumeration rba_Emm_ErrorActionTo [0..*]: {CPU0, CPU1, CPU2, CPU3, CPU4, CPU5, DME, DSPH}, multiplicity set at pre-compile, origin=RB, requires-index=true, set at pre-compile  # Error Action Routing | Routing configuration of error action to cores. If an error notification is configured, it will be executed only on the first configured core.
        string rba_Emm_ErrorCEM0Enable [0..1]: multiplicity set at pre-compile, origin=RB, set at pre-compile, regular-expression=0[xX][0-9a-fA-F]{8}  # Error CEM0 Enable | Sets enable bits in first CEM register. Provide as a 32-bit hexadecimal value starting with "0x".
        string rba_Emm_ErrorCEM1Enable [0..1]: multiplicity set at pre-compile, origin=RB, set at pre-compile, regular-expression=0[xX][0-9a-fA-F]{8}  # Error CEM1 Enable | Sets enable bits in second CEM register. Provide as a 32-bit hexadecimal value starting with "0x".
        string rba_Emm_ErrorNotification [0..1]: multiplicity set at pre-compile, origin=RB, set at pre-compile  # Error Notification | The notification callback to be called if error becomes active
        string rba_Emm_ErrorNotificationHeader [0..1]: multiplicity set at pre-compile, origin=RB, set at pre-compile  # Error Notification header file | Header file that declares the configured notification callback function
        boolean rba_Emm_ErrorPin: origin=RB, set at pre-compile  # Error Pin | - for error description see hardware manual - for Reset action the ErrorPin set to true is needed
        boolean rba_Emm_ErrorTimeoutEnable [0..1]: multiplicity set at pre-compile, origin=RB, set at pre-compile, default-value=false  # Error Timeout Enable | Recoverable Fault Alarm Timeout Enable
        reference rba_Emm_ErrorPinReference [0..*]: multiplicity set at pre-compile, origin=RB, set at pre-compile, destination=rba_Emm_GeneralStConfigSet/rba_Emm_ErrorPinCfg  # Error Pin Reference | References the error pins that are affected by this alarm
    container rba_Emm_General: multiplicity set at pre-compile  # General Configuration | General configuration container
      boolean rba_Emm_DevErrorDetect: origin=RB, set at pre-compile  # Development error detection | Enables/disables the detection and notification of development errors. If this parameter is enabled, then extended error checking is performed during runtime; any errors detected by these checks are reported to the Det module. This feature should be switched off in series software.
    container rba_Emm_GeneralIfxConfigSet [0..1]: multiplicity set at pre-compile  # General Configuration IFX | General configuration for IFX devices
      string rba_Emm_AccessEnable [0..1]: multiplicity set at pre-compile, origin=RB, set at pre-compile, regular-expression=0[xX][0-9a-fA-F]{8}  # Access Enable Configuration | The Access Enable feature (SMU.ACCEN0) controls write access for transactions of SMU with the on-chip bus masters. The related bus masters (and their bit position in SMU.ACCEN0) for which access can be enabled/disabled are provided in device specification, chapter "On Chip Bus Master TAG Assignments". Provide the configuration value as a 32-bit hexadecimal string starting with "0x".
      container rba_Emm_ErrorPinCfg [0..1]: multiplicity set at pre-compile  # Error Pin Configuration | When this is set a Port Emergency Stop is automatically requested when an alarm event configured to start the Fault Signalling Protocol is detected.
        boolean rba_Emm_EnableAlternateExtAlrmInput [0..1]: multiplicity set at pre-compile, origin=RB, set at pre-compile, default-value=false  # Enable alternate external alarm input | Changes to input path from the Error Pin to the alternate input Port B.
        enumeration rba_Emm_ErrorPinMode [0..1]: multiplicity set at pre-compile, origin=RB, set at pre-compile  # Error Pin Mode | This switches the mode for the Error Pin.
          PushPull  # Push Pull
          OpenDrain  # Open Drain
    container rba_Emm_GeneralStConfigSet [0..1]: multiplicity set at pre-compile  # General Configuration ST | General configuration for ST devices
      integer rba_Emm_ErrorTimeout [0..1]: 1..4000, origin=RB, default-value=4000  # Error Timeout | The timeout timer value [us] for recoverable fault reactions.
      container rba_Emm_ErrorPinCfg [1..*]: multiplicity set at pre-compile, requires-index=true  # Error Pin Configuration | When this is set a Port Emergency Stop is automatically requested when an alarm event configured to start the Fault Signalling Protocol is detected.
        enumeration rba_Emm_ErrorPinId: multiplicity set at pre-compile, origin=RB, set at pre-compile  # Error Pin Id | The error pin configuration refers to the error pin with this given physical Id or to a software driven pin (identified by shortname)
          ErrorPin{0..3}  # Error Pin {0..3}
          SW  # Software
        enumeration rba_Emm_ErrorPinMode [0..1]: multiplicity set at pre-compile, origin=RB, set at pre-compile  # Error Pin Mode | This switches the mode for the Error Pin.
          PushPull  # Push Pull
          OpenDrain  # Open Drain
          NoOutput  # No output
        string rba_Emm_ErrorPinSafetyCriticalPin [0..*]: multiplicity set at pre-compile, origin=RB, set at pre-compile  # Error Pin Safety critical pin | Name of safety critical pin hardware connector that shall be asserted together with this error pin
        string rba_Emm_ErrorPinSoftwarePortPin [0..1]: multiplicity set at pre-compile, origin=RB, set at pre-compile  # Software driven error pin port pin | Name of software driven error pin port pin hardware connector
    container rba_Emm_IfxEccConfiguration [0..1]: multiplicity set at pre-compile  # ECC Configuration IFX | IFX ECC configuration
      boolean rba_Emm_EccRamAddrTrackOvfeConf: multiplicity set at pre-compile, origin=RB, set at pre-compile  # RAM Address Tracking overflow notification configuration | With this configuration it is possible to enable/disable the forwarding of the ETRR Overflow event as an alarm source to the UCE alarm. The Error information can be obtained via the ECCD.VALID bits and the EOV bit.
    container rba_Emm_IfxMonIntClockConfigSet [0..1]: multiplicity set at pre-compile  # Monitor Internal Clock IFX | Internal clock monitoring configuration for IFX
      boolean rba_Emm_ClockMonCfg [0..1]: multiplicity set at pre-compile, origin=RB, set at pre-compile  # Clock Monitoring Configuration | When this is set, the clock monitoring will be enable.
    container rba_Emm_IfxMonIntTempConfigSet [0..1]: multiplicity set at pre-compile  # Monitor Internal Temperature IFX | Internal temperature monitoring configuration for IFX
      integer rba_Emm_TempMonLowerLimit: 0.., origin=RB, set at pre-compile, default-value=514  # Die Temperature Measurement lower limit --> calculated decimal value (see description) | Lower Limit This bit field defines the lower limit of the DTS temerature check. The DTS measurement result is compared against this value and if the measurement result is smaller than LOWER bit LLU is set. To calculate the correct value use the following formula: RESULT = (Tj + 273.15) x 7.505
      integer rba_Emm_TempMonUpperLimit: 0.., origin=RB, set at pre-compile, default-value=935  # Die Temperature Measurement upper limit --> calculated decimal value (see description) | Upper Limit This bit field defines the upper limit of the DTS temperature check. The DTS measurement result is compared against this value and if the measurement result is greater than UPPER bit UOF is set. To calculate the correct value use the following formula: RESULT = (Tj + 273.15) x 7.505
    container rba_Emm_IfxMonIntVolConfigSet [0..1]: multiplicity set at pre-compile  # Monitor Internal Voltage IFX | Internal voltage monitoring configuration for IFX
      container rba_Emm_OverVolSuppCfg [0..1]: multiplicity set at pre-compile  # Over voltage supply | This is the overvoltage configuration.
        integer rba_Emm_13OverVolLimit [0..1]: multiplicity set at pre-compile, origin=RB, set at pre-compile, default-value=1430  # 1.3V over voltage limit - [in mV] | Overvoltage limit for the internal voltage monitor.
        integer rba_Emm_33OverVolLimit [0..1]: multiplicity set at pre-compile, origin=RB, set at pre-compile, default-value=3630  # 3.3V over voltage limit - [in mV] | Overvoltage limit for the internal voltage monitor.
        integer rba_Emm_50OverVolLimit [0..1]: multiplicity set at pre-compile, origin=RB, set at pre-compile, default-value=5500  # 5.0V over voltage limit - [in mV] | Overvoltage limit for the internal voltage monitor.
        integer rba_Emm_VddmAdcOverVolLimit [0..1]: multiplicity set at pre-compile, origin=RB, set at pre-compile, default-value=5561  # VDDM ADC supply over voltage limit - [in mV] | Overvoltage limit for the VDDM ADC supply secondary monitor.
        integer rba_Emm_VddpdEvrprOverVolLimit [0..1]: multiplicity set at pre-compile, origin=RB, set at pre-compile, default-value=1436  # VDDPD/EVRPR output over voltage limit - [in mV] | Overvoltage limit for the VDDPD supply secondary monitor.
        integer rba_Emm_VevrsbExtStandbyOverVolLimit [0..1]: multiplicity set at pre-compile, origin=RB, set at pre-compile, default-value=5561  # VEVRSB external standby supply over voltage limit - [in mV] | Overvoltage limit for the VEVRSB supply secondary monitor.
      container rba_Emm_UnderVolSuppCfg [0..1]: multiplicity set at pre-compile  # Under voltage supply [not configured by default - if configured, it has to be tested separately] | This is the undervoltage configuration.
        integer rba_Emm_13UnderVolLimit [0..1]: multiplicity set at pre-compile, origin=RB, set at pre-compile, default-value=1170  # 1.3V under voltage limit - [in mV] | Undervoltage limit for the internal voltage monitor.
        integer rba_Emm_33UnderVolLimit [0..1]: multiplicity set at pre-compile, origin=RB, set at pre-compile, default-value=2970  # 3.3V under voltage limit - [in mV] | Undervoltage limit for the internal voltage monitor.
        integer rba_Emm_50UnderVolLimit [0..1]: multiplicity set at pre-compile, origin=RB, set at pre-compile, default-value=4500  # 5.0V under voltage limit - [in mV] | Undervoltage limit for the internal voltage monitor.
        integer rba_Emm_VddmAdcUnderVolLimit [0..1]: multiplicity set at pre-compile, origin=RB, set at pre-compile, default-value=4570  # VDDM ADC supply under voltage limit - [in mV] | Undervoltage limit for the VDDM ADC supply secondary monitor.
        integer rba_Emm_VddmEvadcEdsadcUnderVolLimit [0..1]: multiplicity set at pre-compile, origin=RB, set at pre-compile, default-value=3800  # VDDM EVADC/EDSADC supply under voltage limit - [in mV] | Undervoltage limit for VDD for EVADC and EDSADC.
        integer rba_Emm_VddpdEvrprUnderVolLimit [0..1]: multiplicity set at pre-compile, origin=RB, set at pre-compile, default-value=1067  # VDDPD/EVRPR output under voltage limit - [in mV] | Undervoltage limit for the VDDPD supply secondary monitor.
        integer rba_Emm_VevrsbExtStandbyUnderVolLimit [0..1]: multiplicity set at pre-compile, origin=RB, set at pre-compile, default-value=4570  # VEVRSB external standby supply under voltage limit - [in mV] | Undervoltage limit for the VEVRSB supply secondary monitor.
      container rba_Emm_VOLFIL_MAXSwitch [0..1]: multiplicity set at pre-compile  # Voltage Filter Configuration | Voltage filter configuration
        boolean rba_Emm_VDDEVRCFIL_MAXSwitchEnable: multiplicity set at pre-compile, origin=RB, set at pre-compile  # VDD Filter Configuration Enable (EVRCFIL) | Register reset value is 0.53 μs (EVRCFIL = 0). By setting this parameter to true it is set to the maximum of 48.53 μs (EVRCFIL = 0xF).
        boolean rba_Emm_VDDPREFIL_MAXSwitchEnable: multiplicity set at pre-compile, origin=RB, set at pre-compile  # VDDPD Filter Configuration Enable (PREFIL) | Register reset value is 0.53 μs (PREFIL = 0). By setting this parameter to true it is set to the maximum of 48.53 μs (PREFIL = 0xF).
        boolean rba_Emm_VDD_EVR33FIL_MAXSwitchEnable: multiplicity set at pre-compile, origin=RB, set at pre-compile  # VDDP3 Filter Configuration Enable (EVR33FIL) | Register reset value is 0.53 μs (EVR33FIL = 0). By setting this parameter to true it is set to the maximum of 48.53 μs (EVR33FIL = 0xF).
        boolean rba_Emm_VDD_M_FIL_MAXSwitchEnable: multiplicity set at pre-compile, origin=RB, set at pre-compile  # VDDM Filter Configuration Enable (VDDMFIL) | Register reset value is 0.53 μs (VDDMFIL = 0). By setting this parameter to true it is set to the maximum of 48.53 μs (VDDMFIL = 0xF).
        boolean rba_Emm_VDD_SWB_FIL_MAXSwitchEnable: multiplicity set at pre-compile, origin=RB, set at pre-compile  # VEVRSB Filter Configuration Enable (SBFIL) | Register reset value is 0.53 μs (SBFIL = 0). By setting this parameter to true it is set to the maximum of 48.53 μs (SBFIL = 0xF).
        boolean rba_Emm_VDD_SWDFIL_MAXSwitchEnable: multiplicity set at pre-compile, origin=RB, set at pre-compile  # VEXT Filter Configuration Enable (SWDFIL) | Register reset value is 0.53 μs (SWDFIL = 0). By setting this parameter to true it is set to the maximum of 48.53 μs (SWDFIL = 0xF).
        boolean rba_Emm_VoltageFix_TC3xx_CY329_Enable: multiplicity set at pre-compile, origin=RB, set at pre-compile  # VDDM TC3xx-CY329 Workaround Enable | This switch shall be enabled for projects which work on one trip MIL indication. During ECU undervoltage conditions the voltage regulator FET is full open and with a sudden voltage increase the control loop in the ASIC needs some time to regulate the VDD5 and therefore an overshoot will occur. During the controller startup consider the voltage has breached the register reset value of EVROVMON. Because of that alarm is already active before EVRMONCTRL and EVRMONFILT are set. In this case Infineon confirmed that alarm coming at startup shall be cleared once based on the project need as a workaround. The project has to ensure that supply dynamics do not harm the controller.
    container rba_Emm_StMonIntClockConfigSet [0..1]: multiplicity set at pre-compile  # Monitor Internal Clock ST | Internal clock monitoring configuration for ST
      string rba_Emm_ClockMonAlarmDisabled [0..*]: multiplicity set at pre-compile, origin=RB, set at pre-compile  # Clock Monitor alarm disabled | Provide the name of the clock monitor that shall not report a monitoring fault to the alarm handler. Initially, if rba_Emm_ClockMonCfg is set to true, all available clock monitors will be connected to the alarm handler. If needed the user can exclude specific monitors by using this configuration parameter. For a list of all supported clock monitors see generated report file rba_Emm_Report.txt
      boolean rba_Emm_ClockMonCfg [0..1]: multiplicity set at pre-compile, origin=RB, set at pre-compile  # Clock Monitoring Configuration | When this is set, the clock monitoring will be enable.
    container rba_Emm_StMonIntTempConfigSet [0..1]: multiplicity set at pre-compile  # Monitor Internal Temperature ST | Internal temperature monitoring configuration for ST
      string rba_Emm_TempMonAlarmDisabled [0..*]: multiplicity set at pre-compile, origin=RB, set at pre-compile  # Temperature Monitor alarm disabled | Provide the name of the temperature monitor that shall not report a monitoring fault to the alarm handler. Initially, if rba_Emm_TempMonCfg is set to true, all available temperature monitors will be connected to the alarm handler. If needed the user can exclude specific monitors by using this configuration parameter. Available temperature monitors are: FIXED_TEMP_MON0, FIXED_TEMP_MON1, FIXED_TEMP_MON2, TEMP0_COMPARATOR0, TEMP0_COMPARATOR1, TEMP0_COMPARATOR2
      boolean rba_Emm_TempMonCfg [0..1]: multiplicity set at pre-compile, origin=RB, set at pre-compile  # Temperature Monitoring Configuration | When this is set, the temperature monitoring will be enable.
    container rba_Emm_StMonIntVolConfigSet [0..1]: multiplicity set at pre-compile  # Monitor Internal Voltage ST | Internal voltage monitoring configuration for ST
      string rba_Emm_VolMonAlarmDisabled [0..*]: multiplicity set at pre-compile, origin=RB, set at pre-compile  # Voltage Monitor alarm disabled | Provide the name of the voltage monitor that shall not report a monitoring fault to the alarm handler. Initially, if rba_Emm_VolMonCfg is set to true, all available voltage monitors will be connected to the alarm handler. If needed the user can exclude specific monitors by using this configuration parameter. For a list of all supported voltage monitors see generated report file rba_Emm_Report.txt
      boolean rba_Emm_VolMonCfg [0..1]: multiplicity set at pre-compile, origin=RB, set at pre-compile  # Voltage Monitoring Configuration | When this is set, the voltage monitoring will be enable.
