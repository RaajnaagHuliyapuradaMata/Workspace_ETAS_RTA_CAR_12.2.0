AUTOSAR XML (schema 4-2-2)
package /RB/RBA/rba_MemLibVal/EcucModuleDefs
  module definition rba_MemLibVal [0..1]: category=VENDOR_SPECIFIC_MODULE_DEFINITION, variants pre-compile  # Memory: Library Validation | Validation part of the rba_MemLib
    container rba_MemLibValComp [0..255]: multiplicity set at pre-compile  # Validation Component Name | Validation information generated by the component in shortname
      string rba_MemLibValMessageErr [0..255]: multiplicity set at pre-compile, origin=RB:21.0.0:2022-12-01, set at pre-compile  # Validation Error Message | Validation error message
      string rba_MemLibValMessageWarn [0..255]: multiplicity set at pre-compile, origin=RB:21.0.0:2022-12-01, set at pre-compile  # Validation Warning Message | Validation warning message
