AUTOSAR XML (schema 00051)
package /System
  composition sw component type TopLevelComposition
    component CPT_MySWC_ApplicationECU: type=MySWC
    component CPT_MySWC_TestECU: type=MySWC
    connect CPT_MySWC_ApplicationECU.PPortPrototype_0 -> CPT_MySWC_TestECU.RPortPrototype_0
    connect CPT_MySWC_TestECU.PPortPrototype_0 -> CPT_MySWC_ApplicationECU.RPortPrototype_0
