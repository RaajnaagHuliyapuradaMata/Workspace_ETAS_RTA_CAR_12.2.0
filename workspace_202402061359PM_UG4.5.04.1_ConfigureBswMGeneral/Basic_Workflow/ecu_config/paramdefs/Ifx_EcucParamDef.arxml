AUTOSAR XML (schema 4-2-2)
package /AUTOSAR_Ifx/EcucModuleDefs
  module definition Ifx [0..1]: category=VENDOR_SPECIFIC_MODULE_DEFINITION, refined-module-def=Ifx, variants pre-compile  # Fixed Point Interpolation Library
    container IfxGeneral  # General settings for Ifx | General settings for Ifx with selections for used controller and activation of GetVersionInfo interface
      enumeration IfxRbOptimization [0..1]: multiplicity set at pre-compile, origin=RB:1.0.0:2010-12-15, set at pre-compile  # Select for which controller optimized implementations shall be used
        TC17xx  # Tricore TC17xx controller
        TC27xx  # Tricore TC27xx controller
        MPC57xx  # JDP MPC57xx controller
        MPCCut2  # JDP MPC Cut2 controller
        ARMV8X32  # ARMV8X32 controllers
        NO_OPTIMIZATION  # No optimization, standard C implementations shall be used
      boolean IfxRbOptimizationMcuExtract [0..1]: multiplicity set at pre-compile, origin=RB:10.0.0:2015-06-18, set at pre-compile, default-value=false  # Select whether to fetch machine type from MCU and configure for controller optimized implementation | If IfxRbOptimizationMcuExtract is chosen as "True", then the controller information will be extracted from MCU.Based on this, optimized implementations will be selected.Hence the user should not configure "IfxRbOptimization".If IfxRbOptimizationMcuExtract is chosen as "False", the controller information will not be extracted from MCU and so the user needs to configure "IfxRbOptimization" manually.
      enumeration Ifx_ASAM_VersionUsed: origin=RB:4.0.0:2023-01-01, set at pre-compile, default-value=IFX_ASAM_VERSION_1_7  # Configuration parameter for selection of ASAM version used. | If Ifx_ASAM_VersionUsed is set to "IFX_ASAM_VERSION_1_6", Address Recalculation function call for Interpolation Maps/Curves services shall support downscaling/resizing for ASAM 1.6 in the Ifx library. If Ifx_ASAM_VersionUsed is set to "IFX_ASAM_VERSION_1_7", Normal function call for Interpolation Maps/Curves services shall support for ASAM 1.7 in the Ifx library
        IFX_ASAM_VERSION_1_6  # ASAM version 1.6 used.
        IFX_ASAM_VERSION_1_7  # ASAM version 1.7 used.
      enumeration Ifx_VersionInfoAPI: origin=RB:1.0.0:2010-12-15, set at pre-compile  # Configuration parameter for activation of Ifx_GetVersionInfo function. | If IfxVersionInfoAPI is set to "ON", the function IfxGetVersionInfo shall return the version information of the Ifx library. If IfxVersionInfoAPI is set to "OFF", the Ifx library shall not provide the function Ifx_GetVersionInfo
        ON  # Activate IfxGetVersionInfo function.
        OFF  # Deactivate IfxGetVersionInfo function.
    container IfxRbMemoryLocations  # Memory locations | Choose memory location settings for each single service
      enumeration ifxRbMemLocDPSearchs16: origin=RB:1.0.0:2010-12-17, set at pre-compile  # Ifx_DPSearch_s16 | Select one of following values: NORMAL for location in normal flash, FAST for location in fast flash, SLOW for location in slow flash, INLINE for inlining of the service
        NORMAL  # Location in normal flash
        FAST  # Location in fast flash
        SLOW  # Location in slow flash
        INLINE  # Service is inlined
      enumeration ifxRbMemLocDPSearchs32: origin=RB:1.0.0:2023-03-15, set at pre-compile  # Ifx_DPSearch_s32 | Select one of following values: NORMAL for location in normal flash, FAST for location in fast flash, SLOW for location in slow flash, INLINE for inlining of the service
        NORMAL  # Location in normal flash
        FAST  # Location in fast flash
        SLOW  # Location in slow flash
        INLINE  # Service is inlined
      enumeration ifxRbMemLocDPSearchs8: origin=RB:1.0.0:2010-12-17, set at pre-compile  # Ifx_DPSearch_s8 | Select one of following values: NORMAL for location in normal flash, FAST for location in fast flash, SLOW for location in slow flash, INLINE for inlining of the service
        NORMAL  # Location in normal flash
        FAST  # Location in fast flash
        SLOW  # Location in slow flash
        INLINE  # Service is inlined
      enumeration ifxRbMemLocDPSearchu16: origin=RB:1.0.0:2010-12-17, set at pre-compile  # Ifx_DPSearch_u16 | Select one of following values: NORMAL for location in normal flash, FAST for location in fast flash, SLOW for location in slow flash, INLINE for inlining of the service
        NORMAL  # Location in normal flash
        FAST  # Location in fast flash
        SLOW  # Location in slow flash
        INLINE  # Service is inlined
      enumeration ifxRbMemLocDPSearchu32: origin=RB:1.0.0:2023-03-15, set at pre-compile  # Ifx_DPSearch_u32 | Select one of following values: NORMAL for location in normal flash, FAST for location in fast flash, SLOW for location in slow flash, INLINE for inlining of the service
        NORMAL  # Location in normal flash
        FAST  # Location in fast flash
        SLOW  # Location in slow flash
        INLINE  # Service is inlined
      enumeration ifxRbMemLocDPSearchu8: origin=RB:1.0.0:2010-12-17, set at pre-compile  # Ifx_DPSearch_u8 | Select one of following values: NORMAL for location in normal flash, FAST for location in fast flash, SLOW for location in slow flash, INLINE for inlining of the service
        NORMAL  # Location in normal flash
        FAST  # Location in fast flash
        SLOW  # Location in slow flash
        INLINE  # Service is inlined
      enumeration ifxRbMemLocIntIpoCurs16s16: origin=RB:1.0.0:2010-12-17, set at pre-compile  # Ifx_IntIpoCur_s16_s16 | Select one of following values: NORMAL for location in normal flash, FAST for location in fast flash, SLOW for location in slow flash, INLINE for inlining of the service
        NORMAL  # Location in normal flash
        FAST  # Location in fast flash
        SLOW  # Location in slow flash
        INLINE  # Service is inlined
      enumeration ifxRbMemLocIntIpoCurs16s8: origin=RB:1.0.0:2010-12-17, set at pre-compile  # Ifx_IntIpoCur_s16_s8 | Select one of following values: NORMAL for location in normal flash, FAST for location in fast flash, SLOW for location in slow flash, INLINE for inlining of the service
        NORMAL  # Location in normal flash
        FAST  # Location in fast flash
        SLOW  # Location in slow flash
        INLINE  # Service is inlined
      enumeration ifxRbMemLocIntIpoCurs16u16: origin=RB:1.0.0:2010-12-17, set at pre-compile  # Ifx_IntIpoCur_s16_u16 | Select one of following values: NORMAL for location in normal flash, FAST for location in fast flash, SLOW for location in slow flash, INLINE for inlining of the service
        NORMAL  # Location in normal flash
        FAST  # Location in fast flash
        SLOW  # Location in slow flash
        INLINE  # Service is inlined
      enumeration ifxRbMemLocIntIpoCurs16u8: origin=RB:1.0.0:2010-12-17, set at pre-compile  # Ifx_IntIpoCur_s16_u8 | Select one of following values: NORMAL for location in normal flash, FAST for location in fast flash, SLOW for location in slow flash, INLINE for inlining of the service
        NORMAL  # Location in normal flash
        FAST  # Location in fast flash
        SLOW  # Location in slow flash
        INLINE  # Service is inlined
      enumeration ifxRbMemLocIntIpoCurs32s32: origin=RB:1.0.0:2023-03-15, set at pre-compile  # Ifx_IntIpoCur_s32_s32 | Select one of following values: NORMAL for location in normal flash, FAST for location in fast flash, SLOW for location in slow flash, INLINE for inlining of the service
        NORMAL  # Location in normal flash
        FAST  # Location in fast flash
        SLOW  # Location in slow flash
        INLINE  # Service is inlined
      enumeration ifxRbMemLocIntIpoCurs8s16: origin=RB:1.0.0:2010-12-17, set at pre-compile  # Ifx_IntIpoCur_s8_s16 | Select one of following values: NORMAL for location in normal flash, FAST for location in fast flash, SLOW for location in slow flash, INLINE for inlining of the service
        NORMAL  # Location in normal flash
        FAST  # Location in fast flash
        SLOW  # Location in slow flash
        INLINE  # Service is inlined
      enumeration ifxRbMemLocIntIpoCurs8s8: origin=RB:1.0.0:2010-12-17, set at pre-compile  # Ifx_IntIpoCur_s8_s8 | Select one of following values: NORMAL for location in normal flash, FAST for location in fast flash, SLOW for location in slow flash, INLINE for inlining of the service
        NORMAL  # Location in normal flash
        FAST  # Location in fast flash
        SLOW  # Location in slow flash
        INLINE  # Service is inlined
      enumeration ifxRbMemLocIntIpoCurs8u16: origin=RB:1.0.0:2010-12-17, set at pre-compile  # Ifx_IntIpoCur_s8_u16 | Select one of following values: NORMAL for location in normal flash, FAST for location in fast flash, SLOW for location in slow flash, INLINE for inlining of the service
        NORMAL  # Location in normal flash
        FAST  # Location in fast flash
        SLOW  # Location in slow flash
        INLINE  # Service is inlined
      enumeration ifxRbMemLocIntIpoCurs8u8: origin=RB:1.0.0:2010-12-17, set at pre-compile  # Ifx_IntIpoCur_s8_u8 | Select one of following values: NORMAL for location in normal flash, FAST for location in fast flash, SLOW for location in slow flash, INLINE for inlining of the service
        NORMAL  # Location in normal flash
        FAST  # Location in fast flash
        SLOW  # Location in slow flash
        INLINE  # Service is inlined
      enumeration ifxRbMemLocIntIpoCuru16s16: origin=RB:1.0.0:2010-12-17, set at pre-compile  # Ifx_IntIpoCur_u16_s16 | Select one of following values: NORMAL for location in normal flash, FAST for location in fast flash, SLOW for location in slow flash, INLINE for inlining of the service
        NORMAL  # Location in normal flash
        FAST  # Location in fast flash
        SLOW  # Location in slow flash
        INLINE  # Service is inlined
      enumeration ifxRbMemLocIntIpoCuru16s8: origin=RB:1.0.0:2010-12-17, set at pre-compile  # Ifx_IntIpoCur_u16_s8 | Select one of following values: NORMAL for location in normal flash, FAST for location in fast flash, SLOW for location in slow flash, INLINE for inlining of the service
        NORMAL  # Location in normal flash
        FAST  # Location in fast flash
        SLOW  # Location in slow flash
        INLINE  # Service is inlined
      enumeration ifxRbMemLocIntIpoCuru16u16: origin=RB:1.0.0:2010-12-17, set at pre-compile  # Ifx_IntIpoCur_u16_u16 | Select one of following values: NORMAL for location in normal flash, FAST for location in fast flash, SLOW for location in slow flash, INLINE for inlining of the service
        NORMAL  # Location in normal flash
        FAST  # Location in fast flash
        SLOW  # Location in slow flash
        INLINE  # Service is inlined
      enumeration ifxRbMemLocIntIpoCuru16u8: origin=RB:1.0.0:2010-12-17, set at pre-compile  # Ifx_IntIpoCur_u16_u8 | Select one of following values: NORMAL for location in normal flash, FAST for location in fast flash, SLOW for location in slow flash, INLINE for inlining of the service
        NORMAL  # Location in normal flash
        FAST  # Location in fast flash
        SLOW  # Location in slow flash
        INLINE  # Service is inlined
      enumeration ifxRbMemLocIntIpoCuru32u32: origin=RB:1.0.0:2023-03-15, set at pre-compile  # Ifx_IntIpoCur_u32_u32 | Select one of following values: NORMAL for location in normal flash, FAST for location in fast flash, SLOW for location in slow flash, INLINE for inlining of the service
        NORMAL  # Location in normal flash
        FAST  # Location in fast flash
        SLOW  # Location in slow flash
        INLINE  # Service is inlined
      enumeration ifxRbMemLocIntIpoCuru8s16: origin=RB:1.0.0:2010-12-17, set at pre-compile  # Ifx_IntIpoCur_u8_s16 | Select one of following values: NORMAL for location in normal flash, FAST for location in fast flash, SLOW for location in slow flash, INLINE for inlining of the service
        NORMAL  # Location in normal flash
        FAST  # Location in fast flash
        SLOW  # Location in slow flash
        INLINE  # Service is inlined
      enumeration ifxRbMemLocIntIpoCuru8s8: origin=RB:1.0.0:2010-12-17, set at pre-compile  # Ifx_IntIpoCur_u8_s8 | Select one of following values: NORMAL for location in normal flash, FAST for location in fast flash, SLOW for location in slow flash, INLINE for inlining of the service
        NORMAL  # Location in normal flash
        FAST  # Location in fast flash
        SLOW  # Location in slow flash
        INLINE  # Service is inlined
      enumeration ifxRbMemLocIntIpoCuru8u16: origin=RB:1.0.0:2010-12-17, set at pre-compile  # Ifx_IntIpoCur_u8_u16 | Select one of following values: NORMAL for location in normal flash, FAST for location in fast flash, SLOW for location in slow flash, INLINE for inlining of the service
        NORMAL  # Location in normal flash
        FAST  # Location in fast flash
        SLOW  # Location in slow flash
        INLINE  # Service is inlined
      enumeration ifxRbMemLocIntIpoCuru8u8: origin=RB:1.0.0:2010-12-17, set at pre-compile  # Ifx_IntIpoCur_u8_u8 | Select one of following values: NORMAL for location in normal flash, FAST for location in fast flash, SLOW for location in slow flash, INLINE for inlining of the service
        NORMAL  # Location in normal flash
        FAST  # Location in fast flash
        SLOW  # Location in slow flash
        INLINE  # Service is inlined
      enumeration ifxRbMemLocIntIpoFixCurs16s16: origin=RB:1.0.0:2010-12-17, set at pre-compile  # Ifx_IntIpoFixCur_s16_s16 | Select one of following values: NORMAL for location in normal flash, FAST for location in fast flash, SLOW for location in slow flash
        NORMAL  # Location in normal flash
        FAST  # Location in fast flash
        SLOW  # Location in slow flash
      enumeration ifxRbMemLocIntIpoFixCurs32s32: origin=RB:1.0.0:2023-05-29, set at pre-compile  # Ifx_IntIpoFixCur_s32_s32 | Select one of following values: NORMAL for location in normal flash, FAST for location in fast flash, SLOW for location in slow flash, INLINE for inlining of the service
        NORMAL  # Location in normal flash
        FAST  # Location in fast flash
        SLOW  # Location in slow flash
        INLINE  # Service is inlined
      enumeration ifxRbMemLocIntIpoFixCurs8s8: origin=RB:1.0.0:2010-12-17, set at pre-compile  # Ifx_IntIpoFixCur_s8_s8 | Select one of following values: NORMAL for location in normal flash, FAST for location in fast flash, SLOW for location in slow flash
        NORMAL  # Location in normal flash
        FAST  # Location in fast flash
        SLOW  # Location in slow flash
      enumeration ifxRbMemLocIntIpoFixCuru16u16: origin=RB:1.0.0:2010-12-17, set at pre-compile  # Ifx_IntIpoFixCur_u16_u16 | Select one of following values: NORMAL for location in normal flash, FAST for location in fast flash, SLOW for location in slow flash
        NORMAL  # Location in normal flash
        FAST  # Location in fast flash
        SLOW  # Location in slow flash
      enumeration ifxRbMemLocIntIpoFixCuru32u32: origin=RB:1.0.0:2023-05-29, set at pre-compile  # Ifx_IntIpoFixCur_u32_u32 | Select one of following values: NORMAL for location in normal flash, FAST for location in fast flash, SLOW for location in slow flash, INLINE for inlining of the service
        NORMAL  # Location in normal flash
        FAST  # Location in fast flash
        SLOW  # Location in slow flash
        INLINE  # Service is inlined
      enumeration ifxRbMemLocIntIpoFixCuru8u8: origin=RB:1.0.0:2010-12-17, set at pre-compile  # Ifx_IntIpoFixCur_u8_u8 | Select one of following values: NORMAL for location in normal flash, FAST for location in fast flash, SLOW for location in slow flash
        NORMAL  # Location in normal flash
        FAST  # Location in fast flash
        SLOW  # Location in slow flash
      enumeration ifxRbMemLocIntIpoFixICurs16s16: origin=RB:1.0.0:2010-12-17, set at pre-compile  # Ifx_IntIpoFixICur_s16_s16 | Select one of following values: NORMAL for location in normal flash, FAST for location in fast flash, SLOW for location in slow flash
        NORMAL  # Location in normal flash
        FAST  # Location in fast flash
        SLOW  # Location in slow flash
      enumeration ifxRbMemLocIntIpoFixICurs8s8: origin=RB:1.0.0:2010-12-17, set at pre-compile  # Ifx_IntIpoFixICur_s8_s8 | Select one of following values: NORMAL for location in normal flash, FAST for location in fast flash, SLOW for location in slow flash
        NORMAL  # Location in normal flash
        FAST  # Location in fast flash
        SLOW  # Location in slow flash
      enumeration ifxRbMemLocIntIpoFixICuru16u16: origin=RB:1.0.0:2010-12-17, set at pre-compile  # Ifx_IntIpoFixICur_u16_u16 | Select one of following values: NORMAL for location in normal flash, FAST for location in fast flash, SLOW for location in slow flash
        NORMAL  # Location in normal flash
        FAST  # Location in fast flash
        SLOW  # Location in slow flash
      enumeration ifxRbMemLocIntIpoFixICuru32u32: origin=RB:1.0.0:2023-05-29, set at pre-compile  # Ifx_IntIpoFixICur_u32_u32 | Select one of following values: NORMAL for location in normal flash, FAST for location in fast flash, SLOW for location in slow flash, INLINE for inlining of the service
        NORMAL  # Location in normal flash
        FAST  # Location in fast flash
        SLOW  # Location in slow flash
        INLINE  # Service is inlined
      enumeration ifxRbMemLocIntIpoFixICuru8u8: origin=RB:1.0.0:2010-12-17, set at pre-compile  # Ifx_IntIpoFixICur_u8_u8 | Select one of following values: NORMAL for location in normal flash, FAST for location in fast flash, SLOW for location in slow flash
        NORMAL  # Location in normal flash
        FAST  # Location in fast flash
        SLOW  # Location in slow flash
      enumeration ifxRbMemLocIntIpoFixIMaps16s16s16: origin=RB:1.0.0:2010-12-17, set at pre-compile  # Ifx_IntIpoFixIMap_s16s16_s16 | Select one of following values: NORMAL for location in normal flash, FAST for location in fast flash, SLOW for location in slow flash
        NORMAL  # Location in normal flash
        FAST  # Location in fast flash
        SLOW  # Location in slow flash
      enumeration ifxRbMemLocIntIpoFixIMaps8s8s8: origin=RB:1.0.0:2010-12-17, set at pre-compile  # Ifx_IntIpoFixIMap_s8s8_s8 | Select one of following values: NORMAL for location in normal flash, FAST for location in fast flash, SLOW for location in slow flash
        NORMAL  # Location in normal flash
        FAST  # Location in fast flash
        SLOW  # Location in slow flash
      enumeration ifxRbMemLocIntIpoFixIMapu16u16u16: origin=RB:1.0.0:2010-12-17, set at pre-compile  # Ifx_IntIpoFixIMap_u16u16_u16 | Select one of following values: NORMAL for location in normal flash, FAST for location in fast flash, SLOW for location in slow flash
        NORMAL  # Location in normal flash
        FAST  # Location in fast flash
        SLOW  # Location in slow flash
      enumeration ifxRbMemLocIntIpoFixIMapu8u8u8: origin=RB:1.0.0:2010-12-17, set at pre-compile  # Ifx_IntIpoFixIMap_u8u8_u8 | Select one of following values: NORMAL for location in normal flash, FAST for location in fast flash, SLOW for location in slow flash
        NORMAL  # Location in normal flash
        FAST  # Location in fast flash
        SLOW  # Location in slow flash
      enumeration ifxRbMemLocIntIpoFixMaps16s16s16: origin=RB:1.0.0:2010-12-17, set at pre-compile  # Ifx_IntIpoFixMap_s16s16_s16 | Select one of following values: NORMAL for location in normal flash, FAST for location in fast flash, SLOW for location in slow flash
        NORMAL  # Location in normal flash
        FAST  # Location in fast flash
        SLOW  # Location in slow flash
      enumeration ifxRbMemLocIntIpoFixMaps8s8s8: origin=RB:1.0.0:2010-12-17, set at pre-compile  # Ifx_IntIpoFixMap_s8s8_s8 | Select one of following values: NORMAL for location in normal flash, FAST for location in fast flash, SLOW for location in slow flash
        NORMAL  # Location in normal flash
        FAST  # Location in fast flash
        SLOW  # Location in slow flash
      enumeration ifxRbMemLocIntIpoFixMapu16u16u16: origin=RB:1.0.0:2010-12-17, set at pre-compile  # Ifx_IntIpoFixMap_u16u16_u16 | Select one of following values: NORMAL for location in normal flash, FAST for location in fast flash, SLOW for location in slow flash
        NORMAL  # Location in normal flash
        FAST  # Location in fast flash
        SLOW  # Location in slow flash
      enumeration ifxRbMemLocIntIpoFixMapu8u8u8: origin=RB:1.0.0:2010-12-17, set at pre-compile  # Ifx_IntIpoFixMap_u8u8_u8 | Select one of following values: NORMAL for location in normal flash, FAST for location in fast flash, SLOW for location in slow flash
        NORMAL  # Location in normal flash
        FAST  # Location in fast flash
        SLOW  # Location in slow flash
      enumeration ifxRbMemLocIntIpoMaps16s16s16: origin=RB:1.0.0:2010-12-17, set at pre-compile  # Ifx_IntIpoMap_s16s16_s16 | Select one of following values: NORMAL for location in normal flash, FAST for location in fast flash, SLOW for location in slow flash, INLINE for inlining of the service
        NORMAL  # Location in normal flash
        FAST  # Location in fast flash
        SLOW  # Location in slow flash
        INLINE  # Service is inlined
      enumeration ifxRbMemLocIntIpoMaps16s16s8: origin=RB:1.0.0:2010-12-17, set at pre-compile  # Ifx_IntIpoMap_s16s16_s8 | Select one of following values: NORMAL for location in normal flash, FAST for location in fast flash, SLOW for location in slow flash, INLINE for inlining of the service
        NORMAL  # Location in normal flash
        FAST  # Location in fast flash
        SLOW  # Location in slow flash
        INLINE  # Service is inlined
      enumeration ifxRbMemLocIntIpoMaps16s16u16: origin=RB:1.0.0:2010-12-17, set at pre-compile  # Ifx_IntIpoMap_s16s16_u16 | Select one of following values: NORMAL for location in normal flash, FAST for location in fast flash, SLOW for location in slow flash, INLINE for inlining of the service
        NORMAL  # Location in normal flash
        FAST  # Location in fast flash
        SLOW  # Location in slow flash
        INLINE  # Service is inlined
      enumeration ifxRbMemLocIntIpoMaps16s16u8: origin=RB:1.0.0:2010-12-17, set at pre-compile  # Ifx_IntIpoMap_s16s16_u8 | Select one of following values: NORMAL for location in normal flash, FAST for location in fast flash, SLOW for location in slow flash, INLINE for inlining of the service
        NORMAL  # Location in normal flash
        FAST  # Location in fast flash
        SLOW  # Location in slow flash
        INLINE  # Service is inlined
      enumeration ifxRbMemLocIntIpoMaps16s8s16: origin=RB:1.0.0:2010-12-17, set at pre-compile  # Ifx_IntIpoMap_s16s8_s16 | Select one of following values: NORMAL for location in normal flash, FAST for location in fast flash, SLOW for location in slow flash
        NORMAL  # Location in normal flash
        FAST  # Location in fast flash
        SLOW  # Location in slow flash
      enumeration ifxRbMemLocIntIpoMaps16s8s8: origin=RB:1.0.0:2010-12-17, set at pre-compile  # Ifx_IntIpoMap_s16s8_s8 | Select one of following values: NORMAL for location in normal flash, FAST for location in fast flash, SLOW for location in slow flash
        NORMAL  # Location in normal flash
        FAST  # Location in fast flash
        SLOW  # Location in slow flash
      enumeration ifxRbMemLocIntIpoMaps16s8u16: origin=RB:1.0.0:2010-12-17, set at pre-compile  # Ifx_IntIpoMap_s16s8_u16 | Select one of following values: NORMAL for location in normal flash, FAST for location in fast flash, SLOW for location in slow flash
        NORMAL  # Location in normal flash
        FAST  # Location in fast flash
        SLOW  # Location in slow flash
      enumeration ifxRbMemLocIntIpoMaps16s8u8: origin=RB:1.0.0:2010-12-17, set at pre-compile  # Ifx_IntIpoMap_s16s8_u8 | Select one of following values: NORMAL for location in normal flash, FAST for location in fast flash, SLOW for location in slow flash
        NORMAL  # Location in normal flash
        FAST  # Location in fast flash
        SLOW  # Location in slow flash
      enumeration ifxRbMemLocIntIpoMaps16u8s16: origin=RB:1.0.0:2010-12-17, set at pre-compile  # Ifx_IntIpoMap_s16u8_s16 | Select one of following values: NORMAL for location in normal flash, FAST for location in fast flash, SLOW for location in slow flash, INLINE for inlining of the service
        NORMAL  # Location in normal flash
        FAST  # Location in fast flash
        SLOW  # Location in slow flash
        INLINE  # Service is inlined
      enumeration ifxRbMemLocIntIpoMaps16u8s8: origin=RB:1.0.0:2010-12-17, set at pre-compile  # Ifx_IntIpoMap_s16u8_s8 | Select one of following values: NORMAL for location in normal flash, FAST for location in fast flash, SLOW for location in slow flash
        NORMAL  # Location in normal flash
        FAST  # Location in fast flash
        SLOW  # Location in slow flash
      enumeration ifxRbMemLocIntIpoMaps16u8u16: origin=RB:1.0.0:2010-12-17, set at pre-compile  # Ifx_IntIpoMap_s16u8_u16 | Select one of following values: NORMAL for location in normal flash, FAST for location in fast flash, SLOW for location in slow flash, INLINE for inlining of the service
        NORMAL  # Location in normal flash
        FAST  # Location in fast flash
        SLOW  # Location in slow flash
        INLINE  # Service is inlined
      enumeration ifxRbMemLocIntIpoMaps16u8u8: origin=RB:1.0.0:2010-12-17, set at pre-compile  # Ifx_IntIpoMap_s16u8_u8 | Select one of following values: NORMAL for location in normal flash, FAST for location in fast flash, SLOW for location in slow flash, INLINE for inlining of the service
        NORMAL  # Location in normal flash
        FAST  # Location in fast flash
        SLOW  # Location in slow flash
        INLINE  # Service is inlined
      enumeration ifxRbMemLocIntIpoMaps8s8s16: origin=RB:1.0.0:2010-12-17, set at pre-compile  # Ifx_IntIpoMap_s8s8_s16 | Select one of following values: NORMAL for location in normal flash, FAST for location in fast flash, SLOW for location in slow flash
        NORMAL  # Location in normal flash
        FAST  # Location in fast flash
        SLOW  # Location in slow flash
      enumeration ifxRbMemLocIntIpoMaps8s8s8: origin=RB:1.0.0:2010-12-17, set at pre-compile  # Ifx_IntIpoMap_s8s8_s8 | Select one of following values: NORMAL for location in normal flash, FAST for location in fast flash, SLOW for location in slow flash, INLINE for inlining of the service
        NORMAL  # Location in normal flash
        FAST  # Location in fast flash
        SLOW  # Location in slow flash
        INLINE  # Service is inlined
      enumeration ifxRbMemLocIntIpoMaps8s8u16: origin=RB:1.0.0:2010-12-17, set at pre-compile  # Ifx_IntIpoMap_s8s8_u16 | Select one of following values: NORMAL for location in normal flash, FAST for location in fast flash, SLOW for location in slow flash
        NORMAL  # Location in normal flash
        FAST  # Location in fast flash
        SLOW  # Location in slow flash
      enumeration ifxRbMemLocIntIpoMaps8s8u8: origin=RB:1.0.0:2010-12-17, set at pre-compile  # Ifx_IntIpoMap_s8s8_u8 | Select one of following values: NORMAL for location in normal flash, FAST for location in fast flash, SLOW for location in slow flash, INLINE for inlining of the service
        NORMAL  # Location in normal flash
        FAST  # Location in fast flash
        SLOW  # Location in slow flash
        INLINE  # Service is inlined
      enumeration ifxRbMemLocIntIpoMapu16s16s16: origin=RB:1.0.0:2010-12-17, set at pre-compile  # Ifx_IntIpoMap_u16s16_s16 | Select one of following values: NORMAL for location in normal flash, FAST for location in fast flash, SLOW for location in slow flash, INLINE for inlining of the service
        NORMAL  # Location in normal flash
        FAST  # Location in fast flash
        SLOW  # Location in slow flash
        INLINE  # Service is inlined
      enumeration ifxRbMemLocIntIpoMapu16s16s8: origin=RB:1.0.0:2010-12-17, set at pre-compile  # Ifx_IntIpoMap_u16s16_s8 | Select one of following values: NORMAL for location in normal flash, FAST for location in fast flash, SLOW for location in slow flash, INLINE for inlining of the service
        NORMAL  # Location in normal flash
        FAST  # Location in fast flash
        SLOW  # Location in slow flash
        INLINE  # Service is inlined
      enumeration ifxRbMemLocIntIpoMapu16s16u16: origin=RB:1.0.0:2010-12-17, set at pre-compile  # Ifx_IntIpoMap_u16s16_u16 | Select one of following values: NORMAL for location in normal flash, FAST for location in fast flash, SLOW for location in slow flash, INLINE for inlining of the service
        NORMAL  # Location in normal flash
        FAST  # Location in fast flash
        SLOW  # Location in slow flash
        INLINE  # Service is inlined
      enumeration ifxRbMemLocIntIpoMapu16s16u8: origin=RB:1.0.0:2010-12-17, set at pre-compile  # Ifx_IntIpoMap_u16s16_u8 | Select one of following values: NORMAL for location in normal flash, FAST for location in fast flash, SLOW for location in slow flash, INLINE for inlining of the service
        NORMAL  # Location in normal flash
        FAST  # Location in fast flash
        SLOW  # Location in slow flash
        INLINE  # Service is inlined
      enumeration ifxRbMemLocIntIpoMapu16s8s16: origin=RB:1.0.0:2010-12-17, set at pre-compile  # Ifx_IntIpoMap_u16s8_s16 | Select one of following values: NORMAL for location in normal flash, FAST for location in fast flash, SLOW for location in slow flash
        NORMAL  # Location in normal flash
        FAST  # Location in fast flash
        SLOW  # Location in slow flash
      enumeration ifxRbMemLocIntIpoMapu16s8s8: origin=RB:1.0.0:2010-12-17, set at pre-compile  # Ifx_IntIpoMap_u16s8_s8 | Select one of following values: NORMAL for location in normal flash, FAST for location in fast flash, SLOW for location in slow flash
        NORMAL  # Location in normal flash
        FAST  # Location in fast flash
        SLOW  # Location in slow flash
      enumeration ifxRbMemLocIntIpoMapu16s8u16: origin=RB:1.0.0:2010-12-17, set at pre-compile  # Ifx_IntIpoMap_u16s8_u16 | Select one of following values: NORMAL for location in normal flash, FAST for location in fast flash, SLOW for location in slow flash
        NORMAL  # Location in normal flash
        FAST  # Location in fast flash
        SLOW  # Location in slow flash
      enumeration ifxRbMemLocIntIpoMapu16s8u8: origin=RB:1.0.0:2010-12-17, set at pre-compile  # Ifx_IntIpoMap_u16s8_u8 | Select one of following values: NORMAL for location in normal flash, FAST for location in fast flash, SLOW for location in slow flash
        NORMAL  # Location in normal flash
        FAST  # Location in fast flash
        SLOW  # Location in slow flash
      enumeration ifxRbMemLocIntIpoMapu16u16s16: origin=RB:1.0.0:2010-12-17, set at pre-compile  # Ifx_IntIpoMap_u16u16_s16 | Select one of following values: NORMAL for location in normal flash, FAST for location in fast flash, SLOW for location in slow flash, INLINE for inlining of the service
        NORMAL  # Location in normal flash
        FAST  # Location in fast flash
        SLOW  # Location in slow flash
        INLINE  # Service is inlined
      enumeration ifxRbMemLocIntIpoMapu16u16s8: origin=RB:1.0.0:2010-12-17, set at pre-compile  # Ifx_IntIpoMap_u16u16_s8 | Select one of following values: NORMAL for location in normal flash, FAST for location in fast flash, SLOW for location in slow flash, INLINE for inlining of the service
        NORMAL  # Location in normal flash
        FAST  # Location in fast flash
        SLOW  # Location in slow flash
        INLINE  # Service is inlined
      enumeration ifxRbMemLocIntIpoMapu16u16u16: origin=RB:1.0.0:2010-12-17, set at pre-compile  # Ifx_IntIpoMap_u16u16_u16 | Select one of following values: NORMAL for location in normal flash, FAST for location in fast flash, SLOW for location in slow flash, INLINE for inlining of the service
        NORMAL  # Location in normal flash
        FAST  # Location in fast flash
        SLOW  # Location in slow flash
        INLINE  # Service is inlined
      enumeration ifxRbMemLocIntIpoMapu16u16u8: origin=RB:1.0.0:2010-12-17, set at pre-compile  # Ifx_IntIpoMap_u16u16_u8 | Select one of following values: NORMAL for location in normal flash, FAST for location in fast flash, SLOW for location in slow flash, INLINE for inlining of the service
        NORMAL  # Location in normal flash
        FAST  # Location in fast flash
        SLOW  # Location in slow flash
        INLINE  # Service is inlined
      enumeration ifxRbMemLocIntIpoMapu16u8s16: origin=RB:1.0.0:2010-12-17, set at pre-compile  # Ifx_IntIpoMap_u16u8_s16 | Select one of following values: NORMAL for location in normal flash, FAST for location in fast flash, SLOW for location in slow flash, INLINE for inlining of the service
        NORMAL  # Location in normal flash
        FAST  # Location in fast flash
        SLOW  # Location in slow flash
        INLINE  # Service is inlined
      enumeration ifxRbMemLocIntIpoMapu16u8s8: origin=RB:1.0.0:2010-12-17, set at pre-compile  # Ifx_IntIpoMap_u16u8_s8 | Select one of following values: NORMAL for location in normal flash, FAST for location in fast flash, SLOW for location in slow flash
        NORMAL  # Location in normal flash
        FAST  # Location in fast flash
        SLOW  # Location in slow flash
      enumeration ifxRbMemLocIntIpoMapu16u8u16: origin=RB:1.0.0:2010-12-17, set at pre-compile  # Ifx_IntIpoMap_u16u8_u16 | Select one of following values: NORMAL for location in normal flash, FAST for location in fast flash, SLOW for location in slow flash
        NORMAL  # Location in normal flash
        FAST  # Location in fast flash
        SLOW  # Location in slow flash
      enumeration ifxRbMemLocIntIpoMapu16u8u8: origin=RB:1.0.0:2010-12-17, set at pre-compile  # Ifx_IntIpoMap_u16u8_u8 | Select one of following values: NORMAL for location in normal flash, FAST for location in fast flash, SLOW for location in slow flash, INLINE for inlining of the service
        NORMAL  # Location in normal flash
        FAST  # Location in fast flash
        SLOW  # Location in slow flash
        INLINE  # Service is inlined
      enumeration ifxRbMemLocIntIpoMapu8s8s16: origin=RB:1.0.0:2010-12-17, set at pre-compile  # Ifx_IntIpoMap_u8s8_s16 | Select one of following values: NORMAL for location in normal flash, FAST for location in fast flash, SLOW for location in slow flash
        NORMAL  # Location in normal flash
        FAST  # Location in fast flash
        SLOW  # Location in slow flash
      enumeration ifxRbMemLocIntIpoMapu8s8s8: origin=RB:1.0.0:2010-12-17, set at pre-compile  # Ifx_IntIpoMap_u8s8_s8 | Select one of following values: NORMAL for location in normal flash, FAST for location in fast flash, SLOW for location in slow flash, INLINE for inlining of the service
        NORMAL  # Location in normal flash
        FAST  # Location in fast flash
        SLOW  # Location in slow flash
        INLINE  # Service is inlined
      enumeration ifxRbMemLocIntIpoMapu8s8u16: origin=RB:1.0.0:2010-12-17, set at pre-compile  # Ifx_IntIpoMap_u8s8_u16 | Select one of following values: NORMAL for location in normal flash, FAST for location in fast flash, SLOW for location in slow flash
        NORMAL  # Location in normal flash
        FAST  # Location in fast flash
        SLOW  # Location in slow flash
      enumeration ifxRbMemLocIntIpoMapu8s8u8: origin=RB:1.0.0:2010-12-17, set at pre-compile  # Ifx_IntIpoMap_u8s8_u8 | Select one of following values: NORMAL for location in normal flash, FAST for location in fast flash, SLOW for location in slow flash, INLINE for inlining of the service
        NORMAL  # Location in normal flash
        FAST  # Location in fast flash
        SLOW  # Location in slow flash
        INLINE  # Service is inlined
      enumeration ifxRbMemLocIntIpoMapu8u8s16: origin=RB:1.0.0:2010-12-17, set at pre-compile  # Ifx_IntIpoMap_u8u8_s16 | Select one of following values: NORMAL for location in normal flash, FAST for location in fast flash, SLOW for location in slow flash
        NORMAL  # Location in normal flash
        FAST  # Location in fast flash
        SLOW  # Location in slow flash
      enumeration ifxRbMemLocIntIpoMapu8u8s8: origin=RB:1.0.0:2010-12-17, set at pre-compile  # Ifx_IntIpoMap_u8u8_s8 | Select one of following values: NORMAL for location in normal flash, FAST for location in fast flash, SLOW for location in slow flash, INLINE for inlining of the service
        NORMAL  # Location in normal flash
        FAST  # Location in fast flash
        SLOW  # Location in slow flash
        INLINE  # Service is inlined
      enumeration ifxRbMemLocIntIpoMapu8u8u16: origin=RB:1.0.0:2010-12-17, set at pre-compile  # Ifx_IntIpoMap_u8u8_u16 | Select one of following values: NORMAL for location in normal flash, FAST for location in fast flash, SLOW for location in slow flash
        NORMAL  # Location in normal flash
        FAST  # Location in fast flash
        SLOW  # Location in slow flash
      enumeration ifxRbMemLocIntIpoMapu8u8u8: origin=RB:1.0.0:2010-12-17, set at pre-compile  # Ifx_IntIpoMap_u8u8_u8 | Select one of following values: NORMAL for location in normal flash, FAST for location in fast flash, SLOW for location in slow flash, INLINE for inlining of the service
        NORMAL  # Location in normal flash
        FAST  # Location in fast flash
        SLOW  # Location in slow flash
        INLINE  # Service is inlined
      enumeration ifxRbMemLocIntLkUpBaseMaps16s16s16: origin=RB:5.0.0:2012-12-17, set at pre-compile  # Ifx_IntLkUpBaseMap_s16s16_s16 | Select one of following values: NORMAL for location in normal flash, FAST for location in fast flash, SLOW for location in slow flash
        NORMAL  # Location in normal flash
        FAST  # Location in fast flash
        SLOW  # Location in slow flash
      enumeration ifxRbMemLocIntLkUpBaseMaps8s8s8: origin=RB:5.0.0:2012-12-17, set at pre-compile  # Ifx_IntLkUpBaseMap_s8s8_s8 | Select one of following values: NORMAL for location in normal flash, FAST for location in fast flash, SLOW for location in slow flash
        NORMAL  # Location in normal flash
        FAST  # Location in fast flash
        SLOW  # Location in slow flash
      enumeration ifxRbMemLocIntLkUpBaseMapu16u16u16: origin=RB:5.0.0:2012-12-17, set at pre-compile  # Ifx_IntLkUpBaseMap_u16u16_u16 | Select one of following values: NORMAL for location in normal flash, FAST for location in fast flash, SLOW for location in slow flash
        NORMAL  # Location in normal flash
        FAST  # Location in fast flash
        SLOW  # Location in slow flash
      enumeration ifxRbMemLocIntLkUpBaseMapu8u8u8: origin=RB:5.0.0:2012-12-17, set at pre-compile  # Ifx_IntLkUpBaseMap_u8u8_u8 | Select one of following values: NORMAL for location in normal flash, FAST for location in fast flash, SLOW for location in slow flash
        NORMAL  # Location in normal flash
        FAST  # Location in fast flash
        SLOW  # Location in slow flash
      enumeration ifxRbMemLocIntLkUpCurs16s16: origin=RB:1.0.0:2010-12-17, set at pre-compile  # Ifx_IntLkUpCur_s16_s16 | Select one of following values: NORMAL for location in normal flash, FAST for location in fast flash, SLOW for location in slow flash, INLINE for inlining of the service
        NORMAL  # Location in normal flash
        FAST  # Location in fast flash
        SLOW  # Location in slow flash
        INLINE  # Service is inlined
      enumeration ifxRbMemLocIntLkUpCurs16s8: origin=RB:1.0.0:2010-12-17, set at pre-compile  # Ifx_IntLkUpCur_s16_s8 | Select one of following values: NORMAL for location in normal flash, FAST for location in fast flash, SLOW for location in slow flash, INLINE for inlining of the service
        NORMAL  # Location in normal flash
        FAST  # Location in fast flash
        SLOW  # Location in slow flash
        INLINE  # Service is inlined
      enumeration ifxRbMemLocIntLkUpCurs16u16: origin=RB:1.0.0:2010-12-17, set at pre-compile  # Ifx_IntLkUpCur_s16_u16 | Select one of following values: NORMAL for location in normal flash, FAST for location in fast flash, SLOW for location in slow flash, INLINE for inlining of the service
        NORMAL  # Location in normal flash
        FAST  # Location in fast flash
        SLOW  # Location in slow flash
        INLINE  # Service is inlined
      enumeration ifxRbMemLocIntLkUpCurs16u8: origin=RB:1.0.0:2010-12-17, set at pre-compile  # Ifx_IntLkUpCur_s16_u8 | Select one of following values: NORMAL for location in normal flash, FAST for location in fast flash, SLOW for location in slow flash, INLINE for inlining of the service
        NORMAL  # Location in normal flash
        FAST  # Location in fast flash
        SLOW  # Location in slow flash
        INLINE  # Service is inlined
      enumeration ifxRbMemLocIntLkUpCurs32s32: origin=RB:1.0.0:2023-05-29, set at pre-compile  # Ifx_IntLkUpCur_s32_s32 | Select one of following values: NORMAL for location in normal flash, FAST for location in fast flash, SLOW for location in slow flash, INLINE for inlining of the service
        NORMAL  # Location in normal flash
        FAST  # Location in fast flash
        SLOW  # Location in slow flash
        INLINE  # Service is inlined
      enumeration ifxRbMemLocIntLkUpCurs8s16: origin=RB:1.0.0:2010-12-17, set at pre-compile  # Ifx_IntLkUpCur_s8_s16 | Select one of following values: NORMAL for location in normal flash, FAST for location in fast flash, SLOW for location in slow flash, INLINE for inlining of the service
        NORMAL  # Location in normal flash
        FAST  # Location in fast flash
        SLOW  # Location in slow flash
        INLINE  # Service is inlined
      enumeration ifxRbMemLocIntLkUpCurs8s8: origin=RB:1.0.0:2010-12-17, set at pre-compile  # Ifx_IntLkUpCur_s8_s8 | Select one of following values: NORMAL for location in normal flash, FAST for location in fast flash, SLOW for location in slow flash, INLINE for inlining of the service
        NORMAL  # Location in normal flash
        FAST  # Location in fast flash
        SLOW  # Location in slow flash
        INLINE  # Service is inlined
      enumeration ifxRbMemLocIntLkUpCurs8u16: origin=RB:1.0.0:2010-12-17, set at pre-compile  # Ifx_IntLkUpCur_s8_u16 | Select one of following values: NORMAL for location in normal flash, FAST for location in fast flash, SLOW for location in slow flash, INLINE for inlining of the service
        NORMAL  # Location in normal flash
        FAST  # Location in fast flash
        SLOW  # Location in slow flash
        INLINE  # Service is inlined
      enumeration ifxRbMemLocIntLkUpCurs8u8: origin=RB:1.0.0:2010-12-17, set at pre-compile  # Ifx_IntLkUpCur_s8_u8 | Select one of following values: NORMAL for location in normal flash, FAST for location in fast flash, SLOW for location in slow flash, INLINE for inlining of the service
        NORMAL  # Location in normal flash
        FAST  # Location in fast flash
        SLOW  # Location in slow flash
        INLINE  # Service is inlined
      enumeration ifxRbMemLocIntLkUpCuru16s16: origin=RB:1.0.0:2010-12-17, set at pre-compile  # Ifx_IntLkUpCur_u16_s16 | Select one of following values: NORMAL for location in normal flash, FAST for location in fast flash, SLOW for location in slow flash, INLINE for inlining of the service
        NORMAL  # Location in normal flash
        FAST  # Location in fast flash
        SLOW  # Location in slow flash
        INLINE  # Service is inlined
      enumeration ifxRbMemLocIntLkUpCuru16s8: origin=RB:1.0.0:2010-12-17, set at pre-compile  # Ifx_IntLkUpCur_u16_s8 | Select one of following values: NORMAL for location in normal flash, FAST for location in fast flash, SLOW for location in slow flash, INLINE for inlining of the service
        NORMAL  # Location in normal flash
        FAST  # Location in fast flash
        SLOW  # Location in slow flash
        INLINE  # Service is inlined
      enumeration ifxRbMemLocIntLkUpCuru16u16: origin=RB:1.0.0:2010-12-17, set at pre-compile  # Ifx_IntLkUpCur_u16_u16 | Select one of following values: NORMAL for location in normal flash, FAST for location in fast flash, SLOW for location in slow flash, INLINE for inlining of the service
        NORMAL  # Location in normal flash
        FAST  # Location in fast flash
        SLOW  # Location in slow flash
        INLINE  # Service is inlined
      enumeration ifxRbMemLocIntLkUpCuru16u8: origin=RB:1.0.0:2010-12-17, set at pre-compile  # Ifx_IntLkUpCur_u16_u8 | Select one of following values: NORMAL for location in normal flash, FAST for location in fast flash, SLOW for location in slow flash, INLINE for inlining of the service
        NORMAL  # Location in normal flash
        FAST  # Location in fast flash
        SLOW  # Location in slow flash
        INLINE  # Service is inlined
      enumeration ifxRbMemLocIntLkUpCuru32u32: origin=RB:1.0.0:2023-05-29, set at pre-compile  # Ifx_IntLkUpCur_u32_u32 | Select one of following values: NORMAL for location in normal flash, FAST for location in fast flash, SLOW for location in slow flash, INLINE for inlining of the service
        NORMAL  # Location in normal flash
        FAST  # Location in fast flash
        SLOW  # Location in slow flash
        INLINE  # Service is inlined
      enumeration ifxRbMemLocIntLkUpCuru8s16: origin=RB:1.0.0:2010-12-17, set at pre-compile  # Ifx_IntLkUpCur_u8_s16 | Select one of following values: NORMAL for location in normal flash, FAST for location in fast flash, SLOW for location in slow flash, INLINE for inlining of the service
        NORMAL  # Location in normal flash
        FAST  # Location in fast flash
        SLOW  # Location in slow flash
        INLINE  # Service is inlined
      enumeration ifxRbMemLocIntLkUpCuru8s8: origin=RB:1.0.0:2010-12-17, set at pre-compile  # Ifx_IntLkUpCur_u8_s8 | Select one of following values: NORMAL for location in normal flash, FAST for location in fast flash, SLOW for location in slow flash, INLINE for inlining of the service
        NORMAL  # Location in normal flash
        FAST  # Location in fast flash
        SLOW  # Location in slow flash
        INLINE  # Service is inlined
      enumeration ifxRbMemLocIntLkUpCuru8u16: origin=RB:1.0.0:2010-12-17, set at pre-compile  # Ifx_IntLkUpCur_u8_u16 | Select one of following values: NORMAL for location in normal flash, FAST for location in fast flash, SLOW for location in slow flash, INLINE for inlining of the service
        NORMAL  # Location in normal flash
        FAST  # Location in fast flash
        SLOW  # Location in slow flash
        INLINE  # Service is inlined
      enumeration ifxRbMemLocIntLkUpCuru8u8: origin=RB:1.0.0:2010-12-17, set at pre-compile  # Ifx_IntLkUpCur_u8_u8 | Select one of following values: NORMAL for location in normal flash, FAST for location in fast flash, SLOW for location in slow flash, INLINE for inlining of the service
        NORMAL  # Location in normal flash
        FAST  # Location in fast flash
        SLOW  # Location in slow flash
        INLINE  # Service is inlined
      enumeration ifxRbMemLocIntLkUpFixBaseMaps16s16s16: origin=RB:5.0.0:2012-12-17, set at pre-compile  # Ifx_IntLkUpFixBaseMap_s16s16_s16 | Select one of following values: NORMAL for location in normal flash, FAST for location in fast flash, SLOW for location in slow flash
        NORMAL  # Location in normal flash
        FAST  # Location in fast flash
        SLOW  # Location in slow flash
      enumeration ifxRbMemLocIntLkUpFixBaseMaps8s8s8: origin=RB:5.0.0:2012-12-17, set at pre-compile  # Ifx_IntLkUpFixBaseMap_s8s8_s8 | Select one of following values: NORMAL for location in normal flash, FAST for location in fast flash, SLOW for location in slow flash
        NORMAL  # Location in normal flash
        FAST  # Location in fast flash
        SLOW  # Location in slow flash
      enumeration ifxRbMemLocIntLkUpFixBaseMapu16u16u16: origin=RB:5.0.0:2012-12-17, set at pre-compile  # Ifx_IntLkUpFixBaseMap_u16u16_u16 | Select one of following values: NORMAL for location in normal flash, FAST for location in fast flash, SLOW for location in slow flash
        NORMAL  # Location in normal flash
        FAST  # Location in fast flash
        SLOW  # Location in slow flash
      enumeration ifxRbMemLocIntLkUpFixBaseMapu8u8u8: origin=RB:5.0.0:2012-12-17, set at pre-compile  # Ifx_IntLkUpFixBaseMap_u8u8_u8 | Select one of following values: NORMAL for location in normal flash, FAST for location in fast flash, SLOW for location in slow flash
        NORMAL  # Location in normal flash
        FAST  # Location in fast flash
        SLOW  # Location in slow flash
      enumeration ifxRbMemLocIntLkUpFixCurs16s16: origin=RB:1.0.0:2010-12-17, set at pre-compile  # Ifx_IntLkUpFixCur_s16_s16 | Select one of following values: NORMAL for location in normal flash, FAST for location in fast flash, SLOW for location in slow flash, INLINE for inlining of the service
        NORMAL  # Location in normal flash
        FAST  # Location in fast flash
        SLOW  # Location in slow flash
        INLINE  # Service is inlined
      enumeration ifxRbMemLocIntLkUpFixCurs8s8: origin=RB:1.0.0:2010-12-17, set at pre-compile  # Ifx_IntLkUpFixCur_s8_s8 | Select one of following values: NORMAL for location in normal flash, FAST for location in fast flash, SLOW for location in slow flash
        NORMAL  # Location in normal flash
        FAST  # Location in fast flash
        SLOW  # Location in slow flash
      enumeration ifxRbMemLocIntLkUpFixCuru16u16: origin=RB:1.0.0:2010-12-17, set at pre-compile  # Ifx_IntLkUpFixCur_u16_u16 | Select one of following values: NORMAL for location in normal flash, FAST for location in fast flash, SLOW for location in slow flash, INLINE for inlining of the service
        NORMAL  # Location in normal flash
        FAST  # Location in fast flash
        SLOW  # Location in slow flash
        INLINE  # Service is inlined
      enumeration ifxRbMemLocIntLkUpFixCuru8u8: origin=RB:1.0.0:2010-12-17, set at pre-compile  # Ifx_IntLkUpFixCur_u8_u8 | Select one of following values: NORMAL for location in normal flash, FAST for location in fast flash, SLOW for location in slow flash
        NORMAL  # Location in normal flash
        FAST  # Location in fast flash
        SLOW  # Location in slow flash
      enumeration ifxRbMemLocIntLkUpFixIBaseMaps16s16s16: origin=RB:5.0.0:2012-12-17, set at pre-compile  # Ifx_IntLkUpFixIBaseMap_s16s16_s16 | Select one of following values: NORMAL for location in normal flash, FAST for location in fast flash, SLOW for location in slow flash
        NORMAL  # Location in normal flash
        FAST  # Location in fast flash
        SLOW  # Location in slow flash
      enumeration ifxRbMemLocIntLkUpFixIBaseMaps8s8s8: origin=RB:5.0.0:2012-12-17, set at pre-compile  # Ifx_IntLkUpFixIBaseMap_s8s8_s8 | Select one of following values: NORMAL for location in normal flash, FAST for location in fast flash, SLOW for location in slow flash
        NORMAL  # Location in normal flash
        FAST  # Location in fast flash
        SLOW  # Location in slow flash
      enumeration ifxRbMemLocIntLkUpFixIBaseMapu16u16u16: origin=RB:5.0.0:2012-12-17, set at pre-compile  # Ifx_IntLkUpFixIBaseMap_u16u16_u16 | Select one of following values: NORMAL for location in normal flash, FAST for location in fast flash, SLOW for location in slow flash
        NORMAL  # Location in normal flash
        FAST  # Location in fast flash
        SLOW  # Location in slow flash
      enumeration ifxRbMemLocIntLkUpFixIBaseMapu8u8u8: origin=RB:5.0.0:2012-12-17, set at pre-compile  # Ifx_IntLkUpFixIBaseMap_u8u8_u8 | Select one of following values: NORMAL for location in normal flash, FAST for location in fast flash, SLOW for location in slow flash
        NORMAL  # Location in normal flash
        FAST  # Location in fast flash
        SLOW  # Location in slow flash
      enumeration ifxRbMemLocIntLkUpFixICurs16s16: origin=RB:1.0.0:2010-12-17, set at pre-compile  # Ifx_IntLkUpFixICur_s16_s16 | Select one of following values: NORMAL for location in normal flash, FAST for location in fast flash, SLOW for location in slow flash, INLINE for inlining of the service
        NORMAL  # Location in normal flash
        FAST  # Location in fast flash
        SLOW  # Location in slow flash
        INLINE  # Service is inlined
      enumeration ifxRbMemLocIntLkUpFixICurs8s8: origin=RB:1.0.0:2010-12-17, set at pre-compile  # Ifx_IntLkUpFixICur_s8_s8 | Select one of following values: NORMAL for location in normal flash, FAST for location in fast flash, SLOW for location in slow flash
        NORMAL  # Location in normal flash
        FAST  # Location in fast flash
        SLOW  # Location in slow flash
      enumeration ifxRbMemLocIntLkUpFixICuru16u16: origin=RB:1.0.0:2010-12-17, set at pre-compile  # Ifx_IntLkUpFixICur_u16_u16 | Select one of following values: NORMAL for location in normal flash, FAST for location in fast flash, SLOW for location in slow flash, INLINE for inlining of the service
        NORMAL  # Location in normal flash
        FAST  # Location in fast flash
        SLOW  # Location in slow flash
        INLINE  # Service is inlined
      enumeration ifxRbMemLocIntLkUpFixICuru8u8: origin=RB:1.0.0:2010-12-17, set at pre-compile  # Ifx_IntLkUpFixICur_u8_u8 | Select one of following values: NORMAL for location in normal flash, FAST for location in fast flash, SLOW for location in slow flash
        NORMAL  # Location in normal flash
        FAST  # Location in fast flash
        SLOW  # Location in slow flash
      enumeration ifxRbMemLocIntLkUpFixIMaps16s16s16: origin=RB:1.0.0:2010-12-17, set at pre-compile  # Ifx_IntLkUpFixIMap_s16s16_s16 | Select one of following values: NORMAL for location in normal flash, FAST for location in fast flash, SLOW for location in slow flash
        NORMAL  # Location in normal flash
        FAST  # Location in fast flash
        SLOW  # Location in slow flash
      enumeration ifxRbMemLocIntLkUpFixIMaps8s8s8: origin=RB:1.0.0:2010-12-17, set at pre-compile  # Ifx_IntLkUpFixIMap_s8s8_s8 | Select one of following values: NORMAL for location in normal flash, FAST for location in fast flash, SLOW for location in slow flash
        NORMAL  # Location in normal flash
        FAST  # Location in fast flash
        SLOW  # Location in slow flash
      enumeration ifxRbMemLocIntLkUpFixIMapu16u16u16: origin=RB:1.0.0:2010-12-17, set at pre-compile  # Ifx_IntLkUpFixIMap_u16u16_u16 | Select one of following values: NORMAL for location in normal flash, FAST for location in fast flash, SLOW for location in slow flash
        NORMAL  # Location in normal flash
        FAST  # Location in fast flash
        SLOW  # Location in slow flash
      enumeration ifxRbMemLocIntLkUpFixIMapu8u8u8: origin=RB:1.0.0:2010-12-17, set at pre-compile  # Ifx_IntLkUpFixIMap_u8u8_u8 | Select one of following values: NORMAL for location in normal flash, FAST for location in fast flash, SLOW for location in slow flash
        NORMAL  # Location in normal flash
        FAST  # Location in fast flash
        SLOW  # Location in slow flash
      enumeration ifxRbMemLocIntLkUpFixMaps16s16s16: origin=RB:1.0.0:2010-12-17, set at pre-compile  # Ifx_IntLkUpFixMap_s16s16_s16 | Select one of following values: NORMAL for location in normal flash, FAST for location in fast flash, SLOW for location in slow flash
        NORMAL  # Location in normal flash
        FAST  # Location in fast flash
        SLOW  # Location in slow flash
      enumeration ifxRbMemLocIntLkUpFixMaps8s8s8: origin=RB:1.0.0:2010-12-17, set at pre-compile  # Ifx_IntLkUpFixMap_s8s8_s8 | Select one of following values: NORMAL for location in normal flash, FAST for location in fast flash, SLOW for location in slow flash
        NORMAL  # Location in normal flash
        FAST  # Location in fast flash
        SLOW  # Location in slow flash
      enumeration ifxRbMemLocIntLkUpFixMapu16u16u16: origin=RB:1.0.0:2010-12-17, set at pre-compile  # Ifx_IntLkUpFixMap_u16u16_u16 | Select one of following values: NORMAL for location in normal flash, FAST for location in fast flash, SLOW for location in slow flash
        NORMAL  # Location in normal flash
        FAST  # Location in fast flash
        SLOW  # Location in slow flash
      enumeration ifxRbMemLocIntLkUpFixMapu8u8u8: origin=RB:1.0.0:2010-12-17, set at pre-compile  # Ifx_IntLkUpFixMap_u8u8_u8 | Select one of following values: NORMAL for location in normal flash, FAST for location in fast flash, SLOW for location in slow flash
        NORMAL  # Location in normal flash
        FAST  # Location in fast flash
        SLOW  # Location in slow flash
      enumeration ifxRbMemLocIntLkUpMaps16s16s16: origin=RB:1.0.0:2010-12-17, set at pre-compile  # Ifx_IntLkUpMap_s16s16_s16 | Select one of following values: NORMAL for location in normal flash, FAST for location in fast flash, SLOW for location in slow flash
        NORMAL  # Location in normal flash
        FAST  # Location in fast flash
        SLOW  # Location in slow flash
      enumeration ifxRbMemLocIntLkUpMaps8s8s8: origin=RB:1.0.0:2010-12-17, set at pre-compile  # Ifx_IntLkUpMap_s8s8_s8 | Select one of following values: NORMAL for location in normal flash, FAST for location in fast flash, SLOW for location in slow flash
        NORMAL  # Location in normal flash
        FAST  # Location in fast flash
        SLOW  # Location in slow flash
      enumeration ifxRbMemLocIntLkUpMapu16u16u16: origin=RB:1.0.0:2010-12-17, set at pre-compile  # Ifx_IntLkUpMap_u16u16_u16 | Select one of following values: NORMAL for location in normal flash, FAST for location in fast flash, SLOW for location in slow flash
        NORMAL  # Location in normal flash
        FAST  # Location in fast flash
        SLOW  # Location in slow flash
      enumeration ifxRbMemLocIntLkUpMapu8u8u8: origin=RB:1.0.0:2010-12-17, set at pre-compile  # Ifx_IntLkUpMap_u8u8_u8 | Select one of following values: NORMAL for location in normal flash, FAST for location in fast flash, SLOW for location in slow flash
        NORMAL  # Location in normal flash
        FAST  # Location in fast flash
        SLOW  # Location in slow flash
      enumeration ifxRbMemLocIpoCubs16: origin=RB:1.0.0:2023-06-14, set at pre-compile  # Ifx_IpoCub_s16 | Select one of following values: NORMAL for location in normal flash, FAST for location in fast flash, SLOW for location in slow flash, INLINE for inlining of the service
        NORMAL  # Location in normal flash
        FAST  # Location in fast flash
        SLOW  # Location in slow flash
        INLINE  # Service is inlined
      enumeration ifxRbMemLocIpoCubs8: origin=RB:1.0.0:2023-06-14, set at pre-compile  # Ifx_IpoCub_s8 | Select one of following values: NORMAL for location in normal flash, FAST for location in fast flash, SLOW for location in slow flash, INLINE for inlining of the service
        NORMAL  # Location in normal flash
        FAST  # Location in fast flash
        SLOW  # Location in slow flash
        INLINE  # Service is inlined
      enumeration ifxRbMemLocIpoCubu16: origin=RB:1.0.0:2023-06-14, set at pre-compile  # Ifx_IpoCub_u16 | Select one of following values: NORMAL for location in normal flash, FAST for location in fast flash, SLOW for location in slow flash, INLINE for inlining of the service
        NORMAL  # Location in normal flash
        FAST  # Location in fast flash
        SLOW  # Location in slow flash
        INLINE  # Service is inlined
      enumeration ifxRbMemLocIpoCubu8: origin=RB:1.0.0:2023-06-14, set at pre-compile  # Ifx_IpoCub_u8 | Select one of following values: NORMAL for location in normal flash, FAST for location in fast flash, SLOW for location in slow flash, INLINE for inlining of the service
        NORMAL  # Location in normal flash
        FAST  # Location in fast flash
        SLOW  # Location in slow flash
        INLINE  # Service is inlined
      enumeration ifxRbMemLocIpoCurs16: origin=RB:1.0.0:2010-12-17, set at pre-compile  # Ifx_IpoCur_s16 | Select one of following values: NORMAL for location in normal flash, FAST for location in fast flash, SLOW for location in slow flash, INLINE for inlining of the service
        NORMAL  # Location in normal flash
        FAST  # Location in fast flash
        SLOW  # Location in slow flash
        INLINE  # Service is inlined
      enumeration ifxRbMemLocIpoCurs32: origin=RB:1.0.0:2023-03-15, set at pre-compile  # Ifx_IpoCur_s32 | Select one of following values: NORMAL for location in normal flash, FAST for location in fast flash, SLOW for location in slow flash, INLINE for inlining of the service
        NORMAL  # Location in normal flash
        FAST  # Location in fast flash
        SLOW  # Location in slow flash
        INLINE  # Service is inlined
      enumeration ifxRbMemLocIpoCurs8: origin=RB:1.0.0:2010-12-17, set at pre-compile  # Ifx_IpoCur_s8 | Select one of following values: NORMAL for location in normal flash, FAST for location in fast flash, SLOW for location in slow flash, INLINE for inlining of the service
        NORMAL  # Location in normal flash
        FAST  # Location in fast flash
        SLOW  # Location in slow flash
        INLINE  # Service is inlined
      enumeration ifxRbMemLocIpoCuru16: origin=RB:1.0.0:2010-12-17, set at pre-compile  # Ifx_IpoCur_u16 | Select one of following values: NORMAL for location in normal flash, FAST for location in fast flash, SLOW for location in slow flash, INLINE for inlining of the service
        NORMAL  # Location in normal flash
        FAST  # Location in fast flash
        SLOW  # Location in slow flash
        INLINE  # Service is inlined
      enumeration ifxRbMemLocIpoCuru32: origin=RB:1.0.0:2023-03-15, set at pre-compile  # Ifx_IpoCur_u32 | Select one of following values: NORMAL for location in normal flash, FAST for location in fast flash, SLOW for location in slow flash, INLINE for inlining of the service
        NORMAL  # Location in normal flash
        FAST  # Location in fast flash
        SLOW  # Location in slow flash
        INLINE  # Service is inlined
      enumeration ifxRbMemLocIpoCuru8: origin=RB:1.0.0:2010-12-17, set at pre-compile  # Ifx_IpoCur_u8 | Select one of following values: NORMAL for location in normal flash, FAST for location in fast flash, SLOW for location in slow flash, INLINE for inlining of the service
        NORMAL  # Location in normal flash
        FAST  # Location in fast flash
        SLOW  # Location in slow flash
        INLINE  # Service is inlined
      enumeration ifxRbMemLocIpoMaps16: origin=RB:1.0.0:2010-12-17, set at pre-compile  # Ifx_IpoMap_s16 | Select one of following values: NORMAL for location in normal flash, FAST for location in fast flash, SLOW for location in slow flash, INLINE for inlining of the service
        NORMAL  # Location in normal flash
        FAST  # Location in fast flash
        SLOW  # Location in slow flash
        INLINE  # Service is inlined
      enumeration ifxRbMemLocIpoMaps32: origin=RB:1.0.0:2023-05-29, set at pre-compile  # Ifx_IpoMap_s32 | Select one of following values: NORMAL for location in normal flash, FAST for location in fast flash, SLOW for location in slow flash, INLINE for inlining of the service
        NORMAL  # Location in normal flash
        FAST  # Location in fast flash
        SLOW  # Location in slow flash
        INLINE  # Service is inlined
      enumeration ifxRbMemLocIpoMaps8: origin=RB:1.0.0:2010-12-17, set at pre-compile  # Ifx_IpoMap_s8 | Select one of following values: NORMAL for location in normal flash, FAST for location in fast flash, SLOW for location in slow flash, INLINE for inlining of the service
        NORMAL  # Location in normal flash
        FAST  # Location in fast flash
        SLOW  # Location in slow flash
        INLINE  # Service is inlined
      enumeration ifxRbMemLocIpoMapu16: origin=RB:1.0.0:2010-12-17, set at pre-compile  # Ifx_IpoMap_u16 | Select one of following values: NORMAL for location in normal flash, FAST for location in fast flash, SLOW for location in slow flash, INLINE for inlining of the service
        NORMAL  # Location in normal flash
        FAST  # Location in fast flash
        SLOW  # Location in slow flash
        INLINE  # Service is inlined
      enumeration ifxRbMemLocIpoMapu32: origin=RB:1.0.0:2023-05-29, set at pre-compile  # Ifx_IpoMap_u32 | Select one of following values: NORMAL for location in normal flash, FAST for location in fast flash, SLOW for location in slow flash, INLINE for inlining of the service
        NORMAL  # Location in normal flash
        FAST  # Location in fast flash
        SLOW  # Location in slow flash
        INLINE  # Service is inlined
      enumeration ifxRbMemLocIpoMapu8: origin=RB:1.0.0:2010-12-17, set at pre-compile  # Ifx_IpoMap_u8 | Select one of following values: NORMAL for location in normal flash, FAST for location in fast flash, SLOW for location in slow flash, INLINE for inlining of the service
        NORMAL  # Location in normal flash
        FAST  # Location in fast flash
        SLOW  # Location in slow flash
        INLINE  # Service is inlined
      enumeration ifxRbMemLocLkUpBaseMaps16: origin=RB:5.0.0:2012-12-17, set at pre-compile  # Ifx_LkUpBaseMap_s16 | Select one of following values: NORMAL for location in normal flash, FAST for location in fast flash, SLOW for location in slow flash, INLINE for inlining of the service
        NORMAL  # Location in normal flash
        FAST  # Location in fast flash
        SLOW  # Location in slow flash
        INLINE  # Service is inlined
      enumeration ifxRbMemLocLkUpBaseMaps32: origin=RB:1.0.0:2023-05-29, set at pre-compile  # Ifx_LkUpBaseMap_s32 | Select one of following values: NORMAL for location in normal flash, FAST for location in fast flash, SLOW for location in slow flash, INLINE for inlining of the service
        NORMAL  # Location in normal flash
        FAST  # Location in fast flash
        SLOW  # Location in slow flash
        INLINE  # Service is inlined
      enumeration ifxRbMemLocLkUpBaseMaps8: origin=RB:5.0.0:2012-12-17, set at pre-compile  # Ifx_LkUpBaseMap_s8 | Select one of following values: NORMAL for location in normal flash, FAST for location in fast flash, SLOW for location in slow flash, INLINE for inlining of the service
        NORMAL  # Location in normal flash
        FAST  # Location in fast flash
        SLOW  # Location in slow flash
        INLINE  # Service is inlined
      enumeration ifxRbMemLocLkUpBaseMapu16: origin=RB:5.0.0:2012-12-17, set at pre-compile  # Ifx_LkUpBaseMap_u16 | Select one of following values: NORMAL for location in normal flash, FAST for location in fast flash, SLOW for location in slow flash, INLINE for inlining of the service
        NORMAL  # Location in normal flash
        FAST  # Location in fast flash
        SLOW  # Location in slow flash
        INLINE  # Service is inlined
      enumeration ifxRbMemLocLkUpBaseMapu32: origin=RB:1.0.0:2023-05-29, set at pre-compile  # Ifx_LkUpBaseMap_u32 | Select one of following values: NORMAL for location in normal flash, FAST for location in fast flash, SLOW for location in slow flash, INLINE for inlining of the service
        NORMAL  # Location in normal flash
        FAST  # Location in fast flash
        SLOW  # Location in slow flash
        INLINE  # Service is inlined
      enumeration ifxRbMemLocLkUpBaseMapu8: origin=RB:5.0.0:2012-12-17, set at pre-compile  # Ifx_LkUpBaseMap_u8 | Select one of following values: NORMAL for location in normal flash, FAST for location in fast flash, SLOW for location in slow flash, INLINE for inlining of the service
        NORMAL  # Location in normal flash
        FAST  # Location in fast flash
        SLOW  # Location in slow flash
        INLINE  # Service is inlined
      enumeration ifxRbMemLocLkUpCurs16: origin=RB:1.0.0:2010-12-17, set at pre-compile  # Ifx_LkUpCur_s16 | Select one of following values: NORMAL for location in normal flash, FAST for location in fast flash, SLOW for location in slow flash, INLINE for inlining of the service
        NORMAL  # Location in normal flash
        FAST  # Location in fast flash
        SLOW  # Location in slow flash
        INLINE  # Service is inlined
      enumeration ifxRbMemLocLkUpCurs32: origin=RB:1.0.0:2023-05-29, set at pre-compile  # Ifx_LkUpCur_s32 | Select one of following values: NORMAL for location in normal flash, FAST for location in fast flash, SLOW for location in slow flash, INLINE for inlining of the service
        NORMAL  # Location in normal flash
        FAST  # Location in fast flash
        SLOW  # Location in slow flash
        INLINE  # Service is inlined
      enumeration ifxRbMemLocLkUpCurs8: origin=RB:1.0.0:2010-12-17, set at pre-compile  # Ifx_LkUpCur_s8 | Select one of following values: NORMAL for location in normal flash, FAST for location in fast flash, SLOW for location in slow flash, INLINE for inlining of the service
        NORMAL  # Location in normal flash
        FAST  # Location in fast flash
        SLOW  # Location in slow flash
        INLINE  # Service is inlined
      enumeration ifxRbMemLocLkUpCuru16: origin=RB:1.0.0:2010-12-17, set at pre-compile  # Ifx_LkUpCur_u16 | Select one of following values: NORMAL for location in normal flash, FAST for location in fast flash, SLOW for location in slow flash, INLINE for inlining of the service
        NORMAL  # Location in normal flash
        FAST  # Location in fast flash
        SLOW  # Location in slow flash
        INLINE  # Service is inlined
      enumeration ifxRbMemLocLkUpCuru32: origin=RB:1.0.0:2023-05-29, set at pre-compile  # Ifx_LkUpCur_u32 | Select one of following values: NORMAL for location in normal flash, FAST for location in fast flash, SLOW for location in slow flash, INLINE for inlining of the service
        NORMAL  # Location in normal flash
        FAST  # Location in fast flash
        SLOW  # Location in slow flash
        INLINE  # Service is inlined
      enumeration ifxRbMemLocLkUpCuru8: origin=RB:1.0.0:2010-12-17, set at pre-compile  # Ifx_LkUpCur_u8 | Select one of following values: NORMAL for location in normal flash, FAST for location in fast flash, SLOW for location in slow flash, INLINE for inlining of the service
        NORMAL  # Location in normal flash
        FAST  # Location in fast flash
        SLOW  # Location in slow flash
        INLINE  # Service is inlined
      enumeration ifxRbMemLocLkUpMaps16: origin=RB:1.0.0:2010-12-17, set at pre-compile  # Ifx_LkUpMap_s16 | Select one of following values: NORMAL for location in normal flash, FAST for location in fast flash, SLOW for location in slow flash, INLINE for inlining of the service
        NORMAL  # Location in normal flash
        FAST  # Location in fast flash
        SLOW  # Location in slow flash
        INLINE  # Service is inlined
      enumeration ifxRbMemLocLkUpMaps32: origin=RB:1.0.0:2023-05-29, set at pre-compile  # Ifx_LkUpMap_s32 | Select one of following values: NORMAL for location in normal flash, FAST for location in fast flash, SLOW for location in slow flash, INLINE for inlining of the service
        NORMAL  # Location in normal flash
        FAST  # Location in fast flash
        SLOW  # Location in slow flash
        INLINE  # Service is inlined
      enumeration ifxRbMemLocLkUpMaps8: origin=RB:1.0.0:2010-12-17, set at pre-compile  # Ifx_LkUpMap_s8 | Select one of following values: NORMAL for location in normal flash, FAST for location in fast flash, SLOW for location in slow flash, INLINE for inlining of the service
        NORMAL  # Location in normal flash
        FAST  # Location in fast flash
        SLOW  # Location in slow flash
        INLINE  # Service is inlined
      enumeration ifxRbMemLocLkUpMapu16: origin=RB:1.0.0:2010-12-17, set at pre-compile  # Ifx_LkUpMap_u16 | Select one of following values: NORMAL for location in normal flash, FAST for location in fast flash, SLOW for location in slow flash, INLINE for inlining of the service
        NORMAL  # Location in normal flash
        FAST  # Location in fast flash
        SLOW  # Location in slow flash
        INLINE  # Service is inlined
      enumeration ifxRbMemLocLkUpMapu32: origin=RB:1.0.0:2023-05-29, set at pre-compile  # Ifx_LkUpMap_u32 | Select one of following values: NORMAL for location in normal flash, FAST for location in fast flash, SLOW for location in slow flash, INLINE for inlining of the service
        NORMAL  # Location in normal flash
        FAST  # Location in fast flash
        SLOW  # Location in slow flash
        INLINE  # Service is inlined
      enumeration ifxRbMemLocLkUpMapu8: origin=RB:1.0.0:2010-12-17, set at pre-compile  # Ifx_LkUpMap_u8 | Select one of following values: NORMAL for location in normal flash, FAST for location in fast flash, SLOW for location in slow flash, INLINE for inlining of the service
        NORMAL  # Location in normal flash
        FAST  # Location in fast flash
        SLOW  # Location in slow flash
        INLINE  # Service is inlined
