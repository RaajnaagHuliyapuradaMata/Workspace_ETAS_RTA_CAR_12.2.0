AUTOSAR XML (schema 00048)
package /AUTOSAR_SoAd/EcucModuleDefs
  module definition SoAd [0..1]: category=VENDOR_SPECIFIC_MODULE_DEFINITION, post-build-variant-support=true, refined-module-def=SoAd, variants pre-compile  # Configuration of the SoAd (Socket Adaptor) module.
    container SoAdBswModules [0..*]  # Each container describes a specific BSW module that the SoAd shall interface to.
      string SoAdCddHeaderFileName [0..1]: origin=RB:AR41.16.2.0:2015-02-04, set at pre-compile, max-length=32, min-length=1  # RB (Vendor06) specific parameter: If upper layer of SoAd is an AUTOSAR module, then the header files are statically specified and automatically included in SoAd. In case of non-AUTOSAR Upper Layer components, the name of the CDD header would be configured with this parameter and the same would be included.
      boolean SoAdGetZeroCopyIfUdpTransmit [0..1]: origin=RB:AR42.4.3.0:2019-12-02, set at pre-compile  # RB (Vendor06) specific parameter: Enables SoAdGetZeroCopyIfUdpTransmit feature. | TRUE: Enables SoAdGetZeroCopyIfUdpTransmit feature. FALSE: Disables SoAdGetZeroCopyIfUdpTransmit feature.
      boolean SoAdIf: set at pre-compile  # Specifies if the BSW module supports the Communication Interface APIs or not. Value true means that the APIs are supported. A module can have both Communication Interface APIs and Transport Protocol APIs (e.g. the PduR module).
      boolean SoAdIfTriggerTransmit: set at pre-compile, default-value=false  # Specifies if the BSW module supports the TriggerTransmit API or not. Value true means that the API is supported.
      boolean SoAdIfTxConfirmation: set at pre-compile  # Specifies if the BSW module supports the TxConfirmation API or not. Value true means that the API is supported.
      boolean SoAdLocalIpAddrAssigmentChg [0..0]: set at pre-compile  # Specifies if the BSW module supports the LocalIpAddrAssigmentChg API or not. Value true means that the API is supported.
      boolean SoAdSoConModeChg [0..0]: set at pre-compile  # Specifies if the BSW module supports the SoConModeChg API or not. Value true means that the API is supported.
      boolean SoAdTp: set at pre-compile  # Specifies if the BSW module supports the TransportProtocol APIs or not. Value true means that the APIs are supported. A module can have both Communication Interface APIs and Transport Protocol APIs (e.g. the PduR module).
      boolean SoAdUseCallerInfix: set at pre-compile, default-value=true  # Specifies if SoAd shall use (TRUE) the infix "SoAd" when calling an upper layer module function or not (FALSE). E.g. if SoAdUseCallerInfix is TRUE for the upper layer "ABC" then SoAd will call ABC_SoAdIfRxIndication() otherwise SoAd would call ABC_IfRxIndication().
      boolean SoAdUseTypeInfix: set at pre-compile, default-value=true  # Specifies if SoAd shall use (TRUE) the API type infix "Tp" or "If" when calling an upper layer module function or not (FALSE). E.g. if SoAdUseTypeInfix is TRUE for the upper layer "ABC" then SoAd will call ABC_IfRxIndication(), otherwise SoAd would call ABC_RxIndication().
      foreign reference SoAdBswModuleRef: set at pre-compile, destination-type=ECUC-MODULE-CONFIGURATION-VALUES  # This is a reference to one BSW module's configuration (i.e. not the ECUC parameter definition template). | Example, there could be several configurations of PduR and this reference selects one of them. SoAd has to figure out from the structure of the referenced BSW module's configuration, what kind of upper layer he deals with. In case of a CDD SoAd expects UL-APIs in form of _SoAd<If|Tp><function> and expects CDD Pdu configuration structures according to the Ecu Configuration specification (chapter CDD module\Socket Adaptor). In case it is one of the standardized AUTOSAR BSW modules, the configuration structures and API names for interaction with SoAd are defined in the corresponding SWS.
    container SoAdConfig  # This container contains the configuration parameters and sub containers of the AUTOSAR SoAd module.
      container SoAdPduRoute [0..*]  # Describes the path of a PDU from an upper layer of the SoAd to the socket in the TCP/IP stack for transmission. This PDU can consume meta data items of type SOCKET_CONNECTION_ID_16.
        enumeration SoAdTxPduCollectionSemantics: {SOAD_COLLECT_LAST_IS_BEST, SOAD_COLLECT_QUEUED}, set at link in variant link-time / post-build in variant post-build / pre-compile in variant pre-compile, default-value=SOAD_COLLECT_QUEUED  # Specifies if this PDU shall be collected using a queued or last-is-best semantics. This parameter is only relevant if the PDU collection feature is enabled. Shall only be set to SOAD_COLLECT_LAST_IS_BEST if the related upper layer is configured with SoAdIfTriggerTransmit set to TRUE.
        integer SoAdTxPduId: 0..65535, scope=ECU, set at pre-compile, symbolic-name-value=true, with-auto=true  # SoAdTxPduId (automatically Generated) | Tx PDU ID of the PDU coming from the PDU Router.
        enumeration SoAdTxUpperLayerType: {IF, TP}, scope=ECU, set at link in variant link-time / post-build in variant post-build / pre-compile in variant pre-compile  # Specifies the upper layer interface type (must be "IF" in case of multiple PduRoutes).
        enumeration SoAdTxUser: {PduR, Sd, Cdd, UdpNm, Xcp, DoIP, EthDiagMM}, scope=ECU, origin=RB:AR41.16.2.0:2015-02-04, set at link in variant link-time / post-build in variant post-build / pre-compile in variant pre-compile  # RB (Vendor06) specific parameter: Specifies the upper layer module which owns this Pdu.
        integer SoAdUpperLayerTxPduId [0..1]: 0..65535, scope=ECU, origin=RB:AR41.16.2.0:2015-02-04, set at link in variant link-time / post-build in variant post-build / pre-compile in variant pre-compile, with-auto=true  # SoAdUpperLayerTxPduId (automatically Generated) | RB (Vendor06) specific parameter: Tx PDU ID of the upper layer module would be configured with this parameter if Upper Layer is CDD.
        string UL_SoAdIfTxConfirmation [0..1]: origin=RB:AR41.16.2.0:2015-02-04, set at link in variant link-time+post-build / pre-compile in variant pre-compile  # RB (Vendor06) specific parameter: This parameter configures the name of the callback that is used to notify upper layers about IfTxConfirmation.
        string UL_SoAdTpCopyTxData [0..1]: origin=RB:AR41.16.2.0:2015-02-04, set at link in variant link-time+post-build / pre-compile in variant pre-compile  # RB (Vendor06) specific parameter: This parameter configures the name of the callback function that is called to retrieve the data from upper layer.
        string UL_SoAdTpTxConfirmation [0..1]: origin=RB:AR41.16.2.0:2015-02-04, set at link in variant link-time+post-build / pre-compile in variant pre-compile  # RB (Vendor06) specific parameter: This parameter configures the name of the callback that is used to notify the upper layers about the TpTxConfirmation.
        reference SoAdTxPduRef: scope=ECU, set at link in variant link-time / post-build in variant post-build / pre-compile in variant pre-compile, destination=Pdu  # Reference to the global PDU structure
        container SoAdPduRouteDest [1..*]  # Specifies the PDU route destination.
          integer SoAdTxPduHeaderId [0..1]: 0..4294967296, multiplicity set at link in variant link-time / post-build in variant post-build / pre-compile in variant pre-compile, post-build-variant-multiplicity=true, post-build-variant-value=true, set at link in variant link-time / post-build in variant post-build / pre-compile in variant pre-compile  # ID to be sent on the TCP/IP connection if the PDU header option is enabled.
          enumeration SoAdTxUdpTriggerMode [0..1]: {TRIGGER_ALWAYS, TRIGGER_NEVER}, multiplicity set at link in variant link-time / post-build in variant post-build / pre-compile in variant pre-compile, set at link in variant link-time / post-build in variant post-build / pre-compile in variant pre-compile  # Specifies whether a PDU triggers the transmission of the nPduUdpTxBuffer. | If this parameter is set to TRIGGER_NEVER, SoAd shall use an nPduUdpTxBuffer for the related socket connection. nPduUdpTxBuffer can only be used for upper layers with IF API, i.e. this parameter shall only be set to TRIGGER_NEVER if all upper layers belonging to the related socket connection have SoAdTxUpperLayerType set to "IF". This parameter is only relevant for UDP connections.
          float SoAdTxUdpTriggerTimeout [0..1]: 0..INF, multiplicity set at link in variant link-time / post-build in variant post-build / pre-compile in variant pre-compile, post-build-variant-multiplicity=true, set at link in variant link-time / post-build in variant post-build / pre-compile in variant pre-compile  # Specifies the timeout in [s] the nPduUdpTxBuffer shall be transmitted at the latest after this PDU is put into the buffer. This optional parameter is only relevant if SoAdTxUdpTriggerMode is TRIGGER_NEVER.
          reference SoAdTxRoutingGroupRef [0..*]: multiplicity set at link in variant link-time / post-build in variant post-build / pre-compile in variant pre-compile, post-build-variant-multiplicity=true, set at link in variant link-time / post-build in variant post-build / pre-compile in variant pre-compile, destination=SoAdRoutingGroup  # Reference to the routing group.
          choice reference SoAdTxSocketConnOrSocketConnBundleRef: set at link in variant link-time / post-build in variant post-build / pre-compile in variant pre-compile, destination=[SoAdSocketConnection, SoAdSocketConnectionGroup]  # Choice Reference to a SocketConnection or to a SocketConnectionGroup on which the PDU is to be sent on. The reference to a SocketConnectionGroup shall only be used for upper layers with IF API.
      container SoAdRoutingGroup [0..*]  # Each container describes a specific routing group which can be enabled or disabled. A routing group consists of PDUs. Routing of PDUs can either be forwarding of PDUs from the upper layer to a TCP or UDP socket of the TCP/IP stack specified by a SoAdPduRoute or the other way around specified by a SoAdSocketRoute.
        integer SoAdRoutingGroupId: 0..65535, scope=ECU, set at pre-compile, symbolic-name-value=true, with-auto=true  # SoAdRoutingGroupId (automatically Generated) | Unique ID of Routing Group
        boolean SoAdRoutingGroupIsEnabledAtInit: set at link in variant link-time / post-build in variant post-build / pre-compile in variant pre-compile  # If set to true this routing group will be enabled after initializing the SoAd module (i.e. enabled in the SoAd_Init function).
        boolean SoAdRoutingGroupTxTriggerable: set at pre-compile, default-value=false  # Specifies if the If-TxPDUs related to the PduRouteDest containers | referenced by this routing group can be triggered via SoAd_IfRoutingGroupTransmit (TRUE) or not (FALSE).
      container SoAdSocketConnectionGroup [1..*]  # Specifies the configuration of a socket connection group, i.e. specifies the socket connections belonging to the group and the parameters which are common for all socket connections of the group. A socket connection specifies how data can be received and transmited via a TCP or UDP socket.
        boolean SoAdBypassMsgAcceptanceFilterPolicy [0..1]: origin=RB:AR42.4.2.0:2018-01-29, set at pre-compile  # Activates the bypass for the message acceptance filter policy (remote address is always overwritten and socket goes ONLINE when remote address contained wildcard). | TRUE: Bypass allows SoAd to overwrite remote address and make the socket ONLINE during reception of UDP message. FALSE: Bypass is disabled and normal processing of SoAdSocketMsgAcceptanceFilter disabled takes place.
        boolean SoAdPduHeaderEnable: set at link in variant link-time / post-build in variant post-build / pre-compile in variant pre-compile  # Enables the transmission of the PDU header (ID, length) on this socket connection. | TRUE: add SoAd PDU header before PDU data FALSE: No SoAd PDU header is used
        boolean SoAdSocketAutomaticSoConSetup: set at link in variant link-time / post-build in variant post-build / pre-compile in variant pre-compile, default-value=true  # Specifies if the setup of the socket connection shall be done automatically (TRUE) or manually (FALSE) via SoAd_OpenSoCon() and SoAd_CloseSoCon().
        integer SoAdSocketConnectionGroupId: 0..255, scope=ECU, origin=RB:AR41.16.2.0:2015-02-04, set at link in variant link-time / post-build in variant post-build / pre-compile in variant pre-compile, symbolic-name-value=true, with-auto=true  # SoAdSocketConnectionGroupId (automatically Generated) | RB (Vendor06) specific parameter: By this parameter the Identifier per SoAdConnectionGroup is configured. This is needed for other BSW modules to refer this configuration container. The configured ID must be unique across the configured SoAdConnectionGroups. This Socket Connection Group Id will be generated automatically in sequential incremental order which starts from '0'
        integer SoAdSocketDifferentiatedServicesField [0..1]: 0..63, multiplicity set at link in variant link-time / post-build in variant post-build / pre-compile in variant pre-compile, set at link in variant link-time / post-build in variant post-build / pre-compile in variant pre-compile  # The 6-bit Differentiated Service Field in the IP headers may be used for classifying network traffic. If not set a value of zero is used to indicate packets that have not been classified.
        integer SoAdSocketFlowLabel [0..1]: 0..1048575, multiplicity set at link in variant link-time / post-build in variant post-build / pre-compile in variant pre-compile, set at link in variant link-time / post-build in variant post-build / pre-compile in variant pre-compile  # The 20-bit Flow Label field in the IPv6 header may be used by a source to label sequences of packets for which it requests special handling by the IPv6 routers, such as non-default quality of service. If not set a Flow Label of zero is used to indicate packets that have not been labeled.
        integer SoAdSocketFramePriority [0..1]: 0..7, multiplicity set at link in variant link-time / post-build in variant post-build / pre-compile in variant pre-compile, set at link in variant link-time / post-build in variant post-build / pre-compile in variant pre-compile  # Specifies the priority of the Ethernet frame. | If IEEE 802.1Q VLAN Tags are used, the specified priority will be used in the VLAN Tag PCP filed. If this optional parameter is not available the default priority specified in the TcpIp module is used.
        boolean SoAdSocketIpAddrAssignmentChgNotification: set at link in variant link-time / post-build in variant post-build / pre-compile in variant pre-compile, default-value=false  # Specifies if the local IP address assignment change notification callback function of the upper layer shall be called if the assignment of the local IP address used by this socket connection changes.
        integer SoAdSocketLocalPort: 0..65535, set at link in variant link-time / post-build in variant post-build / pre-compile in variant pre-compile, default-value=0  # Local UDP or TCP port used for this connection. If this parameter set to 0 SoAd requests TcpIp to select an ephemeral port.
        boolean SoAdSocketMsgAcceptanceFilterEnabled: set at link in variant link-time / post-build in variant post-build / pre-compile in variant pre-compile, default-value=true  # Specifies if the message acceptance filter is enabled (TRUE) or not (FALSE). | Note: if a wildcard is used in SoAdSocketRemoteAddress AND SoAdSocketUdpListenOnly is FALSE, this parameter must be TRUE. Note: if multiple SoAdSocketConnections are configured for one SoAdSocketConnectionGroup, this parameter must be TRUE.
        boolean SoAdSocketPathMTUEnable [0..1]: multiplicity set at link in variant link-time / post-build in variant post-build / pre-compile in variant pre-compile, set at link in variant link-time / post-build in variant post-build / pre-compile in variant pre-compile, default-value=false  # Specifies if path MTU discovery shall be performed for this connection. If this optional parameter is not available the default behavior configured for the controller in the TcpIp module via the parameter TcpIpIpV4PathMtuEnabled or TcpIpIpV6PathMtuEnabled is applied.
        boolean SoAdSocketSoConModeChgBswMNotification [0..1]: set at link in variant link-time / post-build in variant post-build / pre-compile in variant pre-compile, default-value=false  # Specifies if the BswM_SoAd_SoConModeChg notification shall be called in case of SoCon mode change.
        boolean SoAdSocketSoConModeChgNotification: set at link in variant link-time / post-build in variant post-build / pre-compile in variant pre-compile, default-value=false  # Specifies if the SoCon mode change notification callback function of the upper layer shall be called in case of SoCon mode change.
        integer SoAdSocketTpRxBufferMin [0..1]: 0..65535, multiplicity set at link in variant link-time / post-build in variant post-build / pre-compile in variant pre-compile, set at link in variant link-time / post-build in variant post-build / pre-compile in variant pre-compile  # Specifies the amount of data in bytes (PDU data for the upper layer and PDU Header if used) the SoAd shall at least be able to buffer for data reception via each socket connection of the socket connection group and using an upper layer with TP. | Note: in case of a TCP socket where PduHeaderMode is used and an upper layer with IF-API, the required buffer size can be determined automatically.
        reference SoAdSocketLocalAddressRef: set at link in variant link-time / post-build in variant post-build / pre-compile in variant pre-compile, requires-symbolic-name-value=true, destination=TcpIpLocalAddr  # Local IP address and interface used for this connection.
        reference SoAdSocketSoConModeChgNotifUpperLayerRef [0..1]: multiplicity set at pre-compile, set at pre-compile, destination=SoAdBswModules  # Reference to an additional upper layer that shall receive socket connection state changes (although it is not a direct upper layer of the socket connection).
        container SoAdSocketConnection [1..*]  # Specifies the socket connection (Id and remote address information). | Note: Parameters which are common to all socket connections of a socket connection group are specified directly at the group.
          integer SoAdSocketId: 0..65535, scope=ECU, set at pre-compile, symbolic-name-value=true, with-auto=true  # SoAdSocketId (automatically Generated) | Socket connection identifier used as SoConId in the interaction with upper layers.
          string UL_LocalIpAddrAssignmentChg [0..*]: origin=RB:AR42.8.5.0:2020-05-27, set at link in variant link-time+post-build / pre-compile in variant pre-compile  # RB (Vendor06) specific parameter: This parameter configures the name of the callback function that is used to notify the upper layers about the Local Ip address assignment change. This parameter needs only to be configured if SoAdSocketIpAddrAssignmentChgNotification is set to TRUE for this group.
          string UL_SoConModeChg [0..*]: origin=RB:AR42.8.5.0:2020-05-, set at link in variant link-time+post-build / pre-compile in variant pre-compile  # RB (Vendor06) specific parameter: This parameter configures the name of the callback that is used to notify upper layers about SocketConnection Mode change information. This parameter needs only to be configured if SoAdSocketSoConModeChgNotification is set to TRUE for this group.
          container SoAdSocketRemoteAddress [0..1]  # Subcontainer of SoAdSocketConnection to specify the remote address (IP address and port) for a socket connection. | If SoAdSocketRemoteAddress is not specified the remote address has to be set by the upper layer via SoAd_SetRemoteAddr().
            string SoAdSocketRemoteIpAddress: set at link in variant link-time / post-build in variant post-build / pre-compile in variant pre-compile  # IP address of remote node. The configured address must be of the same TcpIpDomainType (i.e. IPv4 or IPv6) as the TcpIpLocalAddr referred by SoAdSocketLocalAddressRef . | To accept any remote IP address, set SoAdSocketRemoteIpAddress to "ANY". See message acceptance policy for more details.
            integer SoAdSocketRemotePort: 0..65535, set at link in variant link-time / post-build in variant post-build / pre-compile in variant pre-compile  # Remote UDP or TCP port used for this connection. | To accept any remote port, set SoAdSocketRemotePort to 0. See message acceptance policy for more details.
        choice container SoAdSocketProtocol  # Specifies the transport protocol and transport protocol specific parameters used for the socket connections of the socket connection group.
          container SoAdSocketTcp [0..1]  # Specifies that TCP is used as transport protocol for the socket connection group and parameters only related to TCP socket connections.
            boolean SoAdSocketRbTcpTimestampEnable [0..1]: scope=ECU, origin=RB:AR45.1.4.0:2021-09-30, set at pre-compile, default-value=false  # RB (Vendor06) Specifies to use the Timestamp option for this connection. It will not be defined for UDP sockets. | TRUE: This TCP connection will support Timestamp option feature. FALSE: This TCP connection will not support Timestamp option feature. Note: This parameter must not be set to TRUE if TcpIpRbTcpTimeStampEnabled is set to FALSE.
            float SoAdSocketTcpAutoConnectTimeout [0..1]: 0..INF, multiplicity set at link in variant link-time / post-build in variant post-build / pre-compile in variant pre-compile, set at link in variant link-time / post-build in variant post-build / pre-compile in variant pre-compile  # Specifies the time in seconds how long ´TCP connect attempts are repeated to reach SOAD_SOCON_ONLINE. This parameter is restricted to socket connection groups which are initiating a TCP connection and are under control of SoAd.
            boolean SoAdSocketTcpImmediateTpTxConfirmation: scope=ECU, set at link in variant link-time / post-build in variant post-build / pre-compile in variant pre-compile, default-value=false  # If set to FALSE, SoAd notifies the TP upper layer via transmit confirmation after a Tcp Ack has been received. If set to TRUE, SoAd notifies the TP upper layer via transmit confirmation immediately after transmit has been accepted by TcpIp.
            boolean SoAdSocketTcpInitiate: set at link in variant link-time / post-build in variant post-build / pre-compile in variant pre-compile  # Specifies the initiator for this TCP connection. It will not be defined for UDP sockets. | TRUE: This TCP connection is initiated by this module. FALSE: This TCP connection is to be initiated in the listen mode.
            boolean SoAdSocketTcpKeepAlive [0..1]: set at link in variant link-time / post-build in variant post-build / pre-compile in variant pre-compile, default-value=false  # Specifies to use the keep-alive mechanism for this connection. It will not be defined for UDP sockets. | TRUE: This TCP connection will use the keep-alive mechanism. FALSE: This TCP connection will not use the keep-alive mechanism. Note: This parameter must not be set to TRUE if TcpIpTcpKeepAliveEnabled is set to FALSE.
            float SoAdSocketTcpKeepAliveInterval [0..1]: 0..INF, multiplicity set at link in variant link-time / post-build in variant post-build / pre-compile in variant pre-compile, set at link in variant link-time / post-build in variant post-build / pre-compile in variant pre-compile  # Specifies the interval in seconds between subsequent keepalive probes.
            integer SoAdSocketTcpKeepAliveProbesMax [0..1]: 0..65535, multiplicity set at link in variant link-time / post-build in variant post-build / pre-compile in variant pre-compile, set at link in variant link-time / post-build in variant post-build / pre-compile in variant pre-compile  # Maximum number of times that TCP retransmits an individual data segment before aborting the connection.
            float SoAdSocketTcpKeepAliveTime [0..1]: 0..INF, multiplicity set at link in variant link-time / post-build in variant post-build / pre-compile in variant pre-compile, set at link in variant link-time / post-build in variant post-build / pre-compile in variant pre-compile, default-value=7200  # Specifies the time in seconds between the last data packet sent and the first keepalive probe.
            boolean SoAdSocketTcpNoDelay [0..1]: multiplicity set at link in variant link-time / post-build in variant post-build / pre-compile in variant pre-compile, set at link in variant link-time / post-build in variant post-build / pre-compile in variant pre-compile  # Specifies not to use the congestion control mechanism for this connection. It will not be defined for UDP sockets. | TRUE: This TCP connection will NOT use congestion control. FALSE: This TCP connection will use congestion control. If the optional parameter is not enabled, the default behavior configured for TcpIp via the parameter TcpIpTcpNagleEnabled is applied. Note: This parameter must not be set to FALSE if TcpIpTcpNagleEnabled is set to FALSE.
            boolean SoAdSocketTcpOutOfOrderEnable [0..1]: scope=ECU, origin=RB:AR45.1.4.0:2020-03-26, set at pre-compile, default-value=false  # RB (Vendor06) Specifies whether this socket connection is able to recieve Tcp OutOfOrder frames or not. | TRUE: TCP OutOfOrder is configured. FALSE:TCP OutOfOrder is not configured
            float SoAdSocketTcpRetransmissionTimeout [0..1]: 0.001..INF, multiplicity set at link in variant link-time / post-build in variant post-build / pre-compile in variant pre-compile, set at link in variant link-time / post-build in variant post-build / pre-compile in variant pre-compile  # Timeout in [s] before an unacknowledged TCP segment is sent again. If the timeout is set to INF, no TCP segments shall be retransmitted.
            integer SoAdSocketTcpTxQuota [0..1]: 0..4294967295, multiplicity set at link in variant link-time / post-build in variant post-build / pre-compile in variant pre-compile, set at link in variant link-time / post-build in variant post-build / pre-compile in variant pre-compile  # Specifies the maximum amount of bytes (PDU data provided by the upper layer and PDU Header if used) the SoAd may queue for transmission via TCP at the TcpIp module for each socket connection of this socket connection group. | Rationale: prohibits that a socket connection consumes all available transmit buffers at the TcpIp and blocks transmissions via other socket connections. If the optional parameter is not enabled, the amount of data is not limited.
            reference SoAdSocketTCPOptionFilterRef [0..1]: multiplicity set at link in variant link-time / post-build in variant post-build / pre-compile in variant pre-compile, set at link in variant link-time / post-build in variant post-build / pre-compile in variant pre-compile, requires-symbolic-name-value=true, destination=TcpIpTcpConfigOptionFilter  # Specifies which TCP option filter shall be applied on the related socket.
            reference SoAdSocketTcpTlsConnectionRef [0..1]: multiplicity set at pre-compile, set at pre-compile, requires-symbolic-name-value=true, destination=TcpIpTlsConnection  # If set the TCP socket is assigned to a TLS connection. The SoAd need to call Tcpip_ChangeParameter with the reference to the TLS connection as the parameter.
          container SoAdSocketUdp [0..1]  # Specifies that UDP is used as transport protocol for the socket connection group and parameters only related to UDP socket connections.
            integer SoAdSocketPduUdpTpTxBuffer [0..1]: 0..65535, multiplicity set at link in variant link-time / post-build in variant post-build / pre-compile in variant pre-compile, origin=RB:AR42.2.0.0:2017-04-04, set at link in variant link-time / post-build in variant post-build / pre-compile in variant pre-compile  # RB (Vendor06) specific parameter: Specifies the amount of data in bytes (PDU data provided by the upper layer and PDU Header if used) the SoAd shall buffer the data's under the relavant socket connection if TP PDU wanted to be buffered for UDP transmission. | Note: in case of a UDP socket and an upper layer with TP API is configured, the required buffer size can be determined automatically. This optional parameter is only relevant if a nPduUdpTxBuffer is used.
            float SoAdSocketUdpAliveSupervisionTimeout [0..1]: 0..INF, multiplicity set at link in variant link-time / post-build in variant post-build / pre-compile in variant pre-compile, set at link in variant link-time / post-build in variant post-build / pre-compile in variant pre-compile  # Specifies the time in [s] a UDP socket connection remains in the mode SOAD_SOCON_ONLINE after the latest reception of a frame from the remote peer specified by the remote address. If this optional parameter is not enabled UDP Alive Supervision is deactivated for the related socket connection group.
            boolean SoAdSocketUdpChecksumEnabled: set at link in variant link-time / post-build in variant post-build / pre-compile in variant pre-compile, default-value=true  # Specifies if UDP checksum calculation shall be enabled (TRUE) or skipped (FALSE) on the related socket. FALSE implies that the upper layer of the socket connection is either capable to handle malformed messages or applies a checksum mechanism itself.
            boolean SoAdSocketUdpListenOnly: set at link in variant link-time / post-build in variant post-build / pre-compile in variant pre-compile, default-value=false  # Specifies if the socket connection group is only used for reception (TRUE) or used for both reception and transmission (FALSE).
            boolean SoAdSocketUdpStrictHeaderLenCheckEnabled [0..1]: set at link in variant link-time / post-build in variant post-build / pre-compile in variant pre-compile, default-value=false  # Specifies if UDP messages shall be dropped (TRUE) if the length of all contained PDUs does not match the length of the whole message or not (FALSE). Shall only be set to TRUE if SoAdPduHeaderEnable is also set to TRUE.
            float SoAdSocketUdpTriggerTimeout [0..1]: 0..INF, multiplicity set at link in variant link-time / post-build in variant post-build / pre-compile in variant pre-compile, set at link in variant link-time / post-build in variant post-build / pre-compile in variant pre-compile  # Specifies the timeout in [s] a nPduUdpTxBuffer is waiting for a PDU with TriggerMode = TRIGGER_ALWAYS, i.e. when the timeout expires the nPduUdpTxBuffer is transmitted. Timer is reset after each UDP transmission. This optional parameter is only relevant if a nPduUdpTxBuffer is used.
            integer SoAdSocketnPduUdpTxBufferMin [0..1]: 0..65535, multiplicity set at link in variant link-time / post-build in variant post-build / pre-compile in variant pre-compile, set at link in variant link-time / post-build in variant post-build / pre-compile in variant pre-compile  # Specifies the amount of data in bytes (PDU data provided by the upper layer and PDU Header if used) the SoAd shall be able to buffer for data transmission via this socket connection in case the UDP message shall be buffered for transmission of multiple PDUs per UDP. | Note: in case of a UDP socket and an upper layer with TP API is configured, the required buffer size can be determined automatically. This optional parameter is only relevant if a nPduUdpTxBuffer is used.
      container SoAdSocketRoute [0..*]  # Describes the path of a PDU from a socket in the TCP/IP stack to an upper layer of the SoAd after reception in the TCP/IP Stack.
        integer SoAdRxPduHeaderId [0..1]: 0..4294967296, multiplicity set at link in variant link-time / post-build in variant post-build / pre-compile in variant pre-compile, post-build-variant-multiplicity=true, post-build-variant-value=true, set at link in variant link-time / post-build in variant post-build / pre-compile in variant pre-compile  # ID contained in the packet received on the TCP/IP connection if the PDU header option is enabled.
        choice reference SoAdRxSocketConnOrSocketConnBundleRef: set at link in variant link-time / post-build in variant post-build / pre-compile in variant pre-compile, destination=[SoAdSocketConnection, SoAdSocketConnectionGroup]  # Choice Reference to a SocketConnection or to a SocketConnectionGroup on which the PDU was received. The reference to a SocketConnectionGroup shall only be used for upper layers with IF API.
        container SoAdSocketRouteDest [1..*]  # Describes the upper layer destination PDU for a message received on a TcpIp socket. This PDU can produce meta data items of type SOCKET_CONNECTION_ID_16. | Multiple socket route destinations in the SoAdSocketRoute can only be used for upper layers of interface type (IF) and only for SoAdSocketRoute referring a SocketConnectionGroup. In this case SoAdRoutingGroups shall be used to map each SoAdSocketRouteDest uniquely to different socket connections of the SocketConnectionGroup.
          integer SoAdRxPduId [0..1]: 0..65535, scope=ECU, multiplicity set at link in variant link-time / post-build in variant post-build / pre-compile in variant pre-compile, set at link in variant link-time / post-build in variant post-build / pre-compile in variant pre-compile, with-auto=true  # SoAdRxPduId (automatically Generated) | This unique identifier is used for a receive cancellation request from an upper layer of the SoAd.
          enumeration SoAdRxUpperLayerType: {IF, TP}, scope=ECU, set at link in variant link-time / post-build in variant post-build / pre-compile in variant pre-compile  # Specifies the upper layer interface type (must be "IF" in case of multiple RxPdus).
          enumeration SoAdRxUser: {PduR, Sd, Cdd, UdpNm, Xcp, DoIP, EthDiagMM}, scope=ECU, origin=RB:AR41.16.2.0:2015-02-04, set at link in variant link-time+post-build / pre-compile in variant pre-compile  # RB (Vendor06) specific parameter: Specifies the upper layer module, owner of this RxPdu.
          integer SoAdUpperLayerRxPduId [0..1]: 0..65535, scope=ECU, multiplicity set at link in variant link-time / post-build in variant post-build / pre-compile in variant pre-compile, origin=RB:AR41.16.2.0:2015-02-04, set at link in variant link-time / post-build in variant post-build / pre-compile in variant pre-compile, with-auto=true  # SoAdUpperLayerRxPduId (automatically Generated) | RB (Vendor06) specific parameter: Rx PDU ID of the upper layer module would be configured with this parameter if Upper Layer is CDD.
          string UL_SoAdIfRxIndication [0..1]: origin=RB:AR41.16.2.0:2015-02-04, set at link in variant link-time+post-build / pre-compile in variant pre-compile  # RB (Vendor06) specific parameter: This parameter configures the name of the callback that is used to notify upper layers about IfRxIndication.
          string UL_SoAdTpCopyRxData [0..1]: origin=RB:AR41.16.2.0:2015-02-04, set at link in variant link-time+post-build / pre-compile in variant pre-compile  # RB (Vendor06) specific parameter: This parameter configures the name of the callback that is called to copy received data to upper layer.
          string UL_SoAdTpRxIndication [0..1]: origin=RB:AR41.16.2.0:2015-02-04, set at link in variant link-time+post-build / pre-compile in variant pre-compile  # RB (Vendor06) specific parameter: This parameter configures the name of the callback that is used to notify upper layers about TpRxIndication.
          string UL_SoAdTpStartOfReception [0..1]: origin=RB:AR41.16.2.0:2015-02-04, set at link in variant link-time+post-build / pre-compile in variant pre-compile  # RB (Vendor06) specific parameter: This parameter configures the name of the callback that is used to notify upper layers about the TpStartOfReception.
          reference SoAdRxPduRef: scope=ECU, set at link in variant link-time / post-build in variant post-build / pre-compile in variant pre-compile, destination=Pdu  # Reference to the global PDU structure
          reference SoAdRxRoutingGroupRef [0..*]: multiplicity set at link in variant link-time / post-build in variant post-build / pre-compile in variant pre-compile, set at link in variant link-time / post-build in variant post-build / pre-compile in variant pre-compile, destination=SoAdRoutingGroup  # Reference to the routing group. Mandatory if the parent SoAdSocketRoute contains more than one SoAdSocketRouteDest."
    container SoAdGeneral  # This container contains all global configuration parameters of SoAd.
      boolean SoAdBestMatchRxHeaderIdCheck [0..1]: scope=ECU, origin=RB:AR42.5.5.0:2018-11-19, set at pre-compile, default-value=false  # RB (Vendor06) specific parameter: This parameter would be used to enable the Rx Header Id check for Best Match Algorithm. | TRUE: Enables the Rx Header Id check for Best Match Algorithm FALSE: Disables the Rx Header Id check for Best Match Algorithm
      boolean SoAdChangeParameterEnabled: scope=ECU, origin=RB:AR41.19.0.0:2015-10-29, set at pre-compile  # RB (Vendor06) specific parameter: Allows Upper Layer to change the Parameter | TRUE: Allows Upper Layer to change the Parameter FALSE: Does not allow Upper Layer to change the Parameter
      boolean SoAdDHCPFQDNEnabled: scope=ECU, origin=RB:AR41.19.0.0:2015-10-29, set at pre-compile  # RB (Vendor06) specific parameter: Allows the Upper Layer to read/write the DHCP FQDN options | TRUE: Allows the Upper Layer to read/write the DHCP FQDN options FALSE: Does not allow the Upper Layer to read/write the DHCP FQDN options
      boolean SoAdDevErrorDetect: set at pre-compile, default-value=false  # Switches the development error detection and notification on or off. | * true: detection and notification is enabled. * false: detection and notification is disabled.
      boolean SoAdEnableSecurityEventReporting: scope=ECU, set at pre-compile, default-value=false  # Switches the reporting of security events to the IdsM: | - true: reporting is enabled. - false: reporting is disabled.
      boolean SoAdGetAndResetMeasurementDataApi: scope=ECU, set at pre-compile  # Enables / Disables the Get and Reset Measurement Data API | TRUE: Enables the SoAd_GetAndResetMeasurementData feature. FALSE: Disables the SoAd_GetAndResetMeasurementData feature.
      boolean SoAdIPAddrAssignmentEnabled: scope=ECU, origin=RB:AR41.19.0.0:2015-10-29, set at pre-compile  # RB (Vendor06) specific parameter: Allows Upper Layer to release/request the IP address assignment | TRUE: Allows Upper Layer to release/request the IP address assignment FALSE: Does not allow Upper Layer to release/request the IP address assignment
      boolean SoAdIPv6AddressEnabled: scope=ECU, set at pre-compile  # Allows for increased memory allocation to store IPv6 addresses. | TRUE: Enables support for IPv6 addresses FALSE: Only IPv4 addresses are supported
      float SoAdMainFunctionPeriod: 0..INF, scope=ECU, set at pre-compile  # Determines the frequency at which the SoAd_MainFunction() is called in [s].
      integer SoAdRbIfTcpTxQueSize [0..1]: 0..255, multiplicity set at pre-compile, origin=RB:AR45.1.0.0:2021-06-30, set at pre-compile, default-value=0  # RB (Vendor06) specific parameter: This parameter defines number of IF Tcp transmissions possible per socket before receiving ACK from the remote node. Any further transmission will be discarded. This parameter is relevant only if a socket is mapped to multiple IF Pdus and any one of the Pdu has configured uL_SoAdIfTxConfirmation. | Note: Each entry costs 4 * ( Number of Tcp sockets with multiple IF Pdus and with at least one PDU has configured uL_SoAdIfTxConfirmation) bytes of RAM.
      boolean SoAdRbTcpTlsEnabled [0..1]: scope=ECU, origin=RB:AR42.8.4.0:2020-03-26, set at pre-compile, default-value=false  # RB (Vendor06) specific parameter:Tls feature is supported | TRUE: TLS feature enabled FALSE:TLS feature disabled
      boolean SoAdRestUdpMsgDiscardByInvalidPduHeaderId [0..1]: scope=ECU, origin=RB:AR42.5.5.0:2018-11-19, set at pre-compile, default-value=false  # RB (Vendor06) specific parameter: This parameter would be used to enable the feature, Discarding of the rest of the message if no socket route can be found. | TRUE: Enables the feature, Discarding of the rest of the message if no socket route can be found. FALSE: Disables the feature, Discarding of the rest of the message if no socket route can be found.
      integer SoAdRoutingGroupMax: 0..65535, set at pre-compile  # Specifies the maximum number of SoAd routing groups. Furthermore it defines the platform type used for RoutingGroupIdType. If SoAdRoutingGroupMax is not greater than 256, a uint8 is used, | otherwise a uint16.
      integer SoAdSoConMax: 0..65535, set at pre-compile  # Specifies the maximum number of SoAd socket connections. | Furthermore it defines the platform type used for SoAd_SoConIdType. If SoAdSoConMax is not greater than 256, a uint8 is used, otherwise uint16.
      boolean SoAdTpCancelComEnabled: scope=ECU, origin=RB:AR41.19.0.0:2015-10-29, set at pre-compile  # RB (Vendor06) specific parameter: Allows the Upper Layer to request the cancelation of the active ongoing TP transmission/reception | TRUE: Upper Layer can cancel/terminate the active ongoing packets FALSE: Upper Layer cannot cancel/terminate the active ongoing packets
      integer SoAdTpTcpTransmitRetryCount [0..1]: 0..65535, origin=RB:AR41.16.2.0:2015-02-04, set at pre-compile  # RB (Vendor06) specific parameter: Determines the number of times SoAd shall retry Tp Tcp transmission through TcpIp_TcpTransmit when Tcp buffer is unavailable | If parameter is not configured or configured with 65535 then retry would happen infinitely
      boolean SoAdUseLocalPortFromConfig [0..1]: scope=ECU, origin=RB:AR42.4.2.0:2018-02-20, set at pre-compile  # RB (Vendor06) specific parameter: This parameter would be used only if UL wants to get the valid local port address from the configuration if any, when the API SoAd_GetLocalAddr() is called. Otherwise it will take the local port from the dynamic socket configurations. | TRUE: Reads Local Port from the configuration FALSE: Reads Local Port from the Dynamic Socket Configuration
      boolean SoAdVersionInfoApi: set at pre-compile, default-value=false  # Activates the SoAd_GetVersionInfo() API. | TRUE: Enables the SoAd_GetVersionInfo() API. FALSE: SoAd_GetVersionInfo() API is not included.
      container SoAdSecurityEventRefs [0..1]: multiplicity set at pre-compile  # Container for the references to IdsMEvent elements representing the security events that the SoAd module shall report to the IdsM in case the coresponding security related event occurs (and if SoAdEnableSecurityEventReporting is set to "true"). The standardized security events in this container can be extended by vendor-specific security events.
        symbolic name reference SOAD_SEV_DROP_PDU_RX_TCP [0..1]: multiplicity set at pre-compile, set at pre-compile, destination=IdsMEvent  # SoAd dropped a PDU. The PDU violates stack configuration and was received via a TCP socket.
        symbolic name reference SOAD_SEV_DROP_PDU_RX_UDP [0..1]: multiplicity set at pre-compile, set at pre-compile, destination=IdsMEvent  # SoAd dropped a PDU. The PDU violates stack configuration and was received via a UDP socket.
        symbolic name reference SOAD_SEV_DROP_MSG_RX_UDP_LENGTH [0..1]: multiplicity set at pre-compile, set at pre-compile, destination=IdsMEvent  # SoAd dropped a message. The message contains at least one PDU which violates stack configuration and was received via a UDP socket. The violation relates to thelength of the PDUs compared to the overall length of the message.
        symbolic name reference SOAD_SEV_DROP_MSG_RX_UDP_SOCKET [0..1]: multiplicity set at pre-compile, set at pre-compile, destination=IdsMEvent  # SoAd received a UDP message which violates stack configuration and was dropped. No suitable socket connection matching to configuration was found.
        symbolic name reference SOAD_SEV_REJECTED_TCP_CONNECTION [0..1]: multiplicity set at pre-compile, set at pre-compile, destination=IdsMEvent  # SoAd rejected a TCP connection. The connection request violates stack configuration.
