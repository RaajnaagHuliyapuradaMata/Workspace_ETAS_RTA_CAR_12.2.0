AUTOSAR XML (schema 00048)
package /AUTOSAR_Adc/EcucModuleDefs
  module definition Adc [0..1]: category=VENDOR_SPECIFIC_MODULE_DEFINITION, post-build-variant-support=true, refined-module-def=Adc, variants pre-compile  # MCAL Analog/Digital Converter | Configuration of the MCAL module for the analog-digital-converter (ADC).
    container AdcConfigSet  # Configuration data set | This is the base container that contains the post-build selectable configuration parameters
      container AdcHwUnit [1..31]: multiplicity set at pre-compile, post-build-variant-multiplicity=true  # HW unit | This container contains the Driver configuration (parameters) depending on grouping of channels This container could contain HW specific parameters which are not defined in the Standardized Module Definition. They must be added in the Vendor Specific Module Definition.
        enumeration AdcHwUnitId: {ADC_0, ADC_1, ADC_2, ADC_3, ADC_4, ADC_5, ADC_6, ADC_7, ADC_8, ADC_9, ADC_10, ADC_11, ADC_B}, post-build-variant-value=true, set at pre-compile  # Unit ID | Description: Numeric ID of the HW Unit. This symbolic name allows accessing Hw Unit data. Enumeration literals are defined vendor specific.
        container AdcChannel [1..255]: multiplicity set at pre-compile, post-build-variant-multiplicity=true  # Channel | This container contains the channel configuration (parameters) depending on the hardware capability. The organization of this data structure could contain dependencies to the microcontroller so this is left up to the implementer and its location is left up to the configuration. Note: Since a AdcChannel can be part of several AdcGroups, this container is not realized as a subcontainer of AdcGroup but instead as a subcontainer of AdcHwUnit.
          integer AdcChannelId: 0..1024, post-build-variant-value=true, set at pre-compile  # Channel ID | This parameter defines the assignment of the channel to the physical ADC hardware channel. ImplementationType: Adc_ChannelType
          integer AdcMuxChannel [0..1]: 0..7, multiplicity set at pre-compile, origin=RB, post-build-variant-multiplicity=true, post-build-variant-value=true, set at pre-compile  # Multiplexer Channel | This optional parameter defines the assignment of the channel to the physical pin of an external ADC-Multiplexer
          enumeration AdcRbChannelResAccess [0..1]: multiplicity set at pre-compile, origin=RB, post-build-variant-multiplicity=true, post-build-variant-value=true, set at pre-compile, default-value=ADC_RB_ACCESS_MODE_NORMAL  # Conversion result access mode | Configuration of the result access. Conversion result may either be read from ADC register directly or a DMA channel may be linked to end of conversion event of the channel if the normal access is unwanted. The data handling must be done in complex driver for these two modes. There is no notification (callback) available for channels which are different from normal mode.
            ADC_RB_ACCESS_MODE_NORMAL  # Normal access
            ADC_RB_ACCESS_MODE_REGISTER  # Direct register access
            ADC_RB_ACCESS_MODE_DMA  # DMA transfer
          string AdcRbChannelResDmaName [0..1]: multiplicity set at pre-compile, origin=RB, post-build-variant-multiplicity=true, post-build-variant-value=true, set at pre-compile, max-length=32, min-length=1  # Name of transferring DMA | If the conversion result access is done by DMA transfer the channel longname for the separately configured DMA has to be added here as rba_Dma_<SHORTNAME_of_rba_Dma_Ch_config>
          string AdcRbCustSpecName [0..1]: multiplicity set at pre-compile, origin=RB, post-build-variant-multiplicity=true, post-build-variant-value=true, set at pre-compile, max-length=32, min-length=1  # Customer-specific name | Customer-specific name of this signal. If configured, this name is given in the report file additionally
          function name AdcRbVirtFunc [0..1]: multiplicity set at pre-compile, origin=RB, post-build-variant-multiplicity=true, post-build-variant-value=true, set at pre-compile  # Virtualization function | Virtualization function to inject Adc result values into Adc driver for virtuell Mcal
        container AdcGroup [1..255]: multiplicity set at pre-compile, post-build-variant-multiplicity=true  # Group | This container contains the Group configuration (parameters).
          integer AdcGroupId: 0..1023, set at pre-compile, symbolic-name-value=true  # Group ID | Numeric ID of the group. This parameter is the symbolic name to be used on the API. This symbolic name allows accessing Channel Group data. This value will be assigned to the symbolic name derived of the AdcGroup container shortName. ImplementationType: Adc_GroupType
          enumeration AdcGroupTriggSrc: post-build-variant-value=true, set at pre-compile  # Type of trigger | Type of source event that starts a group conversion. ImplementationType: Adc_TriggerSourceType
            ADC_TRIGG_SRC_HW  # Group trigger by hardware
            ADC_TRIGG_SRC_SW  # Group trigger by software
          enumeration AdcHwTrigLine [0..1]: {GTM_TRIG0, GTM_TRIG1, GTM_TRIG2, GTM_TRIG3, GTM_TRIG4}, multiplicity set at pre-compile, origin=RB, post-build-variant-multiplicity=true, post-build-variant-value=true, set at pre-compile  # Input line for trigger (IFX) | IFX: Configures from which input line the hardware trigger signal will be taken. This must match the GTM (A)TOM configuration "Output connection" like ADC0_TRIG0. Default line is GTM_TRIG0 (ADCx_TRIG0). For background group the default is GTM_TRIG1 (ADC0_TRIG1). ST: Leave unset, there is only one input line per SARADC unit which is used per default. ImplementationType: Adc_Rb_GroupTriggerType
          enumeration AdcHwTrigSignal [0..1]: multiplicity set at pre-compile, post-build-variant-multiplicity=true, post-build-variant-value=true, set at pre-compile  # Active trigger edge | Configures on which edge of the hardware trigger signal the driver should react, i.e. start the conversion (only if supported by the ADC hardware). ImplementationType: Adc_HwTriggerSignalType
            ADC_HW_TRIG_BOTH_EDGES  # React on both edges of trigger
            ADC_HW_TRIG_FALLING_EDGE  # React on the falling edge of trigger
            ADC_HW_TRIG_RISING_EDGE  # React on the rising edge of trigger
          function name AdcNotification [0..1]: multiplicity set at pre-compile, post-build-variant-multiplicity=true, post-build-variant-value=true, set at pre-compile  # Callback function | Callback function for each group
          string AdcRbNotificationHeaderName [0..1]: multiplicity set at pre-compile, origin=RB, post-build-variant-multiplicity=true, post-build-variant-value=true, set at pre-compile  # Notification header file | Header file with declaration of the notification callback
          reference AdcGroupDefinition [1..255]: multiplicity set at pre-compile, post-build-variant-multiplicity=true, post-build-variant-value=true, set at pre-compile, destination=AdcChannel  # Assign Channels to Groups | Assignment of AdcChannels to AdcGroups. ImplementationType: Adc_GroupDefType
      container AdcMuxConfig [0..8]: multiplicity set at pre-compile, post-build-variant-multiplicity=true  # Optional External Multiplexer | This container contains configuration (parameters) for an external multiplexer.
        string AdcMuxInput: origin=RB, post-build-variant-value=true, set at pre-compile, max-length=10, min-length=1  # Analog Input | Specifies to which ADC channel of the uCs background conversion unit this multiplexer is connected to. The scheme to be used is: ST: ADC_B_<ChannelIdx> IFX: ADC_<UnitIdx>_<ChannelIdx> <UnitIdx>,<ChannelIdx> must use the minimum number of decimals. This means a leading 0 must not be applied for Ids < 10.
      container AdcMuxResources [0..1]: multiplicity set at pre-compile, post-build-variant-multiplicity=true  # Optional External Multiplexer Resources | This container contains additional configuration parameters for resources needed by external multiplexers.
        string AdcMuxNameDMA [0..1]: multiplicity set at pre-compile, origin=RB, post-build-variant-multiplicity=true, post-build-variant-value=true, set at pre-compile, max-length=32, min-length=1  # DMA short name | Specifies the name of the DMA which is used for external MUX purpose. The name will not be forwarded to rba_Dma. Configuratiion must be done in rba_Dma.
        enumeration AdcMuxPort0 [0..1]: multiplicity set at pre-compile, origin=RB, post-build-variant-multiplicity=true, post-build-variant-value=true, set at pre-compile  # Port line 0 | Specifies the output port of the lowest significant multiplexer control line 0.
          ADC_CFG_EMUXPORT_PC_{3..5}  # PC[{3..5}]
          ADC_CFG_EMUXPORT_PD_12  # PD[12]
          ADC_CFG_EMUXPORT_PD_13  # PD[13]
          ADC_CFG_EMUXPORT_PE_3  # PE[3]
          ADC_CFG_EMUXPORT_PI_{10..12}  # PI[{10..12}]
          ADC_CFG_EMUXPORT_P00_06  # P00[6]
          ADC_CFG_EMUXPORT_P00_07  # P00[7]
          ADC_CFG_EMUXPORT_P00_08  # P00[8]
          ADC_CFG_EMUXPORT_P02_06  # P02[6]
          ADC_CFG_EMUXPORT_P02_07  # P02[7]
          ADC_CFG_EMUXPORT_P02_08  # P02[8]
          ADC_CFG_EMUXPORT_P33_01  # P33[1]
          ADC_CFG_EMUXPORT_P33_02  # P33[2]
          ADC_CFG_EMUXPORT_P33_03  # P33[3]
          ADC_CFG_EMUXPORT_P33_04  # P33[4]
          ADC_CFG_EMUXPORT_P33_05  # P33[5]
          ADC_CFG_EMUXPORT_P33_06  # P33[6]
        enumeration AdcMuxPort1 [0..1]: multiplicity set at pre-compile, origin=RB, post-build-variant-multiplicity=true, post-build-variant-value=true, set at pre-compile  # Port line 1 | Specifies the output port of the multiplexer control line 1.
          ADC_CFG_EMUXPORT_PC_{3..5}  # PC[{3..5}]
          ADC_CFG_EMUXPORT_PD_12  # PD[12]
          ADC_CFG_EMUXPORT_PD_13  # PD[13]
          ADC_CFG_EMUXPORT_PE_3  # PE[3]
          ADC_CFG_EMUXPORT_PI_{10..12}  # PI[{10..12}]
          ADC_CFG_EMUXPORT_P00_06  # P00[6]
          ADC_CFG_EMUXPORT_P00_07  # P00[7]
          ADC_CFG_EMUXPORT_P00_08  # P00[8]
          ADC_CFG_EMUXPORT_P02_06  # P02[6]
          ADC_CFG_EMUXPORT_P02_07  # P02[7]
          ADC_CFG_EMUXPORT_P02_08  # P02[8]
          ADC_CFG_EMUXPORT_P33_01  # P33[1]
          ADC_CFG_EMUXPORT_P33_02  # P33[2]
          ADC_CFG_EMUXPORT_P33_03  # P33[3]
          ADC_CFG_EMUXPORT_P33_04  # P33[4]
          ADC_CFG_EMUXPORT_P33_05  # P33[5]
          ADC_CFG_EMUXPORT_P33_06  # P33[6]
        enumeration AdcMuxPort2 [0..1]: multiplicity set at pre-compile, origin=RB, post-build-variant-multiplicity=true, post-build-variant-value=true, set at pre-compile  # Port line 2 | Specifies the output port of the most significant multiplexer control line 2.
          ADC_CFG_EMUXPORT_PC_{3..5}  # PC[{3..5}]
          ADC_CFG_EMUXPORT_PD_12  # PD[12]
          ADC_CFG_EMUXPORT_PD_13  # PD[13]
          ADC_CFG_EMUXPORT_PE_3  # PE[3]
          ADC_CFG_EMUXPORT_PI_{10..12}  # PI[{10..12}]
          ADC_CFG_EMUXPORT_P00_06  # P00[6]
          ADC_CFG_EMUXPORT_P00_07  # P00[7]
          ADC_CFG_EMUXPORT_P00_08  # P00[8]
          ADC_CFG_EMUXPORT_P02_06  # P02[6]
          ADC_CFG_EMUXPORT_P02_07  # P02[7]
          ADC_CFG_EMUXPORT_P02_08  # P02[8]
          ADC_CFG_EMUXPORT_P33_01  # P33[1]
          ADC_CFG_EMUXPORT_P33_02  # P33[2]
          ADC_CFG_EMUXPORT_P33_03  # P33[3]
          ADC_CFG_EMUXPORT_P33_04  # P33[4]
          ADC_CFG_EMUXPORT_P33_05  # P33[5]
          ADC_CFG_EMUXPORT_P33_06  # P33[6]
      container AdcRbFastComparator [0..31]: multiplicity set at pre-compile, post-build-variant-multiplicity=true  # Optional Fast Comparator | This container contains the fast comparator configuration parameters.
        string AdcRbConnectedTo: origin=RB, post-build-variant-value=true, set at pre-compile  # Connected to | Represents unit and channel number of the Adc fast comparator unit. Eg: ADCFC_x_y where x is the Adc FastComp unit and y is the channel number. for ST 28nm: 9bit converter for IFX 40nm: 10bit converter
        enumeration AdcRbThresholdRange: multiplicity set at pre-compile, origin=RB, post-build-variant-multiplicity=true, post-build-variant-value=true, set at pre-compile  # Threshold range | Defines which kind of threshold comparison needs to be covered by the fast comparator. (upper limit violation or lower limit violation)
          ADC_ABOVE  # Fast comparator triggers if result is above threshold value
          ADC_BELOW  # Fast comparator triggers if result is below threshold value
        integer AdcRbThresholdValue: multiplicity set at pre-compile, origin=RB, set at pre-compile  # Threshold value | Adc threshold voltage value in milli volts (mV) that is used for fast comparison. The value ranges from 0 to Adc reference voltage (5V) of the selected unit. Note: the configured threshold value in mV will be converted into a discrete threshold value based on resolution of the used fast comparator. See Adc_Report.txt for detailed information.
        enumeration AdcRbTriggerToGTM: multiplicity set at pre-compile, origin=RB, post-build-variant-multiplicity=true, post-build-variant-value=true, set at pre-compile  # Trigger to GTM | Defines which GTM input needs to be triggered by fast comparator. See Port Assignment list for corresponding GTM input selection. The valid Watchdog Level Triggers are WdgLevelTrigger0 WdgLevelTrigger1 Device-specific availability: ST 28nm: WdgLevelTrigger 0..1 IFX 40nm: WdgLevelTrigger 0 (Ifx Gtm input is FCxBFL aka BoundaryFlagLevel)
          ADC_WDGLEVEL0  # Watchdog Level Trigger0
          ADC_WDGLEVEL1  # Watchdog Level Trigger1
    container AdcGeneral  # General settings | General configuration (parameters) of the ADC Driver software module.
      boolean AdcDevErrorDetect: set at pre-compile  # Development error detection | Switches the Development Error Detection and Notification ON or OFF. true: Enabled. false: Disabled.
      boolean AdcEnableMedc17Legacy [0..1]: multiplicity set at pre-compile, origin=RB:UNICON, set at pre-compile, default-value=false  # Enable MEDC17 legacy interface | Add MEDC17 legacy interfaces by rba_IoSigIfAdapt_Adc.h into the include chain of Adc.h. (optional) This setting will be forwarded from upper configuration layers. Default setting is FALSE
      boolean AdcEnableStartStopGroupApi: set at pre-compile, default-value=true  # Enable Adc_StartGroupConversion function | Adds / removes the services Adc_StartGroupConversion() and Adc_StopGroupConversion() from the code. true: Adc_StartGroupConversion() and Adc_StopGroupConversion() can be used. false: Adc_StartGroupConversion() and Adc_StopGroupConversion() can not be used.
      boolean AdcGrpNotifCapability: set at pre-compile, default-value=true  # Activate group notification mechanism | Determines, if the group notification mechanism (the functions to enable and disable the notifications) is available at runtime. true: Enabled. false: Disabled.
      boolean AdcHwTriggerApi: set at pre-compile, default-value=true  # Enable Adc_EnableHardwareTrigger function | Adds / removes the services Adc_EnableHardwareTrigger() and Adc_DisableHardwareTrigger() from the code. true: Adc_EnableHardwareTrigger() and Adc_DisableHardwareTrigger() can be used. false: Adc_EnableHardwareTrigger() and Adc_DisableHardwareTrigger() can not be used.
      boolean AdcRbPollingMode: origin=RB:UNICON, set at pre-compile, default-value=false  # Enable polling mode of Adc component | Enables / disables the polling mode of the Adc component. true: polling mode enabled, no interrupts triggered at end of conversion false: polling modes disabled, interrupts triggered at end of conversion
      boolean AdcReadGroupApi: set at pre-compile, default-value=true  # Enable Adc_ReadGroup function | Adds / removes the service Adc_ReadGroup() from the code. true: Adc_ReadGroup() can be used. false: Adc_ReadGroup() can not be used.
