AUTOSAR XML (schema 00048)
package /AUTOSAR_SecOC/EcucModuleDefs
  module definition SecOC [0..1]: category=VENDOR_SPECIFIC_MODULE_DEFINITION, post-build-variant-support=true, refined-module-def=SecOC, variants post-build  # Configuration of the SecOC (Secure Onboard Communication) module.
    container SecOCGeneral  # SecOC General | Contains the general configuration parameters of the SecOC module.
      integer SecOCDefaultAuthenticationInformationPattern [0..1]: 0..255, multiplicity set at pre-compile, set at pre-compile  # SecOC Default Authentication Information Pattern | The parameter describes the behaviour of SecOC when authentication build counter has reached the configuration value SecOCAuthenticationBuildAttempts, or the query of the freshness function returns E_NOT_OK or the calculation of the authenticator has returned a non-recoverable error such as returning E_NOT_OK or KEY_FAILURE. If the configuration parameter is not present, SecOC module shall remove the Authentic I-PDU from its internal buffer and cancel the transmission request If the configuration parameter is present, SecOC will use this value for each byte of Freshness Value and Authenticator when building the Authentication Information, and will not cancel the transmission request.
      boolean SecOCDevErrorDetect: set at pre-compile, default-value=false  # Default error tracer (Det) | Switches the default error tracer (Det) detection and notification ON or OFF.
      boolean SecOCEnableForcedPassOverride: set at pre-compile, default-value=false  # Enable forced pass override | When this configuration option is set to TRUE then the functionality inside the function SecOC_VerifyStatusOverride to forcibly override the VerifyStatus to "Pass" is enabled.
      boolean SecOCEnableSecurityEventReporting: set at pre-compile, default-value=false  # Enable security reporting | Switches the reporting of security events to the IdsM ON or OFF. If the switch is set to true the reporting is enabled. If the switch is set to false the reporting is disabled.
      boolean SecOCIgnoreVerificationResult: set at pre-compile, default-value=false  # Ignore verification result | Switches the handling of verification result ON or OFF. If the switch is set to true the verification is performed but the verification result is ignored. So if the verification fails the PDU is forwarded to the PduR nevertheless and an error event is set in the Logging Module. The switch is implemented for the test phase and will be ignored in series software.
      float SecOCMainFunctionPeriodRx [0..1]: 0..1, multiplicity set at pre-compile, set at pre-compile  # Period of the default main function SecOC_MainFunctionRx | Specifies the period in seconds of the default main function (SecOC_MainFunctionRx) which handles all Rx PDUs with no reference to a SecOCMainFunctionRx container. If there is no such Rx PDU configured, this parameter has no usage (each SecOCMainFunctionRx container has its own periodicity parameter).
      float SecOCMainFunctionPeriodTx [0..1]: 0..1, multiplicity set at pre-compile, set at pre-compile  # Period of the default main function SecOC_MainFunctionTx | Specifies the period in seconds of the default main function (SecOC_MainFunctionTx) which handles all Tx PDUs with no reference to a SecOCMainFunctionTx container. If there is no such Tx PDU configured, this parameter has no usage (each SecOCMainFunctionTx container has its own periodicity parameter).
      enumeration SecOCMaxAlignScalarType: {uint16, uint32, uint8}, set at pre-compile, default-value=uint32  # SecOC maximum alignment type | The scalar type which has the maximum alignment restrictions on the given platform. This type can be e.g. uint8, uint16 or uint32.
      boolean SecOCOverrideStatusWithDataId [0..1]: multiplicity set at pre-compile, set at pre-compile, default-value=false  # SecOC Override Status with DataId | This option defines if the parameter "ValueId" of the function SecOC_VerifyStatusOverride() accepts the freshness value (as a collection of one or more Secured I-PDUs to freshness) or the dataID for individual Secured I-PDUs. True: Function SecOC_VerifyStatusOverride accepts SecOCDataId. False: Function SecOC_VerifyStatusOverride accepts SecOCFreshnessValueId.
      boolean SecOCPropagateOnlyFinalVerificationStatus: set at pre-compile, default-value=false  # SecOC propagate only final verification status | Specify if the verification status shall be reported only after the final determination of the verification status (TRUE) or on every verification attempt (FALSE). If the switch is set to true verification status shall be reported only after the final determination of the verification status and if the switch is set to false verification status shall be reported on every verification attempt.
      enumeration SecOCQueryFreshnessValue: {CFUNC, RTE}, set at pre-compile, default-value=CFUNC  # SecOC query freshness value | Specifies if the freshness value shall be determined through a C-function (CD) or a software component (SW-C).
      enumeration SecOCRbCryptDefaultInterface: {Csm_rba_CryptoCCL, Csm_rba_CryptoHSM, Csm_Crypto, None}, origin=RB:1.0.0:2021-06-01, set at pre-compile, default-value=Csm_rba_CryptoCCL  # SecOC default cryptographic interface | Selects the default cryptographic interface. It is set for all Rx and Tx pdus if the mac calculation is done via the cryptographic library (value Csm_rba_CryptoCCL ) or via hardware security module (value Csm_rba_CryptoHSM). If value 'None' is selected no cryptographic interface is called. Nevertheless the PDUs are forwarded to the PduR for further routing. This configuration can be overwritten for each pdu in the pdu configuration containers.
      enumeration SecOCRbCryptDefaultMode: {asynchronous, synchronous}, origin=RB:1.0.0:2021-06-01, set at pre-compile, default-value=synchronous  # SecOC cryptographic mode | SecOC can call the cryptographic services synchronous or asynchronous. Both are done in the cyclic main functions but in case of asynchronous mode the result is received via callbacks. AR defines the asynchronous mode. This configuration is set for all Rx and Tx PDUs but it can be overwritten for each pdu in the pdu configuration containers.
      enumeration SecOCRbDefaultCryptAlgoFamily: {AES, POLY1305, SIPHASH}, origin=RB:1.0.0:2021-06-01, set at pre-compile, default-value=AES  # SecOC cryptographic algorithm family | Selects the algorithm family used for generation and verification of MAC.*At least the following AlgoFam, Mode, 2ndFam combinations are support:*AES, CMAC, AES*POLY1305, NOT_SET, POLY1305 (Poly1305 algorithm hasn't got different modes)*SIPHASH, SIPHASH_2_4, SPIHASH
      enumeration SecOCRbDefaultCryptAlgoMode: {CMAC, NOT_SET, SIPHASH_2_4}, origin=RB:1.0.0:2021-06-01, set at pre-compile, default-value=CMAC  # SecOC cryptographic algorithm mode | Selects the algorithm mode used for generation and verification of MAC.*At least the following AlgoFam, Mode, 2ndFam combinations are support:*AES, CMAC, AES*POLY1305, NOT_SET, POLY1305 (Poly1305 algorithm hasn't got different modes)*SIPHASH, SIPHASH_2_4, SPIHASH
      enumeration SecOCRbDefaultCryptAlgoSecondFamily: {AES, POLY1305, SIPHASH}, origin=RB:1.0.0:2021-06-01, set at pre-compile, default-value=AES  # SecOC cryptographic algorithm secondary family | Selects the algorithm secondary family used for generation and verification of MAC.*At least the following AlgoFam, Mode, 2ndFam combinations are support:*AES, CMAC, AES*POLY1305, NOT_SET, POLY1305 (Poly1305 algorithm hasn't got different modes)*SIPHASH, SIPHASH_2_4, SPIHASH
      boolean SecOCRbDefaultUseBulkProcessing [0..1]: multiplicity set at pre-compile, origin=RB:1.0.0:2021-06-01, set at pre-compile, default-value=false  # SecOC Default use Bulk Processing | This parameter indicates if the MAC calculation should be processed in Bulk mode or in single shot mode only for those PDUs which do not have the parameter SecOCRb[Rx/Tx]UseBulkProcessing configured. The SecOCRbDefaultUseBulkProcessing parameter will be ignored by those PDUs that have SecOCRb[Rx/Tx]UseBulkProcessing configured. The MAC calculation will be processed according to the value of SecOCRb[Rx/Tx]UseBulkProcessing parameter. Note: Bulk mode is available only for PDUs with cryptographic interface set to HSM and cryptographic mode set to asynchronous. The default value is FALSE.
      boolean SecOCRbEnableCryptPduBypass [0..1]: multiplicity set at pre-compile, origin=RB:1.0.0:2021-06-01, set at pre-compile, default-value=false  # SecOC enable cryptgraphic pdu bypass | When this configuration option ist set to TRUE the functionality inside the optional Interface SecOC_VerifyStatusOverride provide an additional overrideStatus = 43 (meaning bypass verification until notice)
      boolean SecOCRbEnableMeasurementPoint [0..1]: multiplicity set at pre-compile, origin=RB:1.0.0:2021-06-01, set at pre-compile, default-value=false  # Enable SecOC measurement points | If this parameter is set to TRUE, the measurement points are enabled for all Tx and Rx PDUs. For details see user documentation.
      boolean SecOCRbEnablePduCollection [0..1]: multiplicity set at pre-compile, origin=RB:1.0.0:2021-06-01, set at pre-compile, default-value=false  # SecOC enable pdu collection | If this parameter ist set to TRUE, pdu collection can be used
      boolean SecOCRbPDUsWithSawtoothBitcounting [0..1]: multiplicity set at pre-compile, origin=RB:5.0.0:2023-05-10, set at pre-compile, default-value=false  # PDUs use sawtooth bit counting | When this parameter is set to TRUE, the SecOCAuthDataFreshnessStartPosition of a PDU and SecOCMessageLinkPos of a secure PDU (if a collection PDU is used) are interpreted following sawtooth bit counting. Otherwise monotone bit counting is assumed. According to AUTOSAR, sawtooth bit counting should be used, monotone bit counting is used as default to keep backwards compatibility.
      boolean SecOCRbRetryVerifyImmediately: origin=RB:1.0.0:2021-06-01, set at pre-compile, default-value=false  # SecOC retry verification immediately | If this parameter is set to true, SecOC retries the verification immediately in the same main function cycle if mac verification fails (see section 9.4 in AR specification). This feature is only possible for synchronous jobs.
      integer SecOCRbRteQLenVerifyStateOverride [0..1]: 1.., multiplicity set at pre-compile, origin=RB:1.0.0:2021-06-01, set at pre-compile, default-value=1  # SecOC Rte queue length for VerifyStatusOverride | This parameter is the depth of the RTE q-length, the history buffer, generated and provided by the Rte. Usage might be needed (IF): Rte is used (AND) Provided PORT and Required PORT are asynchron (AND) running on different OsApplications e.g. 1ms 10ms (AND) a history of all values is needed on the requesting side.
      function name SecOCRbSafetyCallout [0..1]: multiplicity set at pre-compile, origin=RB:1.0.0:2021-06-01, set at pre-compile  # SecOC safety callout | If the safety callout is configured, it is called in API SecOC_VerifyStatusOverride. Depending upon the result of the callout, the execution of API SecOC_VerifyStatusOverride is blocked or not. TRUE: VerifyStatusOverride is blocked, FALSE: VerifyStatusOverride is executed.
      boolean SecOCRbSecuredAreaDeviation [0..1]: multiplicity set at pre-compile, origin=RB:1.0.0:2021-06-01, set at pre-compile, default-value=false  # SecOC secured area Autosar deviation | If this parameter is set to false, Range of secOCSecuredTxPduLength and secOCSecuredRxPduLength is 1 .. 4294967295 (AR compliant), if the parameter is true, Range of secOCSecuredTxPduLength and secOCSecuredRxPduLength is 0 .. 4294967295 (AR deviation). If secOCSecuredTxPduLength or secOCSecuredRxPduLength is set to 0, the PDU payload is excluded for MAC calculation. If secOCSecuredTxPduLength or secOCSecuredRxPduLength is not configured (NULL_PTR), the complete PDU payload is included for MAC calculation.
      function name SecOCVerificationStatusCallout [0..*]: multiplicity set at pre-compile, set at pre-compile  # SecOC verification status callout | Name of the verification status callout
      boolean SecOCVersionInfoApi: set at pre-compile, default-value=true  # SecOC version Info | Switches the availability of the SecOC_GetVersionInfo ON or OFF.
      container SecOCRbCustomerFeat [0..1]: multiplicity set at pre-compile  # SecOC Customer Features | Contains the customer specific extensions. Do not configure anything in this container if you expect AR conformal implementation.
        boolean SecOCRbGmExtendValueID [0..1]: multiplicity set at pre-compile, origin=RB:5.0.0:2023-02-28, set at pre-compile, default-value=false  # SecOC Extended ValueID | This parameter indicates a deviation of AR specification. The ValueIDs, SecOCDataId and SecOCFreshnessValueId, are extended to contain 5 bytes. FALSE: ValueID [2Bytes AR Spec] TRUE: ValueID [5Bytes GM requirement] default: FALSE
        integer SecOCRbGmKsn [0..1]: 0..65535, multiplicity set at pre-compile, origin=RB:5.0.0:2023-02-28, set at pre-compile  # SecOC key serial number | This parameter defines the key serial number for Some/IP PDUs (only for customer GM required)
    container SecOCMainFunctionRx [0..*]: multiplicity set at pre-compile  # SecOC Main Function Rx | Each element of this container defines one instance of SecOC_MainFunctionRx.
      float SecOCMainFunctionPeriodRx: 0..4294967295, set at pre-compile  # Period of this SecOC Main Function Rx container | Allows to configure the time for the respective MainFunction instance of the Rx path (as float in seconds).
      reference SecOCMainFunctionRxPartitionRef: set at pre-compile, destination=EcucPartition  # SecOC Main Function Rx partition reference | Reference to EcucPartition, where the according SecOC_MainFunction instance is assigned to.
    container SecOCMainFunctionTx [0..*]: multiplicity set at pre-compile  # SecOC Main Function Tx | Each element of this container defines one instance of SecOC_MainFunctionTx.
      float SecOCMainFunctionPeriodTx: 0..4294967295, set at pre-compile  # Period of this SecOC Main Function Tx container | Allows to configure the time for the respective MainFunction instance of the Tx path (as float in seconds).
      reference SecOCMainFunctionTxPartitionRef: set at pre-compile, destination=EcucPartition  # SecOC Main Function Tx partition reference | Reference to EcucPartition, where the according SecOC_MainFunction instance is assigned to.
    container SecOCRxPduProcessing [0..*]: multiplicity set at pre-compile  # SecOC configuration of received PDUs to be verified | Contains the parameters to configure the RxPdus to be verified by the SecOC module.
      integer SecOCAuthDataFreshnessLen [0..1]: 0..64, multiplicity set at pre-compile, set at pre-compile, default-value=0  # SecOC authentic data freshness length | This parameter specifies the length of the external authentic PDU data in bits.
      integer SecOCAuthDataFreshnessStartPosition [0..1]: 0..65535, multiplicity set at pre-compile, set at pre-compile, default-value=0  # SecOC authentic data freshness start position | This parameter determines the start position in bits (uint16) of the Authentic PDU that shall be passed on to the Freshness SWC. The bit position starts counting from the MSB of the first byte of the PDU.
      integer SecOCAuthInfoTruncLength: 1..65535, post-build-variant-value=true, set at post-build, default-value=4  # SecOC authentication length | This parameter defines the length in bits of the authentication code to be included in the payload of the Secured I-PDU.
      integer SecOCAuthenticationBuildAttempts [0..1]: 0..65535, multiplicity set at pre-compile, set at pre-compile, default-value=0  # SecOC number of authentication build attempts | This parameter specifies the number of authentication build attempts.
      integer SecOCAuthenticationVerifyAttempts [0..1]: 0..65535, multiplicity set at pre-compile, set at pre-compile, default-value=0  # SecOC number of verification attempts | This parameter specifies the number of authentication verify attempts that are to be carried out when the verification of the authentication information failed for a given Secured I_PDU.If zero is set then only one authentication verification attempt is done.
      enumeration SecOCClientServerVerificationStatusPropagationMode: {BOTH, FAILURE_ONLY, NONE}, post-build-variant-value=true, set at post-build  # SecOC client server verification status propagation mode | This parameter is used to describe the propagation of the status of each verification attempt from SecOC module through the client/server interface to SWCs.
      integer SecOCDataId: 0..1099511627775, post-build-variant-value=true, set at post-build  # SecOC data identifier | This parameter defines a unique numerical identifier for the Secured I-PDU.
      integer SecOCFreshnessValueId: 0..1099511627775, post-build-variant-value=true, set at post-build  # SecOC freshness value id | This parameter specifies the local freshness identifier used to generate the freshness value used to generate or verify a MAC.
      integer SecOCFreshnessValueLength: 0..64, post-build-variant-value=true, set at post-build, default-value=0  # SecOC freshness value length | This parameter defines the length in bits of the Freshness Value.
      integer SecOCFreshnessValueTruncLength: 0..64, post-build-variant-value=true, set at post-build, default-value=0  # SecOC freshness value payload length | This parameter defines the length in bits of the Freshness Value to be included in the payload of the Secured I-PDU. This length is specific to the least significant bits of the complete Freshness Counter. If the parameter is 0 no Fresh-ness Value is included in the Secured I-PDU.
      string SecOCRbAutoConfigHsmKeySlotId [0..1]: multiplicity set at pre-compile, origin=RB:1.0.0:2021-06-01, set at pre-compile  # SecOC cryptographic HSM key slot | This parameter explicitly maps the secure cryptokey element into a specified key slot inside the HSM secure flash. If left empty, then an available key slot automatically assigned to it. The name (e.g. DYNAMIC_CFG_CRYPTO_AES_KEY_BASE_0) of the key slot must be provided. This autoconfiguration parameter will only apply to key element which are stored in HSM.
      enumeration SecOCRbRxCryptAlgoFamily [0..1]: {AES, POLY1305, SIPHASH}, multiplicity set at pre-compile, origin=RB:1.0.0:2021-06-01, set at pre-compile, default-value=AES  # SecOC cryptographic algorithm family | Selects the algorithm family used for generation and verification of MAC.*At least the following AlgoFam, Mode, 2ndFam combinations are support:*AES, CMAC, AES*POLY1305, NOT_SET, POLY1305 (Poly1305 algorithm hasn't got different modes)*SIPHASH, SIPHASH_2_4, SPIHASH
      enumeration SecOCRbRxCryptAlgoMode [0..1]: {CMAC, NOT_SET, SIPHASH_2_4}, multiplicity set at pre-compile, origin=RB:1.0.0:2021-06-01, set at pre-compile, default-value=CMAC  # SecOC cryptographic algorithm mode | Selects the algorithm mode used for generation and verification of MAC.*At least the following AlgoFam, Mode, 2ndFam combinations are support:*AES, CMAC, AES*POLY1305, NOT_SET, POLY1305 (Poly1305 algorithm hasn't got different modes)*SIPHASH, SIPHASH_2_4, SPIHASH
      enumeration SecOCRbRxCryptAlgoSecondFamily [0..1]: {AES, POLY1305, SIPHASH}, multiplicity set at pre-compile, origin=RB:1.0.0:2021-06-01, set at pre-compile, default-value=AES  # SecOC cryptographic algorithm secondary family | Selects the algorithm secondary family used for generation and verification of MAC.*At least the following AlgoFam, Mode, 2ndFam combinations are support:*AES, CMAC, AES*POLY1305, NOT_SET, POLY1305 (Poly1305 algorithm hasn't got different modes)*SIPHASH, SIPHASH_2_4, SPIHASH
      enumeration SecOCRbRxCryptMode [0..1]: {asynchronous, synchronous}, multiplicity set at pre-compile, origin=RB:1.0.0:2021-06-01, set at pre-compile  # SecOC cryptographic mode | SecOC can call the cryptographic services synchronous or asynchronous. Both are done in the cyclic main functions but in case of asynchronous mode the result is received via callbacks. AR defines the asynchronous mode. This pdu specific configuration overwrites the global setting in container SecOCGeneral.
      enumeration SecOCRbRxPduCryptIF [0..1]: {Csm_rba_CryptoCCL, Csm_rba_CryptoHSM, None, Csm_Crypto}, multiplicity set at pre-compile, origin=RB:1.0.0:2021-06-01, set at pre-compile  # SecOC cryptographic interface | Selects the default cryptographic interface. It is set if the mac calculation is done via the cryptographic library (value Csm_rba_CryptoCCL ) or via hardware security module (value Csm_rba_CryptoHSM). If value 'None' is selected no cryptographic interface is called. Nevertheless the PDUs are forwarded to the PduR for further routing. This pdu specific configuration overwrites the global setting in container SecOCGeneral.
      boolean SecOCRbRxUseBulkProcessing [0..1]: multiplicity set at pre-compile, origin=RB:1.0.0:2021-06-01, set at pre-compile  # SecOC use Bulk Processing | This parameter indicates if the MAC verification for Rx PDUs should be processed in Bulk mode or in single shot mode. Possible values: 1. TRUE: the MAC job will be processed in Bulk mode, 2. FALSE: the MAC job will be processed in single shot mode. Note: If SecOCRbRxUseBulkProcessing is not configured, then it will use the configured value of SecOCGeneral/SecOCRbDefaultUseBulkProcessing as default. Bulk mode is available only for PDUs with cryptographic interface set to HSM and cryptographic mode set to asynchronous.
      enumeration SecOCReceptionOverflowStrategy: {QUEUE, REJECT, REPLACE}, set at pre-compile  # SecOC reception overflow strategy | This parameter defines the overflow strategy for receiving PDUs. QUEUE --> Subsequent received message will be queued as long as there are free queue entries. All PDU ID instances received in the queue are sent for verification to Csm (in MainFunctionRx) at the same time. Any additional messages received when the queue is already full are discarded. REJECT --> First message is processed, second message is saved in a second buffer. Any additional received messages will be discarded (currently started verification on lower level e.g. Csm will not be disturbed, First-Is-Best for both queue entries). REPLACE --> First message is processed, second message is saved in a second buffer. Any additional received messages will overwrite the second buffer (currently started verification on lower level e.g. Csm will not be disturbed, message is buffered, last one will be processed next cycle, First-Is-Best for the first PDU instance, Last-Is-Best for the additional PDU instances).
      integer SecOCReceptionQueueSize [0..1]: 1..254, multiplicity set at pre-compile, set at pre-compile, default-value=2  # SecOC reception queue size | This parameter defines the queue size in case the overflow strategy for receiving PDUs is set to QUEUE.
      boolean SecOCUseAuthDataFreshness: set at pre-compile, default-value=false  # SecOC use authentic PDU data freshness | This parametert indicates if a part of the Authentic-PDU shall be passed on to the SWC that verifies and generates the Freshness. If it is set to TRUE, the values SecOCAuthDataFreshnessStartPosition and SecOCAuthDataFreshnessLen must be set to specify the bit position and length within the Authentic-PDU.
      enumeration SecOCVerificationStatusPropagationMode: {BOTH, FAILURE_ONLY, NONE}, post-build-variant-value=true, set at post-build  # SecOC verification status propagation mode | This parameter is used to describe the propagation of the status of each verification attempt from SecOC module to SWCs.
      reference SecOCRxAuthServiceConfigRef [0..*]: multiplicity set at pre-compile, set at pre-compile, destination=CsmJob  # Reference to Csm Job | This reference is used to define which crypto service function is called for authentication.
      reference SecOCRxPduMainFunctionRef [0..1]: multiplicity set at pre-compile, set at pre-compile, destination=SecOCMainFunctionRx  # Reference to SecOC_MainFunctionRx | Reference to the SecOC_MainFunctionRx this PDU belongs to.
      reference SecOCSameBufferPduRef [0..1]: multiplicity set at pre-compile, set at pre-compile, destination=SecOCSameBufferPduCollection  # Reference to Buffer collection | This reference is used to collect Pdus that are using the same SecOC buffer.
      container SecOCRxAuthenticPduLayer  # SecOC configuration of authentic PDU | This container specifies the Pdu that is transmitted by the SecOC module to the PduR after the Mac was verified.
        enumeration SecOCPduType [0..1]: {SECOC_IFPDU, SECOC_TPPDU}, multiplicity set at pre-compile, set at pre-compile, default-value=SECOC_IFPDU  # SecOC Pdu Type | This parameter defines the API Type to use for communication with PduR. SECOC_IFPDU --> Interface communication API SECOC_TPPDU --> Transport Protocol communication API
        integer SecOCRxAuthenticLayerPduId: 0..65535, set at pre-compile, symbolic-name-value=true, with-auto=true  # SecOC identifier of authentic PDU | SecOC identifier of authentic PDU, used by PduR for SecOC_TpCancelReceive. Do not set it manually, it will be set by SecOC forwarder.
        reference SecOCRxAuthenticLayerPduRef: post-build-variant-value=true, set at post-build, destination=Pdu  # Reference to authentic PDU | Reference to the global Pdu.
      container SecOCRxPduSecuredArea [0..1]: multiplicity set at pre-compile  # SecOC Rx Pdu secured area | This container specifies an area in the Authentic I-Pdu that will be the input to the Authenticator verification algorithm. If this container does not exist in the configuration the complete Authentic I-Pdu will be the input to the Authenticator verification algorithm.
        integer SecOCSecuredRxPduLength: 0..4294967295, post-build-variant-value=true, set at post-build  # Length of Rx secured area | This parameter defines the length (in bytes) of the area within the Pdu which is secured.
        integer SecOCSecuredRxPduOffset: 0..4294967295, post-build-variant-value=true, set at post-build, default-value=0  # Start position of Rx secured area | This parameter defines the start position (offset in bytes) of the area within the Pdu which is secured.
      choice container SecOCRxSecuredPduLayer  # SecOC configuration of received PDU from PduR | This is a choice container
        container SecOCRxSecuredPdu [0..1]: multiplicity set at pre-compile  # SecOC configuration of SecOCRxSecuredPdu | This container specifies the Pdu that is received by the SecOC module from the PduR. For this Pdu the Mac verification is provided.
          integer SecOCAuthPduHeaderLength [0..1]: 0..4, multiplicity set at pre-compile, set at pre-compile, default-value=0  # Length of secured PDU header | This parameter indicates the length in bytes of the Secured I-PDU Header in the Secured I-PDU. The length of zero means there is no header in the secured PDU.
          enumeration SecOCRbSecuredHeaderRepresentation [0..1]: {HEADER_IN_BITS, HEADER_IN_BYTES}, multiplicity set at pre-compile, origin=RB:1.0.0:2021-06-01, set at pre-compile, default-value=HEADER_IN_BYTES  # SecOC secured header representation | Secured header length can be configured to be represented in bytes or bits. The representation in bits is not AUTOSAR compliant and is used to handle padding at the end of secured PDU. HEADER_IN_BITS --> The length of authentic PDU given in the secured header is in bits HEADER_IN_BYTES --> The length of authentic PDU given in the secured header is in bytes
          integer SecOCRxSecuredLayerPduId: 0..65535, set at pre-compile, symbolic-name-value=true, with-auto=true  # SecOC identifier of secured PDU | PDU identifier assigned by SecOC module, Used by PduR for SecOC_PduRRxIndication. Do not set it manually, it will be set by SecOC forwarder.
          boolean SecOCSecuredRxPduVerification: post-build-variant-value=true, set at post-build, default-value=false  # SecOC verification on secured PDU | This parameter defines whether the signature authentication or MAC verification shall be performed on this Secured I-PDU. If set to false, the SecOC module extracts the Authentic PDU from the Secured PDU without verification. Default value (false) will disable signature authentication or MAC verification on this Secured I-PDU.
          reference SecOCRxSecuredLayerPduRef: post-build-variant-value=true, set at post-build, destination=Pdu  # Reference to secured PDU | Reference to the global Pdu.
        container SecOCRxSecuredPduCollection [0..1]: multiplicity set at pre-compile  # SecOC configuration of SecOCRxSecuredPduCollection | This container specifies two Pdus that are received by the SecOC module from the PduR and a message linking between them.
          boolean SecOCSecuredRxPduVerification: post-build-variant-value=true, set at post-build, default-value=false  # SecOC verification on secured PDU | This parameter defines whether the signature authentication or MAC verification shall be performed on this Secured I-PDU. If set to false, the SecOC module extracts the Authentic PDU from the Secured PDU without verification. . Default value (false) will disable signature authentication or MAC verification on this Secured I-PDU.
          container SecOCRxAuthenticPdu  # SecOC configuration of SecOCRxAuthenticPdu | This container specifies the Pdu that is transmitted by the SecOC module to the PduR after the Mac was verified.
            integer SecOCAuthPduHeaderLength [0..1]: 0..4, multiplicity set at pre-compile, set at pre-compile, default-value=0  # Length of secured PDU header | This parameter indicates the length in bytes of the Secured I-PDU Header in the Authentic I-PDU. The length of zero means there is no header in the Authentic PDU.
            enumeration SecOCRbSecuredHeaderRepresentation [0..1]: {HEADER_IN_BITS, HEADER_IN_BYTES}, multiplicity set at pre-compile, origin=RB:1.0.0:2021-06-01, set at pre-compile, default-value=HEADER_IN_BYTES  # SecOC secured header representation | Secured header length can be configured to be represented in bytes or bits. The representation in bits is not AUTOSAR compliant and is used to handle padding at the end of Authentic PDU.
            integer SecOCRxAuthenticPduId: 0..65535, set at pre-compile, symbolic-name-value=true, with-auto=true  # SecOC identifier of authentic PDU | PDU identifier of the Authentic I-PDU assigned by SecOC module. Used by PduR for SecOC_PduRRxIndication. Do not set it manually, it will be set by SecOC forwarder.
            reference SecOCRxAuthenticPduRef: post-build-variant-value=true, set at post-build, destination=Pdu  # Reference to authentic PDU | Reference to the global Pdu.
          container SecOCRxCryptographicPdu  # SecOC configuration of SecOCRxCryptographicPdu | This container specifies the Cryptographic Pdu that is received by the SecOC module from the PduR.
            integer SecOCRxCryptographicPduId: 0..65535, set at pre-compile, symbolic-name-value=true, with-auto=true  # SecOC identifier of Cryptographic PDU | PDU identifier of the Cryptographic I-PDU assigned by SecOC module. Used by PduR for SecOC_PduRRxIndication. Do not set it manually, it will be set by SecOC forwarder.
            reference SecOCRxCryptographicPduRef: post-build-variant-value=true, set at post-build, destination=Pdu  # Reference to cryptographic PDU | Reference to the global Pdu.
          container SecOCUseMessageLink [0..1]: multiplicity set at pre-compile  # Message linker of authentic and cryptographic PDU | SecOC links an Authentic I-PDU and Cryptographic I-PDU together by repeating a specific part (Message Linker) of the Authentic I-PDU in the Cryptographic I-PDU.
            integer SecOCMessageLinkLen: 0..65535, set at pre-compile  # Length of message linker | Length of the message linker inside the Authentic PDU in bits.
            integer SecOCMessageLinkPos: 0..65535, set at pre-compile  # Position of message linker | The position of message linker inside the Authentic PDU in bits.
    container SecOCSameBufferPduCollection [0..*]: multiplicity set at pre-compile  # SecOC Buffer configuration that may be used by a collection of Pdus. | SecOCBuffer configuration that may be used by a collection of Pdus.
      integer SecOCBufferLength: 0..4294967295, set at pre-compile, default-value=0  # Buffer length | This parameter defines the length of the buffer for Pdu collection in bytes.
    container SecOCTxPduProcessing [0..*]: multiplicity set at pre-compile  # SecOC configuration of transmitted PDUs to be secured | Contains the parameters to configure the TxPdus to be secured by the SecOC module.
      integer SecOCAuthInfoTruncLength: 1..65535, post-build-variant-value=true, set at post-build, default-value=4  # SecOC authentication length | This parameter defines the length in bits of the authentication code to be included in the payload of the Secured I-PDU.
      integer SecOCAuthenticationBuildAttempts [0..1]: 0..65535, multiplicity set at pre-compile, set at pre-compile, default-value=0  # SecOC number of authentication build attempts | This parameter specifies the number of authentication build attempts.
      integer SecOCDataId: 0..1099511627775, post-build-variant-value=true, set at post-build  # SecOC data identifier | This parameter defines a unique numerical identifier for the Secured I-PDU.
      integer SecOCFreshnessValueId: 0..1099511627775, post-build-variant-value=true, set at post-build  # SecOC freshness value id | This parameter specifies the local freshness identifier used to generate the freshness value used to generate or verify a MAC.
      integer SecOCFreshnessValueLength: 0..64, post-build-variant-value=true, set at post-build, default-value=0  # SecOC freshness value length | This parameter defines the length in bits of the Freshness Value. If it is non-byte aligned, padding bits from freshness manager are used for mac generation.
      integer SecOCFreshnessValueTruncLength: 0..64, post-build-variant-value=true, set at post-build, default-value=0  # SecOC freshness value payload length | This parameter defines the length in bits of the Freshness Value to be included in the payload of the Secured I-PDU. This length is specific to the least significant bits of the complete Freshness Counter. If the parameter is 0 no Fresh-ness Value is included in the Secured I-PDU.
      boolean SecOCProvideTxTruncatedFreshnessValue: set at pre-compile, default-value=false  # SecOC provide Tx truncated freshness value | This parameter specifies if the Tx query freshness function provides the truncated freshness info instead of generating this by SecOC. In this case, SecOC shall add this data to the Authentic PDU instead of truncating the freshness value.
      string SecOCRbAutoConfigHsmKeySlotId [0..1]: multiplicity set at pre-compile, origin=RB:1.0.0:2021-06-01, set at pre-compile  # SecOC cryptographic HSM key slot | This parameter explicitly maps the secure cryptokey element into a specified key slot inside the HSM secure flash. If left empty, then an available key slot automatically assigned to it. The name (e.g. DYNAMIC_CFG_CRYPTO_AES_KEY_BASE_0) of the key slot must be provided. This autoconfiguration parameter will only apply to key element which are stored in HSM.
      boolean SecOCRbClearBufferAfterTransmit [0..1]: multiplicity set at pre-compile, origin=RB:1.0.0:2021-06-01, set at pre-compile, default-value=false  # SecOCRB Clear buffers after transmit | If this parameter is set to true, SecOC doesn't wait for TxConfirmation to clear the buffers and instead clears the buffers and resets the PDU state to idle directly after passing the secured PDU to the PduR.
      enumeration SecOCRbTxCryptAlgoFamily [0..1]: {AES, POLY1305, SIPHASH}, multiplicity set at pre-compile, origin=RB:1.0.0:2021-06-01, set at pre-compile, default-value=AES  # SecOC cryptographic algorithm family | Selects the algorithm family used for generation and verification of MAC.*At least the following AlgoFam, Mode, 2ndFam combinations are support:*AES, CMAC, AES*POLY1305, NOT_SET, POLY1305 (Poly1305 algorithm hasn't got different modes)*SIPHASH, SIPHASH_2_4, SPIHASH
      enumeration SecOCRbTxCryptAlgoMode [0..1]: {CMAC, NOT_SET, SIPHASH_2_4}, multiplicity set at pre-compile, origin=RB:1.0.0:2021-06-01, set at pre-compile, default-value=CMAC  # SecOC cryptographic algorithm mode | Selects the algorithm mode used for generation and verification of MAC.*At least the following AlgoFam, Mode, 2ndFam combinations are support:*AES, CMAC, AES*POLY1305, NOT_SET, POLY1305 (Poly1305 algorithm hasn't got different modes)*SIPHASH, SIPHASH_2_4, SPIHASH
      enumeration SecOCRbTxCryptAlgoSecondFamily [0..1]: {AES, POLY1305, SIPHASH}, multiplicity set at pre-compile, origin=RB:1.0.0:2021-06-01, set at pre-compile, default-value=AES  # SecOC cryptographic algorithm secondary family | Selects the algorithm secondary family used for generation and verification of MAC.*At least the following AlgoFam, Mode, 2ndFam combinations are support:*AES, CMAC, AES*POLY1305, NOT_SET, POLY1305 (Poly1305 algorithm hasn't got different modes)*SIPHASH, SIPHASH_2_4, SPIHASH
      enumeration SecOCRbTxCryptMode [0..1]: {asynchronous, synchronous}, multiplicity set at pre-compile, origin=RB:1.0.0:2021-06-01, set at pre-compile  # SecOC cryptographic mode | SecOC can call the cryptographic services synchronous or asynchronous. Both are done in the cyclic main functions but in case of asynchronous mode the result is received via callbacks. AR defines the asynchronous mode. This pdu specific configuration overwrites the global setting in container SecOCGeneral.
      enumeration SecOCRbTxPduCryptIF [0..1]: {Csm_rba_CryptoCCL, Csm_rba_CryptoHSM, Csm_Crypto, None}, multiplicity set at pre-compile, origin=RB:1.0.0:2021-06-01, set at pre-compile  # SecOC cryptographic interface | Selects the default cryptographic interface. It is set if the mac calculation is done via the cryptographic library (value Csm_rba_CryptoCCL ) or via hardware security module (value Csm_rba_CryptoHSM). If value 'None' is selected no cryptographic interface is called. Nevertheless the PDUs are forwarded to the PduR for further routing. This pdu specific configuration overwrites the global setting in container SecOCGeneral.
      boolean SecOCRbTxUseBulkProcessing [0..1]: multiplicity set at pre-compile, origin=RB:1.0.0:2021-06-01, set at pre-compile  # SecOC use Bulk Processing | This parameter indicates if the MAC generation for Tx PDUs should be processed in Bulk mode or in single shot mode. Possible values: 1. TRUE: the MAC job will be processed in Bulk mode, 2. FALSE: the MAC job will be processed in single shot mode. Note: If SecOCRbTxUseBulkProcessing is not configured, then it will use the configured value of SecOCGeneral/SecOCRbDefaultUseBulkProcessing as default. Bulk mode is available only for PDUs with cryptographic interface set to HSM and cryptographic mode set to asynchronous.
      boolean SecOCReAuthenticateAfterTriggerTransmit: post-build-variant-value=true, set at post-build, default-value=true  # SecOC reauthenticate after TriggerTransmit | This parameter specifies if the authentication information of the Secured PDU is updated after the successful transmission of a triggered transmission was confirmed. TRUE if the authentication information shall be updated after triggered transmission. FALSE if the authentication information shall not be updated after triggered transmission. Note: This parameter should only be set to FALSE if the upper layer SecOC_IfTransmit have the same or higher frequency than the SecOC_TriggerTransmit calls.
      integer SecOCTxPduUnusedAreasDefault: 0..255, set at pre-compile, default-value=0  # SecOC default pattern for unused areas | The AUTOSAR SecOC module fills not used areas of a transmitted Secured Pdu or a transmitted Cryptographic Pdu with this byte pattern. This attribute is mandatory to avoid undefined behavior.
      boolean SecOCUseTxConfirmation [0..1]: multiplicity set at pre-compile, set at pre-compile, default-value=false  # SecOC use SPduTxConfirmation | If this parameter is set to TRUE, the function SecOC_SPduTxConfirmation shall be called to indicate that the Secured I-PDU has been initiated for transmission.
      reference SecOCSameBufferPduRef [0..1]: multiplicity set at pre-compile, set at pre-compile, destination=SecOCSameBufferPduCollection  # Reference to Buffer collection | This reference is used to collect Pdus that are using the same SecOC buffer.
      reference SecOCTxAuthServiceConfigRef [0..1]: multiplicity set at pre-compile, set at pre-compile, destination=CsmJob  # Reference to Csm Job | This reference is used to define which crypto service function is called for authentication.
      reference SecOCTxPduMainFunctionRef [0..1]: multiplicity set at pre-compile, set at pre-compile, destination=SecOCMainFunctionTx  # Reference to SecOC_MainFunctionTx | Reference to the SecOC_MainFunctionTx this PDU belongs to.
      container SecOCTxAuthenticPduLayer  # SecOC configuration of authentic PDU | This container specifies the Pdu that is received by the SecOC module from the PduR. For this Pdu the Mac generation is provided.
        enumeration SecOCPduType [0..1]: {SECOC_IFPDU, SECOC_TPPDU}, multiplicity set at pre-compile, set at pre-compile, default-value=SECOC_IFPDU  # SecOC Pdu Type | This parameter defines the API Type to use for communication with PduR. SECOC_IFPDU --> Interface communication API SECOC_TPPDU --> Transport Protocol communication API
        integer SecOCTxAuthenticLayerPduId: 0..65535, set at pre-compile, symbolic-name-value=true, with-auto=true  # SecOC identifier of authentic PDU | PDU identifier assigned by SecOC module. Used by PduR for SecOC_PduRTransmit. Do not set it manually, it will be set by SecOC forwarder.
        reference SecOCTxAuthenticLayerPduRef: post-build-variant-value=true, set at post-build, destination=Pdu  # Reference to authentic PDU | Reference to the global Pdu.
      container SecOCTxPduSecuredArea [0..1]: multiplicity set at pre-compile  # SecOC Tx Pdu secured area | This container specifies an area in the Authentic I-Pdu that will be the input to the Authenticator generation algorithm. If this container does not exist in the configuration the complete Authentic I-Pdu will be the input to the Authenticator generation algorithm.
        integer SecOCSecuredTxPduLength: 0..4294967295, post-build-variant-value=true, set at post-build  # Length of Tx secured area | This parameter defines the length (in bytes) of the area within the Pdu which shall be secured.
        integer SecOCSecuredTxPduOffset: 0..4294967295, post-build-variant-value=true, set at post-build, default-value=0  # Start position of Tx secured area | This parameter defines the start position (offset in bytes) of the area within the Pdu which shall be secured.
      choice container SecOCTxSecuredPduLayer  # SecOC configuration of transmitted PDU to PduR | This is a choice container
        container SecOCTxSecuredPdu [0..1]: multiplicity set at pre-compile  # SecOC configuration of SecOCTxSecuredPdu | This container specifies one Pdu that is transmitted by the SecOC module to the PduR after the Mac was generated. This Pdu contains the cryptographic information.
          integer SecOCAuthPduHeaderLength [0..1]: 0..4, multiplicity set at pre-compile, set at pre-compile, default-value=0  # Length of secured PDU header | This parameter indicates the length in bytes of the Secured I-PDU Header in the Secured I-PDU. The length of zero means there is no header in the secured PDU.
          enumeration SecOCRbSecuredHeaderRepresentation [0..1]: {HEADER_IN_BITS, HEADER_IN_BYTES}, multiplicity set at pre-compile, origin=RB:1.0.0:2021-06-01, set at pre-compile, default-value=HEADER_IN_BYTES  # SecOC secured header representation | Secured header length can be configured to be represented in bytes or bits. The representation in bits is not AUTOSAR compliant and is used to handle padding at the end of secured PDU. HEADER_IN_BITS --> The length of authentic PDU given in the secured header is in bits HEADER_IN_BYTES --> The length of authentic PDU given in the secured header is in bytes
          integer SecOCTxSecuredLayerPduId: 0..65535, set at pre-compile, symbolic-name-value=true, with-auto=true  # SecOC identifier of secured PDU | PDU identifier assigned by SecOC module. Used by PduR for confirmation (SecOC_PduRTxConfirmation) and for TriggerTransmit. Do not set it manually, it will be set by SecOC forwarder.
          reference SecOCTxSecuredLayerPduRef: post-build-variant-value=true, set at post-build, destination=Pdu  # Reference to secured PDU | Reference to the global Pdu.
        container SecOCTxSecuredPduCollection [0..1]: multiplicity set at pre-compile  # SecOC configuration of SecOCTxSecuredPduCollection | This container specifies the Pdu that is transmitted by the SecOC module to the PduR after the Mac was generated. Two separate Pdus are transmitted to the PduR: Authentic I-PDU and Cryptographic I-PDU.
          container SecOCTxAuthenticPdu  # SecOC configuration of SecOCTxAuthenticPdu | This container specifies the PDU (that is transmitted by the SecOC module to the PduR) which contains the Secured I-PDU Header and the Authentic I-PDU.
            integer SecOCAuthPduHeaderLength [0..1]: 0..4, multiplicity set at pre-compile, set at pre-compile, default-value=0  # Length of secured PDU header | This parameter indicates the length in bytes of the Secured I-PDU Header in the Authentic I-PDU. The length of zero means there is no header in the secured PDU.
            enumeration SecOCRbSecuredHeaderRepresentation [0..1]: {HEADER_IN_BITS, HEADER_IN_BYTES}, multiplicity set at pre-compile, origin=RB:1.0.0:2021-06-01, set at pre-compile, default-value=HEADER_IN_BYTES  # SecOC secured header representation | Secured header length can be configured to be represented in bytes or bits. The representation in bits is not AUTOSAR compliant and is used to handle padding at the end of Authentic PDU.
            integer SecOCTxAuthenticPduId: 0..65535, set at pre-compile, symbolic-name-value=true, with-auto=true  # SecOC identifier of authentic PDU | PDU identifier of the Authentic I-PDU assigned by SecOC module. Used by PduR for confirmation (SecOC_PduRTxConfirmation) and for TriggerTransmit. Do not set it manually, it will be set by SecOC forwarder.
            reference SecOCTxAuthenticPduRef: post-build-variant-value=true, set at post-build, destination=Pdu  # Reference to authentic PDU | Reference to the global Pdu.
          container SecOCTxCryptographicPdu  # SecOC configuration of SecOCTxCryptographicPdu | This container specifies the Cryptographic Pdu that is transmitted by the SecOC module to the PduR after the Mac was generated.
            integer SecOCTxCryptographicPduId: 0..65535, set at pre-compile, symbolic-name-value=true, with-auto=true  # SecOC identifier of Cryptographic PDU | PDU identifier of the Cryptographic I-PDU assigned by SecOC module. Used by PduR for confirmation (SecOC_PduRTxConfirmation) and for TriggerTransmit. Do not set it manually, it will be set by SecOC forwarder.
            reference SecOCTxCryptographicPduRef: post-build-variant-value=true, set at post-build, destination=Pdu  # Reference to cryptographic PDU | Reference to the global Pdu.
          container SecOCUseMessageLink [0..1]: multiplicity set at pre-compile  # Message linker of authentic and cryptographic PDU | SecOC links an Authentic I-PDU and Cryptographic I-PDU together by repeating a specific part (Message Linker) of the Authentic I-PDU in the Cryptographic I-PDU.
            integer SecOCMessageLinkLen: 0..65535, set at pre-compile  # Length of message linker | Length of the message linker inside the Authentic PDU in bits.
            integer SecOCMessageLinkPos: 0..65535, set at pre-compile  # Position of message linker | The position of message linker inside the Authentic PDU in bits.
