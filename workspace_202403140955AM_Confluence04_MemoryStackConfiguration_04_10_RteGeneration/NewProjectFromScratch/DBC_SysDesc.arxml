AUTOSAR XML (schema 00051)
package /DBC_SysDesc_Can_Network/Pkg_Cluster
  can cluster Can_Network: protocol-name=CAN
    can physical channel Can_Network_Channel: comm-connectors=Conn_Can_Network_CANNODE_0_ApplicationECU
      frame TestECU_TestCode_Tx: id 0x14, to ApplicationECU, frame-length=8, can-addressing-mode=STANDARD, can-frame-rx-behavior=CAN-20
        pdu TestECU_TestCode_Tx: length=8, transmission-mode-condition{data-filter={data-filter-type=NEW-IS-WITHIN, max=0, min=0, offset=0}, i-signal-in-i-pdu=TestECU_SG_TestCode_Tx}, transmission-mode-false-timing=cyclic-timing=time-period=0.1, transmission-mode-true-timing=cyclic-timing=time-period=0.1
          signal TestECU_SG_TestCode_Tx: start 0, 8 bit, little-endian, base-type=sint8, compu {raw=phys for phys 0}, to ApplicationECU
      frame ApplicationECU_TestResult_Tx: id 0xA, from ApplicationECU, frame-length=8, can-addressing-mode=STANDARD, can-frame-tx-behavior=CAN-20
        pdu ApplicationECU_TestResult_Tx: length=8, transmission-mode-condition{data-filter={data-filter-type=NEW-IS-WITHIN, max=0, min=0, offset=0}, i-signal-in-i-pdu=ApplicationECU_SG_TestResult_Tx}, transmission-mode-false-timing=cyclic-timing=time-period=0.1, transmission-mode-true-timing=cyclic-timing=time-period=0.1
          signal ApplicationECU_SG_TestResult_Tx: start 0, 8 bit, little-endian, base-type=sint8, compu {raw=phys for phys 0}
package /DBC_SysDesc_Can_Network/Pkg_Ecu
  ecu instance ApplicationECU: com-configuration-gw-time-base=0.005, com-configuration-rx-time-base=0.01, com-configuration-tx-time-base=0.01, sleep-mode-supported=false, wake-up-over-bus-supported=false
    can communication controller Can_Network_CANNODE_0: can-controller-attributes=can-controller-configuration={can-controller-fd-requirements=max-sample-point=81.4, prop-seg=0, sync-jump-width=0, time-seg-1=10, time-seg-2=0}
    can communication connector Conn_Can_Network_CANNODE_0_ApplicationECU: comm-controller=Can_Network_CANNODE_0
package /System
  system System: category=SYSTEM_DESCRIPTION
    system mapping SystemMapping
      data-mappings:
        data-element=CPT_MyReceivingSWC_ApplicationEcu.RootSwCompositionPrototype.RPortPrototype_0.DE_MyDataElement, system-signal=TestECU_SG_TestCode_Tx
        data-element=CPT_MyTransmittingSWC_TestEcu.RootSwCompositionPrototype.PPortPrototype_0.DE_MyDataElement, system-signal=ApplicationECU_SG_TestResult_Tx
      sw-mappings:
        swc to ecu mapping SwcToEcuMapping_0: ecu-instance=ApplicationECU
          component:
            RootSwCompositionPrototype.CPT_MyReceivingSWC_ApplicationEcu
            RootSwCompositionPrototype.CPT_MyTransmittingSWC_ApplicationEcu
            RootSwCompositionPrototype.CPT_ComM
    root-software-compositions:
      root sw composition prototype RootSwCompositionPrototype: software-composition=TopLevelComposition
