AUTOSAR XML (schema 00051)
package /ETAS_Project/EcucModuleConfigurationValuess
  ecuc value collection EcucValueCollection: ecu-extract=EXTR_ApplicationECU
    ecuc-values:
      Rte
      Os
      rba_BswSrv
      Com
      CanIf
      Can
      PduR
      CanSM
      ComM
      EcuC
      Mcu
      Compiler
      Platform
      rba_ArxmlGen
      EcuM
      BswM
      NvM
      Fee
      rba_MemLib
      MemIf
      E2E
      Crc
