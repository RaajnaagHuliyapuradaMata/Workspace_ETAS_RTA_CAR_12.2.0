AUTOSAR XML (schema 4-2-2)
package /AUTOSAR_BswM/EcucModuleDefs
  module definition BswM [0..1]: category=VENDOR_SPECIFIC_MODULE_DEFINITION, post-build-variant-support=true, refined-module-def=BswM, variants post-build/pre-compile  # Configuration of the BswM (Basic SW Mode Manager) module (with vendor specific enhancements of RB).
    container BswMConfig  # This container contains the configuration parameters and sub containers of the AUTOSAR BswM module. This container exists once per partition.
      container BswMArbitration  # This container includes all configuration sub-containers and parameters related to the mode arbitration functionality of the BswM.
        container BswMEventRequestPort [0..*]: multiplicity set at pre-compile  # Each instance of this container defines an event which can be sent to the BswM. Basic Software Modules may send these events to the BswM by calling the corresponding BswM C-API (for example: BswM_ComM_InitiateReset()). | This choice container specifies the source of the event request. The sender of the event can be another BSW Module, such as ComM.
          enumeration BswMEventRequestProcessing: {BSWM_DEFERRED, BSWM_IMMEDIATE}, set at link in variant link-time+post-build / pre-compile in variant pre-compile  # This parameter defines if the processing of the mode arbitration shall be done immediately when an event request is received or if it shall be deferred to the processing of the main function of BswM.
          choice container BswMEventRequestSource  # This choice container specifies the source of the event request. The sender of the event can be another BSW Module, such as ComM.
            container BswMComMInitiateReset [0..1]  # This is an indication from the ComM to signal a shutdown. | Before Configuring the ERP, make sure the ComM is enabled in BswMGeneral Container. The BswMComMIndication is configured only once.
            container BswMDcmApplicationUpdatedIndication [0..1]  # This is a request to update application data from the DCM. This container does not contain any parameters since there are no further configuration needed for this type of request, configure "BswMBswRequestedMode" value in ModeCondition as TRUE/FALSE. | The ERP request is used to update application data from DCM. It doesn't contain any configurable parameter. Hence dummy channel is used for this ERP.
            container BswMNmCarWakeUpIndication [0..1]  # This is an indication of a CarWakeup from the Nm. | Channel assosciated with CarWakeup
              symbolic name reference BswMNmChannelRef: set at link in variant link-time+post-build / pre-compile in variant pre-compile, destination=ComMChannel  # This is a reference to the channel handle that the indication corresponds to. | This parameter relates the communication channel associated with the car wakeup indication
        container BswMLogicalExpression [0..*]: multiplicity set at pre-compile  # This container describes the logical expressions that can be used for the mode arbitration. The logical expressions are built of a set of arguments and a logical operator. | Each argument can either be a mode condition or a sub-expression to allow definition of more complex logical expressions. There may be an unlimited number of arguments in each logical expression. Note that the order of evaluation of the expressions is not defined.
          enumeration BswMLogicalOperator [0..1]: {BSWM_AND, BSWM_NAND, BSWM_NOT, BSWM_OR, BSWM_XOR}, multiplicity set at link in variant link-time+post-build / pre-compile in variant pre-compile, set at link in variant link-time+post-build / pre-compile in variant pre-compile  # This parameter specifies the logical operator to be used in the logical expression. If the expression only consists of a single condition this parameter shall not be used.
          choice reference BswMArgumentRef [1..*]: multiplicity set at link in variant link-time+post-build / pre-compile in variant pre-compile, set at link in variant link-time+post-build / pre-compile in variant pre-compile, destination=[BswMLogicalExpression, BswMModeCondition]  # This is a choice reference either to a mode condition or a sub-expression. | In case the BswMLogicalExpression.BswMLogicalOperator equals BSWM_NAND only two operands are supported.
        container BswMModeCondition [0..*]: multiplicity set at pre-compile  # This container describes the BswM mode conditions that can be used either by itself to form a rule or as a part of a logical expression.
          enumeration BswMConditionType: {BSWM_EQUALS, BSWM_EQUALS_NOT, BSWM_EVENT_IS_CLEARED, BSWM_EVENT_IS_SET}, set at link in variant link-time+post-build / pre-compile in variant pre-compile  # This parameter specifies what kind of comparison that is made for the evaluation of the mode condition. For BSWM_EQUALS and BSWM_EQUALS_NOT, the BswMModeRequestPort port referenced by BswMConditionMode is compared with the value configured in BswMConditionValue for equality or not-equality. For BSWM_EVENT_IS_SET and BSWM_EVENT_IS_CLEARED, the BswMEventRequestPort port referenced by BswMConditionMode is checked for being set or cleared (not-set).
          choice reference BswMConditionMode: set at link in variant link-time+post-build / pre-compile in variant pre-compile, destination=[BswMModeRequestPort, BswMEventRequestPort]  # This parameter references either a mode request port or an event request port.
          choice container BswMConditionValue [0..1]  # This container holds the parameters and references necessary to identify the mode type and the value that the mode request is compared to.
            container BswMBswMode [0..1]  # This container defines the mode condition value and type of a mode in the BSW,If the related MRP is BswMDcmApplicationUpdatedIndication or BswMJ1939DcmBroadcastStatus configure "BswMBswRequestedMode" value in ModeCondition as TRUE or FALSE.
              string BswMBswRequestedMode: multiplicity set at link in variant link-time+post-build / pre-compile in variant pre-compile, set at link in variant link-time+post-build / pre-compile in variant pre-compile  # This parameter contains the symbolic name (as a string) of a certain mode/state that can be requested/indicated by the BSW modules.
            container BswMModeDeclaration [0..1]  # When the mode corresponds to a mode request or mode indication interface the mode is defined by a mode declaration. The mode declarations belonging to a mode declaration group are defined in the SW-C Template and hence a foreign reference to the corresponding Mode Declaration is used. It is only relevant for Rte.
              foreign reference BswMModeValueRef: set at link in variant link-time+post-build / pre-compile in variant pre-compile, destination-type=MODE-DECLARATION  # This is a foreign reference to the Mode Declaration used for the mode requests corresponding to this condition. e.g. /TestCd_ComM_SWCD/MDG_TestCd_ComM_SWCD/COMM_FULL_COMMUNICATION
        container BswMModeRequestPort [0..*]: multiplicity set at pre-compile  # Each instance of this container defines a mode request interface that is used to requests or indicate modes from/to the BswM. These interfaces are implemented as ports or as ordinary C-functions based upon if the request is made by an SW-C or a BSW module. | There are different types of mode requests: 1. Mode requests from the SW-C:s 2. Mode Requests from other BSW modules such as the DCM. 3. State/mode indications from the RTE or other BSW modules such as the bus specific State Managers. Note that the BswM treats all request and indications in the exact same way.
          enumeration BswMRequestProcessing: {BSWM_DEFERRED, BSWM_IMMEDIATE}, set at link in variant link-time+post-build / pre-compile in variant pre-compile  # This parameter defines if the processing of the mode arbitration shall be done immediately when a mode request is received or if it shall be deferred to the processing of the main function of BswM.
          container BswMModeInitValue [0..1]  # This container defines the initial mode value that is used by BswM for the corresponding mode request after initialization. The initial mode value is defined by configuring either BswMBswModeInitValue or BswMCompuScaleModeValue. This container is optional.
            string BswMBswModeInitValue [0..1]: multiplicity set at link in variant link-time / post-build in variant post-build / pre-compile in variant pre-compile, post-build-variant-multiplicity=true, post-build-variant-value=true, set at link in variant link-time / post-build in variant post-build / pre-compile in variant pre-compile  # This parameter defines the initial mode value that is used by BswM for the corresponding mode request after initialization.
          choice container BswMModeRequestSource  # This choice container specifies the source of the mode request or state/mode indication. The requester of a mode can be both SW-C:s and other BSW Modules, such as the bus specific State Managers.
            container BswMBswModeNotification [0..1]  # The source of the mode request is a Bsw Module. After BSW performs the Mode Switch action, the latest mode is updated in RTE. The updated mode is notified to BswM through BswMBswModeNotification.
              string BswMRbBswModeDeclarationGroup: origin=RB:7.0.0:2015-10-31, set at pre-compile  # In this Parameter, provide the reference to the mode declaration group. e.g: /TestCd_ComM_BSWMD/ModeDeclarationGroups/MDG_TestCd_ComM_BSWMD_Modes.
            container BswMCanSMIndication [0..1]  # This is an indication of the current state of the CAN State Manager.
              symbolic name reference BswMCanSMChannelRef: set at link in variant link-time+post-build / pre-compile in variant pre-compile, destination=ComMChannel  # This is a reference to the CAN channel handle that the mode request corresponds to. | Before Configuring the MRP, make sure the CanSM is enabled in BswMGeneral Container. The BswMCanSMChannelRef has to unique for all BswMCanSMIndication.
            container BswMComMIndication [0..1]  # This is an indication of the current communication mode of a channel in the Communication Manager.
              symbolic name reference BswMComMChannelRef: set at link in variant link-time+post-build / pre-compile in variant pre-compile, destination=ComMChannel  # This is a reference to the Communication Manager channel handle that the indication corresponds to. | Before Configuring the MRP, make sure the ComM is enabled in BswMGeneral Container. The BswMComMChannelRef has to unique for all BswMComMIndication.
            container BswMComMPncRequest [0..1]  # This is a request of the current communication mode of a Partial Network Cluster in the Communication Manager.
              symbolic name reference BswMComMPncRef: set at link in variant link-time+post-build / pre-compile in variant pre-compile, destination=ComMPnc  # This is a reference to the Communication Manager PNC handle of the Partial Network Cluster that the request corresponds to. | Before Configuring the MRP, make sure the ComM is enabled in BswMGeneral Container. The BswMComMPncRef has to unique for all BswMComMPncRequest.
            container BswMDcmComModeRequest [0..1]  # The source of the mode request is the Diagnostic Communication Manager.
              symbolic name reference BswMDcmComMChannelRef: set at link in variant link-time+post-build / pre-compile in variant pre-compile, destination=ComMChannel  # This is a reference from DcmModeRequest to the ComM channel that the indication corresponds to.
            container BswMEcuMIndication [0..1]  # This is a notification of the current operation mode of the ECU State Manager. This container does not contain any parameters since there are no further configuration needed for this type of request.
            container BswMEcuMRUNRequestIndication [0..1]  # This is an indication of the current State of the RUN Request Protocol.
              enumeration BswMEcuMRUNRequestProtocolPort [0..1]: {BSWM_ECUM_STATE_POST_RUN, BSWM_ECUM_STATE_RUN}, set at link in variant link-time+post-build / pre-compile in variant pre-compile  # Identifies the EcuM State which is related to the mode request.
            container BswMEcuMWakeupSource [0..1]  # This is a notification of the current state of an ECU State Manager wakeup source. | Notification of state of EcuM Wakeup Source.
              symbolic name reference BswMEcuMWakeupSrcRef: set at link in variant link-time+post-build / pre-compile in variant pre-compile, destination=EcuMWakeupSource  # This is a reference to the ECU State Manager Wakeup Source that the indication corresponds to. | Reference to EcuM Wakeup Source.
            container BswMEthIfPortGroupLinkStateChg [0..1]  # This is an indication from the EthIf if the link state of a Ethernet interface switch port group has changed. | Notification of link state of a Ethernet interface switch port group.
              symbolic name reference BswMEthIfSwitchPortGroupRef: set at link in variant link-time+post-build / pre-compile in variant pre-compile, destination=EthIfSwitchPortGroup  # This is a reference to the Ethernet Interface Switch Port Group that the indication corresponds to. | Reference to Ethernet Interface Switch Port Group.
            container BswMEthSMIndication [0..1]  # This is an indication of the current state of the Ethernet State Manager.
              symbolic name reference BswMEthSMChannelRef: set at link in variant link-time+post-build / pre-compile in variant pre-compile, destination=ComMChannel  # This is a reference to the Ethernet channel handle that the mode request corresponds to.
            container BswMFrSMIndication [0..1]  # This is an indication of the current state of the FlexRay State Manager.
              symbolic name reference BswMFrSMChannelRef: set at link in variant link-time+post-build / pre-compile in variant pre-compile, destination=ComMChannel  # This is a reference to the FlexRay Cluster handle that the mode request corresponds to.
            container BswMGenericRequest [0..1]  # This mode request originates from a requester that is not among the list of standardized mode requesters (i.e. the different resource managers).
              integer BswMModeRequesterId [0..1]: 0..65535, set at link in variant link-time+post-build / pre-compile in variant pre-compile  # This parameters identifies the different users of the generic mode request interface. | The allowable range of this parameter shall coincide with the range of BswM_UserType (which can be platform-dependent).
              enumeration BswMRbRequestType [0..1]: {BSW, SWC}, multiplicity set at pre-compile, origin=RB:3.0.0:2018-06-22, set at pre-compile, default-value=BSW  # This parameter identifies whether the mode request is from BSW or SWC. If the BswMRbRequestType is BSW, the user request shall originate through BswM_RequestMode( ) API. If the BswMRbRequestType is SWC, BswM generates a Client-Server Interface in it's SWCD. The user shall configure a Syncronous-Server-Call-Point which refers to the Client-Server-Operation provided by BswM. The Client-Server-Operation inturn refers the BswM_RequestMode( ) API. If the BswMRbRequestType is SWC then user has to configure BswMModeCondition with BswMBswMode only. The BswMRbRequestType is considered BSW by default.
              integer BswMRequestedModeMax: 0..65535, set at link in variant link-time+post-build / pre-compile in variant pre-compile  # This parameter defines the upper limit for the modes requested by this mode requester. | The allowable range of this parameter shall coincide with the range of BswM_ModeType (which can be platform-dependent).
              reference BswMRbGenericReqUserRef [0..1]: origin=RB:1.0.0:2017-03-31, set at link in variant link-time+post-build / pre-compile in variant pre-compile, destination=BswMRbGenericReqUser  # This parameter is a reference to one of the BswMRbGenericReqUser configured in BswMGeneral container. | Upon configuring this parameter, the RequesterId is automatically generated. The generated Id will be available as a macro and shall be used by including BswM.h. The name of the macro is the same as the shortname of referenced BswMRbGenericReqUser in upper case with a prefix BSWM_CFG_USERID_. For eg: BSWM_CFG_USERID_MODEUSER0, where MODEUSER0 is the shortname of the referenced BswMRbGenericReqUser. This parameter shall be used as a substitute for BswMModeRequesterId but both cannot be configured together.
            container BswMJ1939DcmBroadcastStatus [0..1]  # This is a notification of the desired broadcast status per network, triggered via DM13.
              symbolic name reference BswMJ1939DcmChannelRef: set at link in variant link-time+post-build / pre-compile in variant pre-compile, destination=ComMChannel  # Reference to the communication channel which is affected by this mode request.
            container BswMJ1939NmIndication [0..1]  # This is an indication of the current state of the J1939 network management module.
              symbolic name reference BswMJ1939NmChannelRef: set at link in variant link-time+post-build / pre-compile in variant pre-compile, destination=ComMChannel  # This is a reference to the J1939Nm channel handle that the mode request corresponds to.
              symbolic name reference BswMJ1939NmNodeRef: set at link in variant link-time+post-build / pre-compile in variant pre-compile, destination=J1939NmNode  # This is a reference to the node that the mode request corresponds to.
            container BswMLinSMIndication [0..1]  # This is an indication of the current state of the LIN State Manager.
              symbolic name reference BswMLinSMChannelRef: set at link in variant link-time+post-build / pre-compile in variant pre-compile, destination=ComMChannel  # This is a reference to the LIN channel handle that the mode request corresponds to.
            container BswMLinScheduleIndication [0..1]  # This is an indication of the currently active LIN Schedule Table for a specific LIN Interface.
              symbolic name reference BswMLinSMChannelRef: post-build-variant-value=true, set at link in variant link-time / post-build in variant post-build / pre-compile in variant pre-compile, destination=ComMChannel  # This is a reference to the LIN channel handle that the mode request corresponds to.
              symbolic name reference BswMLinScheduleRef: post-build-variant-value=true, set at link in variant link-time / post-build in variant post-build / pre-compile in variant pre-compile, destination=LinSMSchedule  # This is a reference to the LIN Schedule Table handle that the mode request corresponds to.
            container BswMLinTpModeRequest [0..1]  # This is a LinTp mode request from the LinIf. This port corresponds to a call of the BswM_LinTp_RequestMode API.
              symbolic name reference BswMLinTpChannelRef: set at link in variant link-time+post-build / pre-compile in variant pre-compile, destination=ComMChannel  # This is a reference to the LIN Interface Channel that the mode | request corresponds to.
            container BswMNmStateChangeNotification [0..1]  # This is a notification from the Nm module that its state has changed.
              symbolic name reference BswMNmChannelRef: set at link in variant link-time+post-build / pre-compile in variant pre-compile, destination=ComMChannel  # This is a reference to the channel handle that this notification corresponds to. | Before Configuring the MRP, make sure the Nm is enabled in BswMGeneral Container. The BswMNmChannelRef has to unique for all BswMNmStateChangeNotification.
            container BswMNvMJobModeIndication [0..1]  # Indicates the current status of the multiblock job. The job is identified via BswMNvmService, e.g. 0x0c for NvmReadAll, 0x0d for NvmWriteAll, 0xfb for NvMRbFirstInitAll, 0xfe for NvMRbRemoveNonResistant. Possible Values are: | NvM_RequestResultType NVM_REQ_OK NVM_REQ_NOT_OK NVM_REQ_PENDING NVM_REQ_INTEGRITY_FAILED NVM_REQ_BLOCK_SKIPPED NVM_REQ_NV_INVALIDATED NVM_REQ_CANCELED NVM_REQ_REDUNDANCY_FAILED NVM_REQ_RESTORED_FROM_ROM
              enumeration BswMNvmService: {NvmReadAll, NvmWriteAll, NvMRbFirstInitAll, NvMRbRemoveNonResistant}, set at link in variant link-time+post-build / pre-compile in variant pre-compile  # Identifies the Nvm job which is related to the mode request.
            container BswMNvMRequest [0..1]  # Via this Mode Request Source the NvM indicates the current status of the specified block. Possible Values are: | NvM_RequestResultType NVM_REQ_OK NVM_REQ_NOT_OK NVM_REQ_PENDING NVM_REQ_INTEGRITY_FAILED NVM_REQ_BLOCK_SKIPPED NVM_REQ_NV_INVALIDATED NVM_REQ_CANCELED NVM_REQ_REDUNDANCY_FAILED NVM_REQ_RESTORED_FROM_ROM
              symbolic name reference BswMNvMBlockRef: set at link in variant link-time+post-build / pre-compile in variant pre-compile, destination=NvMBlockDescriptor  # This is a reference to the NvM Block Descriptor that the request corresponds to.
            container BswMSdClientServiceCurrentState [0..1]  # Used by Service Discovery module to indicate current state of the Client Service (available/down).
              symbolic name reference BswMSdClientMethodsRef: set at link in variant link-time+post-build / pre-compile in variant pre-compile, destination=SdClientService  # This is a reference to a client service in the Sd module.
            container BswMSdConsumedEventGroupCurrentState [0..1]  # Used by Service Discovery to indicate current status of the EventHandler (requested/released).
              symbolic name reference BswMSdConsumedEventGroupRef: set at link in variant link-time+post-build / pre-compile in variant pre-compile, destination=SdConsumedEventGroup  # This is a reference to an eventGroup that is defined within a client service in the Sd module.
            container BswMSdEventHandlerCurrentState [0..1]  # Used by Service Discovery to indicate current status of the EventHandler (requested/released).
              symbolic name reference BswMSdEventHandlerRef: set at link in variant link-time+post-build / pre-compile in variant pre-compile, destination=SdEventHandler  # This is a reference to an event handler that is defined within a server service in the Sd module.
            container BswMSoAdSoConModeChg [0..1]  # This is an indication of the current state of the SoAd.
              symbolic name reference BswMSoAdSocketIdRef: set at link in variant link-time+post-build / pre-compile in variant pre-compile, destination=SoAdSocketConnection  # This is a reference to the SoAd socket ID handle that the mode request corresponds to.
            container BswMSwcModeNotification [0..1]  # This is a mode switch notification associated with a RTE switch interface.
              foreign reference BswMSwcModeNotificationModeDeclarationGroupPrototypeRef: set at link in variant link-time+post-build / pre-compile in variant pre-compile, destination-type=MODE-DECLARATION-GROUP-PROTOTYPE  # This is a foreign reference to the ModeDeclarationGroupPrototype. Give the reference of mode declaration group prototype e.g: /TestCd_ComM_SWCD/MSI_TestCd_ComM_SWCD/ModeDeclarationGroupPrototype
            container BswMSwcModeRequest [0..1]  # The source of the mode request is a SW Component. The SWC module places a Mode request towards BswM using BswMSwcModeRequest and BswM performs a mode switch as a result of Rte_Switch action.
              integer BswMRbModeRequestQueueSize [0..1]: 0..255, origin=RB:2.0.0:2017-10-19, set at pre-compile, default-value=0  # This element specifies whether the mode communication is queued or not.Queued communication - When a queue length is configured with a non zero value,and a buffer is maintained to read the Modes. UnQueued communication - When queuelength is not configured or configured with zero,Modes are directly read . | A non zero value specifies a queued communication and a non configured or zero queue length specifies a nonqueued communication.
              foreign reference BswMSwcModeRequestVariableDataPrototypeRef: set at pre-compile, destination-type=VARIABLE-DATA-PROTOTYPE  # This is a foreign reference to the requestedMode data element of Sender-Receiver Interface from the App Mode Manager. e.g: /TestCd_BswM_SWC2_SWCD/SRI_TestCd_BswM_SWC2_SWCD/Mode
            container BswMTimer [0..1]  # This is a timer which can be used for time dependent rules. This mode request port can be in one of three modes (depending on the state of the timer): BSWM_TIMER_STOPPED (intial) (The timer has been stopped by an action) BSWM_TIMER_STARTED (The timer has been started by an action) BSWM_TIMER_EXPIRED (The timer has expired)
        container BswMRule [0..*]: multiplicity set at link in variant link-time / post-build in variant post-build / pre-compile in variant pre-compile, post-build-variant-multiplicity=true  # Each instance of this container describes a BswM arbitration rule. The rule either consists of a simple mode condition or a more complex logical expression. This container also references the action lists that shall be invoked when the rule is evaluated to True or False.
          boolean BswMNestedExecutionOnly [0..0]: set at link in variant link-time+post-build / pre-compile in variant pre-compile, default-value=false  # This parameter defines for its related Rule if the Rule is an Independent rule or a Subordinate rule. "False": An Independent rule, to be evaluated each time applicable, both as standalone Rule driven by its own BswMModeRequestSource and when referenced by another Rule ( Nested ). "True": A Subordinated rule, to be evaluated ONLY as a result of being referenced in one or more Action Lists. | false: an Independent rule, i.e. to be evaluated each time applicable (both as standalone Rule driven by its own BswMModeRequestSource and when referenced by another Rule). true: a Subordinated rule, to be evaluated ONLY as a result of being referenced in one or more Action Lists.
          enumeration BswMRuleInitState: {BSWM_FALSE, BSWM_TRUE, BSWM_UNDEFINED}, set at link in variant link-time+post-build / pre-compile in variant pre-compile  # This parameter is a part of the reset/initialization behavior of BswM. Action lists(Triggered) are executed when the result of a rule evaluation have changed since the last evaluation. This parameter defines the "previous evaluation result" of a rule to be used after initialization of the BswM. | Action lists are executed when the result of a rule evaluation have changed since the last evaluation. This parameter defines the "previous evaluation result" of a rule to be used after initialization of the BswM. If this parameter is set to BSWM_UNDEFINED, the evaluation result is always treated as changed at the first evaluation of the rule after initialization. If this parameter is set to BSWM_TRUE, the evaluation result is treated as changed if the rule is evaluated to false. If this parameter is set to BSWM_FALSE, the evaluation result is treated as changed if the rule is evaluated to true.
          reference BswMRuleExpressionRef: set at link in variant link-time+post-build / pre-compile in variant pre-compile, destination=BswMLogicalExpression  # This is a reference to the logical expression that is evaluated for each rule.
          reference BswMRuleFalseActionList [0..1]: multiplicity set at link in variant link-time / post-build in variant post-build / pre-compile in variant pre-compile, post-build-variant-multiplicity=true, post-build-variant-value=true, set at link in variant link-time / post-build in variant post-build / pre-compile in variant pre-compile, destination=BswMActionList  # This is a reference to the action list that shall be executed when the rule is evaluated to False
          reference BswMRuleTrueActionList [0..1]: multiplicity set at link in variant link-time / post-build in variant post-build / pre-compile in variant pre-compile, post-build-variant-multiplicity=true, post-build-variant-value=true, set at link in variant link-time / post-build in variant post-build / pre-compile in variant pre-compile, destination=BswMActionList  # This is a reference to the action list that shall be executed when the rule is evaluated to True
      container BswMDataTypeMappingSets [0..1]  # Collection of references to DataTypeMappingSet.
        foreign reference BswMDataTypeMappingSetRef [1..*]: multiplicity set at link in variant link-time+post-build / pre-compile in variant pre-compile, set at link in variant link-time+post-build / pre-compile in variant pre-compile, destination-type=DATA-TYPE-MAPPING-SET  # Reference to DataTypeMappingSet. Provide reference to the data type mapping defined for Mode declaration group e.g: /TestCd_ComM_SWCD/DTMS_TestCd_ComM_SWCD
      container BswMModeControl  # This container includes all configuration sub-containers and parameters related to the mode control functionality of the BswM.
        container BswMAction [0..*]: multiplicity set at pre-compile  # Each container of this type defines an action. These actions can be part of one or several action lists.
          choice container BswMAvailableActions  # Choice container including the available actions to be used in the action lists.
            container BswMClearEventRequest [0..1]  # This container contains a reference to a BswMEventRequestPort which will be cleared (i.e. set to CLEAR state) when this action is executed.
              symbolic name reference BswMClearEventRequestPortRef: set at link in variant link-time+post-build / pre-compile in variant pre-compile, destination=BswMEventRequestPort  # This parameter references the BswMEventRequestPort which will be cleared.
            container BswMComMAllowCom [0..1]  # This container includes all parameters for the action to allow or to block communication for a ComM Channel. ComM_CommunicationAllowed is called when this action is configured.
              boolean BswMComAllowed: set at link in variant link-time+post-build / pre-compile in variant pre-compile  # The parameter BswMComMAllowChannelRef refers to a channel which will allow or block communication using the function ComM_CommunicationAllowed(). | This parameter corresponds to the parameter "Allowed" of the function ComM_CommunicationAllowed().
              symbolic name reference BswMComMAllowChannelRef: set at link in variant link-time+post-build / pre-compile in variant pre-compile, destination=ComMChannel  # This is a reference to the ComM Channel for which communication shall be allowed or blocked. | This reference corresponds to the parameter "Channel" of the function ComM_CommunicationAllowed().
            container BswMComMModeLimitation [0..1]  # This container includes all parameters related to a limitation of communication mode for a ComM Channel. ComM_LimitChannelToNoComMode is called when this action is configured.
              boolean BswMComMLimitMode: set at link in variant link-time+post-build / pre-compile in variant pre-compile  # The function ComM_LimitChannelToNoComMode() takes in this boolean parameter to limit the channel's com mode to no-com mode. | This parameter corresponds to the parameter "Status" of the function ComM_LimitChannelToNoComMode.
              symbolic name reference BswMComMLimitChannelRef: set at link in variant link-time+post-build / pre-compile in variant pre-compile, destination=ComMChannel  # This is a reference to the ComM channel for which the communication mode should be limited. | This reference corresponds to the parameter "Channel" of the function ComM_LimitChannelToNoComMode.
            container BswMComMModeSwitch [0..1]  # This container includes all parameters related to a switch of communication mode for a ComM User. ComM_RequestComMode is called when this action is configured.
              enumeration BswMComMRequestedMode: {BSWM_COMM_FULL_COMMUNICATION, BSWM_COMM_NO_COMMUNICATION}, set at link in variant link-time+post-build / pre-compile in variant pre-compile  # This parameter specifies if the requested communication mode. | This parameter corresponds to the parameter "ComMode" of the function ComM_RequestComMode.
              symbolic name reference BswMComMUserRef: set at link in variant link-time+post-build / pre-compile in variant pre-compile, destination=ComMUser  # This is a reference to the ComM User that is associated to the Communication channel for which the communication mode should be requested. | This reference corresponds to the parameter "User" of the function ComM_RequestComMode.
            container BswMCoreHaltMode [0..1]  # This container includes all parameters related to a switch of the activation state of core Halt.
              string BswMCoreHaltActivationState: set at link in variant link-time+post-build / pre-compile in variant pre-compile  # Different possibilities are offered depending on the OS implementation and the CPU HW. The HALT modes addressed by this parameter are defined as names (strings) in the OS implementation. Different implementation may implement different HALT modes and subsequently different names. | This reference corresponds to the parameter "IdleMode" of the function ControlIdle.
              reference BswMTargetCoreRef: set at link in variant link-time+post-build / pre-compile in variant pre-compile, destination=EcucCoreDefinition  # This is a reference to the core on which the Core Halt process must be influenced. | This reference corresponds to the parameter "CoreID" of the function ControlIdle.
            container BswMDeadlineMonitoringControl [0..1]  # This container includes all parameters related to enabling and disabling of deadline monitoring for one or several PDUs in COM.
              symbolic name reference BswMDisabledDMPduGroupRef [0..*]: multiplicity set at link in variant link-time / post-build in variant post-build / pre-compile in variant pre-compile, post-build-variant-multiplicity=true, post-build-variant-value=true, set at link in variant link-time / post-build in variant post-build / pre-compile in variant pre-compile, destination=ComIPduGroup  # This is a reference to a PDU Group for which the Deadline Monitoring should be disabled. | This reference corresponds to the parameter "IpduGroupId" of the function Com_DisableReceptionDM.
              symbolic name reference BswMEnabledDMPduGroupRef [0..*]: multiplicity set at link in variant link-time / post-build in variant post-build / pre-compile in variant pre-compile, post-build-variant-multiplicity=true, post-build-variant-value=true, set at link in variant link-time / post-build in variant post-build / pre-compile in variant pre-compile, destination=ComIPduGroup  # This is a reference to a PDU Group for which the Deadline Monitoring should be enabled. | This reference corresponds to the parameter "IpduGroupId" of the function Com_EnableReceptionDM.
            container BswMEcuMDriverInitListBswM [0..1]  # This container defines the action to trigger an EcuM driver initialization list.
              symbolic name reference BswMEcuMDriverInitListBswMRef: set at link in variant link-time+post-build / pre-compile in variant pre-compile, destination=EcuMDriverInitListBswM  # This is a reference to the EcuM EcuMDriverInitListBswM container which represents the driver init list to be triggered.
            container BswMEcuMGoDownHaltPoll [0..1]  # This container defines the action to trigger the EcuM_GoDownHaltPoll from BswM.
              symbolic name reference BswMEcuMUserIdRef: set at link in variant link-time+post-build / pre-compile in variant pre-compile, destination=EcuMFlexUserConfig  # This is a reference to a EcuM UserId.
            container BswMEcuMSelectShutdownTarget [0..1]  # This container defines the shutdown target.
              enumeration BswMEcuMShutdownTarget: set at link in variant link-time+post-build / pre-compile in variant pre-compile  # This parameter contains the shutdown target that the BswM selects at the EcuM.
                BSWM_ECUM_SHUTDOWN_TARGET_OFF
                BSWM_ECUM_SHUTDOWN_TARGET_RESET  # In case the configuration parameter BswMEcuMShutdownTarget is set to BSWM_ECUM_SHUTDOWN_TARGET_RESET the configuration parameter BswMEcuMResetModeRef shall exist and contain a valid reference to a EcuM reset mode.
                BSWM_ECUM_SHUTDOWN_TARGET_SLEEP  # In case the configuration parameter BswMEcuMShutdownTarget is set to BSWM_ECUM_SHUTDOWN_TARGET_SLEEP the configuration parameter BswMEcuMSleepModeRef shall exist and contain a valid reference to a EcuM sleep mode.
              symbolic name reference BswMEcuMResetModeRef [0..1]: multiplicity set at link in variant link-time / post-build in variant post-build / pre-compile in variant pre-compile, set at link in variant link-time / post-build in variant post-build / pre-compile in variant pre-compile, destination=EcuMResetMode  # This is a reference to a reset mode. | Symbolic name reference to EcuMResetMode.
              symbolic name reference BswMEcuMSleepModeRef [0..1]: multiplicity set at link in variant link-time / post-build in variant post-build / pre-compile in variant pre-compile, set at link in variant link-time / post-build in variant post-build / pre-compile in variant pre-compile, destination=EcuMSleepMode  # This is a reference to a sleep mode. | Symbolic name reference to EcuMSleepMode
            container BswMEcuMStateSwitch [0..1]  # This container defines the action to switch a State of the ECU State Manager.
              enumeration BswMEcuMState: {BSWM_ECUM_STATE_APP_POST_RUN, BSWM_ECUM_STATE_APP_RUN, BSWM_ECUM_STATE_SHUTDOWN, BSWM_ECUM_STATE_SLEEP, BSWM_ECUM_STATE_STARTUP}, set at link in variant link-time+post-build / pre-compile in variant pre-compile  # This parameter corresponds to the parameter "State" of the function EcuM_ SetState ().
            container BswMEthIfStartAllPorts [0..1]  # This container defines the action to call EthIf_StartAllPorts from BswM and thus to start all affected EthSwPorts.
            container BswMEthIfSwitchPortGroupRequestMode [0..1]  # This container includes all parameters related to requesting a mode for the EthIfSwtPortGroup. | The EthIf_SwitchPortGroupRequestMode API is called when this action is executed.
              enumeration BswMEthTrcvMode: {BSWM_ETHTRCV_MODE_ACTIVE, BSWM_ETHTRCV_MODE_DOWN}, set at link in variant link-time+post-build / pre-compile in variant pre-compile  # This parameter contains the mode which will be requested.
              symbolic name reference BswMEthIfSwitchPortGroupRef: set at link in variant link-time+post-build / pre-compile in variant pre-compile, destination=EthIfSwitchPortGroup  # This is a reference to the Ethernet Interface Switch Port Group which will receive the request.
            container BswMIdsMBlockStateChangeRequest [0..1]  # This container includes all parameters related to switching the Block State of the IdsM.The IdsM_BswM_StateChanged API is called when this action is executed.
              symbolic name reference BswMIdsMBlockStateChangeRequestRef [0..1]: set at link in variant link-time+post-build / pre-compile in variant pre-compile, destination=IdsMBlockState  # This is a reference to the Block State, that shall be set as current Block State of the IdsM. This reference corresponds to the parameter "state" of the function IdsM_BswM_StateChanged.
            container BswMJ1939DcmStateSwitch [0..1]  # This container includes all parameters related to a switch of the J1939 Diagnostic Communication Managers network state for a J1939 node. J1939Dcm_SetState is called when this action is configured.
              enumeration BswMJ1939DcmRequestedState: {BSWM_J1939DCM_STATE_OFFLINE, BSWM_J1939DCM_STATE_ONLINE}, set at link in variant link-time+post-build / pre-compile in variant pre-compile  # This parameter describes the communication state of the J1939 Diagnostic Communication Manager and corresponds to the parameter "newState" of the function J1939Dcm_SetState.
              symbolic name reference BswMJ1939DcmChannelRef: set at link in variant link-time+post-build / pre-compile in variant pre-compile, destination=ComMChannel  # This reference points to the unique channel defined by the ComMChannel and provides access to the unique channel index value in ComMChannelId. | This reference corresponds to the parameter "channel" of the function J1939Dcm_SetState.
              symbolic name reference BswMJ1939DcmNodeRef: set at link in variant link-time+post-build / pre-compile in variant pre-compile, destination=J1939NmNode  # This reference points to a J1939NmNode and provides access to the unique J1939NmNodeId.This reference corresponds to the parameter "node" of the function J1939Dcm_SetState.
            container BswMJ1939RmStateSwitch [0..1]  # This container includes all parameters related to a switch of the J1939 Request Managers network state for a J1939 node. J1939Rm_SetState is called when this action is configured.
              enumeration BswMJ1939RmRequestedState: {BSWM_J1939RM_STATE_OFFLINE, BSWM_J1939RM_STATE_ONLINE}, set at link in variant link-time+post-build / pre-compile in variant pre-compile  # This parameter describes the communication state of the J1939 Request Manager and corresponds to the parameter "new state" of the function J1939Rm_SetState.
              symbolic name reference BswMJ1939RmChannelRef: set at link in variant link-time+post-build / pre-compile in variant pre-compile, destination=ComMChannel  # This reference points to the unique channel defined by the ComMChannel and provides access to the unique channel index value in ComMChannelId. This reference corresponds to the parameter "channel" of the function J1939Rm_SetState. | This reference corresponds to the parameter "channel" of the function J1939Rm_SetState.
              symbolic name reference BswMJ1939RmNodeRef: set at link in variant link-time+post-build / pre-compile in variant pre-compile, destination=J1939NmNode  # This reference points to a J1939NmNode and provides access to the unique J1939NmNodeId. This reference corresponds to the parameter "node" of the function J1939Rm_SetState. | This reference corresponds to the parameter "node" of the function J1939Rm_SetState.
            container BswMLinScheduleSwitch [0..1]  # This container includes all parameters related to a switch of LIN schedule table. LinSM_ScheduleRequest is called when this action is configured. | The configuration for the "network" parameter can be accessed via the reference LinSMComMNetworkHandleRef contained in the parent container LinSMChannel of the container referenced by BswMLinScheduleRef.
              symbolic name reference BswMLinScheduleRef: post-build-variant-value=true, set at link in variant link-time / post-build in variant post-build / pre-compile in variant pre-compile, destination=LinSMSchedule  # This is a reference to the LIN schedule table that the LIN SM shall change to. | This reference corresponds to the parameter "schedule" of the function LinSM_ScheduleRequest.
            container BswMNMControl [0..1]  # This container includes all parameters related to enabling and disabling of Network Management communication. Disabling of NM communication can be requested by DCM. | Nm_EnableCommunication or Nm_DisableCommunication is called when this action is configured.
              enumeration BswMNMAction: {BSWM_NM_DISABLE, BSWM_NM_ENABLE}, set at link in variant link-time+post-build / pre-compile in variant pre-compile  # This parameter specifies if the communication of the corresponding NM channel should be enabled or disabled.
              symbolic name reference BswMComMNetworkHandleRef: set at link in variant link-time+post-build / pre-compile in variant pre-compile, destination=ComMChannel  # This reference points to the unique channel defined by the ComMChannel and provides access to the unique channel index value in ComMChannelId. | This reference corresponds to the parameter "NetworkHandle" of the function Nm_EnableCommunication and Nm_DisableCommunication.
            container BswMPduGroupSwitch [0..1]  # This container includes references to the PDU groups that shall be enabled and disabled.
              boolean BswMPduGroupSwitchReinit [0..1]: multiplicity set at link in variant link-time / post-build in variant post-build / pre-compile in variant pre-compile, post-build-variant-multiplicity=true, post-build-variant-value=true, set at link in variant link-time / post-build in variant post-build / pre-compile in variant pre-compile, default-value=false  # This parameter defines if the data of the I-PDU, the shadow buffers of included signal groups, etc. are reinitialized when a PDU Group is started. | This parameter corresponds to the parameter "initialize" of the function Com_IpduGroupStart.
              symbolic name reference BswMDisabledPduGroupRef [0..*]: multiplicity set at link in variant link-time / post-build in variant post-build / pre-compile in variant pre-compile, post-build-variant-multiplicity=true, post-build-variant-value=true, set at link in variant link-time / post-build in variant post-build / pre-compile in variant pre-compile, destination=ComIPduGroup  # This is a reference to a PDU Group that should be disabled. | This reference corresponds to the parameter "IpduGroupId" of the function Com_IpduGroupStop.
              symbolic name reference BswMEnabledPduGroupRef [0..*]: multiplicity set at link in variant link-time / post-build in variant post-build / pre-compile in variant pre-compile, post-build-variant-multiplicity=true, post-build-variant-value=true, set at link in variant link-time / post-build in variant post-build / pre-compile in variant pre-compile, destination=ComIPduGroup  # This is a reference to a PDU Group that should be enabled. | TThis reference corresponds to the parameter "IpduGroupId" of the function Com_IpduGroupStart.
            container BswMPduRouterControl [0..1]  # This container includes all parameters related to enabling and disabling of routing of Routing Path Groups in the PDU Router. PduR_EnableRouting or PduR_DisableRouting is called when this action is configured.
              enumeration BswMPduRouterAction: {BSWM_PDUR_DISABLE, BSWM_PDUR_ENABLE}, post-build-variant-value=true, set at link in variant link-time / post-build in variant post-build / pre-compile in variant pre-compile  # This parameter specifies if the routing of the corresponding PDU should be enabled or disabled.
              boolean BswMPduRouterDisableInitBuffer [0..1]: multiplicity set at link in variant link-time / post-build in variant post-build / pre-compile in variant pre-compile, post-build-variant-multiplicity=true, post-build-variant-value=true, set at link in variant link-time / post-build in variant post-build / pre-compile in variant pre-compile  # When BswPduRouterAction is set to BSWM_PDUR_DISABLE and this parameter is set to true, then the call to PduR_DisableRouting will be invoked with parameter "initialize" set to true, otherwise false.
              symbolic name reference BswMPduRoutingPathGroupRef [1..*]: multiplicity set at link in variant link-time / post-build in variant post-build / pre-compile in variant pre-compile, post-build-variant-multiplicity=true, post-build-variant-value=true, set at link in variant link-time / post-build in variant post-build / pre-compile in variant pre-compile, destination=PduRRoutingPathGroup  # This is a reference to the PDU Routing Path Group for which the routing in the PDU Router should be enabled or disabled. | This reference corresponds to the parameter "id" of the function PduR_EnableRouting and PduR_DisableRouting.
            container BswMRbSwcUserCallout [0..1]  # This container includes all details for the BswM to invoke a user defined function call in SWC. The return value (if any) of the user define function that is invoked will be ignored by BswM.
              string BswMRbSwcClientServerOperationRef: origin=RB:7.0.0:2015-10-31, set at pre-compile  # This is a reference to the Client-Server-Operation of Client-Server Interface from the SWC, e.g:/TestCd_BswM/TestCd_BswM_CSInterface/TestCd_BswM_SWC_UserCallout. BswM generates a Syncronous-Server-Call-Point which refers to the Client-Server-Operation provided by SWC. The Client-Server-Operation inturn refers the user defined function in SWC. Any return values passed by the callout will be ignored.
              string BswMRbSwcUserCalloutArgument [0..*]: origin=RB:7.0.0:2015-10-31, set at pre-compile  # This parameter holds the value which is passed as input argument for the user defined function call. It is not in the scope of BswM to validate the data type of the arguments and the number of arguments passed, the integrator have to taken care of this.
            container BswMFrSMAllSlots [0..1]  # This container includes all parameter(s) for the action to request an exit from Flexray KeySlotOnlyMode. FrSM_AllSlots is called when this action is executed.
              symbolic name reference BswMFrSMAllSlotsNetworkHandleRef: set at link in variant link-time+post-build / pre-compile in variant pre-compile, destination=ComMChannel  # This references the FlexRay cluster. The reference corresponds to the parameter "NetworkHandle" of the function FrSM_AllSlots.
            container BswMRteModeRequest [0..1]  # This container defines a mode request that the BswM may send to a SW-C which is acting as a mode-manager. RTE_Write is called when this action is configured.
              foreign reference BswMRequestedModeRef: set at link in variant link-time+post-build / pre-compile in variant pre-compile, destination-type=MODE-DECLARATION  # This is a foreign reference to the Mode Declaration used for the mode request e.g: /TestCd_ComM_SWCD/MDG_TestCd_ComM_SWCD/COMM_SILENT_COMMUNICATION
              reference BswMRteModeRequestPortRef: set at link in variant link-time+post-build / pre-compile in variant pre-compile, destination=BswMRteModeRequestPort  # This is a reference to a BswMRteModeRequestPort.This will defines the PPorts for Rte_Write action e.g: BswMRteModeRequestPort_1. where BswMRteModeRequestPort_1 is a BswMRteModeRequest port defined in BswM configurations.
            container BswMRteStart [0..1]  # This container defines the action to start the Rte from BswM.
            container BswMRteStop [0..1]  # This container defines the action to stop the Rte from BswM.
            container BswMRteSwitch [0..1]  # This container defines a mode switch indication that the BswM provides to the SW-C that need to be notified about the mode switch. RTE_Switch is called when this action is configured. Note: SWC mode request and Rte switch action both are coupled each other. If configuring BswMSwcModeRequest and not configured BswMRteMSwitch action will generate validation error/warning.
              reference BswMRteSwitchPortRef: set at link in variant link-time+post-build / pre-compile in variant pre-compile, destination=BswMSwitchPort  # This is a reference to the BswMSwitchPort.This will defines PPorts for Rte_Switch action e.g: BswMSwitchPort_ComM_Modes. where BswMSwitchPort_ComM_Modes is a switch port defined in BswM configurations.
              foreign reference BswMSwitchedMode: set at link in variant link-time+post-build / pre-compile in variant pre-compile, destination-type=MODE-DECLARATION  # This parameter contains the integer value that corresponds to a certain mode in a Mode Declaration Group. e.g: /TestCd_ComM_SWCD/MDG_TestCd_ComM_SWCD/COMM_FULL_COMMUNICATION.
            container BswMSchMSwitch [0..1]  # This container defines a mode switch indication that the BswM provides to the SW-C that need to be notified about the mode switch. SchM_Switch is called when this action is configured.
              foreign reference BswMSchMModeDeclarationGroupRef [0..1]: set at link in variant link-time+post-build / pre-compile in variant pre-compile, destination-type=MODE-DECLARATION-GROUP  # This is the reference to a ModeDeclarationGroup to define a ModeDeclarationGroupPrototype in the role BswModuleDescription.providedModeGroup.
              foreign reference BswMSchMSwitchedMode: set at link in variant link-time+post-build / pre-compile in variant pre-compile, destination-type=MODE-DECLARATION  # This parameter contains the value that corresponds to a certain mode in a Mode Declaration Group. e.g: /TestCd_ComM_BSWMD/ModeDeclarationGroups/MDG_TestCd_ComM_BSWMD_Modes/COMM_FULL_COMMUNICATION
            container BswMSdClientServiceModeRequest [0..1]  # This container includes all parameters related to the selection of an client service of Sd. Sd_ClientServiceSetState is called when this action is configured.
              enumeration BswMSdClientServiceState: {BSWM_SD_CLIENT_SERVICE_RELEASED, BSWM_SD_CLIENT_SERVICE_REQUESTED}, set at link in variant link-time+post-build / pre-compile in variant pre-compile  # This parameter specifies if the corresponding client service shall be released or requested.
              symbolic name reference BswMSdClientMethodsRef: set at link in variant link-time+post-build / pre-compile in variant pre-compile, destination=SdClientService  # This is a reference to a client service in the Sd module.
            container BswMSdConsumedEventGroupModeRequest [0..1]  # This container includes all parameters related to the selection of a consumed EventGroup of Sd. Sd_ConsumedEventGroupSetState is called when this action is configured.
              enumeration BswMSdConsumedEventGroupState: {BSWM_SD_CONSUMED_EVENTGROUP_RELEASED, BSWM_SD_CONSUMED_EVENTGROUP_REQUESTED}, set at link in variant link-time+post-build / pre-compile in variant pre-compile  # This parameter specifies if the corresponding consumed event group shall be released or requested.
              symbolic name reference BswMSdConsumedEventGroupRef: set at link in variant link-time+post-build / pre-compile in variant pre-compile, destination=SdConsumedEventGroup  # This is a reference to an eventGroup that is defined within a client service in the Sd module.
            container BswMSdServerServiceModeRequest [0..1]  # This container includes all parameters related to the selection of a server service of Sd. Sd_ServerServiceSetState is called when this action is configured.
              enumeration BswMSdServerServiceState: {BSWM_SD_SERVER_SERVICE_AVAILABLE, BSWM_SD_SERVER_SERVICE_DOWN}, set at link in variant link-time+post-build / pre-compile in variant pre-compile  # This parameter specifies if the corresponding server service shall be down or available.
              symbolic name reference BswMSdServerMethodsRef: set at link in variant link-time+post-build / pre-compile in variant pre-compile, destination=SdServerService  # This is a reference to a server service in the Sd module.
            container BswMSdServiceGroupSwitch [0..1]  # This container includes references to the SdServiceGroups that shall be enabled and disabled.
              symbolic name reference BswMDisabledSdServiceGroupRef [0..*]: multiplicity set at link in variant link-time / post-build in variant post-build / pre-compile in variant pre-compile, post-build-variant-multiplicity=true, post-build-variant-value=true, set at link in variant link-time / post-build in variant post-build / pre-compile in variant pre-compile, destination=SdServiceGroup  # This is a reference to a SdServiceGroup that should be disabled. | This reference corresponds to the parameter "ServiceGroupId" of the function Sd_ServiceGroupStop.
              symbolic name reference BswMEnabledSdServiceGroupRef [0..*]: multiplicity set at link in variant link-time / post-build in variant post-build / pre-compile in variant pre-compile, post-build-variant-multiplicity=true, post-build-variant-value=true, set at link in variant link-time / post-build in variant post-build / pre-compile in variant pre-compile, destination=SdServiceGroup  # This is a reference to a SdServiceGroup that should be enabled. | This reference corresponds to the parameter "ServiceGroupId" of the function Sd_ServiceGroupStart.
            container BswMSwitchIPduMode [0..1]  # This container includes all parameters related to the selection of the transmission mode an I-PDU to be sent by COM. Com_SwitchIpduTxMode is called when this action is configured.
              boolean BswMSwitchIPduModeValue: post-build-variant-value=true, set at link in variant link-time / post-build in variant post-build / pre-compile in variant pre-compile  # This parameter defines which transmission mode shall be selected during this call. | This parameter corresponds to the parameter "Mode" of the function Com_SwitchIpduTxMode.
              symbolic name reference BswMSwitchIPduModeRef: post-build-variant-value=true, set at link in variant link-time / post-build in variant post-build / pre-compile in variant pre-compile, destination=ComIPdu  # This is a reference to an I-PDU for which the transmission mode shall be set. | This reference corresponds to the parameter "PduId" of the function Com_SwitchIpduTxMode.
            container BswMTimerControl [0..1]  # This container includes all parameters for the action to start or to stop a timer.
              enumeration BswMTimerAction: {BSWM_TIMER_START, BSWM_TIMER_STOP}, set at link in variant link-time+post-build / pre-compile in variant pre-compile  # Specify the action for the timer. The timer can be started or stopped..
              float BswMTimerValue: set at link in variant link-time+post-build / pre-compile in variant pre-compile  # Specify the timer value (in seconds) that is used when the timer is started.
              symbolic name reference BswMTimerRef: set at link in variant link-time+post-build / pre-compile in variant pre-compile, destination=BswMModeRequestPort  # Specify the Timer for which the timer action shall be executed.
            container BswMTriggerIPduSend [0..1]  # This container includes all parameters related to the triggering of an I-PDU to be sent by COM. Com_TriggerIPDUSend is called when this action is configured.
              symbolic name reference BswMTriggeredIPduRef [1..*]: multiplicity set at link in variant link-time / post-build in variant post-build / pre-compile in variant pre-compile, post-build-variant-multiplicity=true, post-build-variant-value=true, set at link in variant link-time / post-build in variant post-build / pre-compile in variant pre-compile, destination=ComIPdu  # This is a reference to an I-PDU that should be triggered for transmission. | This reference corresponds to the parameter "PduId" of the function Com_TriggerIPDUSend.
            container BswMUserCallout [0..1]  # This container include file containing the function declaration to be added in BswMUserIncludeFiles of BswMGeneral container.
              string BswMUserCalloutFunction: set at link in variant link-time+post-build / pre-compile in variant pre-compile  # This parameter specifies the complete function call including all parameters. The parameters are specified during configuration time, and cannot be changed during run time. Any return values passed by the callout will be ignored. | Example usage can be: Actions to initialize other BSW modules Action to call Rte_Start() Action to call Rte_Stop() Action to call NvM_ReadAll() Action to call NvM_WriteAll()
        container BswMActionList [0..*]: multiplicity set at link in variant link-time / post-build in variant post-build / pre-compile in variant pre-compile, post-build-variant-multiplicity=true  # Each instance of this container defines an action list that is invoked based on the BswM Rules. An action list contains a list of numbered action items to be processed. An action list can also include other action lists.
          enumeration BswMActionListExecution: {BSWM_CONDITION, BSWM_TRIGGER}, set at link in variant link-time+post-build / pre-compile in variant pre-compile  # This parameter controls if the corresponding action list shall be executed every time the rule is evaluated or only when the result of the evaluation changes. "BSWM_CONDITION" - action list shall be executed every time the rule is evaluated. "BSWM_TRIGGER" - action list shall be executed, only when the result of the evaluation changes.
          container BswMActionListItem [1..*]: multiplicity set at link in variant link-time / post-build in variant post-build / pre-compile in variant pre-compile, post-build-variant-multiplicity=true  # This container defines an item in an action list.
            boolean BswMAbortOnFail: post-build-variant-value=true, set at link in variant link-time / post-build in variant post-build / pre-compile in variant pre-compile, default-value=false  # This parameter defines if the execution of the action list shall be aborted if this specific action returns E_NOT_OK. Note that this is only applicable for actions that have E_NOT_OK as a possible return value.
            integer BswMActionListItemIndex: 0..255, post-build-variant-value=true, set at link in variant link-time / post-build in variant post-build / pre-compile in variant pre-compile  # This parameter defines the index of the action in the action list. It is used define in which order the actions shall be performed.
            integer BswMReportFailRuntimeErrorId [0..1]: 128..255, multiplicity set at link in variant link-time / post-build in variant post-build / pre-compile in variant pre-compile, post-build-variant-multiplicity=true, post-build-variant-value=true, set at link in variant link-time / post-build in variant post-build / pre-compile in variant pre-compile, default-value=128  # If this parameter is configured, and this specific action returns E_NOT_OK, the BswM will report a Det Runtime Error. The ErrorId reported in the Runtime Error is given by the value configured in this parameter.The value configured in the parameter is considered only if BswMActionListItemRef referred to an action
            choice reference BswMActionListItemRef: post-build-variant-value=true, set at link in variant link-time / post-build in variant post-build / pre-compile in variant pre-compile, destination=[BswMAction, BswMActionList]  # The action item can either be an atomic action or a reference to another action list. An action item refering to a Rule (Nested Rule) is going to be deprecated in future (Rfc 61155 C#24). Hence it is removed.
            symbolic name reference BswMReportFailToDemRef [0..0]: multiplicity set at link in variant link-time / post-build in variant post-build / pre-compile in variant pre-compile, post-build-variant-multiplicity=true, post-build-variant-value=true, set at link in variant link-time / post-build in variant post-build / pre-compile in variant pre-compile, destination=DemEventParameter  # If the reference is given, the DEM event shall be reported failed if this specific action returns E_NOT_OK; it shall be reported passed if this specific action returns E_OK.
        container BswMRteModeRequestPort [0..*]: multiplicity set at pre-compile  # This container defines a mode request port which the BswM may utilize to send a mode request to a SW-C which is acting as a mode-manager. If this container is referenced by a BswMRteModeRequest, the BswM shall create a corresponding PPort in its service description.
          boolean BswMRbModeRequestQueueEnabled [0..1]: origin=RB:2.0.0:2017-10-19, set at pre-compile, default-value=false  # This element specifies whether the sender receiver communication is queued or not. | When true: Queue is Enabled and when false or not configured : Queue is disabled
          foreign reference BswMRbRteModeRequestPortInterfaceRef: origin=RB:9.0.0:2016-02-16, set at pre-compile, destination-type=VARIABLE-DATA-PROTOTYPE  # This is a foreign reference to the variable data prototype used for the mode request e.g: /TestCd_BswM_RteModeReq_SWC_SWCD/SRI_TestCd_BswM_RteModeReq_1/Mode.
          foreign reference BswMRteModeRequestPortInterfaceMappingRef [0..0]: multiplicity set at link in variant link-time+post-build / pre-compile in variant pre-compile, set at link in variant link-time+post-build / pre-compile in variant pre-compile, destination-type=VARIABLE-AND-PARAMETER-INTERFACE-MAPPING  # This is a foreign reference to the variable and parameter interface mapping used for the mode request.
          instance reference BswMRteModeRequestPortInterfaceRef [0..0]: set at link in variant link-time+post-build / pre-compile in variant pre-compile, destination-context=SW-COMPONENT-PROTOTYPE* PORT-PROTOTYPE, destination-type=VARIABLE-DATA-PROTOTYPE  # This is an instance reference to the variable data prototype used for the mode request.
        container BswMSwitchPort [0..*]: multiplicity set at pre-compile  # This container specifies PPorts , which the BswM has to create in its SWCD. If the container is referenced by one or more BswMRteSwitchActions the BswM shall create a corresponding PPort in its Service Description.
          integer BswMRbModeSwitchQueueLength [0..1]: 1..255, multiplicity set at pre-compile, origin=RB:9.0.0:2016-02-16, set at pre-compile  # This element specifies whether the mode switch communication is queued or not, the length of the mode switch queue ( which is generated by the RTE ) on the provider port. Unqueued communication - When a mode manager initiates a mode switch, RTE will begin processing the request. When the mode switch is currently in progress for the mode instance, any further mode switches will be discarded/overwritten by RTE. Queued communication - When a mode manager initiates a mode switch, RTE will begin processing the request. When the mode switch is currently in progress for the mode instance, any further mode switches will be queued. The size of the mode switch queue is determined by BswMRbModeSwitchQueueLength.
          foreign reference BswMRbModeGroupRef: origin=RB:7.0.0:2020-07-14, set at pre-compile, destination-type=MODE-DECLARATION-GROUP-PROTOTYPE  # In this parameter, provide the reference to the ModeGroup e.g: /TestCd_ComM_SWCD/MSI_TestCd_ComM_SWCD/ModeDeclarationGroupPrototype.
    container BswMGeneral  # General configuration parameters of the Basic SW Mode Manager.
      boolean BswMCanSMEnabled: set at pre-compile, default-value=false  # enable/disable CanSM module related BswM API: | true: Enabled false: Disabled
      boolean BswMComMEnabled: set at pre-compile, default-value=false  # enable/disable ComM module related BswM API: | true: Enabled false: Disabled
      boolean BswMDcmEnabled: set at pre-compile, default-value=false  # enable/disable Dcm module related BswM API: | true: Enabled false: Disabled
      boolean BswMDevErrorDetect: set at pre-compile, default-value=false  # Switches the Default Error Tracer (Det) detection and notification ON or OFF. | * true: enabled (ON). * false: disabled (OFF).
      boolean BswMEcuMEnabled: set at pre-compile, default-value=false  # enable/disable EcuM module related BswM API: | true: Enabled false: Disabled
      boolean BswMEthIfEnabled: set at pre-compile, default-value=false  # enable/disable EthIf module related BswM API: | true: Enabled false: Disabled
      boolean BswMEthSMEnabled: set at pre-compile, default-value=false  # enable/disable EthSM module related BswM API: | true: Enabled false: Disabled
      boolean BswMFrSMEnabled: set at pre-compile, default-value=false  # enable/disable FrSM module related BswM API: | true: Enabled false: Disabled
      boolean BswMGenericRequestEnabled: set at pre-compile, default-value=false  # enable/disable Generic Request related BswM API: | true: Enabled false: Disabled
      boolean BswMJ1939DcmEnabled: multiplicity set at pre-compile, set at pre-compile, default-value=false  # Enable/disable J1939Dcm module related BswM API: | true: Enabled false: Disabled
      boolean BswMJ1939NmEnabled: set at pre-compile, default-value=false  # Enable/disable J1939Nm module related BswM API. | true: Enabled false: Disabled
      boolean BswMLinSMEnabled: set at pre-compile, default-value=false  # enable/disable LinSM module related BswM API: | true: Enabled false: Disabled
      boolean BswMLinTPEnabled: set at pre-compile, default-value=false  # enable/disable LinTP module related BswM API: | true: Enabled false: Disabled
      float BswMMainFunctionPeriod [0..1]: 0..Inf, multiplicity set at link in variant link-time+post-build / pre-compile in variant pre-compile, set at link in variant link-time+post-build / pre-compile in variant pre-compile  # The cycle time of the periodic main function of BswM. Defined in seconds .
      boolean BswMNmEnabled: set at pre-compile, default-value=false  # enable/disable Nm module related BswM API: | true: Enabled false: Disabled
      boolean BswMNvMEnabled: set at pre-compile, default-value=false  # enable/disable NvM module related BswM API: | true: Enabled false: Disabled
      boolean BswMRbComEnabled: set at pre-compile, default-value=false  # enable/disable Com module related BswM API: | true: Enabled false: Disabled
      boolean BswMRbDebugEnable [0..1]: multiplicity set at pre-compile, origin=RB:2.0.0:2017-06-30, set at pre-compile, default-value=false  # Enable : BswM records into NvM if any mode request is interrupted ; Disable: no information will be recorded. Additionally, the first element of RAM variable BswM_Rb_ctrInterrupt_au8 will indicate the number of times a request is being interrupted. | Hint : When this switch is enabled, NvM block for BswM needs to be configured for storing Interrupt related information (example configuration is provided in BswM_Ecucvalues.arxml file). When this switch is disabled, no NvM block should be configured.
      integer BswMRbIntrptQueueMaxSize [0..1]: 1..255, multiplicity set at pre-compile, origin=RB:2.0.0:2017-06-30, set at pre-compile, default-value=1  # In a system where there are multiple requests to BswM more frequently, BswM processes one request at a time and delayes any further requests in a queue. The parameter BswMRbIntrptQueueMaxSize shall be configured accordingly which determines the number of requests which can be delayed in the queue | Hint : The BswMRbDebugEnable parameter when enabled will maintain a record of the number of times a request is interrupted. This information can be used to configure an appropriate value for the maximum queue size.
      integer BswMRbMaxNumOfRules [0..1]: 1..65535, multiplicity set at pre-compile, origin=RB:2.0.0:2017-03-31, set at pre-compile  # This parameter specifies the maximum number of Rules which could be configured for each variant in BswM Module. | This is a pre-compile parameter, which limits the number of BswM Rules that could be configured during post-build time.
      boolean BswMRbSoAdEnabled [0..1]: origin=RB:2.1.0:2022-04-14, set at pre-compile, default-value=false  # Enable/disable SoAd module related BswM API. | true: Enabled false: Disabled
      boolean BswMSchMEnabled: set at pre-compile, default-value=false  # enable/disable SchM module related BswM API: | true: Enabled false: Disabled
      boolean BswMSdEnabled: set at pre-compile, default-value=false  # enable/disable Sd module related BswM API. | true: Enabled false: Disabled
      boolean BswMVersionInfoApi: set at pre-compile, default-value=true  # Switches the possibility to read the version information with the service BswM_GetVersionInfo(). | true: Enabled false: Disabled
      boolean BswMWdgMEnabled [0..0]: set at pre-compile, default-value=false  # enable/disable WdgM module related BswM API: | true: Enabled false: Disabled
      container BswMRbGenericReqUser [0..*]  # This container describes the Generic request ModeRequesterIds in a human readable format. | This container is referenced by BswMRbGenericReqUserRef in BswMGenericRequest mode request port. The values for the ModeRequesterIds are autogenerated and shall be used by including BswM.h. Please refer the description of BswMRbGenericReqUserRef, on how to use this ModeRequesterId
      container BswMUserIncludeFiles [0..1]  # Collection of header file names which shall be included by the BswM.
        string BswMUserIncludeFile [1..*]: multiplicity set at pre-compile, set at pre-compile  # Header file name which shall be included by the BswM. The value of this parameter shall be used as h-char-sequence or q-char-sequence according to ISO C90 section 6.10.2 "source file inclusion". The parameter value MUST NOT represent a path, since ISO C90 does not specify how such a path is treated (i.e., this is implementation defined (and additionally depends on the operating system and the underlying file system)). eg: UserInclude.h, "UserInclude.h", <UserInclude.h>. | The value of this parameter shall be used as h-char-sequence or q-char-sequence according to ISO C90 section 6.10.2 "source file inclusion". The parameter value MUST NOT represent a path, since ISO C90 does not specify how such a path is treated (i.e., this is implementation defined (and additionally depends on the operating system and the underlying file system)).
