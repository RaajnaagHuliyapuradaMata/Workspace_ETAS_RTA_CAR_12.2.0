AUTOSAR XML (schema 4-2-2)
package /AUTOSAR_Fls/EcucModuleDefs
  module definition Fls [0..254]: category=VENDOR_SPECIFIC_MODULE_DEFINITION, refined-module-def=Fls, variants pre-compile  # Memory: Flash Driver | Configuration of the Fls (internal or external flash driver) module.
    container FlsConfigSet  # Configuration data set | Container for runtime configuration parameters of the flash driver
      integer FlsAcErase [0..0]: 0..4294967295, multiplicity set at pre-compile, set at pre-compile  # Address offset in RAM for erase code | Address offset in RAM to which the erase flash access code shall be loaded. Used as function pointer to access the erase flash access code.
      integer FlsAcWrite [0..0]: 0..4294967295, multiplicity set at pre-compile, set at pre-compile  # Address offset in RAM for write code | Address offset in RAM to which the write flash access code shall be loaded. Used as function pointer to access the write flash access code.
      float FlsCallCycle [0..0]: 0..0.1, multiplicity set at pre-compile, set at pre-compile  # Cycle time of main function | Cycle time of calls of the flash driver's main function (in seconds).
      enumeration FlsDefaultMode [0..1]: {MEMIF_MODE_FAST, MEMIF_MODE_SLOW}, multiplicity set at pre-compile, set at pre-compile  # Default of FLS device mode | Default setting of the FLS device moder after initialization.
      function name FlsJobEndNotification [0..1]: multiplicity set at pre-compile, set at pre-compile  # Job End Notification | Function that is called after a job has been processed successfully. A maximum of 1 ConfigSet can be left empty (using the GetJobResult-API).
      function name FlsJobErrorNotification [0..1]: multiplicity set at pre-compile, set at pre-compile  # Job Error Notification | Function that is called after a job has been aborted with an error. A maximum of 1 ConfigSet can be left empty (using the GetJobResult-API).
      integer FlsMaxReadFastMode [0..1]: 0..4294967295, multiplicity set at pre-compile, set at pre-compile  # Read bytes in fast mode | The maximum number of bytes to read or compare in one cycle of the flash driver's job processing function in fast mode.
      integer FlsMaxReadNormalMode [0..1]: 0..4294967295, multiplicity set at pre-compile, set at pre-compile  # Read bytes in normal mode | The maximum number of bytes to read or compare in one cycle of the flash driver's job processing function in normal mode.
      integer FlsMaxWriteFastMode [0..1]: 0..4294967295, multiplicity set at pre-compile, set at pre-compile  # Write bytes in fast mode | The maximum number of bytes to write in one cycle of the flash driver's job processing function in fast mode.
      integer FlsMaxWriteNormalMode [0..1]: 0..4294967295, multiplicity set at pre-compile, set at pre-compile  # Write bytes in normal mode | The maximum number of bytes to write in one cycle of the flash driver's job processing function in normal mode.
      integer FlsProtection [0..0]: 0..4294967295, set at pre-compile  # Protection settings | Erase/write protection settings. Only relevant if supported by hardware.
      string FlsRbDeviceID [0..1]: multiplicity set at pre-compile, origin=RB:1.0.0:2011-09-09, set at pre-compile, max-length=32, min-length=1  # Device ID used (freely configurable) | Configuration of Fls Device ID is not supported anymore! Configuring this parameter will be ignored by the driver.
      enumeration FlsRbDeviceType: multiplicity set at pre-compile, origin=RB:1.0.0:2011-09-09, set at pre-compile  # Device type | Flash device type (might be pushed by other components)
      enumeration FlsRbDeviceTypeForced [0..1]: multiplicity set at pre-compile, origin=RB:1.0.0:2011-09-09, set at pre-compile  # Device type (forced) | Flash device type enforced. This should be used only in special situations to overwrite the settings of the FlsRbDevceType if other components push unprecise or wrong settings.
      container FlsDemEventParameterRefs [0..0]: multiplicity set at pre-compile  # Container for the references to DemEventParameter elements which shall be invoked using the Dem_ReportErrorStatus API in case the corresponding error occurs. The EventId is taken from the referenced DemEventParameter's DemEventId value. NOT SUPPORTED!
      container FlsExternalDriver [0..0]: multiplicity set at pre-compile  # FlsExternalDriver (SPI) | This container is present for external Flash drivers only. Internal Flash drivers do not use the parameter listed in this container, hence its multiplicity is 0 for internal drivers. NOT SUPPORTED!
        symbolic name reference FlsSpiReference [0..0]: multiplicity set at pre-compile, set at pre-compile, destination=SpiSequence  # Reference to Standard SPI sequence (required for external Flash drivers). Attention: ONLY 1 SpiReference allowed. NOT SUPPORTED!
      container FlsSectorList: multiplicity set at pre-compile  # Sector list | List of flashable sectors and pages.
        container FlsSector [1..255]: multiplicity set at pre-compile  # Sector descriptor | Configuration description of a flashable sector.
          integer FlsNumberOfSectors: 0..65535, multiplicity set at pre-compile, set at pre-compile  # Number of identical sectors | Number of continuous sectors with identical values for FlsSectorSize and FlsPageSize. The parameter FlsSectorStartAddress denotes the start address of the first sector.
          integer FlsPageSize [0..1]: 0..32768, multiplicity set at pre-compile, set at pre-compile  # Page size | Size of one page (for programming) (logical page size can be defined which has to be multiples of the physical page size)
          integer FlsSectorSize: 0..4294967295, multiplicity set at pre-compile, set at pre-compile  # Sector size | Size of this sector (for erasing) (logical sector can be defined which has to be multiples of the physical sector)
          integer FlsSectorStartaddress: 0..4294967295, multiplicity set at pre-compile, set at pre-compile  # Sector start address | Start address of the first sector.
    container FlsGeneral: multiplicity set at pre-compile  # General Parameters | Container for general parameters of the flash driver. These parameters are always pre-compile.
      boolean FlsAcLoadOnJobStart [0..0]: multiplicity set at pre-compile, set at pre-compile, default-value=false  # The flash driver shall load the flash access code to RAM whenever an erase or write job is started and unload (overwrite) it after that job has been finished or canceled. | true: Flash access code loaded on job start / unloaded on job end or error. false: Flash access code not loaded to / unloaded from RAM at all.
      integer FlsBaseAddress [0..1]: 0..4294967295, multiplicity set at pre-compile, set at pre-compile  # Base address for relative addressing | The flash memory start address for user. This parameter is only relevant in "relative addressing mode" (FlsRbUseRelativeAddressing=true) and shall not be set otherwise. If several users share the same API, they have to have the identical setting.
      boolean FlsBlankCheckApi: multiplicity set at pre-compile, origin=RB:1.0.0:2011-09-09, set at pre-compile  # Activation of Fls_BlankCheck API | Pre-processor switch to enable / disable the API to check for the erase pattern within a certain address area.
      boolean FlsCancelApi [0..1]: multiplicity set at pre-compile, set at pre-compile  # Activation of FlsCancel API | Compile switch to enable and disable the Fls_Cancel function. This function is only useable for the same user as GetJobResult interface (typically Fee). In addition, FlsRbCancelApi must be enabled.
      boolean FlsCompareApi: multiplicity set at pre-compile, set at pre-compile  # Activation of FlsCompare API | Compile switch to enable and disable the Fls_Compare function.
      boolean FlsDevErrorDetect: multiplicity set at pre-compile, set at pre-compile  # Activation of Development Error Detection mode | Pre-processor switch to enable and disable development error detection.
      integer FlsDriverIndex [0..1]: 0..254, multiplicity set at pre-compile, set at pre-compile  # The configured "Memory: Fls-Driver" can be assigned to a dedicated Fls Device-instance by selecting the related FlsDriverIndex. This is only needed if several memories shall be addressed in parallel (e.g. internal memory and external memory connected via SPI). Please note that in that case you have to use dedicated "indexed" interfaces instead of the standard Fls-interfaces. Please note: not all machine-types can be assigned to different Fls Device-instances. If you do not need this feature, please keep this entry "empty". For the AUTOSAR-Standard Fls-interfaces you have to select the FlsDriverIndex=0. Note: all users assigned to the same Fls Device-instance also have to use the same FlsDriverIndex entry. If FlsDriverIndex contains a value >0 then the user has to use interfaces containing the specified driver index (naming: Fls_6_<FlsDriverIndex>_Interface) to perform all tasks. Alternatively, specific Rb-extension interfaces are available which provide an indexed access (independent of this FlsDriverIndex, see FlsRbDriverId). If FlsDriverIndex contains a value >0 then it is necessary to have another "Memory: Fls-Driver" which is assigned to FlsDriverIndex=0. Please note that this setting is enabling the multi-instance handling.
      boolean FlsGetJobResultApi: multiplicity set at pre-compile, set at pre-compile  # Activation of the Fls_GetJobResult function | Compile switch to enable and disable the Fls_GetJobResult function. Please note that only 1 user for each driver-instance is allowed to have this Api activated. All other users of the same driver-instance have to use Job-notification-callback functions or the specific Fls_Rb_GetJobResultAdr-interfaces.
      boolean FlsGetStatusApi [0..1]: multiplicity set at pre-compile, set at pre-compile  # Activation of the Fls_GetStatus function | Compile switch to enable and disable the Fls_GetStatus function.
      float FlsMainFunctionPeriod [0..1]: 0..0.1, multiplicity set at pre-compile, origin=RB:18.1.0:2021-08-30, set at pre-compile  # Cycle time of main function | Cycle time of calls of the flash driver's main function (in seconds). Should be configured greater than zero for Timed RTE scheduling option of FlsRbMainFunctionScheduling parameter. Otherwise keep empty or set to 0.0.
      boolean FlsRbCancelApi [0..1]: multiplicity set at pre-compile, origin=RB:21.0.0:2022-12-01, set at pre-compile  # Activation of Cancel Functionality and API | Compile switch to enable and disable the Fls_Rb_CancelAdr function and the Cancel functionality.
      boolean FlsRbDdrModeApi [0..1]: multiplicity set at pre-compile, origin=RB:16.1.0:2020-09-15, set at pre-compile  # Activation of DDR API | Compiler switch to enable DDR related APIs
      boolean FlsRbDeInitApi [0..1]: multiplicity set at pre-compile, origin=RB:14.1.0:2019-09-16, set at pre-compile  # Activation of FlsRbDeInit API | Compile switch to enable and disable the Fls_Rb_DeInit function.
      boolean FlsRbDeviceInfoApi [0..1]: multiplicity set at pre-compile, origin=RB:15.1.0:2020-03-26, set at pre-compile  # Activation of Device Information API | Pre-processor switch to enable and disable the Fls_Rb_GetDeviceInfo function
      string FlsRbDriverId [0..1]: multiplicity set at pre-compile, origin=RB:13.1.0:2019-03-05, set at pre-compile, max-length=32, min-length=1  # FlsInterfaceName (Nick name) | Optional "Nick name" of the "Memory Fls-driver" used for the API/Interface-name generation. In case a name is given here the related API header/source is generated providing a mapping to the FlsDriverIndex. API activation are then related to this generated API-files. The name of the API-interface is defined either by the FlsDriverIndex (Fls_6_<FlsDriverIndex>.c/h) or by a dedicated name (Fls<FlsRbDriverId>.c/.h). Note: for each Fls-Device-Driver-instance this parameter is mandatory and has to be unique. Note: for each Fls-User this parameter is optional (normally it is left empty)
      integer FlsRbEquadSpiConnect [0..1]: 0..4, multiplicity set at pre-compile, origin=RB:1.0.0:2011-09-09, set at pre-compile, default-value=0  # Fls QuadSPI Communication Channel (not for Standard Spi) | Quad spi channel number. Do not use for Standard Spi connected devices
      boolean FlsRbExt1HWsuspendApi [0..1]: multiplicity set at pre-compile, origin=RB:13.0.0:2019-01-27, set at pre-compile, default-value=false  # Activation of Hardware Suspend API | Hardware Suspend/Resume Feature For External Flash. (Applicable only for Ext1 Devices). Suspend API has to be enabled before enabling this Feature
      boolean FlsRbExtOperFota1Api [0..1]: origin=RB:21.0.0:2022-11-24  # Activation of the Fls_Rb_ModeSwitch/Swap API | Switch to enable and disable the Fls Extended mode API Mode switch and Memory swap API function. (interface is only usable for dedicated CPUs)
      boolean FlsRbExtOperReplaceSectorApi [0..1]: multiplicity set at pre-compile, origin=RB:19.1.0:2022-02-24, set at pre-compile  # Activation of the Fls_Rb_ReplaceSector API | Switch to enable and disable the Fls_Rb_ReplaceSector API function. (interface is only usable for dedicated CPUs)
      boolean FlsRbExtOperSectorLockApi [0..1]: multiplicity set at pre-compile, origin=RB:19.1.0:2022-02-24, set at pre-compile  # Activation of the Fls_Rb_SetSectorLock/CheckSectorUnlocked API | Switch to enable and disable the Fls_Rb_SetSectorLock API and Fls_Rb_CheckSectorUnlocked API function. (interface is only usable for dedicated CPUs)
      boolean FlsRbGetJobErrDetailsApi [0..1]: multiplicity set at pre-compile, origin=RB:16.1.0:2020-09-28, set at pre-compile, default-value=false  # Activation of the Fls_Rb_GetJobErrDetails API | Switch to enable and disable the Fls_Rb_GetJobErrDetails API function. Function can be used to get more insight in the reason why the last job has failed.
      boolean FlsRbGetMediaAddrApi [0..1]: multiplicity set at pre-compile, origin=RB:19.0.0:2021-10-19, set at pre-compile  # Activation of the Fls_Rb_GetMediaAddress API | Switch to enable/disable the interface to get/read the current media address of a finished operation.
      boolean FlsRbGetModeApi [0..1]: multiplicity set at pre-compile, origin=RB:13.1.0:2019-03-21, set at pre-compile, default-value=false  # Activation of the Fls_Rb_GetMode API | Switch to enable and disable the Fls_Rb_GetModus API function.
      boolean FlsRbGetSectorInfo [0..1]: multiplicity set at pre-compile, origin=RB:17.1.0:2021-03-03, set at pre-compile  # Activation of the Fls_Rb_GetSectorInfo | Switch to enable and disable the Fls_Rb_GetSectorInfo API function.
      integer FlsRbHclk [0..1]: multiplicity set at pre-compile, origin=RB:1.0.0:2011-09-09, set at pre-compile  # CPU clock frequency [MHz] (only for V850R1x, RH850xx, RH850P1xC devices). | CPU clock frequency [MHz] that is used by the Low level driver's library for intialization of the device. CPU clock frequency [MHz] that is used by the LLD for intialization of the RH850P1xC, V850R1x and RH850xx libraries. HCLK frequency values supported by RH850P1xC: 120MHz, 160MHz, 240MHz
      boolean FlsRbHighSpeedModeApi [0..1]: multiplicity set at pre-compile, origin=RB:21.1.0:2023-03-19, set at pre-compile  # Activation of the HighSpeedMode APIs | The HighSpeedMode is a combination of SetMode and Suspend-APIs. Activating this function will activate: FlsRbSetModeApi, FlsRbSuspendApi,
      boolean FlsRbInclPrjHeader [0..1]: multiplicity set at pre-compile, origin=RB:16.0.0:2020-06-25, set at pre-compile, default-value=false  # Activate optional project extension header include. | This switch can be used to activate the optional #include Fls_Rb_Prj.h (see template folder) to activate/modify internal functionality within the Fls-HLD and the Fls-LLD. Note: when activating this switch, you have to provide this header file in your project.
      boolean FlsRbInfraApi [0..1]: multiplicity set at pre-compile, origin=RB:17.0.0:2020-12-02, set at pre-compile  # Activation of the Init/MainFunction APIs | Switch to enable/disable the generation of the infrastructure API-functions <Fls>_MainFunction/<Fls>_Init within the related API header. This is only necessary if more than 1 API is used per Device. Then 1 API should be used for system integration (e.g. task process list).
      boolean FlsRbInfraManualApi [0..1]: multiplicity set at pre-compile, origin=RB:17.0.0:2020-12-04, set at pre-compile  # Activation of the MainFunction APIs (special) | Switch to enable the generation of <Fls>_MainFunction API-functions for non-task manual calling. This is only needed in rare cases if FlsRbInfraApi is disabled.
      integer FlsRbLibRamAddr [0..1]: multiplicity set at pre-compile, origin=RB:1.0.0:2011-09-09, set at pre-compile  # RAM address required to locate Library provided by vendor(only necessary for code flash users of V850R1x). | Address required for copying the FCL code to RAM from the code flash area (applicable for boot loader programming sequence) --> Only necessary for Code Flash users of Renesas V850R1x device.
      enumeration FlsRbMachineType [0..1]: multiplicity set at pre-compile, origin=RB:1.0.0:2011-09-09, set at pre-compile  # Machine type | Controller type to be configured (might be pushed from other components). If this parameter is not available then the Machine type is extracted from other users (Memory: Fls-driver) assigned to the same FlsDriverIndex or from the Mcu module (if present). (see documentation section "Device Type Configuration" for further details). Note: for a Fls-Device-Driver-Instance this entry is manadatory. Note: for a Fls-User this entry is not required (keep empty - only needed for one user per device-driver)
      enumeration FlsRbMachineTypeForced [0..1]: multiplicity set at pre-compile, origin=RB:1.0.0:2011-09-09, set at pre-compile  # Machine type (forced) | Controller type - selected with a higher priority than then FlsRbMachineType. Necessary to overwrite a pushed unprecise or wrong settings from other components. Note: normally this parameter is not necessary and shall left empty.
      enumeration FlsRbMainFunctionScheduling [0..1]: multiplicity set at pre-compile, origin=RB:18.1.0:2021-08-30, set at pre-compile  # MainFunction Scheduling Type | Selection on type of scheduling required for the driver. This parameter shall be selected in consistency with FlsMainFunctionPeriod. Select MANUAL triggering if you manually control the calling of the MainFunction.
        FLS_RB_MAINFUNC_SCHEDULING_RTE_BACKGROUND  # RTE Background task
        FLS_RB_MAINFUNC_SCHEDULING_RTE_TIMED  # RTE Timed task
        FLS_RB_MAINFUNC_SCHEDULING_MANUAL  # Manual Scheduling
      boolean FlsRbP1xSupportFACI1 [0..1]: multiplicity set at pre-compile, origin=RB:13.0.0:2018-12-11, set at pre-compile  # Support of FACI1 for P1xC Device(only for RH850P1x devices). | Compiler Switch to Enable the Support of FACI1 for RH850P1xC device. Configure this parameter as True to access Bank B code Flash for device (D3, D4 and D5) of RH850P1xC.
      boolean FlsRbP1xSupportOlderDevice [0..1]: multiplicity set at pre-compile, origin=RB:1.0.0:2011-09-09, set at pre-compile  # Support P1x Dev5EDv1 device and P1x Dev4v1 device(only for RH850P1x devices). | Compile Switch to Enable the Support for P1x Dev5EDV1 device and P1x Dev4V1 Device (only necessary for RH850P1x devices).Configure this parameter as True while using P1x Dev5EDV1 and P1x Dev4V1 controllers.
      float FlsRbPageWriteTime [0..1]: 0.0001..0.01, multiplicity set at pre-compile, origin=RB:14.1.0:2019-08-20, set at pre-compile  # Timeout value (in s) for reference page write | Timeout value (in s) for one (1) reference page write operation. This parameter is needed to determine the volume dependent timeout part. This timeout duration is calculated as: FlsRbPageWriteTime * bytes-to-be-programmed / Ref-page-Size
      boolean FlsRbPartitionEnv [0..1]: multiplicity set at pre-compile, origin=RB:20.0.0:2022-03-11, set at pre-compile  # Activation of Partition Environment | Compiler Switch to Enable and disable the partition environment. Configure this parameter if the driver is used in multi partition environment.
      boolean FlsRbPowerModeApi [0..1]: multiplicity set at pre-compile, origin=RB:13.0.0:2018-10-19, set at pre-compile  # Activation of Fls_PowerMode API | Compile Switch to enable and disable the Deep Power Mode Function in External Flash.
      float FlsRbSectorEraseTime [0..1]: 0.01..10, multiplicity set at pre-compile, origin=RB:14.1.0:2019-08-20, set at pre-compile  # Timeout value (in s) for reference sector erase | Timeout value (in s) for one (1) reference sector erase operation. This parameter is needed to determine the volume dependent timeout part. This timeout duration is calculated as: FlsRbSectorEraseTime * bytes-in-Sectors / Ref-sector-size
      boolean FlsRbSetAuthentIdApi [0..1]: multiplicity set at pre-compile, origin=RB:17.1.0:2021-03-03, set at pre-compile  # Activation of the Fls_Rb_SetAuthentId function | Compile switch to enable and disable the Fls_Rb_SetAuthentId function. This function is applicable only for some uC to pass the authentification Id for the different flash regions.
      boolean FlsRbSetModeApi [0..1]: multiplicity set at pre-compile, origin=RB:13.1.0:2019-03-21, set at pre-compile  # Activation of the Fls_Rb_SetMode function | Compile switch to enable and disable the Fls_Rb_SetMode function. This is a replacement of Fls_SetMode also working if the Fls is busy.
      boolean FlsRbSuspendApi [0..1]: multiplicity set at pre-compile, origin=RB:1.0.0:2011-09-09, set at pre-compile  # Activation of the Suspend/Resume feature | Pre-processor switch to enable / disable the suspend/resume feature (only possible for certain devices).
      boolean FlsRbSyncErase [0..1]: multiplicity set at pre-compile, origin=RB:13.0.0:2018-11-13, set at pre-compile  # Activation of Sync Erase Function | This Function implements erase operation Synchronously
      boolean FlsRbSyncRead [0..1]: multiplicity set at pre-compile, origin=RB:13.0.0:2018-11-13, set at pre-compile  # Activation of Sync Read Function | This Function implements read ,blank check and compare operation synchronously
      boolean FlsRbSyncWriteEna [0..1]: multiplicity set at pre-compile, origin=RB:16.1.0:2020-09-16, set at pre-compile, default-value=false  # Activation of Sync Write Function | Switch to enable /disable Synchronous Mode for Write operation. Disabling this function will turn Write operation to Asynchronous Mode (Default). Note: taken over from FlsRbSyncWrite only with corrected logic (inverted)as a prt of a defect fix
      boolean FlsRbTimeMeasurementEnabled [0..1]: multiplicity set at pre-compile, origin=RB:16.1.0:2020-08-05, set at pre-compile  # Activation of Fls Time measurement | Switch to enable and disable the Fls time measurement. The functionality is intended to verify the parameters set within the timeout-monitoring.
      float FlsRbTimeoutReqAcceptance [0..1]: 0..100, multiplicity set at pre-compile, origin=RB:14.1.0:2019-08-20, set at pre-compile  # Timeout value (in s) for request acceptance | Timeout duration (in seconds) to needed by the hardware / lower layer to accept the request placed by the flash driver. Note: This parameter might be influences by HSM/Host interaction
      float FlsRbTimeoutSupervisionOffset [0..1]: 0..100, multiplicity set at pre-compile, origin=RB:14.1.0:2019-08-14, set at pre-compile  # Timeout value offset (in s) for communication overhead | Duration (in seconds) needed for SPI/DMA etc. to process the accepted job. This configured timeing value will added to the volume depending flash processing time for the timeout supervision. Needed to consider the SPI channel load configured for the Flash device. Recommended: mandatory for external flashes if timeout supervision used.
      boolean FlsRbTransferModeApi [0..1]: multiplicity set at pre-compile, origin=RB:17.1.0:2021-03-25, set at pre-compile, default-value=false  # Activation of TransferMode API | Switch to enable and disable the Transfer-mode APIs needed for LLDs using SPI/QuadSpi communications. Only if this function is enabled, the LLD will perform asynchronuous tranfer operations.
      boolean FlsRbTransientErrorCompare [0..1]: multiplicity set at pre-compile, origin=RB:16.0.0:2020-06-15, set at pre-compile, default-value=false  # Activation of Compare Transient Error Det reporting | Switch to enable and disable the Fls transient errors for Compare operation. When activated the related JobFailed incident is in addition reported to the Det. Note: in AR4.2 reporting happens as Runtime-Error
      boolean FlsRbTransientErrorErase [0..1]: multiplicity set at pre-compile, origin=RB:16.0.0:2020-06-15, set at pre-compile, default-value=true  # Activation of Erase Transient Error Det reporting | Switch to enable and disable the Fls transient errors for Erase operation. When activated the related JobFailed incident is in addition reported to the Det. Note: in AR4.2 reporting happens as Runtime-Error
      boolean FlsRbTransientErrorFlashId [0..1]: multiplicity set at pre-compile, origin=RB:16.0.0:2020-06-15, set at pre-compile, default-value=true  # Activation of unexpected Flash ID Det reporting | Switch to enable/disable the unexpected FlashId DET reporting. The FlashID is checked during initialization of external flash chips. If it fails the Fls driver remains in state UNINIT. By activating this function and addition Det reporting is performed.
      boolean FlsRbTransientErrorRead [0..1]: multiplicity set at pre-compile, origin=RB:16.0.0:2020-06-15, set at pre-compile, default-value=false  # Activation of Read Transient Error Det reporting | Switch to enable and disable the Fls transient errors for Read operation. When activated the related JobFailed incident is in addition reported to the Det. Note: in AR4.2 reporting happens as Runtime-Error
      boolean FlsRbTransientErrorWrite [0..1]: multiplicity set at pre-compile, origin=RB:16.0.0:2020-06-15, set at pre-compile, default-value=false  # Activation of Write Transient Error Det reporting | Switch to enable and disable the Fls transient errors for Write operation. When activated the related JobFailed incident is in addition reported to the Det. Note: in AR4.2 reporting happens as Runtime-Error
      boolean FlsRbUseRelativeAddressing [0..1]: multiplicity set at pre-compile, origin=RB:19.1.0:2022-03-05, set at pre-compile  # Activation of the relative Addressing Mode | This mode is used for AR compatibility check of the Fee. It is only working if all users of one API interface have the relative mode activated.
      boolean FlsRbWriteWithParallelActionApi [0..1]: multiplicity set at pre-compile, origin=RB:16.1.0:2020-09-28, set at pre-compile, default-value=false  # Activation of Fls_Rb_WriteWithParallelAction API | Switch to enable / disable the special API for write with a parallel operation (e.g. erase) dependent on the selected uC
      boolean FlsRbWriteWithoutTransientErrorApi [0..1]: multiplicity set at pre-compile, origin=RB:18.0.0:2021-05-21, set at pre-compile, default-value=false  # Activation of Fls_Rb_WriteWithoutTransientError API | Switch to enable / disable the special API for write which prevents transient error entries. This API is needed in special cases and some controllers for invalidating data.
      boolean FlsReadApi [0..1]: multiplicity set at pre-compile, origin=RB:13.1.0:2019-03-21, set at pre-compile, default-value=true  # Activation of FlsRead API | Compiler switch to enable and disable the Fls_Read function (only in exceptional cases)
      integer FlsSPIBufferSize [0..1]: 0..2048, multiplicity set at pre-compile, origin=RB:13.0.0:2018-10-31, set at pre-compile, default-value=261  # Fls SPI Buffer Size | Length of Transmission and reception buffer for SPI (shall be >=261)
      boolean FlsSetModeApi: multiplicity set at pre-compile, set at pre-compile, default-value=false  # Activation of the Fls_SetMode function | Switch to enable and disable the Fls_SetMode function. It is recommended to use the Fls_Rb_SetMode function instead as this is working also in BUSY-states. If you use Fls_SetMode the call is only accepted in IDLE state!
      boolean FlsTimeoutSupervisionEnabled [0..1]: multiplicity set at pre-compile, set at pre-compile  # Activation of Timeout Supervision | Switch to enable timeout supervision for the device. true: timeout supervision for read/erase/write/compare jobs enabled. false: timeout supervision for read/erase/write/compare jobs disabled.
      integer FlsTotalSize [0..1]: 0..4294967295, multiplicity set at pre-compile, set at pre-compile  # Amount of flash memory bytes | The total amount of flash memory in bytes (This parameter in conjunction with FLS_BASE_ADDRESS defines the upper boundary for read / write / erase and compare jobs). Not necessary to configure this tag anymore as the information of total size of configured sectors will be automatically computed and considered by the Fls script based on user configuration.
      boolean FlsUseInterrupts [0..1]: multiplicity set at pre-compile, set at pre-compile, default-value=false  # Switch to enable the MainFunction-API which can be used in interrupts to process the status. | true: Job processing triggered by interrupt (hardware controlled). false: Job processing not triggered by interrupt (software controlled)
      boolean FlsVersionInfoApi: multiplicity set at pre-compile, set at pre-compile, default-value=true  # Activation of FlsVersionInfo API | Switch to enable / disable the API to read out the modules version information.
    container FlsPublishedInformation [0..1]  # Additional published parameters not covered by CommonPublishedInformation container.
      integer FlsAcLocationErase [0..0]: 0..4294967295, multiplicity set at pre-compile, set at published-information  # Position in RAM, to which the erase flash access code has to be loaded. | Only relevant if the erase flash access code is not position independent. If this information is not provided it is assumed that the erase flash access code is position independent and that therefore the RAM position can be freely configured.
      integer FlsAcLocationWrite [0..0]: 0..4294967295, multiplicity set at pre-compile, set at published-information  # Position in RAM, to which the write flash access code has to be loaded. | Only relevant if the write flash access code is not position independent. If this information is not provided it is assumed that the write flash access code is position independent and that therefore the RAM position can be freely configured.
      integer FlsAcSizeErase [0..0]: 0..4294967295, multiplicity set at pre-compile, set at published-information  # Number of bytes in RAM needed for the erase flash access code.
      integer FlsAcSizeWrite [0..0]: 0..4294967295, multiplicity set at pre-compile, set at published-information  # Number of bytes in RAM needed for the write flash access code.
      float FlsEraseTime [0..0]: multiplicity set at pre-compile, set at published-information  # Maximum time to erase one complete flash sector. (in seconds)
      integer FlsErasedValue [0..1]: 0..4294967295, multiplicity set at pre-compile, set at pre-compile  # Erase pattern | The contents of an erased flash memory cell.
      string FlsExpectedHwId [0..0]: multiplicity set at pre-compile, set at published-information  # Unique identifier of the hardware device that is expected by this driver (the device for which this driver has been implemented). | Only relevant for external flash drivers.
      string FlsRbPubDeviceType [0..1]: multiplicity set at pre-compile, origin=RB:19.1.0:2022-03-18, set at published-information  # Selected Device type | Device type selected
      integer FlsRbPubDriverIndex [0..1]: 0..254, multiplicity set at pre-compile, origin=RB:16.1.0:2020-09-18, set at published-information  # Generated Driver Index | Published information about the driver index assigned to this user
      string FlsRbPubDriverIndexEnum [0..1]: multiplicity set at pre-compile, origin=RB:16.1.0:2020-09-18, set at published-information  # Generated Driver Enum | Published information about the driver enum generated from Nickname/DriverIndex to address the related Fls-device. This enum can be used for the provided indexed interfaces
      string FlsRbPubLldName [0..1]: multiplicity set at pre-compile, origin=RB:19.1.0:2022-03-18, set at published-information  # Selected Lld Driver | Name of the Lld
      integer FlsRbPubLldSubIndex [0..1]: 0..254, multiplicity set at pre-compile, origin=RB:19.1.0:2022-03-18, set at published-information  # Selected Lld SubIndex | Sub Index within the Lld
      string FlsRbPubMachineType [0..1]: multiplicity set at pre-compile, origin=RB:16.1.0:2020-09-18, set at published-information  # Selected Machine type | Controller type selected.
      boolean FlsRbPubMultiInstanceRouting [0..1]: multiplicity set at pre-compile, origin=RB:20.1.0:2022-07-22, set at published-information  # Used Multi-Instance Routing | Is multi-Instance routing used for this channel
      integer FlsSpecifiedEraseCycles [0..1]: 0..4294967295, multiplicity set at pre-compile, set at pre-compile  # Maximum erase cycles | Number of erase cycles specified for the flash device (usually given in the device data sheet). If the number of specified erase cycles depends on the operating environment (temperature, voltage, ...) during reprogramming of the flash device, the minimum number forwhich a data retention of atleast 15 years over the temperature range from -40degC .. +125degC can be guaranteed shall be given. Fls will ignore the configuration of this tag as it is not considered for any purpose, hence it is not necessary to configure this tag any more!
      float FlsWriteTime [0..0]: multiplicity set at pre-compile, set at pre-compile  # Maximum page programming time | Maximum time to program one complete flash page. (in seconds)
    container FlsRbModuleNvMFeeData [0..1]  # Fls Parameter to Upper Modules NvM and Fee | Addtional General Parameter for Timeout Storage
      boolean FlsRbPersistTimeoutData [0..1]: multiplicity set at pre-compile, origin=RB:17.0.0:2020-11-20, set at pre-compile  # Activation of Timeout Data Storage | Switch to Enable Fls timeout data storage in NvM.
