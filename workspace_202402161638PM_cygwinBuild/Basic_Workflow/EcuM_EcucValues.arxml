AUTOSAR XML (schema 00051)
package /ETAS_Project/EcucModuleConfigurationValuess
  module config EcuM
    EcuMConfiguration_0 (EcuMConfiguration)
      EcuMCommonConfiguration_0 (EcuMCommonConfiguration): EcuMIgnoreWakeupEvValOffPreOS=0, EcuMDefaultAppMode=OSDEFAULTAPPMODE
        EcuMDefaultShutdownTarget_0 (EcuMDefaultShutdownTarget): EcuMDefaultState=EcuMStateOff
        ECUM_WKSOURCE_POWER (EcuMWakeupSource): EcuMCheckWakeupTimeout=0.0, EcuMValidationTimeout=0.0
        EcuMDriverInitListOne_0 (EcuMDriverInitListOne)
          6 x EcuMDriverInitItem, all with EcuMModuleService=Init:
            Can_Init: EcuMModuleParameter=POSTBUILD_PTR, EcuMModuleRef=Can
            CanIf_Init: EcuMModuleParameter=NULL_PTR, EcuMModuleRef=CanIf
            CanSM_Init: EcuMModuleParameter=NULL_PTR, EcuMModuleRef=CanSM
            PduR_Init: EcuMModuleParameter=POSTBUILD_PTR, EcuMModuleRef=PduR
            Com_Init: EcuMModuleParameter=NULL_PTR, EcuMModuleRef=Com
            ComM_Init: EcuMModuleParameter=NULL_PTR, EcuMModuleRef=ComM
        4 x EcuMWakeupSource, all with EcuMCheckWakeupTimeout=0.0, EcuMValidationTimeout=0.0:
          ECUM_WKSOURCE_RESET
          ECUM_WKSOURCE_INTERNAL_RESET
          ECUM_WKSOURCE_INTERNAL_WDG
          ECUM_WKSOURCE_EXTERNAL_WDG
      EcuMFlexConfiguration_0 (EcuMFlexConfiguration)
        EcuMFlexUserConfig_0 (EcuMFlexUserConfig): EcuMFlexUser=0
        ECUM_RESET_MCU (EcuMResetMode)
        ECUM_CAUSE_ECU_STATE (EcuMShutdownCause)
        ECUM_RESET_WDGM (EcuMResetMode)
        ECUM_RESET_IO (EcuMResetMode)
        3 x EcuMShutdownCause:
          ECUM_CAUSE_WDGM
          ECUM_CAUSE_DCM
          ECUM_CAUSE_UNKNOWN
    EcuMGeneral_0 (EcuMGeneral):
      EcuMDevErrorDetect = 0
      EcuMRbConfigCCASInit = 0
      EcuMRbDisableNvM = 0
      EcuMRbIncludeComm = 1
      EcuMRbModeSwitchQueueLength = 1
      EcuMRbSlaveCoreEarlierStart = 0
      EcuMRbStartupDuration = 0
      EcuMRbUserTypeUpdate = 0
      EcuMVersionInfoApi = 0
      EcuMIncludeDet = false
      EcuMMainFunctionPeriod = 0.01
      EcuMRbIncludeHeaderList_0 (EcuMRbIncludeHeaderList): EcuMRbModuleHeader=EcuM_User
