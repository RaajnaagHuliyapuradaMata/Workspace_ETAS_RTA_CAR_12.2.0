AUTOSAR XML (schema 4-3-0)
package /AUTOSAR_CanSM/ApplicationDataTypes
  5 x application array data type, all with category=ARRAY, sw-calibration-access=READ-WRITE:
    CanSM_Au8_app  # Array of the type Uint8
      element CanSM_uint8: category=VALUE, type=CanSM_u8_app, max-number-of-elements=1
    CanSM_Aboolean_app  # Array of the type Boolean
      element CanSM_boolean: category=VALUE, type=CanSM_boolean_app, max-number-of-elements=1
    CanSM_currBOR_State_a_Aenum_app  # Array of enum
      element CanSM_BusOffRecoveryStateType: category=VALUE, type=CanSM_BusOffRecoveryStateType_Enum_app, max-number-of-elements=1
    CanSM_currComM_Mode_a_Aenum_app  # Array of enum
      element CanSM_enum_CanSM_currComM_Mode_a_app: category=VALUE, type=CanSM_NetworkModeStateType_Enum_app, max-number-of-elements=1
    CanSM_TimerConfig_ast_Astruct_app  # Array of structure
      element CanSM_TimerConfig_tst: category=STRUCTURE, type=CanSM_TimerConfig_tst_struct_app, max-number-of-elements=1
  5 x app type, all with category=VALUE, sw-calibration-access=READ-WRITE, display-format=%5.0f:
    CanSM_u8_app: compu-method=Identical, range phys 0..255  # uint8 application datatype in CanSM
    CanSM_u16_app: compu-method=Identical, range phys 0..65535  # uint16 application datatype in CanSM
    CanSM_BusOffRecoveryStateType_Enum_app: compu {0=CANSM_BOR_IDLE, 1=CANSM_S_BUS_OFF_CHECK, 2=CANSM_S_NO_BUS_OFF, 3=CANSM_S_BUS_OFF_RECOVERY_L1, 4=CANSM_S_RESTART_CC, 5=CANSM_S_RESTART_CC_WAIT, 6=CANSM_S_BUS_OFF_RECOVERY_L2} "Computation method for the enum CanSM_BusOffRecoveryStateType", range phys 0..255  # enum application datatype in CanSM
    CanSM_NetworkModeStateType_Enum_app: compu {0=CANSM_BSM_S_NOCOM, 1=CANSM_BSM_S_SILENTCOM, 2=CANSM_BSM_S_FULLCOM, 3=CANSM_BSM_S_NOT_INITIALIZED, 4=CANSM_BSM_S_PRE_NOCOM, 5=CANSM_BSM_WUVALIDATION, 6=CANSM_BSM_S_PRE_FULLCOM, 7=CANSM_BSM_S_SET_BAUDRATE, 8=CANSM_BSM_S_SILENTCOM_BOR, 9=CANSM_BSM_S_TX_TIMEOUT_EXCEPTION} "Computation method for the enum CanSM_NetworkModeStateType", range phys 0..255  # enum application datatype in CanSM
    CanSM_TimerStateType_Enum_app: compu {1=CANSM_TIMER_INIT, 2=CANSM_TIMER_RUNNING, 3=CANSM_TIMER_ELAPSED, 4=CANSM_TIMER_CANCELLED} "Computation method for the enum CanSM_TimerStateType", range phys 0..255  # enum application datatype in CanSM
  application record data type CanSM_TimerConfig_tst_struct_app: category=STRUCTURE, sw-calibration-access=READ-WRITE  # structure datatype in CanSM
    application record element cntTick_u16: category=VALUE, type=CanSM_u16_app
    application record element stTimer: category=VALUE, type=CanSM_TimerStateType_Enum_app
  app type CanSM_boolean_app: category=VALUE, sw-calibration-access=READ-WRITE, compu-method=Identical, range phys 0..255, display-format=%5.0f  # boolean application datatype in CanSM
package /AUTOSAR_CanSM/BswImplementations
  bsw implementation CanSM: programming-language=C, sw-version=5.0.0, ar-release-version=4.5.0, behavior=BswInternalBehavior
    code-descriptors:
      code CodeDescriptor: artifact-descriptors=autosar-engineering-object={short-label=ArEngObj, category=SWSRC}
    resource consumption CanSM_ResourceConsumption
      16 x memory section:
        CANSM_CONFIG_DATA_POSTBUILD_8: alignment=8, prefix=CANSM, sw-addrmethod=CONFIG_DATA_POSTBUILD, symbol=CONFIG_DATA_POSTBUILD_8
        CANSM_CONFIG_DATA_POSTBUILD_16: alignment=16, prefix=CANSM, sw-addrmethod=CONFIG_DATA_POSTBUILD, symbol=CONFIG_DATA_POSTBUILD_16
        CANSM_CONFIG_DATA_POSTBUILD_32: alignment=32, prefix=CANSM, sw-addrmethod=CONFIG_DATA_POSTBUILD, symbol=CONFIG_DATA_POSTBUILD_32
        CANSM_CONFIG_DATA_POSTBUILD_UNSPECIFIED: alignment=UNSPECIFIED, prefix=CANSM, sw-addrmethod=CONFIG_DATA_POSTBUILD, symbol=CONFIG_DATA_POSTBUILD_UNSPECIFIED
        CANSM_CONST_8: alignment=8, prefix=CANSM, sw-addrmethod=CONST, symbol=CONST_8
        CANSM_CONST_16: alignment=16, prefix=CANSM, sw-addrmethod=CONST, symbol=CONST_16
        CANSM_CONST_32: alignment=32, prefix=CANSM, sw-addrmethod=CONST, symbol=CONST_32
        CANSM_CONST_UNSPECIFIED: alignment=UNSPECIFIED, prefix=CANSM, sw-addrmethod=CONST, symbol=CONST_UNSPECIFIED
        CANSM_VAR_CLEARED_8: alignment=8, prefix=CANSM, sw-addrmethod=VAR_CLEARED, symbol=VAR_CLEARED_8
        CANSM_VAR_CLEARED_16: alignment=16, prefix=CANSM, sw-addrmethod=VAR_CLEARED, symbol=VAR_CLEARED_16
        CANSM_VAR_CLEARED_32: alignment=32, prefix=CANSM, sw-addrmethod=VAR_CLEARED, symbol=VAR_CLEARED_32
        CANSM_VAR_CLEARED_UNSPECIFIED: alignment=UNSPECIFIED, prefix=CANSM, sw-addrmethod=VAR_CLEARED, symbol=VAR_CLEARED_UNSPECIFIED
        CANSM_VAR_INIT_UNSPECIFIED: alignment=UNSPECIFIED, prefix=CANSM, sw-addrmethod=VAR_INIT, symbol=VAR_INIT_UNSPECIFIED
        CanSM_CODE: prefix=CanSM, sw-addrmethod=CODE, symbol=CODE
        CANSM_CODE: prefix=CANSM, sw-addrmethod=CODE, symbol=CODE
        CANSM_CONFIG_DATA_UNSPECIFIED: alignment=UNSPECIFIED, prefix=CANSM, sw-addrmethod=CONFIG_DATA, symbol=CONFIG_DATA_UNSPECIFIED
      section name prefix CanSM
      section name prefix CANSM
package /AUTOSAR_CanSM/BswModuleDescriptions
  bsw module description CanSM: category=BSW_MODULE, module-id=140  # CanStateManager
    bsw internal behavior BswInternalBehavior: data-type-mapping=DataTypeMappingSet
      static-memorys:
        9 x data, all with category=ARRAY, sw-addr-method=INTERNAL_VAR_CLEARED, sw-calibration-access=READ-ONLY, display-format=%5.0f:
          CanSM_BusOff_Cntr_au8: type=CanSM_Au8_app  # Bus-Off counter for CanSM
          CanSM_currBOR_State_en: type=CanSM_currBOR_State_a_Aenum_app  # Current Bus-Off recovery state for CanSM
          CanSM_ReqComM_Mode_en: type=CanSM_Au8_app  # stores the requested communication mode
          CanSM_BORMode_au8: type=CanSM_Au8_app  # Variable to SET/RESET the BOR mode
          CanSM_BusOffISRPend_ab: type=CanSM_Aboolean_app  # To Set the BOR ISR Pending Request to True or False
          CanSM_Network_Init_ab: type=CanSM_Aboolean_app  # Setting this leads to initialisation of the network
          CanSM_MutexMode_au8: type=CanSM_Au8_app  # Used to set
          CanSM_CurrNw_Mode_en: type=CanSM_currComM_Mode_a_Aenum_app  # current ComM mode
          CanSM_TimerConfig_ast: type=CanSM_TimerConfig_ast_Astruct_app  # CanSM timer configuration
      bsw called entity CE_Init: implemented-entry=CanSM_Init
      bsw schedulable entity SE_MainFunction: implemented-entry=CanSM_MainFunction
      bsw timing event EV_SE_MainFunction: starts-on-event=SE_MainFunction, period=0.01
package /AUTOSAR_CanSM/DataTypeMappingSets
  data type mapping set DataTypeMappingSet
    data-type-maps:
      application-data-type=CanSM_Au8_app, implementation-data-type=CanSM_Au8_impl
      application-data-type=CanSM_Aboolean_app, implementation-data-type=CanSM_Aboolean_impl
      application-data-type=CanSM_currBOR_State_a_Aenum_app, implementation-data-type=CanSM_currBOR_State_a_Aenum_impl
      application-data-type=CanSM_currComM_Mode_a_Aenum_app, implementation-data-type=CanSM_currComM_Mode_a_Aenum_impl
      application-data-type=CanSM_TimerConfig_ast_Astruct_app, implementation-data-type=CanSM_TimerConfig_ast_Astruct_impl
      application-data-type=CanSM_u8_app, implementation-data-type=CanSM_u8_Impl
      application-data-type=CanSM_u16_app, implementation-data-type=CanSM_u16_Impl
      application-data-type=CanSM_BusOffRecoveryStateType_Enum_app, implementation-data-type=uint8
      application-data-type=CanSM_NetworkModeStateType_Enum_app, implementation-data-type=uint8
      application-data-type=CanSM_TimerStateType_Enum_app, implementation-data-type=uint8
      application-data-type=CanSM_TimerConfig_tst_struct_app, implementation-data-type=CanSM_TimerConfig_tst_struct_impl
      application-data-type=CanSM_boolean_app, implementation-data-type=CanSM_boolean_Impl
package /AUTOSAR_CanSM/ImplementationDataTypes
  12 x impl type:
    CanSM_Au8_impl: category=ARRAY  # array of elements of the type Uint8
      element CanSM_uint8_Impl: array-size=1, array-size-semantics=FIXED-SIZE, implementation-data-type=CanSM_u8_Impl
    CanSM_Aboolean_impl: category=ARRAY  # array of elements of the type Boolean
      element CanSM_boolean_Impl: array-size=1, array-size-semantics=FIXED-SIZE, implementation-data-type=CanSM_boolean_Impl
    CanSM_currBOR_State_a_Aenum_impl: category=ARRAY  # Array of enum for implementation data type
      element CanSM_enum_CanSM_currBOR_State_a_Impl: array-size=1, array-size-semantics=FIXED-SIZE, implementation-data-type=CanSM_BusOffRecoveryStateType_Enum_impl
    CanSM_currComM_Mode_a_Aenum_impl: category=ARRAY  # Array of enum for implementation data type
      element CanSM_enum_CanSM_currComM_Mode_a_Impl: array-size=1, array-size-semantics=FIXED-SIZE, implementation-data-type=CanSM_NetworkModeStateType_Enum_impl
    CanSM_TimerConfig_ast_Astruct_impl: category=ARRAY  # Array of structure
      element CanSM_TimerConfig_tst: array-size=1, array-size-semantics=FIXED-SIZE, implementation-data-type=CanSM_TimerConfig_tst_struct_impl
    CanSM_u8_Impl: implementation-data-type=uint8  # uint8 implementation data type in CanSM
    CanSM_u16_Impl: implementation-data-type=uint16  # uint16 implementation data type in CanSM
    CanSM_boolean_Impl: implementation-data-type=uint8  # Boolean implementation data type in CanSM
    CanSM_BusOffRecoveryStateType_Enum_impl: implementation-data-type=uint8  # enum implementation data type in CanSM
    CanSM_NetworkModeStateType_Enum_impl: implementation-data-type=uint8  # enum implementation data type in CanSM
    CanSM_TimerStateType_Enum_impl: implementation-data-type=uint8  # enum implementation data type in CanSM
    CanSM_TimerConfig_tst_struct_impl: category=STRUCTURE  # structure
      element cntTick_u16: implementation-data-type=CanSM_u16_Impl
      element stTimer: implementation-data-type=CanSM_TimerStateType_Enum_impl
package /AUTOSAR_CanSM/Units
  unit NoUnit: display-name=noUnit, factor-si-to-unit=1.0, offset-si-to-unit=0.0, physical-dimension=NoUnit  # No Unit
package /AUTOSAR_CanSM/PhysicalDimensions
  physical dimension NoUnit: length-exp=0
