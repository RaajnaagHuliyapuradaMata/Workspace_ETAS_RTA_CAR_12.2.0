AUTOSAR XML (schema 00049)
# The material contained in this specification is protected by copyright and
# other types of Intellectual Property Rights. The commercial exploitation of the
# material contained in this specification requires a license to such
# Intellectual Property Rights.
# This specification may be utilized or reproduced without any modification, in
# any form or by any means, for informational purposes only. For any other
# purpose, no part of the specification may be utilized or reproduced, in any
# form or by any means, without permission in writing from the publisher.
# licensed under the same rules as applicable to the AUTOSAR Standard.
package /AUTOSAR_Xfrm/EcucModuleDefs
  ecuc definition collection AUTOSARParameterDefinition: module=Xfrm
  module definition Xfrm [0..*]: post-build-variant-support=true, refined-module-def=Xfrm, variants link-time/post-build/pre-compile
    container XfrmGeneral  # Contains the general configuration parameters of the module.
      boolean XfrmDevErrorDetect: set at pre-compile, default-value=false  # Switches the development error detection and notification on or off. | * true: detection and notification is enabled. * false: detection and notification is disabled.
      boolean rba_XfrmEnableAlignedBufferAccess: origin=RB, set at pre-compile  # defines wether the transformer can access the buffer in an aligned manner (e.g. read 4 bytes at once). This can be sued to optimize execution time, but the uffer allocation is handeled externally by the caller. This option should be enabled only if the caller component can guarantee that the start of the buffer is aligned! | * true: enabled (ON) - the caller guarantees that start of the buffer is aligned * false: disabled (OFF) - the Xfrm cannot rely on the caller and should only acces the buffer one byte at a time.
      boolean rba_XfrmFillGapsWithUnusedAreasDefault [0..1]: origin=RB, set at pre-compile, default-value=true  # Switches the filling of Gaps in a SignalGroup with ComTxIPduUnusedAreasDefault. | * true: Gaps in SignalGroup will be filled with ComTxIPduUnusedAreasDefault by ComXf (ON). * false: Gaps in SignalGroup will not be filled with ComTxIPduUnusedAreasDefault by ComXf (OFF).
      boolean rba_XfrmRteInUse [0..1]: origin=RB, set at pre-compile, default-value=true  # If RTE is enabled, then the value of this parameter should be set to true. If RTE is disabled, then the value of this parameter should be set to False. If this parameter is set to false a header file that defines all data types needed by the transformers needs to be defined with rba_XfrmUserHeaderFile | * true: used (ON). * false: not used (OFF).
      enumeration rba_XfrmSomeIpXfAUTOSARVersion [0..1]: {AR4_2_2, AR4_3_0, AR4_3_1, AR4_5_0}, set at pre-compile, origin=RB, default-value=AR4_5_0  # With this parameter it can be defined that for which AR version SomeIpXf is implemented (e.g. String handling) | String handling will not include BOM, as per AUTOSAR_SWS_SOMEIPTransformer 4.2.2, but BOM will be included for AR versions above AR4.2.2
      boolean rba_XfrmSomeIpXfErrorHandling [0..1]: set at pre-compile, origin=RB, default-value=true  # This parameter defines that whether the Error Message Type has to be defined with value 0x80 or 0x81 | As per AUTOSAR_SWS_SOMEIPTransformer 4.2.2, the Message Type Error is defined with value 0x81, whereas as per AR versions above AR4.2.2, the Message Type Response is used with value 0x80 and also for Error. Hence this parameter is introduced to overcome this inconsistency of the Message Type. User shall configure this parameter as, * True : if the Error Response to be set with Message Type as 0x81 * False: if the Error Response to be set with Message Type as 0x80
      boolean rba_XfrmSomeIpXfInitValueBufferAsGlobal [0..1]: origin=RB, set at pre-compile, default-value=false  # Switches the handling of InitValue buffer as Global or local variable in SomeIpXf | * true: InitValue buffer will be defined as Global variable (saves runtime but not Memory) * false: InitValue buffer will be defined as Local variable (less runtime but needs more Stacksize)
      string rba_XfrmSomeIpXfProtofilePath [0..1]: origin=RB, set at pre-compile  # Path of the .proto file that is configured in SOMEIPTransformationISignalProps. | This Parameter should be configured if ProtobufFiles is configured in SOMEIPTransformationISignalProps. i.e., if the Signal has to be serialized/deserialized using Protobuf serializer instead of AUTOSAR SOME/IP Serializer
      string rba_XfrmUserHeaderFile [0..1]: origin=RB, set at pre-compile, default-value=rba_Xfrm_UserCfg_Type.h  # Header file name which shall be included by the transformers ComXf and SomeIpXf instead of Rte_Type.h, if rba_XfrmRteInUse is set to false. The value of this parameter shall be set as eg: UserInclude.h | This Parameter should be configured if rba_XfrmRteInUse Parameter is set to false, to include the userdefined header file instead of Rte header file when RTE is not used
    container XfrmImplementationMapping [1..*]  # For each transformer (TransformationTechnology) in a transformer chain (DataTransformation) which is applied to an ISignal it is necessary to specify the BswModuleEntry which implements it. This is the container to hold these mappings.
      integer XfrmBufferSizeInBytes [0..1]: 0.., set at pre-compile, origin=RB, with-auto=true  # BufferSizeInBytes | Size of the buffer provided to the transformer
      boolean XfrmMalformedMessageCallout [0..1]: origin=RB, set at pre-compile, default-value=false  # Malformed message callout parameter value provided to the transformer to generate callout invocation function in deserializer files
      foreign reference XfrmInvTransformerBswModuleEntryRef [0..1]: multiplicity set at pre-compile, set at pre-compile, destination-type=BSW-MODULE-ENTRY  # Reference to the BswModuleEntry which implements the referenced inverse transformer on the receiving/called side.
      reference rba_SysElem_XfrmTransformationTechnologyRef: origin=RB, set at pre-compile, destination=rba_SysElem_TransformationTechnology  # Reference to the TransformationTechnology in the DataTransformation. This is RB specific reference and point to the SystemElement Ecuc Values rba_SysElem_TransformationTechnology.
      foreign reference XfrmTransformationTechnologyRef: set at pre-compile, destination-type=TRANSFORMATION-TECHNOLOGY  # Reference to the TransformationTechnology in the DataTransformation of the system description for which the implementation (BswModuleEntry) shall be mapped.
      foreign reference XfrmTransformerBswModuleEntryRef [0..1]: multiplicity set at pre-compile, set at pre-compile, destination-type=BSW-MODULE-ENTRY  # Reference to the BswModuleEntry which implements the referenced transformer on the sending/calling side.
      reference rba_SysElem_XfrmVariableDataPrototypeInstanceRef [0..1]: multiplicity set at pre-compile, origin=RB, set at pre-compile, destination=rba_SysElem_VariableDataPrototype  # VS Reference to a VariableDataPrototype inside te RB SysElem EcuConf. (see XfrmVariableDataPrototypeInstanceRef)
      instance reference XfrmVariableDataPrototypeInstanceRef [0..1]: multiplicity set at pre-compile, set at pre-compile, destination-context=SW-COMPONENT-PROTOTYPE PORT-PROTOTYPE, destination-type=VARIABLE-DATA-PROTOTYPE  # Instance Reference to a VariableDataPrototype in case a dedicated transformer BswModuleEntry is required per VariableDataPrototype access.
      container XfrmDemEventParameterRefs [0..1]  # Container for the references to DemEventParameter elements which shall be invoked using the API Dem_SetEventStatus in case the corresponding error occurs. The EventId is taken from the referenced DemEventParameter's DemEventId symbolic value. The standardized errors are provided in this container and can be extended by vendor-specific error references.
        reference XFRM_E_MALFORMED_MESSAGE [0..1]: multiplicity set at pre-compile, set at pre-compile, requires-symbolic-name-value=true, destination=DemEventParameter  # Reference to configured DEM event to report if malformed messages were received by the transformer.
      container XfrmSignal [0..1]  # Reference to the signal in the system description that transports the transformed data.
        choice container XfrmSignalChoice  # Choice whether an ISignal or an ISignalGroup shall be referenced.
          container XfrmISignalGroupRefChoice [0..1]  # Reference to the ISignalGroup in the system description that transports the transformed data.
            reference rba_SysElem_XfrmISignalGroupRef: origin=RB, set at pre-compile, destination=rba_SysElem_ISignalGroup  # Reference to the ISignalGroup in the RB SysElem EcuConf that transports the transformed data.
            foreign reference XfrmISignalGroupRef: set at pre-compile, destination-type=I-SIGNAL-GROUP  # Reference to the ISignalGroup in the system description that transports the transformed data.
          container XfrmISignalRefChoice [0..1]  # Reference to the ISignal in the system description that transports the transformed data.
            reference rba_SysElem_XfrmISignalRef: set at pre-compile, destination=rba_SysElem_ISignal  # Reference to the ISignal in the RB SysElem parmConf that transports the transformed data.
            foreign reference XfrmISignalRef: set at pre-compile, destination-type=I-SIGNAL  # Reference to the ISignal in the system description that transports the transformed data.
