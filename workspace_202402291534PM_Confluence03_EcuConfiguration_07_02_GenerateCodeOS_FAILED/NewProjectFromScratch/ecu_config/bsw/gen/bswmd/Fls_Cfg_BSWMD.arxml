AUTOSAR XML (schema 4-3-0)
package /AUTOSAR_Fls/BswImplementations
  bsw implementation Fls: programming-language=C, sw-version=8.0.0, ar-release-version=4.5.0, behavior=BswInternalBehavior
    code-descriptors:
      code CodeDescriptor: artifact-descriptors=autosar-engineering-object={short-label=ArEngObj, category=SWSRC}
package /AUTOSAR_Fls/BswModuleDescriptions
  bsw module description Fls: category=BSW_MODULE, module-id=92  # FlashDriver
    bsw internal behavior BswInternalBehavior
      bsw schedulable entity Fls_MainFunction: implemented-entry=Fls_MainFunction
      bsw timing event EV_Fls_MainFunction: starts-on-event=Fls_MainFunction, period=0.01
package /AUTOSAR_Fls/Units
  unit NoUnit: display-name=noUnit, factor-si-to-unit=1.0, offset-si-to-unit=0.0, physical-dimension=NoUnit  # No Unit
package /AUTOSAR_Fls/PhysicalDimensions
  physical dimension NoUnit: length-exp=0
