AUTOSAR XML (schema 00051)
package /RB/RBA/rba_ArxmlGen/EcucModuleDefs
  module definition rba_ArxmlGen [0..1]: category=VENDOR_SPECIFIC_MODULE_DEFINITION, variants pre-compile  # ARXML Generator | Provides an abstraction of elements commonly defined in SWCD or BSWMD files. This allows users to define AUTOSAR elements in a more abstract way than by specifying ARXML files directly.
    container rba_ArxmlGen_BswControl [0..1]: multiplicity set at pre-compile  # ARXMLGen_SchedulingControl | The instance of this container is the indication to have control on the generation of schedulable entity.
      boolean rba_ArxmlGen_BswControlStatus [0..1]: multiplicity set at pre-compile, origin=RB:0.1.0:2013-02-05, set at pre-compile, default-value=false  # Control | The status shows to enable or disable the generation of schedulable entity and related parameters globally. If configured true the schedulable entity generation will be disabled globally and vice-versa.
      reference rba_ArxmlGen_BswControlStatus_Comp [0..*]: multiplicity set at pre-compile, origin=RB:0.1.0:2013-02-05, set at pre-compile, destination=rba_ArxmlGen_Comp  # CompRteSchedulingCntrol | The status shows to enable or disable the generation of schedulable entity and related parameters globally.
    container rba_ArxmlGen_Comp [0..*]: multiplicity set at pre-compile  # Component | For each instance of this container, one BSWMD file will be generated for the component named according to the short name of this container. This generated BSWMD file contains the ARXML counterparts of all elements defined inside this container.
      enumeration rba_ArxmlGen_BswMeasurementSupport [0..1]: {arTypedPerInstanceMemory, staticMemory}, origin=RB:5.0.0:2023-03-20, set at pre-compile, default-value=staticMemory  # Bsw Measurement Support | the measurement definition which describes the behavior of memory block which is available for measuremnt variables. currently supports arTypedPerInstanceMemory and staticMemory, by default staticMemory will be generated. (this parameter is provided as a backward compatibility option for projects which do not supports RTE, staticMemorys is provided)
      enumeration rba_ArxmlGen_CompCategory: origin=RB:0.1.0:2013-02-05, set at pre-compile  # Category | Categorizes this component. Currently only the category BswModule is supported.
        BswModule  # BSW module
      integer rba_ArxmlGen_CompId: 1..65535, origin=RB:0.1.0:2013-02-05, set at pre-compile, default-value=false  # Module identifier | Identifier of this component (only applies to BSW). Please refer to the AUTOSAR_TR_BSWModuleList.pdf for a normative list of all module IDs for standardized BSW modules. For non-standardized modules, BSW architects define the ID. Special cases are modules for I/O Hardware Abstraction (ID = 254) and complex drivers (ID = 255).
      boolean rba_ArxmlGen_CompIsConfigurable: origin=RB:0.1.0:2013-02-05, set at pre-compile  # Is configurable | Defines whether this component is configurable via the AUTOSAR ECU configuration methodology. If this is set to true, a reference to the vendor-specific ECUC parameter definition' s top level element is added to the BSWMD output.
      boolean rba_ArxmlGen_CompIsStandalone [0..1]: multiplicity set at pre-compile, origin=RB:2.2.0:2014-05-22, set at pre-compile  # Is standalone | Defines whether the generated BSWMD file by rba_ArxmlGen is the only BSWMD file for the component (tag shall be set to true) or an additional (static) BSWMD file exists in parallel (tag shall be set to false). Due to backwards compatibility this attribute is currently optional---but will become mandatory in future.
      boolean rba_ArxmlGen_CompIsStandardized: origin=RB:0.1.0:2013-02-05, set at pre-compile  # Is standardized | Defines whether this component is a standardized AUTOSAR BSW module.
      boolean rba_ArxmlGen_CompIsVendorspecific [0..1]: origin=RB:7.0.0:2019-05-12, set at pre-compile  # Is Vendor specific | Defines whether this component is configurable as per the Vendor. If this is set to true, then in the BSWMD output the ARPackage structure is generated without the prefix AUTOSAR_.
      string rba_ArxmlGen_CompLongName: origin=RB:0.1.0:2013-02-05, set at pre-compile, min-length=1  # Long name | Long name of this component. The long name shall be the human readable representation of the short name of this component.
      string rba_ArxmlGen_CompVendorApiInfix [0..1]: origin=RB:7.0.0:2019-05-12, set at pre-compile  # VendorApiInfix | VendorApiInfix is the Vendor specific name
      string rba_ArxmlGen_CompVersionAr [0..1]: origin=RB:9.0.0:2020-11-27, set at pre-compile, regular-expression=[0-9]+\.[0-9]+\.[0-9]+([\._; ].*)?  # AUTOSAR version | Version of the AUTOSAR release on which the implementation of this component is based. The version information must follow the pattern defined by the AUTOSAR RevisionLabelString element, e.g. 4.0.3. HINT : this parameter is deprecated and maintained only for backward compatibility purpose... Dont use these parameter for latest developments. Now on if the parameter is not configured, rba_Arxml Gen will use EcuC parameter for deciding the AR version
      string rba_ArxmlGen_CompVersionSw: origin=RB:0.1.0:2013-02-05, set at pre-compile  # Software version | Defines the version of the software which implements this component. Take the variant without the alternative prefix, as specified in the CM plan (this is then conform to the AUTOSAR RevisionLabelString pattern).
      boolean rba_ArxmlGen_EnableBswImplementations [0..1]: origin=RB:1.0.0:2019-08-20, set at pre-compile, default-value=true  # BswImplementations Generation | The status shows to enable or disable the generation of BswImplementations. If configured false the BswImplementations generation will be disabled.
      foreign reference rba_ArxmlGen_CompMappingSetRef [0..*]: multiplicity set at pre-compile, origin=RB:1.0.0:2013-05-22, set at pre-compile, destination-type=DATA-TYPE-MAPPING-SET  # Data type mapping set | Short name path to an externally defined (i.e. not generated with rba_ArxmlGen) data type mapping set. This reference shall only be used if a reference to an externally defined application data type which is used within this component shall be defined.
      foreign reference rba_ArxmlGen_CompSwcBswMappingRef [0..1]: multiplicity set at pre-compile, origin=RB:2.1.0:2014-02-25, set at pre-compile, destination-type=SWC-BSW-MAPPING  # SWC-BSW mapping | Reference to an SwcBswMapping which maps an SwcInternalBehavior to a BswInternalBehavior. This is only required to coordinate the API generation and the scheduling for service components, ECU abstraction components and complex driver components by the RTE and the BSW scheduling mechanisms.
      container rba_ArxmlGen_ApplDataType [0..*]: multiplicity set at pre-compile  # Appl. data type | Defines an application data type used for measurement or calibration. The short name of this application data type shall start with the component' s short name.
        enumeration rba_ArxmlGen_ApplDataTypeCalibrationaccess [0..1]: multiplicity set at pre-compile, origin=RB:0.1.0:2013-02-05, set at pre-compile  # Calibration Access | The parameter shall be configured for application data type which are non calibration parameters and non measurement variables If this parameter is not configured then the value will be taken as " Not accessible"
          Read_Only  # Read only access
          Not_Accessible  # Not Accessible
        enumeration rba_ArxmlGen_ApplDataTypeCategory: origin=RB:0.1.0:2013-02-05, set at pre-compile  # Category | Categorizes this application data type. Currently, simple values, arrays, structures and value blocks are supported.
          Simple  # Simple value
          Array
          Struct  # Structure
          ValBlock  # Value Block
        string rba_ArxmlGen_ApplDataTypeDispFormat [0..1]: multiplicity set at pre-compile, origin=RB:2.0.0:2013-12-08, set at pre-compile, min-length=1  # Display format | Display format of the (physical) value of the application data type. A printf-like format string shall be given here, e.g. %5.0f. Due to backwards compatibility this attribute is currently optional---but will become mandatory in future.
        string rba_ArxmlGen_ApplDataTypeLongName: origin=RB:0.1.0:2013-02-05, set at pre-compile, min-length=1  # Long name | Long name of this application data type. The long name shall be the human readable representation of the short name of this application data type.
        integer rba_ArxmlGen_ApplDataTypeNumElements [0..1]: 1.., multiplicity set at pre-compile, origin=RB:2.0.0:2013-10-31, set at pre-compile  # Number of array elements | Array size in case of array application data types. Not applicable to simple or structure application data types.
        reference rba_ArxmlGen_ApplDataTypeCompuMethodOwnRef [0..1]: multiplicity set at pre-compile, origin=RB:2.0.0:2013-11-06, set at pre-compile, destination=rba_ArxmlGen_CompuMethod  # Computation method (own) | Reference to the computation method which describes the translation between the internal (often integer) and physical (often floating point) representation of elements using this application data type. Only applicable to simple data types, not to arrays or structures. This parameter shall only be used if the referenced computation method is also defined using rba_ArxmlGen and if it is part of the same component as this application data type.
        foreign reference rba_ArxmlGen_ApplDataTypeCompuMethodRef [0..1]: multiplicity set at pre-compile, origin=RB:0.1.0:2013-02-05, set at pre-compile, destination-type=COMPU-METHOD  # Computation method (other) | Short name path to the (typically centrally defined) computation method which describes the translation between the internal (often integer) and physical (often floating point) representation of elements using this application data type. Only applicable to simple data types, not to arrays or structures. This parameter shall only be used if the referenced computation method is not defined using rba_ArxmlGen or if it is part of a different component than this application data type. The list of centrally available computation methods is provided in the Central Elements Guideline (Rule CEL_113). If a particular computation method is not centrally defined the local expert for central elements has to be consulted.
        reference rba_ArxmlGen_ApplDataTypeDataConstrOwnRef [0..1]: multiplicity set at pre-compile, origin=RB:2.3.0:2014-07-21, set at pre-compile, destination=rba_ArxmlGen_DataConstraint  # Data constraint (own) | DataConstraints are used to implement limits on the values for data element.The meta-class DataConstr is referenced via the attribute SwDataDefProps of an ApplicationDataType.This parameter shall only be used if the referenced DataConstr type is also defined using rba_ArxmlGen and if it is part of the same component as this application data type.
        foreign reference rba_ArxmlGen_ApplDataTypeDataConstrRef [0..1]: multiplicity set at pre-compile, origin=RB:2.3.0:2014-07-21, set at pre-compile, destination-type=DATA-CONSTR  # Data constraint (other) | DataConstraints are used to implement limits on the values for data element.The meta class DataConstr is referenced via the attribute SwDataDefProps of an ApplicationDataType.This parameter shall only be used if the referenced DataConstr type is not defined using rba_ArxmlGen or if it is part of a different component than this application data type.
        reference rba_ArxmlGen_ApplDataTypeImplOwnRef [0..1]: multiplicity set at pre-compile, origin=RB:0.1.0:2013-02-05, set at pre-compile, destination=rba_ArxmlGen_ImplDataType  # Impl. data type (own) | Reference to the implementation data type which is used on implementation level for this application data type. This parameter shall only be used if the referenced implementation data type is also defined using rba_ArxmlGen and if it is part of the same component as this application data type.
        foreign reference rba_ArxmlGen_ApplDataTypeImplRef [0..1]: multiplicity set at pre-compile, origin=RB:0.1.0:2013-02-05, set at pre-compile, destination-type=IMPLEMENTATION-DATA-TYPE  # Impl. data type (other) | Short name path to the implementation data type which is used on implementation level for this application data type. This parameter shall only be used if the referenced implementation data type is not defined using rba_ArxmlGen or if it is part of a different component than this application data type.
        foreign reference rba_ArxmlGen_ApplDataTypeSwRecordLayoutRef [0..1]: multiplicity set at pre-compile, origin=RB:9.0.0:2016-12-26, set at pre-compile, destination-type=SW-RECORD-LAYOUT  # Sw Record Layout Ref | This is reference to a Sw Record Layout. Developers shall make use of Record Layouts for their data elements.
        container rba_ArxmlGen_ApplDataTypeRefreshing [0..1]: multiplicity set at pre-compile  # Refreshing | Specifies the frequency in which the application data is updated. This container shall only be activated in exceptional cases, in particular for adaptive calibration parameters. If this container is activated but not filled a default of 200ms is provided.
          integer rba_ArxmlGen_ApplDataTypeRefreshCode [0..1]: 0..1000, multiplicity set at pre-compile, origin=RB:2.0.0:2013-11-15, set at pre-compile, default-value=3  # CSE code | Specifies the code for the scaling units. The default value for scaling unit is 3 (representing 1 ms). The mapping value to scaling unit can be found in chapter " Common explanation of MSRSW elements" in the ASAM-AE-MDX-V*.pdf document.
          integer rba_ArxmlGen_ApplDataTypeRefreshFactor [0..1]: 1.., multiplicity set at pre-compile, origin=RB:2.0.0:2013-11-15, set at pre-compile, default-value=200  # CSE factor | Specifies the factor for the timing rate. The default refresh factor is 200.
        container rba_ArxmlGen_ApplDataTypeSub [0..*]: multiplicity set at pre-compile  # Sub appl. data type | Specifies a subordinate application data type in case of array or structure application data types. Not applicable to simple application data types, i.e. of category simple value or value block. In case of arrays, only one such subordinate application data type is allowed to be specified here.
          reference rba_ArxmlGen_ApplDataTypeSubOwnRef [0..1]: multiplicity set at pre-compile, origin=RB:2.0.0:2013-10-31, set at pre-compile, destination=rba_ArxmlGen_ApplDataType  # Sub appl. data type (own) | Reference to the subordinate application data type(s) in case of array or structure application data types. Not applicable to simple application data types. This parameter shall only be used if the referenced application data type is also defined using rba_ArxmlGen and if it is part of the same component as this application data type.
          foreign reference rba_ArxmlGen_ApplDataTypeSubXArrayRef [0..1]: multiplicity set at pre-compile, origin=RB:2.0.0:2013-10-31, set at pre-compile, destination-type=APPLICATION-ARRAY-DATA-TYPE  # Sub appl. data type (other, array) | Short name path to the subordinate array application data type(s) in case of array or structure application data types. Not applicable to simple application data types. This parameter shall only be used if the referenced application data type is not defined using rba_ArxmlGen or if it is part of a different component than this application data type.
          foreign reference rba_ArxmlGen_ApplDataTypeSubXPrimitiveRef [0..1]: multiplicity set at pre-compile, origin=RB:2.0.0:2013-10-31, set at pre-compile, destination-type=APPLICATION-PRIMITIVE-DATA-TYPE  # Sub appl. data type (other, simple) | Short name path to the subordinate simple application data type(s) in case of array or structure application data types. Not applicable to simple application data types. This parameter shall only be used if the referenced application data type is not defined using rba_ArxmlGen or if it is part of a different component than this application data type.
          foreign reference rba_ArxmlGen_ApplDataTypeSubXRecordRef [0..1]: multiplicity set at pre-compile, origin=RB:2.0.0:2013-10-31, set at pre-compile, destination-type=APPLICATION-RECORD-DATA-TYPE  # Sub appl. data type (other, structure) | Short name path to the subordinate structure application data type(s) in case of array or structure application data types. Not applicable to simple application data types. This parameter shall only be used if the referenced application data type is not defined using rba_ArxmlGen or if it is part of a different component than this application data type.
      container rba_ArxmlGen_BswModuleEntry [0..*]: multiplicity set at pre-compile  # BswModuleEntry | This class represents a single API entry (C-function prototype) into the BSW module or cluster.The ShortName of the BswModuleEntry shall be set identical to the name of the C-function (but without a VendorId and a VendorApiInfix).
        enumeration rba_ArxmlGen_BswCallType: origin=RB:1.1.0:2021-10-04, set at pre-compile  # BswModuleEntry Call Type | The type of call associated with this service. There could be two use cases possible to call a BSW initialization functions such as before and after the start of OS: 1.Before the start of OS, specify the CALL-TYPE as REGULAR. 2.After the start of OS (for example in an OS_Ini_Task), specify the CALL-TYPE as SCHEDULED
          CALLBACK  # Callback (i.e. the caller specifies the signature).
          INTERRUPT  # Interrupt routine
          REGULAR  # Regular API call.
          SCHEDULED  # Called by the scheduler.
        enumeration rba_ArxmlGen_BswExecutionContext: origin=RB:1.1.0:2021-10-04, set at pre-compile  # BswExecutionContext | Specifies the execution context which is required (in caseof entries into this module) or guaranteed (in case ofentries called from this module) for this service. Hints : It is not recommended to use interrupts of INTERRUPT−CAT−1 because interrupts should be under control of the OS. There could be two use cases possible to call a BSW initialization functions such as before and after the start of OS: 1.Before the start of OS, specify the EXECUTION-CONTEXT as UNSPECIFIED. 2.After the start of OS(for example in an OS_Ini_Task), specify the EXECUTION-CONTEXT as TASK.
          HOOK  # Context of an OS "hook" routine always.
          INTERRUPT_CAT_1  # CAT1 interrupt context always.Cat1 interrupt routines are not controlled by the OS and are only allowed to make a very limited selection of OS calls to enable and disable all interrupts. The BswInterruptEntity is implemented by the interrupt service routine, which is directly called from the interrupt vector (not via the OS).
          INTERRUPT_CAT_2  # CAT2 interrupt context always.Cat2 interrupt routines are controlled by the OS and they are allowed to make OS calls. The BswInterruptEntity is implemented by the interrupt handler, which is called from the OS.
          TASK  # Task context always.
          UNSPECIFIED  # The execution context is not specified by the API
        boolean rba_ArxmlGen_IsReentrant: origin=RB:1.1.0:2021-10-04, set at pre-compile  # IsReentrant | Reentrancy from the viewpoint of function callers:•True: Enables the service to be invoked again, before the service has finished.•False: It is prohibited to invoke the service againbefore is has finished.
        boolean rba_ArxmlGen_IsSynchronus: origin=RB:1.1.0:2021-10-04, set at pre-compile  # IsSynchronus | Synchronicity from the viewpoint of function callers:•True: This calls a synchronous service, i.e. theservice is completed when the call returns.•False: The service (on semantical level) may notbe complete when the call returns
        string rba_ArxmlGen_LongNamebswmoduleentry [0..1]: origin=RB:1.1.0:2021-10-04, set at pre-compile  # Long name | Long name of this Bsw Module Entry. The long name shall be the human readable representation of the short name of this Bsw Module Entry.
        integer rba_ArxmlGen_ServiceId [0..1]: multiplicity set at pre-compile, origin=RB:1.1.0:2021-10-04, set at pre-compile  # ServiceId | Refers to the service identifier of the StandardizedInterfaces of AUTOSAR basic software. Fornon-standardized interfaces, it can optionally be used forproprietary identification
        enumeration rba_ArxmlGen_swServiceImplPolicy: origin=RB:1.1.0:2021-10-04, set at pre-compile  # SwServiceImplPolicy | Denotes the implementation policy as a standard functioncall, inline function or macro. This has to be specified oninterface level because it determines the signature of thecall.
          INLINE  # inline service definition.
          INLINE_CONDITIONAL  # The service (in AUTOSAR: BswModuleEntry) is implemented in a way that it either resolves to aninline function or to a standard function depending on conditions set at a later point in time.This could be handled by using the AUTOSAR compiler abstraction macros (INLINE, LOCAL_INLINE) and/or by further compiler switches depending on ECU configuration values.
          MACRO  # macro service definition
          STANDARD  # Standard service and default value, if nothing is defined.
        container rba_ArxmlGen_Arguments [0..1]  # Arguments | This Container the specifies the arguments belonging to this BswModuleEntry
          container rba_ArxmlGen_SwServiceArg [1..*]: multiplicity set at pre-compile  # SwServiceArg | Specifies the properties of a data object exchanged during the call of an SwService
            enumeration rba_ArxmlGen_Category: {TYPE_REFERENCE, DATA_REFERENCE, FUNCTION_REFERENCE}, origin=RB:4.0.0:2022-12-2, set at pre-compile  # Category | Categorizes the kind of the return value (value, data pointer, functionpointer).
            enumeration rba_ArxmlGen_Direction [0..1]: {IN, INOUT, OUT}, origin=RB:4.0.0:2022-12-2, set at pre-compile  # Direction | Describes the kind of the data flow of the return value of a BswModuleEntry.
            string rba_ArxmlGen_NativeDeclarationString [0..1]: multiplicity set at pre-compile, origin=RB:4.0.0:2022-12-2, set at pre-compile  # AdditionalNativeTypeQualifier | This attribute describes the declaration of such a basetype and is optional and shall only be used if an additional native qualifier is necessary.
            enumeration rba_ArxmlGen_TargetCategory [0..1]: {TYPE_REFERENCE, DATA_REFERENCE}, origin=RB:4.0.0:2022-12-2, set at pre-compile  # TargetCategory | SwPointerTargetProps construct the category of the target shall be specified. Depending on the particular use case the value shall be set to TYPE_REFERENCE or DATA_REFERENCE
            foreign reference rba_ArxmlGen_FunctionPointerRef [0..1]: multiplicity set at pre-compile, origin=RB:4.0.0:2022-12-2, set at pre-compile, destination-type=BSW-MODULE-ENTRY  # FunctionPointerRef | The referenced BswModuleEntry serves as the signature of a function pointer definition.
            foreign reference rba_ArxmlGen_ImplDataTypeRef [0..1]: multiplicity set at pre-compile, origin=RB:4.0.0:2022-12-2, set at pre-compile, destination-type=IMPLEMENTATION-DATA-TYPE  # impl. data type | Short name path to the implementation data type which is used as a basis for this implementation data type. Only applicable to simple implementation data types.
            foreign reference rba_ArxmlGen_baseTypeRef [0..1]: multiplicity set at pre-compile, origin=RB:4.0.0:2022-12-2, set at pre-compile, destination-type=BASE-TYPE  # base data type | Short name path to the base data type which is used as a basis for this base data type. Only applicable to simple base data types.
        container rba_ArxmlGen_returnType [0..1]  # returnType | This container represents the return type belonging to this bswModuleEntry.
          enumeration rba_ArxmlGen_Category: {TYPE_REFERENCE, DATA_REFERENCE, FUNCTION_REFERENCE}, origin=RB:4.0.0:2022-12-2, set at pre-compile  # Category | Categorizes the kind of the return value (value, data pointer, functionpointer).
          string rba_ArxmlGen_NativeDeclarationString [0..1]: multiplicity set at pre-compile, origin=RB:4.0.0:2022-12-2, set at pre-compile  # AdditionalNativeTypeQualifier | This attribute describes the declaration of such a basetype and is optional and shall only be used if an additional native qualifier is necessary.
          enumeration rba_ArxmlGen_TargetCategory [0..1]: {TYPE_REFERENCE, DATA_REFERENCE}, origin=RB:4.0.0:2022-12-2, set at pre-compile  # TargetCategory | SwPointerTargetProps construct the category of the target shall be specified. Depending on the particular use case the value shall be set to TYPE_REFERENCE or DATA_REFERENCE
          foreign reference rba_ArxmlGen_FunctionPointerRef [0..1]: multiplicity set at pre-compile, origin=RB:4.0.0:2022-12-2, set at pre-compile, destination-type=BSW-MODULE-ENTRY  # FunctionPointerRef | The referenced BswModuleEntry serves as the signature of a function pointer definition.
          foreign reference rba_ArxmlGen_ImplDataTypeRef [0..1]: multiplicity set at pre-compile, origin=RB:4.0.0:2022-12-2, set at pre-compile, destination-type=IMPLEMENTATION-DATA-TYPE  # impl. data type | Short name path to the implementation data type which is used as a basis for this implementation data type. Only applicable to simple implementation data types.
          foreign reference rba_ArxmlGen_baseTypeRef [0..1]: multiplicity set at pre-compile, origin=RB:4.0.0:2022-12-2, set at pre-compile, destination-type=BASE-TYPE  # base data type | Short name path to the base data type which is used as a basis for this base data type. Only applicable to simple base data types.
      container rba_ArxmlGen_CalParam [0..*]: multiplicity set at pre-compile  # Calibration parameter | Defines a calibration parameter. The RTE generator automatically defines the corresponding C implementation of this parameter. The short name of this calibration parameter shall start with the component' s short name. The short name shall have one of the following suffixes " _C" (for simple values), " _CA" (for arrays), " _CST" (for structures) or " _CVB" (for value blocks), r.f. Rule BSWMD_MCSupport_005 of the BSW_CodingGuidelines.
        enumeration rba_ArxmlGen_CalParamCategory: origin=RB:0.1.0:2013-02-05, set at pre-compile  # Category | Categorizes this calibration parameter. Currently, simple values, arrays, structures and value blocks are supported.
          Simple  # Simple value
          Array
          Struct  # Structure
          ValBlock  # Value Block
        string rba_ArxmlGen_CalParamDispFormat [0..1]: multiplicity set at pre-compile, origin=RB:0.1.0:2013-02-05, set at pre-compile, min-length=1  # Display format | Display format of the (physical) value of the calibration parameter. A printf-like format string shall be given here, e.g. %5.0f. Note that the display format of the referenced application data type is overwritten if specified at the level of calibration parameters.
        float rba_ArxmlGen_CalParamInitValue [0..1]: multiplicity set at pre-compile, origin=RB:0.1.0:2013-02-05, set at pre-compile  # Initial value | Initial value of the calibration parameter (physical value). Only applicable to simple calibration parameters .
        string rba_ArxmlGen_CalParamLabel [0..1]: multiplicity set at pre-compile, origin=RB:7.0.0:2016-01-29, set at pre-compile, min-length=1  # Short Label | This can be used to identify particular value specifications for human readers.
        string rba_ArxmlGen_CalParamLongName: origin=RB:0.1.0:2013-02-05, set at pre-compile, min-length=1  # Long name | Long name of this calibration parameter. The long name shall be the human readable representation of the short name of this calibration parameter.
        integer rba_ArxmlGen_CalParamNumElements [0..1]: 1.., multiplicity set at pre-compile, origin=RB:2.0.0:2013-11-15, set at pre-compile  # Number of array elements | Array size in case of calibration parameter of category array or value block. Not applicable to any other calibration parameter type. Only has to be filled if the array application data type is externally defined (not via rba_ArxmlGen or defined in a different component).
        foreign reference rba_ArxmlGen_CalParamAddrMethodRef [0..1]: origin=RB:0.1.0:2013-02-05, set at pre-compile, destination-type=SW-ADDR-METHOD  # Addressing method | Short name path to the (typically centrally defined) addressing method used for this calibration parameter. The addressing method describes memory allocation aspects of this calibration parameter. The list of centrally available addressing methods is provided in the Central Elements Guideline (Rule CEL_114). If a particular addressing method is not centrally defined the local expert for central elements has to be consulted.
        reference rba_ArxmlGen_CalParamApplDataTypeOwnRef [0..1]: multiplicity set at pre-compile, origin=RB:0.1.0:2013-02-05, set at pre-compile, destination=rba_ArxmlGen_ApplDataType  # Appl. data type (own) | Reference to the application data type which is used for this calibration parameter. This parameter shall only be used if the referenced application data type is also defined using rba_ArxmlGen and if it is part of the same component as this calibration parameter.
        foreign reference rba_ArxmlGen_CalParamApplDataTypeXArrayRef [0..1]: multiplicity set at pre-compile, origin=RB:1.0.0:2013-05-22, set at pre-compile, destination-type=APPLICATION-ARRAY-DATA-TYPE  # Appl. data type (other, array) | Short name path to the array application data type which is used for this calibration parameter. Only applicable to array type calibration parameters. This parameter shall only be used if the referenced application data type is not defined using rba_ArxmlGen or if it is part of a different component than this calibration parameter.
        foreign reference rba_ArxmlGen_CalParamApplDataTypeXPrimitiveRef [0..1]: multiplicity set at pre-compile, origin=RB:1.0.0:2013-05-22, set at pre-compile, destination-type=APPLICATION-PRIMITIVE-DATA-TYPE  # Appl. data type (other, primitive) | Short name path to the primitive application data type which is used for this calibration parameter. Only applicable to simple type and value block calibration parameters. This parameter shall only be used if the referenced application data type is not defined using rba_ArxmlGen or if it is part of a different component than this calibration parameter.
        foreign reference rba_ArxmlGen_CalParamApplDataTypeXRecordRef [0..1]: multiplicity set at pre-compile, origin=RB:1.0.0:2013-05-22, set at pre-compile, destination-type=APPLICATION-RECORD-DATA-TYPE  # Appl. data type (other, structure) | Short name path to the structure application data type which is used for this calibration parameter. Only applicable to structure type calibration parameters. This parameter shall only be used if the referenced application data type is not defined using rba_ArxmlGen or if it is part of a different component than this calibration parameter.
        reference rba_ArxmlGen_CalParamDataConstrOwnRef [0..1]: multiplicity set at pre-compile, origin=RB:4.4.1:2018-10-31, set at pre-compile, destination=rba_ArxmlGen_DataConstraint  # Data constraint (own) | DataConstraints are used to implement limits on the values for data element.The meta-class DataConstr is referenced via the attribute SwDataDefProps of a Calibration Parameter.This parameter shall only be used if the referenced DataConstr type is also defined using rba_ArxmlGen and if it is part of the same component as this Calibration Parameter.
        foreign reference rba_ArxmlGen_CalParamDataConstrRef [0..1]: multiplicity set at pre-compile, origin=RB:4.4.1:2018-10-31, set at pre-compile, destination-type=DATA-CONSTR  # Data constraint (other) | DataConstraints are used to implement limits on the values for data element.The meta class DataConstr is referenced via the attribute SwDataDefProps of a Calibration Parameter.This parameter shall only be used if the referenced DataConstr type is not defined using rba_ArxmlGen or if it is part of a different component than this Calibration Parameter.
        reference rba_ArxmlGen_CalParamDataInitSubOwnRef [0..1]: multiplicity set at pre-compile, origin=RB:2.1.0:2014-04-08, set at pre-compile, destination=rba_ArxmlGen_DataInit  # Data initialisation reference | Reference to the initialisation of a data structure. Note that the referenced data structure must match the application data type of this calibration parameter.
        reference rba_ArxmlGen_CalParamSwcomp [0..1]: multiplicity set at pre-compile, origin=RB:7.0.0:2019-12-19, set at pre-compile, destination=rba_ArxmlGen_Swspecific  # SW-C | Short name path to the (typically centrally defined) addressing method used for this calibration parameter. The addressing method describes memory allocation aspects of this calibration parameter. The list of centrally available addressing methods is provided in the Central Elements Guideline (Rule CEL_114). If a particular addressing method is not centrally defined the local expert for central elements has to be consulted.
        foreign reference rba_ArxmlGen_CalParamUnitRef [0..1]: multiplicity set at pre-compile, origin=RB:7.0.0:2016-01-29, set at pre-compile, destination-type=UNIT  # Unit Reference | This is the physical unit of the Physical values for which the CompuMethod applies.
        container rba_ArxmlGen_CalParamInit [0..*]: multiplicity set at pre-compile  # Initial value | Defines an initial value for this calibration parameter (physical value). Only applicable to array, value block or structure calibration parameters. The short name of this container is not relevant for the generated output but the order of these initial value containers is expected to be the same as in the corresponding application data type.
          float rba_ArxmlGen_CalParamInitValue [0..1]: multiplicity set at pre-compile, origin=RB:1.0.0:2013-05-22, set at pre-compile  # Initial value | Initial value of the calibration parameter element (physical value). Only applicable to simple calibration parameters inside structure, array, value block calibration parameters.
          string rba_ArxmlGen_CalParamInitValueShortLabel [0..1]: multiplicity set at pre-compile, origin=RB:7.0.0:2016-01-29, set at pre-compile, min-length=1  # Short Label | This can be used to identify particular value specifications for human readers.
          foreign reference rba_ArxmlGen_CalParamInitValueUnitRef [0..1]: multiplicity set at pre-compile, origin=RB:7.0.0:2016-01-29, set at pre-compile, destination-type=UNIT  # Unit Ref | This is the physical unit of the Physical values for which the CompuMethod applies.
          container rba_ArxmlGen_CalParamInitArrayBlock [0..*]: multiplicity set at pre-compile  # Init array block | Defines an initial value block for this calibration parameter (physical value). Only applicable to nested array or structure calibration parameters. The short name of this container is not relevant for the generated output but the order of these initial value containers is expected to be the same as in the corresponding application data type.
            float rba_ArxmlGen_CalParamInitArrayBlockInitValue: origin=RB:2.0.0:2013-12-11, set at pre-compile  # Init array block value | Initial value of the nested calibration parameter element (physical value). Only applicable to nested array calibration parameters.
            string rba_ArxmlGen_CalParamInitArrayBlockInitValueShortLabel [0..1]: multiplicity set at pre-compile, origin=RB:7.0.0:2016-01-29, set at pre-compile, min-length=1  # Init array block Short Label | This can be used to identify particular value specifications for human readers. of the nested calibration parameter element (physical value). Only applicable to nested Array calibration parameters.
            foreign reference rba_ArxmlGen_CalParamInitArrayBlockInitValueUnitRef [0..1]: multiplicity set at pre-compile, origin=RB:7.0.0:2016-01-29, set at pre-compile, destination-type=UNIT  # Init array block Unit | This is the physical unit of the Physical values for which the CompuMethod applies of the nested calibration parameter element (physical value). Only applicable to nested array calibration parameters.
          container rba_ArxmlGen_CalParamInitRecordBlock [0..*]: multiplicity set at pre-compile  # Init record block | Defines an initial array value block for this nested calibration parameter (physical value). Only applicable to nested array calibration parameters. The short name of this container is not relevant for the generated output but the order of these initial value containers is expected to be the same as in the corresponding application data type.
            float rba_ArxmlGen_CalParamInitRecordBlockInitValue: origin=RB:2.0.0:2013-12-11, set at pre-compile  # Init record block value | Initial value of the nested calibration parameter element (physical value). Only applicable to nested structured calibration parameters.
            string rba_ArxmlGen_CalParamInitRecordBlockInitValueShortLabel [0..1]: multiplicity set at pre-compile, origin=RB:7.0.0:2016-01-29, set at pre-compile, min-length=1  # Init record block Short Label | This can be used to identify particular value specifications for human readers. of the nested calibration parameter element (physical value). Only applicable to nested structured calibration parameters.
            foreign reference rba_ArxmlGen_CalParamInitRecordBlockInitValueUnitRef [0..1]: multiplicity set at pre-compile, origin=RB:7.0.0:2016-01-29, set at pre-compile, destination-type=UNIT  # Init record block Unit | This is the physical unit of the Physical values for which the CompuMethod applies of the nested calibration parameter element (physical value). Only applicable to nested structured calibration parameters.
      container rba_ArxmlGen_CompuMethod [0..*]: multiplicity set at pre-compile  # Computation method | Specifies a conversion between the internal and physical representation of data. Only applicable to simple data types.
        enumeration rba_ArxmlGen_CompuMethodCategory: origin=RB:2.0.0:2013-11-06, set at pre-compile  # Category | Categorizes the computation method. Currently only linear conversions and text tables are supported.
          Linear  # Linear function
          TextTable  # Text table
        float rba_ArxmlGen_CompuMethodFactor [0..1]: multiplicity set at pre-compile, origin=RB:2.0.0:2013-11-06, set at pre-compile  # Factor | The internal value is multiplied with the factor defined here to get the physical value. Only applicable to linear conversions.
        string rba_ArxmlGen_CompuMethodLongName: origin=RB:2.0.0:2013-11-06, set at pre-compile, min-length=1  # Long name | Long name of this computation method. The long name shall be the human readable representation of the short name of this computation method.
        foreign reference rba_ArxmlGen_CompuMethodUnitRef [0..1]: multiplicity set at pre-compile, origin=RB:2.0.0:2013-11-06, set at pre-compile, destination-type=UNIT  # Unit | A reference to the physical unit of the physical values for which the computation method applies. Note that units are not specified inside rba_ArxmlGen. Only applicable to linear conversions.By default, texttable computation method refers to Nounit.
        container rba_ArxmlGen_CompuMethodTextEntry [0..*]: multiplicity set at pre-compile  # Text entry | Defines a mapping which is used for the transformation of one or more internal values into the corresponding display text. Only applicable to computation methods of category text table.
          integer rba_ArxmlGen_CompuMethodTEIntVal: origin=RB:2.0.0:2013-11-06, set at pre-compile  # Internal value | The internal value to be displayed as a text.
          integer rba_ArxmlGen_CompuMethodTENumVals [0..1]: 1.., multiplicity set at pre-compile, origin=RB:2.0.0:2013-11-06, set at pre-compile, default-value=1  # Number of values | The number of values which are to be displayed with the same text. If not specified, only a single internal value is displayed with this text. If e.g. the range 4..6 (i.e. 3 values starting from 4) shall be displayed with the same text, specify 4 for the internal value and 3 as the number of values.
          linker symbol rba_ArxmlGen_CompuMethodTESymbol [0..1]: multiplicity set at pre-compile, origin=RB:2.0.0:2013-11-06, set at pre-compile, regular-expression=[a-zA-Z_][a-zA-Z0-9_]*  # Symbol | The symbol, if provided, is used by code generators to get a C identifier for the CompuScale. The name will be used as is for the code generation, therefore it needs to be unique within the generation context.
          string rba_ArxmlGen_CompuMethodTEText: origin=RB:2.0.0:2013-11-06, set at pre-compile, min-length=1  # Text | The text(Vt) shall either be a valid C-Identifier or Symbol shall be defined.Content of Vt elements shall follow C-Identifier syntax. If Vt is explicitely designed to have no C-Identifier syntax developer shall define Symbol additionally. In this case Symbol shall have C-identifier syntax.
      container rba_ArxmlGen_DataConstraint [0..*]: multiplicity set at pre-compile  # Data constraint | Constraints for the possible values of a data type, i.e. limits for the physical and internal value range.
        enumeration rba_ArxmlGen_DataConstraintCategory: origin=RB:2.3.0:2014-07-21, set at pre-compile  # Category | Categorizes this data constraint, i.e. either limitations on the internal or physical domain.
          Physical  # Physical constraint
          Internal  # Internal constraint
        float rba_ArxmlGen_DataConstraintLower: origin=RB:3.0.0:2017-10-31, set at pre-compile  # Lower limit | Specifies the lower limit of this data constraint.
        float rba_ArxmlGen_DataConstraintUpper: origin=RB:3.0.0:2017-10-31, set at pre-compile  # Upper limit | Specifies the upper limit of this data constraint.
        foreign reference rba_ArxmlGen_DataConstraintUnitRef [0..1]: multiplicity set at pre-compile, origin=RB:2.3.0:2014-07-21, set at pre-compile, destination-type=UNIT  # Unit | A reference to the physical unit of the physical values for which the data constraint applies. Note that currently units are not specified inside rba_ArxmlGen.
      container rba_ArxmlGen_DataInit [0..*]: multiplicity set at pre-compile  # Data initialisation | Initialisation of complex data structures (arrays and structures and possible nesting).
        enumeration rba_ArxmlGen_DataInitCategory: origin=RB:2.1.0:2014-04-08, set at pre-compile  # Category | Categorizes this data initialisation. Currently, simple value, array and structure are supported.
          Simple  # Simple value
          Array
          Struct  # Structure
          ValBlock  # Value Block
        string rba_ArxmlGen_DataInitPhyShortLabel [0..1]: multiplicity set at pre-compile, origin=RB:7.0.0:2016-01-29, set at pre-compile, min-length=1  # Short Label | This can be used to identify particular value specifications for human readers.
        foreign reference rba_ArxmlGen_DataInitPhyUnitRef [0..1]: multiplicity set at pre-compile, origin=RB:7.0.0:2016-01-29, set at pre-compile, destination-type=UNIT  # Unit Ref | This is the physical unit of the Physical values for which the CompuMethod applies. This unit reference is used for value block type category.
        reference rba_ArxmlGen_DataInitSubOwnRef [0..*]: multiplicity set at pre-compile, origin=RB:2.1.0:2014-04-08, set at pre-compile, destination=rba_ArxmlGen_DataInit  # Sub data init | Reference to the subordinate application data type(s) in case of array or structure application data types. Not applicable to simple application data types.
        container rba_ArxmlGen_DataInitSubParamInit [0..*]: multiplicity set at pre-compile  # Initial value | Defines an initial value for this calibration parameter (physical value) when data prototype is typified by application data type. The multiple instances of this parameter is created for complex data structures and the values to initialise them.
          float rba_ArxmlGen_DataInitValue [0..1]: multiplicity set at pre-compile, origin=RB:7.0.0:2016-01-29, set at pre-compile  # Initial value | Initial value of the calibration parameter element (physical value).
          string rba_ArxmlGen_DataInitValueShortLabel [0..1]: multiplicity set at pre-compile, origin=RB:7.0.0:2016-01-29, set at pre-compile, min-length=1  # Short Label | This can be used to identify particular value specifications for human readers.
          foreign reference rba_ArxmlGen_DataInitValueUnitRef [0..1]: multiplicity set at pre-compile, origin=RB:7.0.0:2016-01-29, set at pre-compile, destination-type=UNIT  # Unit | This is the physical unit of the Physical values for which the CompuMethod applies.This unit reference shall be used for category array, struct value type.
      container rba_ArxmlGen_ExecEntity [0..*]: multiplicity set at pre-compile  # Executable entity | Defines an executable entity. Don' t prefix the short name of this entity with the component' s short name!
        enumeration rba_ArxmlGen_ExecEntityCategory: origin=RB:1.0.0:2013-05-22, set at pre-compile  # Category | Categorizes this executable entity. Schedulable entities are designed to be scheduled by the RTE. Called entities are designed to be called from another BSW module or cluster. Since the BswEntity and the BswEvent are generated in one go, the schedulable entities can have one of the following five types: schedulable entity either triggered by BswTimingEvent or BswBackgroundEvent, schedulable entity triggered by BswInternalTriggerOccurredEvent, schedulable entity triggered by BswExternalTriggerOccurredEvent, schedulable entity triggered by BswModeSwitchEvent or schedulable entity triggered by BswModeSwitchedAckEvent.
          Schedulable  # Schedulable entity
          Called  # Called entity
          Interrupt  # Interrupt entity
          SchedulableWithInternalTrigger  # Schedulable entity with internal triggering event
          SchedulableWithExternalTrigger  # Schedulable entity with external triggering event
          SchedulableWithModeSwitch  # Schedulable entity with mode switch event
          SchedulableWithModeSwitchedAck  # Schedulable entity with mode switched ack event
        enumeration rba_ArxmlGen_ExecEntityInterruptCategory [0..1]: origin=RB:1.1.0:2021-10-08, set at pre-compile  # InterruptCategory | Every BswInterruptEntity shall specify the category of the interrupt service.The applied category shall be the same as used in the referred BswModuleEntry. Cat1 interrupt routines are not controlled by the OS and are only allowed to make a very limited selection of OS calls to enable and disable all interrupts. The BswInterruptEntity is implemented by the interrupt service routine, which is directly called from the interrupt vector. Cat2 interrupt routines are controlled by the OS and they are allowed to make OS calls. The Bsw InterruptEntity is implemented by the interrupt handler, which is called from the OS.
          CAT_1  # Category1
          CAT_2  # Category2
        enumeration rba_ArxmlGen_ExecEntityModeActivation [0..1]: multiplicity set at pre-compile, origin=RB:2.1.0:2014-03-03, set at pre-compile  # Mode activation | Specifies the kind of mode switch condition that is used for the activation of a BSW ModeSwitchEvent for this schedulable entity, i.e. on entry, on exit or on transition.
          Entry  # on entry
          Exit  # on exit
          Transition  # on transition
        float rba_ArxmlGen_ExecEntityPeriod [0..1]: 0.., multiplicity set at pre-compile, origin=RB:1.0.0:2013-05-22, set at pre-compile  # Calling period [s] | Time period (in seconds) by which this entity is invoked. If set to zero, this entity is invoked in background.
        string rba_ArxmlGen_ExecEntityTrigger [0..1]: multiplicity set at pre-compile, origin=RB:2.1.0:2014-03-03, set at pre-compile, min-length=1  # External trigger | An external trigger which is provided (i.e. released) or required (i.e. used to activate something) in the given context.
        foreign reference rba_ArxmlGen_ExecAddrMethodRef [0..1]: origin=RB:4.3.0:2017-12-27, set at pre-compile, destination-type=SW-ADDR-METHOD  # Addressing method | Short name path to the (typically centrally defined) addressing method used for this executable variable. The addressing method describes memory allocation aspects of this executable variable. The list of centrally available addressing methods is provided in the Central Elements Guideline (Rule CEL_114). If a particular addressing method is not centrally defined the local expert for central elements has to be consulted.
        reference rba_ArxmlGen_ExecEntityITPRef [0..1]: multiplicity set at pre-compile, origin=RB:2.1.0:2014-03-31, set at pre-compile, destination=rba_ArxmlGen_ExecEntity  # Reference to schedulable entity activated by internal trigger | Reference to a schedulable entity that is activated by an internal trigger. This is required to reference the schedulable entity to be triggered by a BswInterrnalTriggerOccurredEvent.
        foreign reference rba_ArxmlGen_ExecEntityImplEntryRef: origin=RB:1.0.0:2013-05-22, set at pre-compile, destination-type=BSW-MODULE-ENTRY  # Implemented entry | Short name path to the BSW module entry implemented by this entity.
        reference rba_ArxmlGen_ExecEntityModeGroupOwnRef [0..1]: multiplicity set at pre-compile, origin=RB:2.1.0:2014-03-03, set at pre-compile, destination=rba_ArxmlGen_ModeDeclGroupPrototype  # Mode declaration group prototype | A reference to a mode declaration group prototype (either provided or required).
        container rba_ArxmlGen_ExecEntityModeIRefs [0..2]: multiplicity set at pre-compile  # Modes | Reference to one or two modes (dependent on the value of the mode activation) that initiate the BswModeSwitchEvent. One mode if the mode activation is set to " on entry" or " on exit" . Two modes if the mode activation is set to " on transition" .
          reference rba_ArxmlGen_ExecEntityModeIRefsTargetRef [0..1]: multiplicity set at pre-compile, origin=RB:2.1.0:2014-03-03, set at pre-compile, destination=rba_ArxmlGen_ModeDeclGroupModeDecls  # Mode (own) | The referenced mode. This parameter shall only be used if the referenced mode is also defined using rba_ArxmlGen and if it is part of the same component as this executable entity.
          foreign reference rba_ArxmlGen_ExecEntityModeIRefsXMGTargetRef [0..1]: multiplicity set at pre-compile, origin=RB:2.2.0:2014-05-22, set at pre-compile, destination-type=MODE-DECLARATION-GROUP  # Mode declaration group (other) | The referenced mode declaration group. In order to define the referenced mode both the mode declaration group and the respective mode declaration group prototype (rba_ArxmlGen_ExecEntityModeIRefsXMPTargetRef) shall be provided. This parameter shall only be used if the referenced mode is not defined using rba_ArxmlGen or if it is part of a different component than this executable entity.
          foreign reference rba_ArxmlGen_ExecEntityModeIRefsXMPTargetRef [0..1]: multiplicity set at pre-compile, origin=RB:2.2.0:2014-05-22, set at pre-compile, destination-type=MODE-DECLARATION-GROUP-PROTOTYPE  # Mode declaration group prototype (other) | The referenced mode declaration group prototype. In order to define the referenced mode both the mode declaration group (rba_ArxmlGen_ExecEntityModeIRefsXMGTargetRef) and the respective mode declaration group prototype shall be provided. This parameter shall only be used if the referenced mode is not defined using rba_ArxmlGen or if it is part of a different component than this executable entity.
      container rba_ArxmlGen_ImplDataType [0..*]: multiplicity set at pre-compile  # Impl. data type | Defines a data type used on implementation level. The RTE generator automatically defines the corresponding C typedef of this data type. The short name of this implementation data type shall start with the component' s short name.
        enumeration rba_ArxmlGen_ImplDataTypeCategory: origin=RB:0.1.0:2013-02-05, set at pre-compile  # Category | Categorizes this implementation data type. Currently, simple typedefs, arrays and structures are supported.
          Simple  # Simple typedef
          Array
          Struct  # Structure
          Enum  # Enumeration
        string rba_ArxmlGen_ImplDataTypeLongName: origin=RB:0.1.0:2013-02-05, set at pre-compile, min-length=1  # Long name | Long name of this implementation data type. The long name shall be the human readable representation of the short name of this implementation data type.
        integer rba_ArxmlGen_ImplDataTypeNumElements [0..1]: 1.., multiplicity set at pre-compile, origin=RB:2.0.0:2013-10-31, set at pre-compile  # Number of array elements | Array size in case of array implementation data types. Not applicable to simple or structure implementation data types.
        foreign reference rba_ArxmlGen_ImplDataTypeBaseRef [0..1]: multiplicity set at pre-compile, origin=RB:0.1.0:2013-02-05, set at pre-compile, destination-type=IMPLEMENTATION-DATA-TYPE  # Base impl. data type | Short name path to the implementation data type which is used as a basis for this implementation data type. Only applicable to simple implementation data types.
        reference rba_ArxmlGen_ImplDataTypeCompuMethodOwnRef [0..1]: multiplicity set at pre-compile, origin=RB:2.0.0:2013-11-06, set at pre-compile, destination=rba_ArxmlGen_CompuMethod  # Computation method (own) | Reference to the computation method which describes the translation between the internal (often integer) and physical (often floating point) representation of elements using this implementation data type.This parameter shall only be used if the referenced computation method is also defined using rba_ArxmlGen and if it is part of the same component as this implementation data type.
        foreign reference rba_ArxmlGen_ImplDataTypeCompuMethodRef [0..1]: multiplicity set at pre-compile, origin=RB:2.0.0:2013-11-06, set at pre-compile, destination-type=COMPU-METHOD  # Computation method (other) | Reference to the computation method which describes the translation between the internal (often integer) and physical (often floating point) representation of elements using this implementation data type.This parameter shall only be used if the referenced computation method is not defined using rba_ArxmlGen or if it is part of a different component than this implementation data type.
        container rba_ArxmlGen_ImplDataTypeSub [0..*]: multiplicity set at pre-compile  # Sub impl. data type | Specifies a subordinate implementation data type in case of array or structure implementation data types. Not applicable to simple implementation data types. In case of arrays, only one such subordinate implementation data type is allowed to be specified here.
          reference rba_ArxmlGen_ImplDataTypeSubOwnRef [0..1]: multiplicity set at pre-compile, origin=RB:2.0.0:2013-10-31, set at pre-compile, destination=rba_ArxmlGen_ImplDataType  # Sub impl. data type (own) | Reference to the subordinate implementation data type(s) in case of array or structure implementation data types. Not applicable to simple implementation data types. This parameter shall only be used if the referenced implementation data type is also defined using rba_ArxmlGen and if it is part of the same component as this implementation data type.
          foreign reference rba_ArxmlGen_ImplDataTypeSubRef [0..1]: multiplicity set at pre-compile, origin=RB:2.0.0:2013-10-31, set at pre-compile, destination-type=IMPLEMENTATION-DATA-TYPE  # Sub impl. data type (other) | Short name path to the subordinate implementation data type(s) in case of array or structure implementation data types. Not applicable to simple implementation data types. This parameter shall only be used if the referenced implementation data type is not defined using rba_ArxmlGen or if it is part of a different component than this implementation data type.
      container rba_ArxmlGen_Measurement [0..*]: multiplicity set at pre-compile  # Measurement | Defines a measurement variable which is visible to measurement and calibration equipment. Note that also a variable of the same name and type has to be created in the C code; the RTE generator does not do this. The short name of this measurement variable shall start with the component' s short name and its suffix shall be " _MP" , r.f. Rule BSWMD_MCSupport_004 of the BSW_CodingGuidelines.
        enumeration rba_ArxmlGen_MeasCategory: origin=RB:0.1.0:2013-02-05, set at pre-compile  # Category | Categorizes this measurement variable. Currently, simple values, arrays and structures are supported.
          Simple  # Simple value
          Array
          Struct  # Structure
        string rba_ArxmlGen_MeasDispFormat [0..1]: multiplicity set at pre-compile, origin=RB:0.1.0:2013-02-05, set at pre-compile, min-length=1  # Display format | Display format of the (physical) value of the measurement variable. A printf-like format string shall be given here, e.g. %5.0f.
        string rba_ArxmlGen_MeasLongName: origin=RB:0.1.0:2013-02-05, set at pre-compile, min-length=1  # Long name | Long name of this measurement variable. The long name shall be the human readable representation of the short name of this measurement variable.
        foreign reference rba_ArxmlGen_MeasAddrMethodRef: origin=RB:0.1.0:2013-02-05, set at pre-compile, destination-type=SW-ADDR-METHOD  # Addressing method | 1.Short name path to the (typically centrally defined) addressing method used for this measurement variable. The addressing method describes memory allocation aspects of this measurement variable. The list of centrally available addressing methods is provided in the Central Elements Guideline (Rule CEL_114). If a particular addressing method is not centrally defined the local expert for central elements has to be consulted. 2. Addressing method ref is not needed for aRTypedPerInstanceMemorys block,explicit SwAddrMethod ref only needed for static memorys
        reference rba_ArxmlGen_MeasApplDataTypeOwnRef [0..1]: multiplicity set at pre-compile, origin=RB:0.1.0:2013-02-05, set at pre-compile, destination=rba_ArxmlGen_ApplDataType  # Appl. data type (own) | Reference to the application data type used for this measurement variable. This parameter shall only be used if the referenced application data type is also defined using rba_ArxmlGen and if it is part of the same component as this measurement.
        foreign reference rba_ArxmlGen_MeasApplDataTypeXArrayRef [0..1]: multiplicity set at pre-compile, origin=RB:1.0.0:2013-05-22, set at pre-compile, destination-type=APPLICATION-ARRAY-DATA-TYPE  # Appl. data type (other, array) | Short name path to the array application data type which is used for this measurement variable. Only applicable to array type measurements. This parameter shall only be used if the referenced application data type is not defined using rba_ArxmlGen or if it is part of a different component than this measurement.
        foreign reference rba_ArxmlGen_MeasApplDataTypeXPrimitiveRef [0..1]: multiplicity set at pre-compile, origin=RB:1.0.0:2013-05-22, set at pre-compile, destination-type=APPLICATION-PRIMITIVE-DATA-TYPE  # Appl. data type (other, simple) | Short name path to the simple application data type which is used for this measurement variable. Only applicable to simple type measurements. This parameter shall only be used if the referenced application data type is not defined using rba_ArxmlGen or if it is part of a different component than this measurement.
        foreign reference rba_ArxmlGen_MeasApplDataTypeXRecordRef [0..1]: multiplicity set at pre-compile, origin=RB:1.0.0:2013-05-22, set at pre-compile, destination-type=APPLICATION-RECORD-DATA-TYPE  # Appl. data type (other, structure) | Short name path to the structure application data type which is used for this measurement variable. Only applicable to structure type measurements. This parameter shall only be used if the referenced application data type is not defined using rba_ArxmlGen or if it is part of a different component than this measurement.
      container rba_ArxmlGen_Memsection [0..*]: multiplicity set at pre-compile  # Memory Section | Specifies the details of memory for the referred SWAddrMethod
        boolean rba_ArxmlGen_MemsectionDatatype_08 [0..1]: origin=RB:6.0.0:2019-06-10, set at pre-compile  # Data Type_8 | Choose the data type
        boolean rba_ArxmlGen_MemsectionDatatype_16 [0..1]: origin=RB:6.0.0:2019-06-10, set at pre-compile  # Data Type_16 | Choose the data type
        boolean rba_ArxmlGen_MemsectionDatatype_32 [0..1]: origin=RB:6.0.0:2019-06-10, set at pre-compile  # Data Type_32 | Choose the data type
        boolean rba_ArxmlGen_MemsectionDatatype_64 [0..1]: origin=RB:6.0.0:2019-06-10, set at pre-compile  # Data Type_64 | Choose the data type
        boolean rba_ArxmlGen_MemsectionDatatype_UNSPECIFIED [0..1]: origin=RB:6.0.0:2019-06-10, set at pre-compile  # Data Type_UNSPECIFIED | Choose the data type
        string rba_ArxmlGen_Memsectioncalloutspecificname [0..1]: origin=RB:7.1.0:2020-01-28, set at pre-compile  # Callout function name | specify the function name
        boolean rba_ArxmlGen_Memsectioncorespecific [0..1]: origin=RB:2.1.0:2019-05-30, set at pre-compile, default-value=false  # Core Specific | defines number of core
        integer rba_ArxmlGen_Memsectionnumberofcores [0..1]: 1..6, origin=RB:2.1.0:2019-05-30, set at pre-compile  # Number of cores | defines number of core
        boolean rba_ArxmlGen_RteSpecificSectionNamePrefix [0..1]: origin=RB:5.0.0:2023-06-19, set at pre-compile, default-value=false  # RTE Specific Section Name | Defines the generation of RTE specific Memory section.By default RTE Memory section for CODE will generated, this has to be enabled only if required for other Memory sections like CODE_FAST, CODE_SLOW. It will the generate the memory sections with module-case e.g WdgM_{Patition}_CODE_FAST, WdgM_CODE_FAST Note: This is not supported for Core Specific memory sections generation, since there is no verified usecase to support
        foreign reference rba_ArxmlGen_MemsectionAddrMethodRef: multiplicity set at pre-compile, origin=RB:2.1.0:2019-05-30, set at pre-compile, destination-type=SW-ADDR-METHOD  # Addressing method | Short name path to the (typically centrally defined) addressing method used for this memory parameter. The addressing method describes memory allocation aspects of this memory parameter. The list of centrally available addressing methods is provided in the Central Elements Guideline (Rule CEL_114). If a particular addressing method is not centrally defined the local expert for central elements has to be consulted.
        reference rba_ArxmlGen_MemsectionEcuCPartitionRef [0..*]: multiplicity set at pre-compile, origin=RB:5.0.0:2023-06-19, set at pre-compile, destination=EcucPartition  # EcuC Partition Ref | EcuC partition reference - To generate the partition specific memory section generation for the configured SwAddrMethod
      container rba_ArxmlGen_ModeDeclGroup [0..*]: multiplicity set at pre-compile  # Mode declaration group | A collection of mode declarations.
        foreign reference rba_ArxmlGen_ModeDeclGroupImplDataType: origin=RB:2.1.0:2014-03-03, set at pre-compile, destination-type=IMPLEMENTATION-DATA-TYPE  # Data type | A reference to an implementation data type in order to explicitly specify by which data type a mode declaration group is implemented. It shall be modelled along the idea of an " unsigned integer-like" data type.
        reference rba_ArxmlGen_ModeDeclGroupInitialModeRef: origin=RB:2.1.0:2014-03-03, set at pre-compile, destination=rba_ArxmlGen_ModeDeclGroupModeDecls  # Initial mode | The initial mode of the mode declaration group. This mode is active before any mode switches occurred.
        container rba_ArxmlGen_ModeDeclGroupModeDecls [1..*]: multiplicity set at pre-compile  # Mode declaration | The single mode declarations collected in this mode declaration group.
          string rba_ArxmlGen_ModeDeclGroupModeDeclsLongName [0..1]: multiplicity set at pre-compile, origin=RB:2.1.0:2014-03-03, set at pre-compile, min-length=1  # Long name | Long name of this mode declaration group. The long name shall be the human readable representation of the short name of this mode declaration group.
      container rba_ArxmlGen_ModeDeclGroupPrototype [0..*]: multiplicity set at pre-compile  # Mode declaration group prototype | A reference to a mode declaration group which is either owned and provided by this module or the module depends on.
        enumeration rba_ArxmlGen_ModeDeclGroupPrototypeCategory: origin=RB:2.1.0:2014-03-12, set at pre-compile  # Category | Categorizes this mode declaration group prototype.
          Required  # Required mode declaration group prototype
          Provided  # Provided mode declaration group prototype
        reference rba_ArxmlGen_ModeDeclGroupPrototypeOwnRef: origin=RB:2.1.0:2014-03-03, set at pre-compile, destination=rba_ArxmlGen_ModeDeclGroup  # Mode group | Reference to a mode declaration group.
      container rba_ArxmlGen_ModeReceiverPolicy [0..*]: multiplicity set at pre-compile  # Mode receiver policy | Specifies the details for receiving of a mode switch for the referred required mode declaration group prototype.
        boolean rba_ArxmlGen_ModeReceiverPolicyAsyncModeSwitch: origin=RB:2.2.0:2014-05-21, set at pre-compile  # Asynchronous mode switch | Specifies whether the module can handle the reception of an asynchronous mode switch (true) or not (false).
        reference rba_ArxmlGen_ModeReceiverPolicyRMGOwnRef: origin=RB:2.2.0:2014-05-21, set at pre-compile, destination=rba_ArxmlGen_ModeDeclGroupPrototype  # Required mode group | A reference to a required mode group.
      container rba_ArxmlGen_ModeSenderPolicy [0..*]: multiplicity set at pre-compile  # Mode sender policy | Specifies the details for sending of a mode switch for the referred provided mode declaration group prototype.
        integer rba_ArxmlGen_ModeSenderPolicyQueue: 0.., origin=RB:2.1.0:2014-03-17, set at pre-compile  # Queue length | Length of the call queue (which is implemented by the RTE) on the sender side. The value must be greater or equal to 0. Value 0 represents non-queued communication.
        reference rba_ArxmlGen_ModeSenderPolicyPMGOwnRef: origin=RB:2.1.0:2014-03-31, set at pre-compile, destination=rba_ArxmlGen_ModeDeclGroupPrototype  # Provided mode group | A reference to a provided mode group.
      container rba_ArxmlGen_Swspecific [0..*]: multiplicity set at pre-compile  # SWC specific | Container that allows SW-C specific addressing methods
        foreign reference rba_ArxmlGen_SWspecificAddrMethodRef: multiplicity set at pre-compile, origin=RB:2.1.0:2019-05-30, set at pre-compile, destination-type=SW-ADDR-METHOD  # Addressing method | Short name path to the (typically centrally defined) addressing method used for this memory parameter. The addressing method describes memory allocation aspects of this memory parameter. The list of centrally available addressing methods is provided in the Central Elements Guideline (Rule CEL_114). If a particular addressing method is not centrally defined the local expert for central elements has to be consulted.
