AUTOSAR XML (schema 4-2-2)
package /AUTOSAR_Eep/EcucModuleDefs
  module definition Eep [0..255]: category=VENDOR_SPECIFIC_MODULE_DEFINITION, refined-module-def=Eep, variants pre-compile  # Memory: EEPROM driver | Configuration of the Eep (internal or external series EEPROM driver) module.
    container EepGeneral: multiplicity set at pre-compile  # General settings | Container for general configuration parameters of the EEPROM driver.
      boolean EepDevErrorDetect: multiplicity set at pre-compile, origin=RB:0.1.0:2011-04-19, set at pre-compile, default-value=true  # Development error detection | Pre-processor switch to enable and disable development error detection. true: Development error detection enabled. false: Development error detection disabled.
      integer EepDriverIndex: 0..254, multiplicity set at pre-compile, origin=RB:0.1.0:2011-04-19, set at pre-compile  # Index of the driver | Index of the driver, used by Ea.
      float EepMainFunctionPeriod: 0..1, multiplicity set at pre-compile, origin=RB:18.1.0:2021-08-30, set at pre-compile  # MainFunction period | Call cycle time of the EEPROM driver's main function. Unit: [s]
      boolean EepRbDevRuntimeErrorDetect [0..1]: multiplicity set at pre-compile, origin=RB:20.1.0:2022-09-28, set at pre-compile, default-value=true  # Development Runtime error detection | Pre-processor switch to enable and disable development error detection. true: Development error detection enabled. false: Development error detection disabled.
      enumeration EepRbMainFunctionScheduling [0..1]: multiplicity set at pre-compile, origin=RB:18.1.0:2021-08-30, set at pre-compile, default-value=EEP_RB_MAINFUNC_SCHEDULING_RTE_TIMED  # MainFuntion Scheduling Type | Selection on type of scheduling required for the driver
        EEP_RB_MAINFUNC_SCHEDULING_RTE_BACKGROUND  # RTE Background task
        EEP_RB_MAINFUNC_SCHEDULING_RTE_TIMED  # RTE Timed task
        EEP_RB_MAINFUNC_SCHEDULING_MANUAL  # Manual Scheduling
      boolean EepRbRedundantReadApi [0..1]: multiplicity set at pre-compile, origin=RB:20.1.0:2022-07-15, set at pre-compile, default-value=false  # Redundant Read API | Pre-processor switch to enable / disable the redundant read functionality. True: Eep user would get an API to enable/disable the feature during runtime. False: Redundant read feature is disabled.
      boolean EepVersionInfoApi: multiplicity set at pre-compile, origin=RB:0.1.0:2011-04-19, set at pre-compile, default-value=false  # Version information API | Pre-processor switch to enable / disable the API to read out the modules version information. true: Version info API enabled. false: Version info API disabled.
    container EepInitConfiguration: multiplicity set at pre-compile  # Configuration data set | Container for runtime configuration parameters of the EEPROM driver. Description Implementation Type: Eep_ConfigType.
      integer EepBaseAddress: 0..4294967295, multiplicity set at pre-compile, origin=RB:0.1.0:2011-04-19, set at pre-compile, default-value=0  # Base address of EEPROM Device | This parameter is the EEPROM device base address. This address is to be extended for supportung more EEPROM devices, if only one serial EEPROM (till now supported), please set it to 0. Implementation Type: Eep_AddressType.
      enumeration EepDefaultMode: {MEMIF_MODE_FAST, MEMIF_MODE_SLOW}, multiplicity set at pre-compile, origin=RB:0.1.0:2011-04-19, set at pre-compile, default-value=MEMIF_MODE_SLOW  # Default mode | This parameter is the default EEPROM device mode after initialization. Implementation Type: MemIf_ModeType.
      enumeration EepRbDeviceID: multiplicity set at pre-compile, origin=RB:0.1.0:2011-04-19, set at pre-compile, default-value=STM95Family_16BitAddresses_ECCper4BytesMax  # EEPROM device ID | This parameter is the used to recegnise the device ID of current EEPROM.
        STM95Family_16BitAddresses_ECCper4BytesMax  # ST Spi EEPROM with 16Bits Addresses and per 4 Bytes ECC check
        STM95Family_24BitAddresses_ECCper4Bytes  # ST Spi EEPROM with 24Bits Addresses and per 4 Bytes ECC check
      function name EepRbErrorHandlingCallback [0..1]: multiplicity set at pre-compile, origin=RB:5.1.0:2015-04-25, set at pre-compile, default-value=NULL_PTR  # EEPROM error handling callback function | Name of the module-specific callback routine which shall be invoked if critical error in Eep occurs, for example automatic size detection not successful or write in progress set, in these cases module Eep doesn't work correctly.
      integer EepRbPageSize [0..1]: 0..4294967295, multiplicity set at pre-compile, origin=RB:0.1.0:2011-04-19, set at pre-compile, default-value=32  # Page size of EEPROM Device | This parameter is the EEPROM device page size. The setting can be found in data sheet of used EEPROM chip. It should be a multiple of 32Bytes. Default value: 32 Byte. Note: Please check it on data sheet of EEPROM chip or contact Eep resposible because a wrong/bigger page size can force an unsuccessful write access on Eeprom.
      boolean EepRbSizeDetection [0..1]: multiplicity set at pre-compile, origin=RB:0.1.0:2011-04-19, set at pre-compile, default-value=false  # EEPROM size detection | This parameter actives the automatical EEPROM size detection. If the real size of used EEPROM is different from the configurated size, it will be detected.
      integer EepRbSpiBufferSize [0..1]: 32..256, multiplicity set at pre-compile, origin=RB:0.1.0:2011-04-19, set at pre-compile, default-value=32  # EEPROM Spi transmit buffer size | This parameter defines the maximal buffer size for Spi transmit.Only 32, 64, 128 and 256 are allowed(default 32), For more effiiciency(ie Eeprom writing speed) the Eeprom page size should be equal to maximal SPI buffer size, pay attention Eep add internal 3 or 4 Bytes for the buffer length for instruction and address
      boolean EepRbTimeOutMonitoring [0..1]: multiplicity set at pre-compile, origin=RB:0.1.0:2011-04-19, set at pre-compile, default-value=false  # EEPROM time out monitoring | This parameter is to activate the time out monitoring functionality. If it takes longer than this setting, the time out error flag will be set.
      integer EepRbTimeOutSpiReqDuration [0..1]: multiplicity set at pre-compile, origin=RB:0.1.0:2019-10-20, set at pre-compile, default-value=1000  # EEPROM SPI request time out duration | This parameter is the maximal time duration (in ms) that SPI takes to process a request given by Eep after Accepting the request. If it takes longer than this setting, the time out error flag will be set. Condition: EepRbTimeOutMonitoring should be set to TRUE.
      integer EepRbTimeOutWriteDuration [0..1]: multiplicity set at pre-compile, origin=RB:0.1.0:2011-04-19, set at pre-compile, default-value=25  # EEPROM Write operation time out duration | This parameter is the maximal time duration (in ms) of write in progress check. If it takes longer than this setting, the time out error flag will be set. Condition: EepRbTimeOutMonitoring should be set to TRUE.
      boolean EepRbToForwardSpi [0..1]: multiplicity set at pre-compile, origin=RB:7.1.0:2016-04-25, set at pre-compile, default-value=false  # Eep forward parameters to SPI | This parameter is used to forward the SPI specific parameters from Eep to Spi module. Currently No productline have requested for this feature this should be configured as 'false'. This parameter is Obsolete. Do not configure this parameter.
      reference EepRbSPIChannelName [0..1]: multiplicity set at pre-compile, origin=RB:7.1.0:2016-04-25, set at pre-compile, destination=SpiChannel  # EepRbSPI Channel | This parameter is used to select the SPI Channel assigned for the EEPROM. The channel should be configured in SPI module before selecting the channel here. Note:This parameter is not supported for the Spi_Csih module. Additionally the EepRbToForwardSpi parameter should be 'false' for this configuration.
      reference EepRbSPISequenceName [0..1]: multiplicity set at pre-compile, origin=RB:7.1.0:2016-04-25, set at pre-compile, destination=SpiSequence  # EepRbSPI Sequence | This parameter is used to select the SPI Sequence assigned for the EEPROM. The sequence should be configured in SPI module before selecting the sequence here. Note: This parameter is not supported for the Spi_Csih module. Additionally the EepRbToForwardSpi parameter should be 'false' for this configuration.
    container EepPublishedInformation: multiplicity set at pre-compile  # Published information settings | Additional published parameters not covered by CommonPublishedInformation container. Note that these parameters do not have any configuration class setting, since they are published information.
      integer EepAllowedWriteCycles: 0..4294967295, multiplicity set at pre-compile, origin=RB:0.1.0:2011-04-19, set at pre-compile  # Allowed write cycle | Specified maximum number of write cycles under worst case conditions of specific EEPROM hardware (e.g. +90 deg C)
      float EepEraseTime: multiplicity set at pre-compile, origin=RB:0.1.0:2011-04-19, set at pre-compile  # Erase time | Maximum time for erasing one EEPROM data unit.
      integer EepEraseUnitSize: 0..4294967295, multiplicity set at pre-compile, origin=RB:0.1.0:2011-04-19, set at pre-compile  # Erase unit size | Size of smallest erasable EEPROM data unit in bytes.
      integer EepEraseValue: 0..255, multiplicity set at pre-compile, origin=RB:0.1.0:2011-04-19, set at pre-compile  # Erase value | Value of an erased EEPROM cell.
      integer EepMinimumAddressType: 0..4294967295, multiplicity set at pre-compile, origin=RB:0.1.0:2011-04-19, set at pre-compile  # Minimum address type | Minimum expected size of Eep_AddressType.
      integer EepMinimumLengthType: 0..4294967295, multiplicity set at pre-compile, origin=RB:0.1.0:2011-04-19, set at pre-compile  # Minimum length type | Minimum expected size of Eep_LengthType.
      integer EepReadUnitSize: 0..4294967295, multiplicity set at pre-compile, origin=RB:0.1.0:2011-04-19, set at pre-compile  # Read unit size | Size of smallest readable EEPROM data unit in bytes.
      integer EepSpecifiedEraseCycles: 0..4294967295, multiplicity set at pre-compile, origin=RB:0.1.0:2011-04-19, set at pre-compile  # Specified erase cycles | Number of erase cycles specified for the EEP device (usually given in the device data sheet).
      integer EepTotalSize: 0..4294967295, multiplicity set at pre-compile, origin=RB:0.1.0:2011-04-19, set at pre-compile  # Total size | Total size of EEPROM in bytes. It should be a multiple of 1024 (1k). The information see datasheet of used EEPROM. Implementation Type: Eep_LengthType.
      float EepWriteTime: multiplicity set at pre-compile, origin=RB:0.1.0:2011-04-19, set at pre-compile  # Write time | Maximum time for writing one EEPROM data unit.
      integer EepWriteUnitSize: 0..4294967295, multiplicity set at pre-compile, origin=RB:0.1.0:2011-04-19, set at pre-compile  # Write unit size | Size of smallest writeable EEPROM data unit in bytes.
