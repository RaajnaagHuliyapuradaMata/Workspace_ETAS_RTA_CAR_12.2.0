AUTOSAR XML (schema 00051)
package /AUTOSAR_Spi/EcucModuleDefs
  module definition Spi [0..1]: category=VENDOR_SPECIFIC_MODULE_DEFINITION, post-build-variant-support=true, refined-module-def=Spi, variants link-time/post-build/pre-compile  # Configuration of the Spi (Serial Peripheral Interface) module.
    container SpiDemEventParameterRefs [0..1]  # Container for the references to DemEventParameter elements which shall be invoked using the API Dem_SetEventStatus in case the corresponding error occurs. The EventId is taken from the referenced DemEventParameter's DemEventId symbolic value. The standardized errors are provided in this container and can be extended by vendor-specific error references.
      reference SPI_E_HARDWARE_ERROR [0..1]: multiplicity set at pre-compile, set at pre-compile, requires-symbolic-name-value=true, destination=DemEventParameter  # Reference to configured DEM event to report "Hardware failure". If the reference is not configured the error shall not be reported.
    container SpiDriver  # This container contains the configuration parameters and sub containers of the AUTOSAR Spi module.
      integer SpiMaxChannel [0..1]: 0..65535, multiplicity set at link in variant link-time / post-build in variant post-build / pre-compile in variant pre-compile, post-build-variant-multiplicity=true, post-build-variant-value=true, set at link in variant link-time / post-build in variant post-build / pre-compile in variant pre-compile, default-value=0  # This parameter contains the number of Channels configured. It will be gathered by tools during the configuration stage.
      integer SpiMaxJob [0..1]: 0..65535, multiplicity set at link in variant link-time / post-build in variant post-build / pre-compile in variant pre-compile, post-build-variant-multiplicity=true, post-build-variant-value=true, set at link in variant link-time / post-build in variant post-build / pre-compile in variant pre-compile, default-value=0  # Total number of Jobs configured.
      integer SpiMaxSequence [0..1]: 0..65535, multiplicity set at link in variant link-time / post-build in variant post-build / pre-compile in variant pre-compile, post-build-variant-multiplicity=true, post-build-variant-value=true, set at link in variant link-time / post-build in variant post-build / pre-compile in variant pre-compile, default-value=0  # Total number of Sequences configured.
      container SpiChannel [1..*]  # All data needed to configure one SPI-channel
        integer SpiChannelId: 0..255, set at pre-compile, symbolic-name-value=true  # SPI Channel ID, used as parameter in SPI API functions.
        enumeration SpiChannelType: {EB, IB}, post-build-variant-value=true, set at link in variant link-time / post-build in variant post-build / pre-compile in variant pre-compile  # Buffer usage with EB/IB channel.
        integer SpiDataWidth: 1..64, post-build-variant-value=true, set at link in variant link-time / post-build in variant post-build / pre-compile in variant pre-compile, default-value=32  # This parameter is the width of a transmitted data unit.
        integer SpiDefaultData [0..1]: 0..4294967295, multiplicity set at link in variant link-time / post-build in variant post-build / pre-compile in variant pre-compile, post-build-variant-multiplicity=true, post-build-variant-value=true, set at link in variant link-time / post-build in variant post-build / pre-compile in variant pre-compile  # The default data to be transmitted when (for internal buffer or external buffer) the pointer passed to Spi_WriteIB (for internal buffer) or to Spi_SetupEB (for external buffer) is NULL.
        integer SpiEbMaxLength [0..1]: 1..1048576, post-build-variant-multiplicity=true, post-build-variant-value=true, set at link in variant link-time / post-build in variant post-build / pre-compile in variant pre-compile, default-value=1024  # This parameter contains the maximum size (number of data elements) of data buffers in case of EB Channels and only.
        integer SpiIbNBuffers [0..1]: 1..65535, post-build-variant-multiplicity=true, post-build-variant-value=true, set at link in variant link-time / post-build in variant post-build / pre-compile in variant pre-compile, default-value=1  # This parameter contains the maximum number of data buffers in case of IB Channels and only.
        enumeration SpiTransferStart: {LSB, MSB}, post-build-variant-value=true, set at link in variant link-time / post-build in variant post-build / pre-compile in variant pre-compile  # This parameter defines the first starting bit for transmission.
      container SpiExternalDevice [1..*]  # The communication settings of an external device. Closely linked to SpiJob.
        float SpiBaudrate: 0..INF, post-build-variant-value=true, set at link in variant link-time / post-build in variant post-build / pre-compile in variant pre-compile, default-value=1000000  # This parameter is the communication baudrate - This parameter allows | using a range of values, from the point of view of configuration tools, from Hz up to MHz.
        enumeration SpiCsBehavior: {CS_KEEP_ASSERTED, CS_TOGGLE}, post-build-variant-value=true, set at link in variant link-time / post-build in variant post-build / pre-compile in variant pre-compile, default-value=CS_KEEP_ASSERTED  # This parameter is used to define the chip select behavior. | Either the CS is toggled for each data frame (bit frame on the SPI bus in relation with SpiDataWidth) inside the channel(s) composing the job or the CS is kept asserted for the whole job.
        string SpiCsIdentifier: set at pre-compile, symbolic-name-value=true  # This parameter is the symbolic name to identify the Chip Select (CS) allocated to this Job.
        enumeration SpiCsPolarity: {HIGH, LOW}, post-build-variant-value=true, set at link in variant link-time / post-build in variant post-build / pre-compile in variant pre-compile  # This parameter defines the active polarity of Chip Select.
        enumeration SpiCsSelection [0..1]: {CS_VIA_GPIO, CS_VIA_PERIPHERAL_ENGINE}, multiplicity set at link in variant link-time / post-build in variant post-build / pre-compile in variant pre-compile, post-build-variant-multiplicity=true, post-build-variant-value=true, set at link in variant link-time / post-build in variant post-build / pre-compile in variant pre-compile, default-value=CS_VIA_PERIPHERAL_ENGINE  # When the Chip select handling is enabled (see SpiEnableCs), then this parameter specifies if the chip select is handled automatically by Peripheral HW engine or via general purpose IO by Spi driver.
        enumeration SpiDataShiftEdge: {LEADING, TRAILING}, post-build-variant-value=true, set at link in variant link-time / post-build in variant post-build / pre-compile in variant pre-compile  # This parameter defines the SPI data shift edge.
        boolean SpiEnableCs: post-build-variant-value=true, set at link in variant link-time / post-build in variant post-build / pre-compile in variant pre-compile  # This parameter enables or not the Chip Select handling functions. If this parameter is enabled then parameter SpiCsSelection further details the type of chip selection.
        enumeration SpiHwUnit: {CSIB0, CSIB1, CSIB2, CSIB3}, post-build-variant-value=true, set at link in variant link-time / post-build in variant post-build / pre-compile in variant pre-compile  # This parameter is the symbolic name to identify the HW SPI Hardware | microcontroller peripheral allocated to this Job.
        enumeration SpiShiftClockIdleLevel: {HIGH, LOW}, post-build-variant-value=true, set at link in variant link-time / post-build in variant post-build / pre-compile in variant pre-compile  # This parameter defines the SPI shift clock idle level.
        float SpiTimeClk2Cs: 1E-8..0.01, post-build-variant-value=true, set at link in variant link-time / post-build in variant post-build / pre-compile in variant pre-compile, default-value=1E-6  # Timing between clock and chip select assertion (in seconds) - This parameter allows to use a range of values from 10 ns up to 0.01 seconds. | The real configuration-value used in software BSW-SPI is calculated out of this by the generator-tools.
        float SpiTimeCs2Clk: 1E-8..0.01, post-build-variant-value=true, set at link in variant link-time / post-build in variant post-build / pre-compile in variant pre-compile, default-value=1E-6  # Timing between chip select assertion and clock (in seconds) - This parameter allows | to use a range of values from 10ns up to 0.01 seconds. The real configuration-value used in software BSW-SPI is calculated out of this by the generator-tools.
        float SpiTimeCs2Cs: 1E-8..0.01, post-build-variant-value=true, set at link in variant link-time / post-build in variant post-build / pre-compile in variant pre-compile, default-value=1E-6  # Timing between the negation of the chip select at the end of frame and the assertion of the chip select at the beginning of the next frame (in seconds) - This parameter allows to use a range of values from 10ns up to 0.01 seconds. | The real configuration-value used in software BSW-SPI is calculated out of this by the generator-tools.
        reference SpiDeviceEcucPartitionRef [0..*]: scope=ECU, multiplicity set at pre-compile, post-build-variant-multiplicity=true, post-build-variant-value=true, set at pre-compile, destination=EcucPartition  # Maps an SPI external device to zero or multiple ECUC partitions to limit the access to this external device. The ECUC partitions referenced are a subset of the ECUC partitions where the SPI driver is mapped to.
      container SpiJob [1..*]  # All data needed to configure one SPI-Job, amongst others the connection between the internal SPI unit and the special settings for an external device is done.
        function name SpiJobEndNotification [0..1]: multiplicity set at link in variant link-time / post-build in variant post-build / pre-compile in variant pre-compile, post-build-variant-multiplicity=true, post-build-variant-value=true, set at link in variant link-time / post-build in variant post-build / pre-compile in variant pre-compile  # This parameter is a reference to a notification function.
        integer SpiJobId: 0..65535, set at pre-compile, symbolic-name-value=true  # SPI Job ID, used as parameter in SPI API functions.
        integer SpiJobPriority: 0..3, post-build-variant-value=true, set at link in variant link-time / post-build in variant post-build / pre-compile in variant pre-compile  # Priority: 0, lowest, 3, highest (see SWS_Spi_00093)
        reference SpiDeviceAssignment: set at pre-compile, destination=SpiExternalDevice  # Reference to the external device used by this job
        container SpiChannelList [1..*]  # References to SPI channels and their order within the Job.
          integer SpiChannelIndex: 0..65535, post-build-variant-value=true, set at link in variant link-time / post-build in variant post-build / pre-compile in variant pre-compile, default-value=0  # This parameter specifies the order of Channels within the Job.
          reference SpiChannelAssignment: post-build-variant-value=true, set at link in variant link-time / post-build in variant post-build / pre-compile in variant pre-compile, destination=SpiChannel  # A job reference to a SPI channel.
      container SpiSequence [1..*]  # All data needed to configure one SPI-sequence
        boolean SpiInterruptibleSequence: post-build-variant-value=true, set at link in variant link-time / post-build in variant post-build / pre-compile in variant pre-compile  # This parameter allows or not this Sequence to be suspended by another one.
        function name SpiSeqEndNotification [0..1]: multiplicity set at link in variant link-time / post-build in variant post-build / pre-compile in variant pre-compile, post-build-variant-multiplicity=true, post-build-variant-value=true, set at link in variant link-time / post-build in variant post-build / pre-compile in variant pre-compile  # This parameter is a reference to a notification function.
        integer SpiSequenceId: 0..255, scope=ECU, set at pre-compile, symbolic-name-value=true  # SPI Sequence ID, used as parameter in SPI API functions.
        reference SpiJobAssignment [1..*]: multiplicity set at link in variant link-time / post-build in variant post-build / pre-compile in variant pre-compile, post-build-variant-multiplicity=true, post-build-variant-value=true, set at link in variant link-time / post-build in variant post-build / pre-compile in variant pre-compile, destination=SpiJob  # A sequence references several jobs, which are executed during a communication sequence
    container SpiGeneral  # General configuration settings for SPI-Handler
      boolean SpiCancelApi: set at pre-compile  # Switches the Spi_Cancel function ON or OFF.
      integer SpiChannelBuffersAllowed: 0..2, set at pre-compile  # Selects the SPI Handler/Driver Channel Buffers usage allowed and | delivered. IB = 0; EB = 1; IB/EB = 2;
      boolean SpiDevErrorDetect: set at pre-compile, default-value=false  # Switches the development error detection and notification on or off. | * true: detection and notification is enabled. * false: detection and notification is disabled.
      boolean SpiHwStatusApi: set at pre-compile  # Switches the Spi_GetHWUnitStatus function ON or OFF.
      boolean SpiInterruptibleSeqAllowed: set at pre-compile  # Switches the Interruptible Sequences handling functionality ON or OFF.
      integer SpiLevelDelivered: 0..2, set at pre-compile  # Selects the SPI Handler/Driver level of scalable functionality that is | available and delivered.
      float SpiMainFunctionPeriod [0..1]: 0..INF, multiplicity set at pre-compile, set at pre-compile, default-value=0.01  # This parameter defines the cycle time of the function Spi_MainFunction_Handling in seconds. The parameter is not used by the driver it self, but it is used by upper layer.
      boolean SpiSupportConcurrentSyncTransmit: set at pre-compile  # Specifies whether concurrent Spi_SyncTransmit() calls for different sequences shall be configurable.
      boolean SpiVersionInfoApi: set at pre-compile, default-value=false  # Switches the Spi_GetVersionInfo function ON or OFF.
      reference SpiEcucPartitionRef [0..*]: scope=ECU, multiplicity set at pre-compile, post-build-variant-multiplicity=true, post-build-variant-value=true, set at pre-compile, destination=EcucPartition  # Maps the SPI driver to zero or multiple ECUC partitions to make the driver API available in the according partition.
      reference SpiKernelEcucPartitionRef [0..1]: scope=ECU, multiplicity set at pre-compile, post-build-variant-multiplicity=true, post-build-variant-value=true, set at pre-compile, destination=EcucPartition  # Maps the SPI kernel to zero or one ECUC partitions to assign the driver kernel to a certain core. The ECUC partition referenced is a subset of the ECUC partitions where the SPI driver is mapped to.
    container SpiPublishedInformation  # Container holding all SPI specific published information parameters
      integer SpiMaxHwUnit: 0..65535, set at published-information, default-value=0  # Number of different SPI hardware microcontroller peripherals (units/busses) available and handled by this SPI Handler/Driver module.
