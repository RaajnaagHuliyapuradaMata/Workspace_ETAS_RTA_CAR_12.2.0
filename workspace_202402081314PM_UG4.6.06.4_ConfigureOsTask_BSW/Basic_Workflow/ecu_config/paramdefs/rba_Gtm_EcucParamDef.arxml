AUTOSAR XML (schema 00048)
package /RB/RBA/rba_Gtm/EcucModuleDefs
  module definition rba_Gtm [0..1]: category=VENDOR_SPECIFIC_MODULE_DEFINITION, post-build-variant-support=true, variants pre-compile  # MCAL Gtm | Container for GTM configuration
    container rba_Gtm_Config: multiplicity set at pre-compile  # GTM configuration | Defines one data set of post-build configuration. Which of these data sets is actually active is controlled by EcuM. Data sets can only be switched at initialization time. Multiple instances of such containers with same identifier are automatically merged. Data set ID is the short name of this container.
      container rba_Gtm_Brc [0..*]: multiplicity set at pre-compile, post-build-variant-multiplicity=true  # Broadcast Module (BRC) | Container for a BRC channel configuration
        string rba_Gtm_Brc_1_Src: origin=RB:1.1.0:2013-08-07, post-build-variant-value=true, set at pre-compile, regular-expression=[A-Za-z_][A-Za-z0-9_]*  # Source | Specifies the source of the data stream, e.g. if the source is a TIM with short name <myTim_22> configure: TIM_myTim_22. Special sources: ARU_ACCESS, ARU_EMPTY_ADDR and ARU_FULL_ADDR are also valid values.
        enumeration rba_Gtm_Brc_2_Mode [0..1]: multiplicity set at pre-compile, origin=RB:1.1.0:2013-08-07, post-build-variant-multiplicity=true, post-build-variant-value=true, set at pre-compile, default-value=DCM  # Operation Mode | BRC channel operation mode (see manual for more details), default mode is DCM.
          DCM  # Data Consistency Mode
          MTM  # Maximum Throughput Mode
        string rba_Gtm_Brc_3_OutId [1..22]: multiplicity set at pre-compile, origin=RB:1.1.0:2013-08-07, post-build-variant-multiplicity=true, post-build-variant-value=true, set at pre-compile, regular-expression=[A-Za-z_][A-Za-z0-9_]*  # Output ID | Configure an Output ID for each required BRC-to-destiantion connection. This ID will be used to get the BRC destination channel ARU address during runtime.
      container rba_Gtm_Ccm [0..*]: multiplicity set at pre-compile, post-build-variant-multiplicity=true  # Cluster Configuration Module (CCM) | Container for a GTM cluster configuration. Do not change the default container short names, they are used to determine the cluster index: 'rba_Gtm_Ccm_0' is the CCM0 configuration, 'rba_Gtm_Ccm_1' is CCM1 etc. Default value of all clock sources is the appropriate CMU clock bus line, so in most cases the only relevant configuration here is the cluster clock divider setting. Following default values are automatically selected: - Cluster 0: DIV_2 (100MHz) - Cluster 1 .. n: DIV_2 (100MHz) Constraints: - In all post build variants Cluster 0 must have the same clocking. This is done to simplify GCLK configuration across different Pb variants. Cluster 0 cannot be disabled because this would disable the whole GTM. - Not all clusters are capable of DIV_1 (i.e. 200 MHz capable), if such a cluster is configured to DIV_1, the configuration is automatically changed to DIV_2. This is a GTM internal HW limitation.
        enumeration rba_Gtm_Ccm_01_Divider [0..1]: multiplicity set at pre-compile, origin=RB:4.23.0:2015-09-30, post-build-variant-multiplicity=true, post-build-variant-value=true, set at pre-compile  # Cluster clock divider | Select a clock divider for this cluster for this cluster or leave the cluster disabled. Clock source is SYS_CLK. NOTE: Not all clusters are 200MHz capable. If a cluster is not 200MHz capable the only allowed settings for the CLS_CLK_DIV are DSBL and DIV_2. Clusters are automatically set to DIV_2 if they are not 200MHz capable. Cross-check with report file rba_Gtm_CmuReport.html for actual configuration.
          BIT0  # disable cluster
          BIT1  # DIV_1
          BIT2  # DIV_2
        enumeration rba_Gtm_Ccm_09_FxClkSrc [0..1]: multiplicity set at pre-compile, origin=RB:4.23.0:2015-09-30, post-build-variant-multiplicity=true, post-build-variant-value=true, set at pre-compile, default-value=BIT0  # Cluster FxClk source | Cluster local clock signal FxClk source selection
          BIT0  # CMU_FXCLK0
          BIT1  # CMU_CLK8
        enumeration rba_Gtm_Ccm_10_Clk0Src [0..1]: multiplicity set at pre-compile, origin=RB:4.23.0:2015-09-30, post-build-variant-multiplicity=true, post-build-variant-value=true, set at pre-compile, default-value=BIT0  # Cluster CLK0 source | Cluster local clock signal CLK0 source selection
          BIT0  # CMU_CLK0
          BIT1  # CMU_CLK8
          BIT2  # TIM_EXT_CAP0
        enumeration rba_Gtm_Ccm_11_Clk1Src [0..1]: multiplicity set at pre-compile, origin=RB:4.23.0:2015-09-30, post-build-variant-multiplicity=true, post-build-variant-value=true, set at pre-compile, default-value=BIT0  # Cluster CLK1 source | Cluster local clock signal CLK1 source selection
          BIT0  # CMU_CLK1
          BIT1  # CMU_CLK8
          BIT2  # TIM_EXT_CAP1
        enumeration rba_Gtm_Ccm_12_Clk2Src [0..1]: multiplicity set at pre-compile, origin=RB:4.23.0:2015-09-30, post-build-variant-multiplicity=true, post-build-variant-value=true, set at pre-compile, default-value=BIT0  # Cluster CLK2 source | Cluster local clock signal CLK2 source selection
          BIT0  # CMU_CLK2
          BIT1  # CMU_CLK8
          BIT2  # TIM_EXT_CAP2
        enumeration rba_Gtm_Ccm_13_Clk3Src [0..1]: multiplicity set at pre-compile, origin=RB:4.23.0:2015-09-30, post-build-variant-multiplicity=true, post-build-variant-value=true, set at pre-compile, default-value=BIT0  # Cluster CLK3 source | Cluster local clock signal CLK3 source selection
          BIT0  # CMU_CLK3
          BIT1  # CMU_CLK8
          BIT2  # TIM_EXT_CAP3
        enumeration rba_Gtm_Ccm_14_Clk4Src [0..1]: multiplicity set at pre-compile, origin=RB:4.23.0:2015-09-30, post-build-variant-multiplicity=true, post-build-variant-value=true, set at pre-compile, default-value=BIT0  # Cluster CLK4 source | Cluster local clock signal CLK4 source selection
          BIT0  # CMU_CLK4
          BIT1  # CMU_CLK8
          BIT2  # TIM_EXT_CAP4
        enumeration rba_Gtm_Ccm_15_Clk5Src [0..1]: multiplicity set at pre-compile, origin=RB:4.23.0:2015-09-30, post-build-variant-multiplicity=true, post-build-variant-value=true, set at pre-compile, default-value=BIT0  # Cluster CLK5 source | Cluster local clock signal CLK5 source selection
          BIT0  # CMU_CLK5
          BIT1  # CMU_CLK8
          BIT2  # TIM_EXT_CAP5
        enumeration rba_Gtm_Ccm_16_Clk6Src [0..1]: multiplicity set at pre-compile, origin=RB:4.23.0:2015-09-30, post-build-variant-multiplicity=true, post-build-variant-value=true, set at pre-compile, default-value=BIT0  # Cluster CLK6 source | Cluster local clock signal CLK6 source selection
          BIT0  # CMU_CLK6
          BIT1  # CMU_CLK8
          BIT2  # TIM_EXT_CAP6
        enumeration rba_Gtm_Ccm_17_Clk7Src [0..1]: multiplicity set at pre-compile, origin=RB:4.23.0:2015-09-30, post-build-variant-multiplicity=true, post-build-variant-value=true, set at pre-compile, default-value=BIT0  # Cluster CLK7 source | Cluster local clock signal CLK7 source selection
          BIT0  # CMU_CLK7
          BIT1  # CMU_CLK8
          BIT2  # TIM_EXT_CAP7
        enumeration rba_Gtm_Ccm_30_McsSched [0..1]: multiplicity set at pre-compile, origin=RB:4.1.0:2018-10-31, post-build-variant-multiplicity=true, post-build-variant-value=true, set at pre-compile, default-value=RoundRobin  # MCS Scheduling Mode | Selects the scheduling mode for this cluster
          Accelerated  # Accelerated scheduling
          RoundRobin  # Round-Robin scheduling
          SinglePrioritization  # Single Prioritization scheduling
          MultiplePrioritization  # Multiple Prioritization scheduling
        integer rba_Gtm_Ccm_31_McsScdCh [0..1]: 0..7, multiplicity set at pre-compile, origin=RB:0.1.0:2018-10-31, post-build-variant-multiplicity=true, post-build-variant-value=true, set at pre-compile, default-value=7  # MCS Scheduling Channel | Channel selection for scheduling algorithm. The significance of this tag depends on the selected scheduling mode, see manual for further information
        boolean rba_Gtm_Ccm_32_McsHltSpOfl [0..1]: multiplicity set at pre-compile, origin=RB:0.1.0:2018-10-31, post-build-variant-multiplicity=true, post-build-variant-value=true, set at pre-compile, default-value=false  # MCS halt on stack pointer overflow | Halt on stack pointer overflow. When this feature is enabled an MCS channel is disabled if a stack pointer counter over/underflow occurs. This feature is only available in GTMv3.
        boolean rba_Gtm_Ccm_33_McsEnTimFout [0..1]: multiplicity set at pre-compile, origin=RB:0.1.0:2018-10-31, post-build-variant-multiplicity=true, post-build-variant-value=true, set at pre-compile, default-value=true  # MCS TIM input signal routing | Enable the routing of TIM_CH_F_OUT signals to MCS_CTRG register. Read access to the trigger bit states have to be made in the STRG registers!
        boolean rba_Gtm_Ccm_34_McsEnXoreg [0..1]: multiplicity set at pre-compile, origin=RB:0.1.0:2018-10-31, post-build-variant-multiplicity=true, post-build-variant-value=true, set at pre-compile, default-value=false  # MCS enable extended register set | Enable extended register set. Note: Has impact on neighbouring channel operation, handle with care! Should be 'false' unless explicitly required! Hint: This feature is always turned on in GTMv4, so this tag is not evaluated in GTMv4.
        boolean rba_Gtm_Ccm_35_McsHltAeimErr [0..1]: multiplicity set at pre-compile, origin=RB:0.1.0:2018-10-31, post-build-variant-multiplicity=true, post-build-variant-value=true, set at pre-compile, default-value=false  # MCS halt on AEI bus master error | Halt on AEI bus master error. When this feature is enabled an MCS channel is disabled if an invalid AEI busmaster access is detected.
        boolean rba_Gtm_Ccm_36_DisMcsRamSplit [0..1]: multiplicity set at pre-compile, origin=RB:0.1.0:2018-10-31, post-build-variant-multiplicity=true, post-build-variant-value=true, set at pre-compile, default-value=false  # Disable separation of MCS data and code | By default MCS data and code sections are seperated in RAM: The first 2/3 hold channel data of all MCS channels, the last 1/3 holds channel source code. In case the code section is too large the separation can be disabled here for a specific cluster.
        boolean rba_Gtm_Ccm_37_DisMcsHarvard [0..1]: multiplicity set at pre-compile, origin=RB:5.1.0:2021-10-31, post-build-variant-multiplicity=true, post-build-variant-value=true, set at pre-compile, default-value=false  # Disable MCS harvard architecture | By default the modified harvard architecture of MCS is turned on. Set this configuration tag to TRUE to disable this feature. Hint: To actually use the harvard feature separation of data and code should be active! This feature is only available in GTMv4.
        boolean rba_Gtm_Ccm_50_ClsAruComDis [0..1]: multiplicity set at pre-compile, origin=RB:0.1.0:2018-10-31, post-build-variant-multiplicity=true, post-build-variant-value=true, set at pre-compile, default-value=false  # Enable ARU Cluster Isolation | Optionally enable ARU cluster isolation. See manual for further details of register GTM_ARU_COM_DIS. This feature is only available in GTMv4. Attention: Please note that there is a GTM HW erratum (GTMDESIGN-256) related to this feature which will disconnect TIMs in the selected cluster completely from ARU communication! Please refer to the GTM errata documentation for further information.
        enumeration rba_Gtm_Ccm_80_IfxEnMcsDataExchange [0..1]: multiplicity set at pre-compile, origin=RB:8.1.0:2023-04-28, post-build-variant-multiplicity=true, post-build-variant-value=true, set at pre-compile, default-value=DEFAULT  # Enable MCS data exchange | Setting this tag to values other than default enables two features: (1) Enable Data Input on MCS RAM address 0x28 in this cluster. Depending on the selection either the DATAINx register or MCS_STAT input signals are chosen.Hint: The input valöue is accessible on RAM address 0x28 and can be accessed like reading a global variable from this address. (2) Enabling tigger outputs on MCS RAM addresses 0x20 (TRIGOUT) and 0x24 (INTOUT). This is done for both possible selections DATAIN or MCS_STAT Hint: Enabling this features reserves the MCS RAM addresses 0x20, 0x24 and 0x28. The three addresses cannot be used for other purposes in this case. Note: This feature is IFX specific and this tag is not evaluated for other controllers!
          DEFAULT  # Data exchange disabled (default)
          DATAIN  # Enable DATAINx register mapping
          MCS_STAT  # Enable MCS_STAT input signal mapping
      container rba_Gtm_Cmp [0..*]: multiplicity set at pre-compile, post-build-variant-multiplicity=true  # Output Compare Unit (CMP) | Container for a CMP configuration
        string rba_Gtm_Cmp_Id1: origin=RB:2.0.0:2013-11-20, post-build-variant-value=true, set at pre-compile, regular-expression=[A-Za-z_][A-Za-z0-9_]*  # Comparison ID1 | TOM or ATOM identifier of the first comparison cell. Only neighbouring (A)TOMs can be compared!
        string rba_Gtm_Cmp_Id2: origin=RB:2.0.0:2013-11-20, post-build-variant-value=true, set at pre-compile, regular-expression=[A-Za-z_][A-Za-z0-9_]*  # Comparison ID2 | TOM or ATOM identifier of the second comparison cell. Only neighbouring (A)TOMs can be compared!
      container rba_Gtm_Dpll [0..1]: multiplicity set at pre-compile, post-build-variant-multiplicity=true  # Digital PLL module (DPLL) | Container for a DPLL configuration
        container rba_Gtm_Map [0..1]: multiplicity set at pre-compile, post-build-variant-multiplicity=true  # TIM0 input mapping module (MAP) | Container for a TIM configuration
          enumeration rba_Gtm_MapStateSrc: {TIM0_CH1, TIM0_CH2, TIM0_CH3, TIM0_CH4, TIM0_CH5, TSPPO}, origin=RB:0.1.0:2011-04-19, post-build-variant-value=true, set at pre-compile  # State source selection | Select the source of the STATE signal which is then routed to DPLL. An appropriate macro will be generated for the user to initialise TSL bitfield.
          enumeration rba_Gtm_MapTriggerSrc: {TIM0_CH1, TSPPO}, origin=RB:0.1.0:2011-04-19, post-build-variant-value=true, set at pre-compile  # Trigger source selection | Select the source of the TRIGGER signal which is then routed to DPLL. An appropriate macro will be generated for the user to initialise SSL bitfield.
      container rba_Gtm_EClk [0..1]: multiplicity set at pre-compile, post-build-variant-multiplicity=true  # External Clock Lines | Container for ECLK configuration
        string rba_Gtm_EClk_0 [0..1]: multiplicity set at pre-compile, origin=RB:0.1.0:2011-05-09, post-build-variant-multiplicity=true, post-build-variant-value=true, set at pre-compile, regular-expression=[0-9]*[A-Za-z0-9_ ]*  # CMU External Clock 0 | Cmu External Clock 0 setting. Giva a value with optional unit in Hz, e.g. 8000000Hz or 50000Hz Must be smaller than or equal to half of the Gtm Sys Clock setting. As second option the two dividers can be directly configured to: DIV_<numerator>_<denominator>, e.g. DIV_5_2. Output pin for ECLK0 is Port F.8 on ST devices and Port 23.1 on IFX devices
        string rba_Gtm_EClk_1 [0..1]: multiplicity set at pre-compile, origin=RB:0.1.0:2011-05-09, post-build-variant-multiplicity=true, post-build-variant-value=true, set at pre-compile, regular-expression=[0-9]*[A-Za-z0-9_ ]*  # CMU External Clock 1 | Cmu External Clock 1 setting. For valid configuration option see ECLK0 description (tag rba_Gtm_EClk_0). Output pin for ECLK1 is Port A.15 on ST devices and Port 32.4 on IFX devices
        string rba_Gtm_EClk_2 [0..1]: multiplicity set at pre-compile, origin=RB:0.1.0:2011-05-09, post-build-variant-multiplicity=true, post-build-variant-value=true, set at pre-compile, regular-expression=[0-9]*[A-Za-z0-9_ ]*  # CMU External Clock 2 | Cmu External Clock 2 setting. For valid configuration option see ECLK0 description (tag rba_Gtm_EClk_0). Output pin for ECLK2 is Port C.10 on ST devices and Port 11.12 on IFX devices
      container rba_Gtm_Fifo [0..*]: multiplicity set at pre-compile, post-build-variant-multiplicity=true  # First in first out module (Fifo) | Container for a FIFO configuration
        enumeration rba_Gtm_Fifo_1_Module: {FIFO0, FIFO1, FIFO2}, origin=RB:0.1.0:2011-04-19, post-build-variant-value=true, set at pre-compile  # Module | Selects the FIFO module, effective number of available FIFO modules is device dependent.
        enumeration rba_Gtm_Fifo_2_Channel: {CH0, CH1, CH2, CH3, CH4, CH5, CH6, CH7}, origin=RB:0.1.0:2011-04-19, post-build-variant-value=true, set at pre-compile  # Channel | Selects the FIFO channel to be configured. All FIFO modules contain eight FIFO channels which share a common memory for data storage.
        integer rba_Gtm_Fifo_3_Size: 1.., origin=RB:3.2.0:2014-07-30, post-build-variant-value=true, set at pre-compile  # Data size | Specify the required number of data words, the minimum value is '1'!
        string rba_Gtm_Fifo_4_AruConn [0..1]: multiplicity set at pre-compile, origin=RB:3.2.0:2014-07-30, post-build-variant-multiplicity=true, post-build-variant-value=true, set at pre-compile, regular-expression=[A-Za-z_][A-Za-z0-9_]*  # Aru Connection | Optionally specify the ARU read source / write target if the FIFO channel shall read data from a TIM or ATOM or the FIFO channel shall provide data for an ATOM channel. The notation is ARU_TIM_READ_<TimId>, ARU_ATOM_READ_<AtomId> or ARU_ATOM_WRITE_<AtomId>. When the FIFO channel is the target of an MCS channel than this tag is not configured. The only configuration in this case is the variable definition in MCS channel request: myFifoWriteAddr = ARU_FIFO_WRITE_<FifoChanId>. The register F2A[i]_CH[x]_ARU_RD_FIFO is automatically filled. Hint: It is also possible to write to multiple FIFO channels from one single MCS channel, in this case a separate MCS variable for each FIFO channel is required.
        string rba_Gtm_Fifo_5_Isr [0..1]: multiplicity set at pre-compile, origin=RB:3.2.0:2014-07-30, post-build-variant-multiplicity=true, post-build-variant-value=true, set at pre-compile, regular-expression=[A-Za-z_][A-Za-z0-9_]*  # Interrupt generation | This Identifier will be used to communicate with the forthcoming IntProxy package
      container rba_Gtm_Mcs [0..1]: multiplicity set at pre-compile, post-build-variant-multiplicity=true  # Multi Channel Sequencer | Container for a MCS configuration
        string rba_Gtm_Mcs_MacroGlob [0..*]: multiplicity set at pre-compile, origin=RB:0.1.0:2011-05-09, post-build-variant-multiplicity=true, post-build-variant-value=true, set at pre-compile, regular-expression=[A-Za-z_][A-Za-z0-9_]*  # Global Macro Definition | Global Macro definition, visible in all MSC channels of all modules
        container rba_Gtm_Mcs_ChanReq [0..*]: multiplicity set at pre-compile, post-build-variant-multiplicity=true  # Channel Request | Container for a MCS function instance request
          enumeration rba_Gtm_Mcs_1_Module: {MCS0, MCS1, MCS2, MCS3, MCS4, MCS5, MCS6, MCS7, MCS8, MCS9}, origin=RB:0.1.0:2011-04-19, post-build-variant-value=true, set at pre-compile  # Module | Selects the MCS module, effective number of available MCS modules is device dependent.
          enumeration rba_Gtm_Mcs_2_Channel: {CH0, CH1, CH2, CH3, CH4, CH5, CH6, CH7}, origin=RB:0.1.0:2011-04-19, post-build-variant-value=true, set at pre-compile  # Channel | Selects the MCS channel to be configured. All MCS modules contain eight MCS channels [0 .. 7]
          string rba_Gtm_Mcs_3_Function: origin=RB:0.1.0:2011-05-09, post-build-variant-value=true, set at pre-compile, regular-expression=[A-Za-z][A-Za-z0-9_]*  # Function Name | Function name of the requested MCS function. Must be defined in a *.mcs file using the BEGIN_MCS_FUNC makro. Creates an instance of this function in the configured MCS module.
          string rba_Gtm_Mcs_4_VarDef [0..*]: multiplicity set at pre-compile, origin=RB:0.1.0:2011-05-09, post-build-variant-multiplicity=true, post-build-variant-value=true, set at pre-compile, regular-expression=[A-Za-z][A-Za-z0-9_= \[\]]*  # Variable Definition | Defines one of the funtion local variables. Variable must be declared in Function declaration! Definition must look like: "tiMaxPer = 1593". Arrays can only be initialised with the same, single value for each member: "myArr[4] = 0" or "myArr[4] = 12". ARU addressing: for variables which shall be initialised with an ARU addresas of a TIM or ATOM use following mechanism: - "myTimReadAdr = ARU_TIM_READ_<TimShortName>" to initialise a variable with the TIM ARU read address of the specified TIM channel <TimShortName>. - "myAtomReadAdr = ARU_ATOM_READ_<AtomShortName>" to initialise a variable with the ATOM ARU read address of the specified ATOM channel <AtomShortName>. - "myAtomWriteAdr = ARU_ATOM_WRITE_<AtomShortName>" to have the variable initialised with the MCS write slot index (for MCS internal use) on bit positions [4 .. 0] and the global, external write slot address on bit positions[23 .. 5] which is used in the ATOM RDADDR register. Hint: The ATOM RDADDR register is automatically initialised wth the appropriate address so if the ATOM RDADDR register contents are overwritten by e.g. an ATOM channel reset, this varible can be used from CPU side to re-initialis the RDADDR register. When used on MCS side in combination with the AWRI instruction only the lower five bits [4:0] are used by the instruction automatically. Cluster addressing / bus master access: If a variable shall be addressed with a cluster address of a write or read target use this mechanism: "myAddr = CLUSTER_TIM_ADDRESS_<TimShortName>". The variable is automatically initialised with the base address of the given TIM channel. The same is valid for TOMs and ATOMs. In case of TOM addressing additionally the TGC address is written to the MHB of the given varibale. However, as the actual address (0xC30 or 0xE30) is larger than the MHB (i.e. larger than a byte): As the last nibble is zero only the upper two nibbles are stored in MHB. Before usage the user has to shift the address left by four bits to get the actual, valid TGC address. CLUSTER_ADCIF_ADDRESS_CH9: resolve the address of ADCIF channel 9 STRG / CTRG access: The STRG/CTRG register bit positions are shared among the eight MCS channels of a module and the CPU. To reserve a bit for usage within an MCS channel configure a channel local variable with the following keyword:"myTriggerPos = SYNC_TRIGGER_<triggerID>" The ID <triggerID> can be used to get the same bit position in a different MCS function. Beware: - use the register STRG to set the bit eiher from CPU or from MCS side - use the register CTRG to clear the bit eiher from CPU or from MCS side - only use the STRG register to read the trigger bit (from CPU or from MCS side)! This is very important to be able to use the feature 'EN_TIM_FOUT' within the CTRG register.
          string rba_Gtm_Mcs_5_Isr [0..1]: multiplicity set at pre-compile, origin=RB:0.1.0:2011-05-09, post-build-variant-multiplicity=true, post-build-variant-value=true, set at pre-compile, regular-expression=[A-Za-z_][A-Za-z0-9_]*  # ISR name | If the function triggers an IRQ (rba_Gtm_Mcs_6_Irq == yes) this Identifier will be used to communicate with the forthcoming IntProxy package. Name the ISR without brackets.
          string rba_Gtm_Mcs_6_ChArray [0..*]: multiplicity set at pre-compile, origin=RB:4.0.0:2015-01-23, post-build-variant-multiplicity=true, post-build-variant-value=true, set at pre-compile, regular-expression=[A-Za-z_][A-Za-z0-9_= \[\]]*  # Channel specific array | Declare a channel specific array including its channel specific size in the form 'myArr[12] = 0'. This array must be defined without a size in rba_Gtm_Mcs_FuncDecl. Hint: This variable will not be part of the function specific C-structure. It can be used to create one or more arrays with differents sizes for multiple channels of a function which normally have identical variables when defined with rba_Gtm_Mcs_4_VarDef. If the array shall have alignment (for DMA circular buffer access) check the description of rba_Gtm_Mcs_FuncDecl -> rba_Gtm_Mcs_8_ChArray
        container rba_Gtm_Mcs_FuncDecl [0..*]: multiplicity set at pre-compile, post-build-variant-multiplicity=true  # Function Declaration | Function declaration for a single MCS function
          enumeration rba_Gtm_Mcs_1_Inst: {yes, no}, origin=RB:0.1.0:2011-05-09, post-build-variant-value=true, set at pre-compile  # Multiple Instances | Set to yes if it is allowed to configure multiple instances of this function (rba_Gtm then accepts multiple channel requests for this function). When multiple instances is set to 'yes' keep in mind: - multiple instances can be configured for this function, this means that each instance will get its own, independent set of local variables (rba_Gtm_Mcs_3_Var) but the function code is not doubled (this will save MCS memory). - indirect addressing must be used for accessing local variables. The base pointer is automatically given in 'r5' and each variable will have its own offset macro like: _OFFS. The address for loading a variable from RAM is calculated by adding 'r5' to the '_OFFS' macro.
          enumeration rba_Gtm_Mcs_2_BasePtr [0..1]: {r0, r1, r2, r3, r4, r5, r6, r7}, multiplicity set at pre-compile, origin=RB:0.1.0:2011-05-09, post-build-variant-multiplicity=true, post-build-variant-value=true, set at pre-compile, default-value=r5  # Data base pointer register | Currently ignored, r5 is used as default value! Hint: Only necessary if Multiple instances == yes Select register which shall be initialised with the channles data set base pointer used for indirect addressing of multiple instance functions.
          string rba_Gtm_Mcs_3_Var [0..*]: multiplicity set at pre-compile, origin=RB:0.1.0:2011-05-09, post-build-variant-multiplicity=true, post-build-variant-value=true, set at pre-compile, regular-expression=[A-Za-z][A-Za-z0-9_= \[\]]*  # Function local MCS RAM variable | RAM variable name, names could be like 'cntValue', 'tiMaxPer'. Varibale must not be named 'xStack' to prevent confusion with auto-generated Stack variable in case stack is used (rba_Gtm_Mcs_5_Stack == yes). Arrays can be declared as 'myArr[4]'. The declarations are valid for each instance of this function, i.e. each instance will get the complete set of declared variables. Default init value is '0'. For a detailed description of the available configuration options see the tag rba_Gtm_Mcs_4_VarDef in the rba_Gtm_Mcs_ChanReq container.
          string rba_Gtm_Mcs_4_VarGlob [0..*]: multiplicity set at pre-compile, origin=RB:0.1.0:2011-05-09, post-build-variant-multiplicity=true, post-build-variant-value=true, set at pre-compile, regular-expression=[A-Za-z][A-Za-z0-9_= \[\]]*  # MCS global RAM variable | RAM variable of which no instances are generated, variables must be initialised on declaration here and not in channel request like normal variables, string must look like: tiMaxPer = 0x300 numTout = 5 globalArray[12] Variable can directly be accessed by the function instances with the name specified here (using direct addressing, usage of r5 is not required in this case!). Global Arrays must not have a specified init value and are initialised with zero.
          enumeration rba_Gtm_Mcs_5_Stack [0..1]: {yes, no}, multiplicity set at pre-compile, origin=RB:0.4.0:2012-08-06, post-build-variant-multiplicity=true, post-build-variant-value=true, set at pre-compile  # Stack required | If this option is set to 'yes' a channel-local eight word stack is reserved for each instance of this function. The stack pointer register R7 is initialised with the appropriate stack address and must not be used as a general purpose register anymore.
          enumeration rba_Gtm_Mcs_6_Irq [0..1]: {yes, no}, multiplicity set at pre-compile, origin=RB:0.4.0:2012-08-06, post-build-variant-multiplicity=true, post-build-variant-value=true, set at pre-compile  # Interrupt generation | Does the function triger an interrupt/DMA transfer using the MCS trigger lines? However, a function instance must not trigger an interrupt in this case, it is only allowed to do so.
          string rba_Gtm_Mcs_7_Macros [0..1]: multiplicity set at pre-compile, origin=RB:0.5.0:2012-11-14, post-build-variant-multiplicity=true, post-build-variant-value=true, set at pre-compile, regular-expression=[A-Za-z_][A-Za-z0-9_]*.h  # Macro definition file | This optional tag specifies a header file in which user-defined macros can be used in MCS source code. The file is pre-processed to be compatible to mcs-assembler: all '#' are replaced by '.'. Other preprocessor commands are not supported. The filename must folle one of the following two conventions: myComp_<anyText>_Mcs.h myComp_<anyText>_mcsass.h
          string rba_Gtm_Mcs_8_ChArray [0..*]: multiplicity set at pre-compile, origin=RB:4.0.0:2015-01-23, set at pre-compile, regular-expression=[A-Za-z_][A-Za-z0-9_]*  # Channel specific array | Declares an array which has a channel specific size. Just configure the array name like 'myArr' without brackes. The actual size is configured in the channel request in tag rba_Gtm_Mcs_6_ChArray. Channel specific arrays can be aligned according to their size using the 'ALIGN_' keyword in order to be used as source or target buffers in a circular buffer DMA configuration. Example for alignment: 'ALIGN_myArrayName' Restrictions: - each declared array must be configured in the channel request with a size of at least '1' (if it is not configured it will be present nevertheless with a size of '1') - channel specific arrays can have no initialisation values, they are initialised with '0' - across all post-build variants the number and name of such arrays per function must be the same. - channel specific arrays are treated as global variables, so their names must be unique - aligned variables must have a size equal to a power of 2 (1, 2, 4, 8, 16, etc.)!
          string rba_Gtm_Mcs_9_SrcPath: origin=RB:0.1.0:2011-05-09, post-build-variant-value=true, set at pre-compile, regular-expression=[A-Za-z_][A-Za-z0-9_]*.mcs  # Name of *.mcs file | Specify the name of the MCS source code file.
      container rba_Gtm_Spe [0..*]: multiplicity set at pre-compile, post-build-variant-multiplicity=true  # Sensor pattern evaluation (SPE) | Container for a SPE configuration
        enumeration rba_Gtm_Spe_1_Module: {SPE0, SPE1, SPE2, SPE3, SPE4, SPE5}, origin=RB:4.22.0:2015-07-31, post-build-variant-value=true, set at pre-compile  # Module | Selects the SPE module, effective number of available SPE modules is device dependent.
        integer rba_Gtm_Spe_2_Ctrl: 0..4294967295, origin=RB:4.22.0:2015-07-31, post-build-variant-value=true, set at pre-compile  # Initial CTRL value | Initial CTRL value, additionally the bit field TRG_SEL is filled according to the configuration of the tag rba_Gtm_Spe_3_TimInput. This means that the original CTRL_STAT.TRG_SEL contents are overwritten.
        string rba_Gtm_Spe_3_TimInput [0..1]: multiplicity set at pre-compile, origin=RB:4.22.0:2015-07-31, post-build-variant-multiplicity=true, post-build-variant-value=true, set at pre-compile, regular-expression=[A-Za-z_][A-Za-z0-9_]*  # TIM input selection | Name one TIM (short name!) out of the three input group TIMs. The input group will be determined automatibally based on the given TIM short name. The CTRL register will be ajdusted accordingly.
      container rba_Gtm_Tim [0..*]: multiplicity set at pre-compile, post-build-variant-multiplicity=true  # Timer input module (TIM) | Container for a TIM configuration
        enumeration rba_Gtm_Tim_2_Module: {TIM0, TIM1, TIM2, TIM3, TIM4, TIM5, TIM6, TIM7}, origin=RB:0.1.0:2011-04-19, post-build-variant-value=true, set at pre-compile  # Module | Selects the TIM module, effective number of available TIM modules is device dependent.
        enumeration rba_Gtm_Tim_3_Channel: {CH0, CH1, CH2, CH3, CH4, CH5, CH6, CH7}, origin=RB:0.1.0:2011-04-19, post-build-variant-value=true, set at pre-compile  # Channel | Selects the TIM channel to be configured. All TIM modules contain eight TIM channels.
        integer rba_Gtm_Tim_4_Ctrl: origin=RB:0.1.0:2011-07-22, post-build-variant-value=true, set at pre-compile  # Initial CTRL value | Specifies the initial CTRL register value.
        integer rba_Gtm_Tim_4a_Ectrl [0..1]: multiplicity set at pre-compile, origin=RB:0.1.0:2011-07-22, post-build-variant-multiplicity=true, post-build-variant-value=true, set at pre-compile, default-value=0  # Initial ECTRL value | Specifies the initial ECTRL register value. This tag is optional and if it is not configured the register is written with 0x0.
        string rba_Gtm_Tim_5_InpConn [0..1]: multiplicity set at pre-compile, origin=RB:0.1.0:2011-05-09, post-build-variant-multiplicity=true, post-build-variant-value=true, set at pre-compile, regular-expression=[A-Za-z_][A-Za-z0-9_]*  # Input connection | Specifies the TIM input connection. Configure the connection in following way: PORT_B_15, PORT_02_08: Port/Pin connection (IFX/ST) DSADC_SRM0: DSADC trigger (IFX) SDADC_3_VDA: SDADC trigger (ST) VADC_C0SR0: VADC service request 0 of common block 0 (IFX) ADC9_3_WLT1: ADC watchdog trigger connection (ST) CICTRL: connection to the input of the preceeding TIM channel AUX_IN_ATOM / AUX_IN_TOM: direct ATOM/TOM connection
        integer rba_Gtm_Tim_6_Tdu [0..1]: multiplicity set at pre-compile, origin=RB:0.1.0:15.06.2011, post-build-variant-multiplicity=true, post-build-variant-value=true, set at pre-compile  # Tdu register | Tdu register configuration (Register TIM[i]_CH[x]_TDU or TDUV depending on GTM revision). It is recommended to initially configure TO_EN to 0 and to enable the TDU in a seperate process.
        integer rba_Gtm_Tim_7_FltRe [0..1]: multiplicity set at pre-compile, origin=RB:0.1.0:29.07.2011, post-build-variant-multiplicity=true, post-build-variant-value=true, set at pre-compile, default-value=0  # Rising edge filter | Rising edge filter time in <ticks>. The filter clock is selected by configuring the FLT_CNT_FRQ bitfield in the CTRL register
        integer rba_Gtm_Tim_8_FltFe [0..1]: multiplicity set at pre-compile, origin=RB:0.1.0:29.07.2011, post-build-variant-multiplicity=true, post-build-variant-value=true, set at pre-compile, default-value=0  # Falling edge filter | Falling edge filter time in <ticks>. The filter clock is selected by configuring the FLT_CNT_FRQ bitfield in the CTRL register
        string rba_Gtm_Tim_9_Irq [0..1]: multiplicity set at pre-compile, origin=RB:0.1.0:2011-05-09, post-build-variant-multiplicity=true, post-build-variant-value=true, set at pre-compile, regular-expression=[A-Za-z_][A-Za-z0-9_]*  # Interrupt generation | This Identifier will be used to communicate with the forthcoming IntProxy package
      container rba_Gtm_Tio [0..*]: multiplicity set at pre-compile, post-build-variant-multiplicity=true  # Timer input output modules (TIO) | Container for TIO channel configurations
        enumeration rba_Gtm_Tio_2_Module: {TIO1, TIO2, TIO3, TIO4, TIO6, TIO7, TIO8, TIO9}, multiplicity set at pre-compile, origin=RB:4.0.0:2021-01-31, post-build-variant-multiplicity=true, post-build-variant-value=true, set at pre-compile  # Module | Selecs the TIO module/cluster, effective number of TIO modules is device dependent. Currently only TIO0-TIO4 and TIO6-TIO9 are supported.
        enumeration rba_Gtm_Tio_3_Channel: {CH0, CH1, CH2, CH3, CH4, CH5, CH6, CH7}, multiplicity set at pre-compile, origin=RB:4.0.0:2021-01-31, post-build-variant-multiplicity=true, post-build-variant-value=true, set at pre-compile  # Channel | Selects the TIO channel to be configured. A TIO module is capable to have either 8, 16 or 24 channels in 1, 2 or 3 groups, depending on device configuration.
        integer rba_Gtm_Tio_4a_Ctrl: multiplicity set at pre-compile, origin=RB:4.0.0:2021-01-31, post-build-variant-multiplicity=true, post-build-variant-value=true, set at pre-compile  # Initial CTRL value | Specifies the initial CTRL register value.
        string rba_Gtm_Tio_5_InpConn [0..1]: multiplicity set at pre-compile, origin=RB:4.0.0:2021-01-31, post-build-variant-multiplicity=true, post-build-variant-value=true, set at pre-compile, regular-expression=[A-Za-z_][A-Za-z0-9_]*  # Input connection | Specifies the TIO input connection. Configure the connection in following way: PORT_B_15, PORT_02_08: Port/Pin connection (IFX/ST) Hint: Other than Port input connections are so far not supported by HW!
        string rba_Gtm_Tio_5_OutpConBase [0..1]: multiplicity set at pre-compile, origin=RB:4.0.0:2021-01-31, post-build-variant-multiplicity=true, post-build-variant-value=true, set at pre-compile  # Output connection | This output connection will not append the '_Px_y' suffix to the pushed Port container. For all other options see rba_Gtm_Tio_5_OutpConn
        string rba_Gtm_Tio_5_OutpConn [0..*]: multiplicity set at pre-compile, origin=RB:4.0.0:2021-01-31, post-build-variant-multiplicity=true, post-build-variant-value=true, set at pre-compile  # Output connection container | Configures a TIO output connection. Possible conection targets are Port or MSC. Following syntax must be followed: - PORT_C_05 for a connection to Port C, Pin 5 - MSC_3_7 for a connection to MSC3, bit7 Hint: Other output connection targets are so far not supported by HW! Hint: Forwarded connections to Port will get a suffix to the port container name as e.g. _PC_5
      container rba_Gtm_Tom [0..*]: multiplicity set at pre-compile, post-build-variant-multiplicity=true  # Timer output modules ((A)TOM) | Container for a (A)TOM configuration
        enumeration rba_Gtm_Tom_2_Module: {ATOM0, ATOM1, ATOM2, ATOM3, ATOM4, ATOM5, ATOM6, ATOM7, ATOM8, ATOM9, ATOM10, ATOM11, TOM0, TOM1, TOM2, TOM3, TOM4, TOM5}, origin=RB:0.1.0:2011-04-19, post-build-variant-value=true, set at pre-compile  # Module | Selecs the (A)TOM module, effective number of (A)TOM modules is device dependent.
        enumeration rba_Gtm_Tom_3_Channel: {CH0, CH1, CH2, CH3, CH4, CH5, CH6, CH7, CH8, CH9, CH10, CH11, CH12, CH13, CH14, CH15}, origin=RB:0.1.0:2011-04-19, post-build-variant-value=true, set at pre-compile  # Channel | Selects the (A)TOM channel to be configured.
        integer rba_Gtm_Tom_4a_Ctrl: origin=RB:0.1.0:2011-07-22, post-build-variant-value=true, set at pre-compile  # Initial CTRL value | Specifies the initial CTRL register value.
        integer rba_Gtm_Tom_4b_Cn0: origin=RB:0.1.0:2011-07-22, post-build-variant-value=true, set at pre-compile  # Initial CN0 value | Specifies the initial CN0 register value.
        integer rba_Gtm_Tom_4c_Cm0: origin=RB:0.1.0:2011-07-22, post-build-variant-value=true, set at pre-compile  # Initial CM0 value | Specifies the initial CM0 register value.
        integer rba_Gtm_Tom_4d_Sr0: origin=RB:0.1.0:2011-07-22, post-build-variant-value=true, set at pre-compile  # Initial SR0 value | Specifies the initial SR0 register value.
        integer rba_Gtm_Tom_4e_Cm1: origin=RB:0.1.0:2011-07-22, post-build-variant-value=true, set at pre-compile  # Initial CM1 value | Specifies the initial CM1 register value.
        integer rba_Gtm_Tom_4f_Sr1: origin=RB:0.1.0:2011-07-22, post-build-variant-value=true, set at pre-compile  # Initial SR1 value | Specifies the initial SR1 register value.
        string rba_Gtm_Tom_5_OutpConBase [0..1]: multiplicity set at pre-compile, origin=RB:0.1.0:05.07.2011, post-build-variant-multiplicity=true, post-build-variant-value=true, set at pre-compile  # Output connection | This output connection will not append the '_Px_y' suffix to the pushed Port container. For all other options see rba_Gtm_Tom_5_OutpConn
        string rba_Gtm_Tom_5_OutpConn [0..*]: multiplicity set at pre-compile, origin=RB:0.1.0:05.07.2011, post-build-variant-multiplicity=true, post-build-variant-value=true, set at pre-compile  # Output connection | Configures a (A)TOM output connection. Possible conection target are Ports, MSC or ADCs. Following syntax must be followed: - PORT_03_05 for a connection to Port 3, Pin 5 - PORT_C_05 for a connection to Port C, Pin 5 - ADC_0_TRIG1 for a connection to ADC0, trigger line 1 (IFX) - SARADC_4_INJ for a connection to ADC4 injection trigger (ST) - DSADC_1_TRIG0 for a DSADC connection (IFX) - SDADC_2_DMAINT for a ADADC connection (ST) - MSC_3_7 (IFX, connections are pushed from rba_Msc to rba_Gtm, normally no manual configuration necessary) - DSPI_5_20 (ST, connections are pushed from rba_Msc to rba_Gtm, normally no manual configuration necessary) - PORT_03_05N to utilise the DTM second output Hint (IFX): A pushed MSC_3_7 connection can be amended by an additional rba_Gtm_Tom_5_OutpConn containing e.g. MCS_3_7_SET8 to disable the automatic SET selection and determine the used SET directly. This is only possible for ATOM connections as TOMs have no alternative SETs. Hint (ST): DSPI connections may also have the form DSPI_5_20_via_23. In this case the connection is established from the timer cell to the second DSPI bit, 23 in this case.
        boolean rba_Gtm_Tom_6a_Endis [0..1]: multiplicity set at pre-compile, origin=RB:0.1.0:2018-08-28, post-build-variant-multiplicity=true, post-build-variant-value=true, set at pre-compile, default-value=false  # Enable channel | Shall the channel be enabled during init? The initialisation sequence is 1) UPEN_CTRL if enabled 2) OUTEN_STAT if enabled 3) ENDIS_STAT if enabled
        boolean rba_Gtm_Tom_6b_Outen [0..1]: multiplicity set at pre-compile, origin=RB:0.1.0:2018-08-28, post-build-variant-multiplicity=true, post-build-variant-value=true, set at pre-compile, default-value=false  # Enable channel output | Shall the output of the channel be enabled during init? 1) UPEN_CTRL if enabled 2) OUTEN_STAT if enabled 3) ENDIS_STAT if enabled
        boolean rba_Gtm_Tom_6c_Upen [0..1]: multiplicity set at pre-compile, origin=RB:0.1.0:2018-08-28, post-build-variant-multiplicity=true, post-build-variant-value=true, set at pre-compile, default-value=true  # Enable shadow register update | Shall the shadow register update snabled during init? 1) UPEN_CTRL if enabled 2) OUTEN_STAT if enabled 3) ENDIS_STAT if enabled
        container rba_Gtm_Tom_1_Irq [0..1]: multiplicity set at pre-compile  # Interrupt generation | Container for a (A)TOM interrupt configuration
          string rba_Gtm_Tom_IrqId: origin=RB:0.1.0:2011-04-19, post-build-variant-value=true, set at pre-compile, max-length=127, min-length=3, regular-expression=[A-Za-z_][A-Za-z0-9_]*  # Identifier | This Identifier will be used to communicate with the forthcoming IntProxy package
          enumeration rba_Gtm_Tom_IrqType: {yes, no}, origin=RB:0.1.0:2011-04-19, post-build-variant-value=true, set at pre-compile  # Shareable | As two (A)TOM channels share one SRN both Interrupt sources ((A)TOM channels) must agree to share the common ressource. Please configure: - yes if sharing with neighbouring (A)TOM channel is ok - no if the SRN is demanded exclusively
      container rba_Gtm_Z_Services [0..1]: multiplicity set at pre-compile  # Services | Container for rba_Gtm services
        container rba_Gtm_DioFastOff [0..*]: multiplicity set at pre-compile, post-build-variant-multiplicity=true  # Dio with fast Switchoff | Container for a pin interrupt configuration
          string rba_Gtm_DioFastOff_10_FeedbackTim [0..1]: multiplicity set at pre-compile, origin=RB:1.0.0:2019-07-31, post-build-variant-multiplicity=true, post-build-variant-value=true, set at pre-compile, regular-expression=TIM[0-9]*_CH[0-7]  # Feedback TIM | Optionally specify the used feedback TIM ressource, e.g. TIM3_CH7
          string rba_Gtm_DioFastOff_11_McsChannel [0..1]: multiplicity set at pre-compile, origin=RB:1.0.0:2019-07-31, post-build-variant-multiplicity=true, post-build-variant-value=true, set at pre-compile, regular-expression=MCS[0-9]*_CH[0-7]  # MCS channel | Optionally specify the used MCS channel ressource, e.g. MCS3_CH6
          string rba_Gtm_DioFastOff_12_OutputAtom [0..1]: multiplicity set at pre-compile, origin=RB:1.0.0:2019-07-31, post-build-variant-multiplicity=true, post-build-variant-value=true, set at pre-compile, regular-expression=ATOM[0-9]*_CH[0-7]  # Output ATOM | Optionally specify the used output ATOM, e.g. ATOM3_CH6
          string rba_Gtm_DioFastOff_1_OutPort: origin=RB:4.1.0:2015-04-30, post-build-variant-value=true, set at pre-compile  # Dio Output Port | Desired DIO output port
          boolean rba_Gtm_DioFastOff_2_OutInvert [0..1]: multiplicity set at pre-compile, origin=RB:4.1.0:2015-04-30, post-build-variant-multiplicity=true, post-build-variant-value=true, set at pre-compile, default-value=false  # Output Invert | enables inversion of the output logic. Default logic is high-active, so activating the output will set it to '1' (and its default level is '0'). If this parameter is set to 'TRUE' the output will have a default level of '1' and an activation will set it to '0'
          enumeration rba_Gtm_DioFastOff_3_OutInit [0..1]: {Idle, Active}, multiplicity set at pre-compile, origin=RB:4.1.0:2015-04-30, post-build-variant-multiplicity=true, post-build-variant-value=true, set at pre-compile, default-value=Idle  # Output Init State | State of this signal after initialization. If this parameter is not specified, it defaults to inactive/idle state.
          string rba_Gtm_DioFastOff_4_TriggerPort: origin=RB:4.1.0:2015-04-30, post-build-variant-value=true, set at pre-compile  # Feedback Trigger Port | Feedback input Port. A switch-off is triggered depending on the selected mode: Shunt: a rising edge on this input Follower: After the selected delay the feed-back level must match the output level (which is always low for a low-side power stage)
          enumeration rba_Gtm_DioFastOff_5_TriggerMode: {Shunt, Follower}, origin=RB:4.1.0:2015-04-30, post-build-variant-value=true, set at pre-compile  # Trigger Mode | Trigger operation mode: Shunt: The feedback signal is directly evaluated after switching the output to active (delay = 0). This mode supports high- and low-side power stages. Follower: The feedback pin evaluation starts with an adjustable delay after switching the output to active (see 'Follower mode delay'). This mode only supports low-side power stages.
          integer rba_Gtm_DioFastOff_6_TriggerFilter [0..1]: multiplicity set at pre-compile, origin=RB:4.1.0:2015-04-30, post-build-variant-multiplicity=true, post-build-variant-value=true, set at pre-compile  # Trigger Filter Time | Optional filter time for trigger input. Specify filter time in [us]. Filter defaults to 2 us when no time is given. Minimum value is 2 us.
          integer rba_Gtm_DioFastOff_7_FmDelay [0..1]: 1..1000, multiplicity set at pre-compile, origin=RB:4.1.0:2015-04-30, post-build-variant-multiplicity=true, post-build-variant-value=true, set at pre-compile  # Follower mode delay | Delay time [us] after which the feedback pin is evaluated. This tag is only relevant for the trigger mode 'follower'. In trigger mode 'shunt' the trigger input is continuously evaluated if the output is switched on.
        container rba_Gtm_PwmFastOff [0..*]: multiplicity set at pre-compile, post-build-variant-multiplicity=true  # Pwm with fast Switchoff | Container for fast Pwm switch-off
          string rba_Gtm_PwmFastOff_AdcSignal: multiplicity set at pre-compile, origin=RB:0.1.0:29.07.2011, post-build-variant-multiplicity=true, post-build-variant-value=true, set at pre-compile  # DTM control Adc fastcomp signal name | Configured ADC signal name for fast-off trigger. Must be an Adc fast comparator configuration!
          enumeration rba_Gtm_PwmFastOff_AdcTimMuxConnection: multiplicity set at pre-compile, origin=RB:4.1.0:2015-04-30, post-build-variant-multiplicity=true, post-build-variant-value=true, set at pre-compile  # DTM switch-off trigger input | PWM fastoff Input trigger multiplexer selection
            AUXINPUT  # AuxInput
            TIMSEL_0  # TimSel_0
            TIMSEL_1  # TimSel_1
          string rba_Gtm_PwmFastOff_PwmSignal: multiplicity set at pre-compile, origin=RB:0.1.0:29.07.2011, post-build-variant-multiplicity=true, post-build-variant-value=true, set at pre-compile  # DTM control Pwm/Cdrv signal name | Signal ID/name of the Pwm signal which shall be protected. Can also be a TOM or ATOM short name if a CDRV signal is protected.
          string rba_Gtm_PwmFastOff_Tim_InpConn [0..1]: multiplicity set at pre-compile, origin=RB:0.1.0:2011-05-09, post-build-variant-multiplicity=true, post-build-variant-value=true, set at pre-compile  # TIM input trigger source | This tag configures the switch-off trigger source if a TIM is selected for routing the switch-off trigger from ADC to DTM. It is not required and is not evaluated if the tag <DTM switch-off trigger input> is configured as <AUXINPUT> Defines WDG Trigger which GTM input needs to be triggered from the ADC module. See Port Assignment list for corresponding GTM input selection. ST example: ADC9_3_WLT0 or ADC9_3_WLT1 IFX example: VADC_FC4BFL.
        container rba_Gtm_RdntSigEvln [0..*]: multiplicity set at pre-compile, post-build-variant-multiplicity=true  # Redundant Input Signal Evaluation | Container for redundant signal evaluation configurations.
          enumeration rba_Gtm_RdntSigEvln_10_PeriodEdge: multiplicity set at pre-compile, origin=RB:6.1.0:2022-04-30, post-build-variant-multiplicity=true, post-build-variant-value=true, set at pre-compile  # Period edge definition | Select how the signal period shall be measured for both channels
            falling  # falling-to-falling
            rising  # rising-to-rising
          enumeration rba_Gtm_RdntSigEvln_11_TimerClock: {CLK0, CLK1, CLK2}, multiplicity set at pre-compile, origin=RB:6.1.0:2022-04-30, post-build-variant-multiplicity=true, post-build-variant-value=true, set at pre-compile  # Timer Clock Resolution | The used TIM timer has a width of 24 bit. There are three possible timer resolutions which can be chosen. The resolution has impact on the lowest possible input frequrncy and additionally has impact on duty cycle resolution at higher frequencies. The lower frequency limits are: CLK0: 50 MHz - 20 ns/tick - fmin ~ 2,98 Hz CLK1: 20 MHz - 50 ns/tick - fmin ~ 1,19 Hz CLK2: 2.5 MHz - 400ns/tick - fmin ~ 0,149 Hz
          integer rba_Gtm_RdntSigEvln_12_TimeoutValueUs [0..1]: 1..6700000, multiplicity set at pre-compile, origin=RB:6.1.0:2022-04-30, post-build-variant-multiplicity=true, post-build-variant-value=true, set at pre-compile  # Timeout Value [us] | Specify the timeout value in [us]. Whenever the input signal remains unchanged for the specified time an error flag is risen in the return status. The default timout time is always the maximum timer ticks, but this time can be lowerd by using this tag. Hint: Too large values will automatically limited to the maximum value according to the selected Timer Clock.
          string rba_Gtm_RdntSigEvln_13_InputPort [0..1]: multiplicity set at pre-compile, origin=RB:6.1.0:2022-04-30, post-build-variant-multiplicity=true, post-build-variant-value=true, set at pre-compile  # Input Port and Pin | Optionally specify the common input PortPin connected to both TIMs, e.g. PORT_D_08 or PORT_02_12. If any other (valid) TIM input is required please use the input configuration possibility within the TIM configuration container.
          string rba_Gtm_RdntSigEvln_20_InputTimA [0..1]: multiplicity set at pre-compile, origin=RB:6.1.0:2022-04-30, post-build-variant-multiplicity=true, post-build-variant-value=true, set at pre-compile, regular-expression=TIM[0-9]*_CH[0-7]  # Input TIM A | Optionally specify the used input TIM ressource, e.g. TIM3_CH6
          string rba_Gtm_RdntSigEvln_21_McsChannelA [0..1]: multiplicity set at pre-compile, origin=RB:6.1.0:2022-04-30, post-build-variant-multiplicity=true, post-build-variant-value=true, set at pre-compile, regular-expression=MCS[0-9]*_CH[0-7]  # MCS channel A | Optionally specify the used MCS channel ressource, e.g. MCS3_CH6
          string rba_Gtm_RdntSigEvln_30_InputTimB [0..1]: multiplicity set at pre-compile, origin=RB:6.1.0:2022-04-30, post-build-variant-multiplicity=true, post-build-variant-value=true, set at pre-compile, regular-expression=TIM[0-9]*_CH[0-7]  # Input TIM B | Optionally specify the used input TIM ressource, e.g. TIM3_CH6
          string rba_Gtm_RdntSigEvln_31_McsChannelB [0..1]: multiplicity set at pre-compile, origin=RB:6.1.0:2022-04-30, post-build-variant-multiplicity=true, post-build-variant-value=true, set at pre-compile, regular-expression=MCS[0-9]*_CH[0-7]  # MCS channel B | Optionally specify the used MCS channel ressource, e.g. MCS3_CH6
        container rba_Gtm_Relay [0..*]: multiplicity set at pre-compile, post-build-variant-multiplicity=true  # Relay | Container for a GTM based relay function
          string rba_Gtm_Relay_10_InputTim [0..1]: multiplicity set at pre-compile, origin=RB:1.0.0:2019-07-31, post-build-variant-multiplicity=true, post-build-variant-value=true, set at pre-compile, regular-expression=TIM[0-9]*_CH[0-7]  # Input TIM | Optionally specify the used input TIM ressource, e.g. TIM3_CH6
          string rba_Gtm_Relay_11_FeedbackTim [0..1]: multiplicity set at pre-compile, origin=RB:1.0.0:2019-07-31, post-build-variant-multiplicity=true, post-build-variant-value=true, set at pre-compile, regular-expression=TIM[0-9]*_CH[0-7]  # Feedback TIM | Optionally specify the used feedback TIM ressource, e.g. TIM3_CH7. Not required for PLAIN!
          string rba_Gtm_Relay_12_McsChannel [0..1]: multiplicity set at pre-compile, origin=RB:1.0.0:2019-07-31, post-build-variant-multiplicity=true, post-build-variant-value=true, set at pre-compile, regular-expression=MCS[0-9]*_CH[0-7]  # MCS channel | Optionally specify the used MCS channel ressource, e.g. MCS3_CH6
          string rba_Gtm_Relay_13_OutputAtom [0..1]: multiplicity set at pre-compile, origin=RB:1.0.0:2019-07-31, post-build-variant-multiplicity=true, post-build-variant-value=true, set at pre-compile, regular-expression=ATOM[0-9]*_CH[0-7]  # Output ATOM | Optionally specify the used output ATOM, e.g. ATOM3_CH6
          enumeration rba_Gtm_Relay_1_Type: origin=RB:1.29.0:2017-04-27, post-build-variant-value=true, set at pre-compile  # Relay type | Following types are supported: - plain: simple relay without diagosis support - shunt: relay function with evaluation of a feedback line based on a shunt resistor. In shunt mode the feedback line must have a '0' as idle level and '1' is treated a switch-off level. - follower: relay function with evaluation of a feedback line based on a simple drain/collector sensing line. In this case an additional delay configuaration is required, see tag 'FmDelay' - external: similar to follower but external routing with supervison of GTM.
            RBA_GTM_RELAY_PLAIN_E  # plain
            RBA_GTM_RELAY_SHUNT_E  # shunt
            RBA_GTM_RELAY_FOLLOWER_E  # follower
            RBA_GTM_RELAY_EXTERNAL_E  # external
          integer rba_Gtm_Relay_2_FmDelay [0..1]: multiplicity set at pre-compile, origin=RB:1.29.0:2017-04-27, post-build-variant-multiplicity=true, post-build-variant-value=true, set at pre-compile  # Follower mode delay | Delay time [us] after which the the feedback pin is evaluated. This tag is only relevant for the feedback types 'follower' and 'external'. In feedback mode 'shunt' the trigger input is continuously evaluated if the output is in active state (i.e. switched on). If the output has passive state the feedback line is not evaluated.
          boolean rba_Gtm_Relay_3_OutInvert [0..1]: multiplicity set at pre-compile, origin=RB:1.29.0:2017-04-27, post-build-variant-multiplicity=true, post-build-variant-value=true, set at pre-compile, default-value=false  # Output inversion | Optional inversion of the output signal. Normally a '1' at the input is passed as '1' to the output port. If inversion is activated a '1' at the input will be given as a '0' to the output.
          string rba_Gtm_Relay_4_Input: origin=RB:1.29.0:2017-04-27, post-build-variant-value=true, set at pre-compile, regular-expression=[A-Za-z_][A-Za-z0-9_]*  # Input Port | Specify the input signal port/pin. Example: P<PortIdx>_<PinIdx>. <PortIdx> is the name of the uC Port, <PinIdx> is the name of the uC Pin. Example for a input connection from Port 2 Pin 8 (IFX): PORT_02_08 Example for a input connection from Port A Pin 3 (JDP): PORT_A_03 The signal is connected to a TIM channel, the module and channel need to be configured seperately.
          string rba_Gtm_Relay_5_Output [0..1]: multiplicity set at pre-compile, origin=RB:1.29.0:2017-04-27, post-build-variant-multiplicity=true, post-build-variant-value=true, set at pre-compile, regular-expression=[A-Za-z_][A-Za-z0-9_]*  # Output Port | Specify the output port of the relay, see Input for description.
          string rba_Gtm_Relay_6_FbPort [0..1]: multiplicity set at pre-compile, origin=RB:1.29.0:2017-04-27, post-build-variant-multiplicity=true, post-build-variant-value=true, set at pre-compile, regular-expression=[A-Za-z_][A-Za-z0-9_]*  # Feedback Port | Specify the feedback port of the relay, see Input for description. The feedback port is required for all modes besides 'PLAIN'.
        container rba_Gtm_SyncPwm [0..*]: multiplicity set at pre-compile, post-build-variant-multiplicity=true  # Sync Pwm | Container for a synchronised PWM output
          string rba_Gtm_SyncPwm_1_InpConn: origin=RB:0.1.0:2011-05-09, post-build-variant-value=true, set at pre-compile, regular-expression=[A-Za-z_][A-Za-z0-9_]*  # Sync Input | Specifies to which port/pin on this device this group input is connected to. Configure the connection in following way: - IFX port connection: PORT_02_08 - ST port connection: PORT_A_03 - internal SW trigger without any port connection: 'none'
          enumeration rba_Gtm_SyncPwm_2_Tim: {TIM0, TIM1, TIM2, TIM3, TIM4, TIM5, TIM6, TIM7}, origin=RB:0.1.0:2011-04-19, post-build-variant-value=true, set at pre-compile  # Timer Input Module | Selects the TIM module, effective number of available TIM modules is device dependent.
          enumeration rba_Gtm_SyncPwm_3_TimCh: {CH0, CH1, CH2, CH3, CH4, CH5, CH6, CH7}, origin=RB:0.1.0:2011-04-19, post-build-variant-value=true, set at pre-compile  # TIM Channel | Selects the used TIM channel.
          enumeration rba_Gtm_SyncPwm_4_SyncEdge: origin=RB:0.1.0:2012-03-09, post-build-variant-value=true, set at pre-compile  # Synchronisation edge | Select the edge of the input signal on which the output signal is synchronised on. Attention: Currently only falling edge is supported, configuration setting of this tag is ignored!
            falling  # output is triggered on falling edge
            rising  # output is triggered on rising edge
          string rba_Gtm_SyncPwm_5_Isr [0..1]: multiplicity set at pre-compile, origin=RB:0.5.0:2012-10-11, post-build-variant-multiplicity=true, post-build-variant-value=true, set at pre-compile, max-length=127, min-length=3, regular-expression=[A-Za-z_][A-Za-z0-9_]*  # ISR Name | This Tag specifies the function which shall be called at the specified event (selected by rba_Gtm_SyncPwm_4_SyncEdge setting). This Isr can be enabled / disabled by SW. The function must be of type void - void.
          string rba_Gtm_SyncPwm_6_IsrHeader [0..1]: multiplicity set at pre-compile, origin=RB:0.5.0:2012-10-11, post-build-variant-multiplicity=true, post-build-variant-value=true, set at pre-compile, max-length=127, min-length=3, regular-expression=[A-Za-z_][A-Za-z0-9_]*.h  # ISR Header Name | Header File name to be included when a call-back is configured. Will be included in the approprate c-file in rba_Gtm_SyncPwm. Also serves as call-back header for the SYNC timeout notification.
          boolean rba_Gtm_SyncPwm_7_InputFilter [0..1]: multiplicity set at pre-compile, origin=RB:1.21.1:2015-05-18, post-build-variant-multiplicity=true, post-build-variant-value=true, set at pre-compile  # Enable input filter | Optionally enables a HW filter for the syncronisation input. Filter time is fixed to 2us.
          integer rba_Gtm_SyncPwm_8_SyncTout [0..1]: multiplicity set at pre-compile, origin=RB:1.23.0:2015-10-30, post-build-variant-multiplicity=true, post-build-variant-value=true, set at pre-compile  # Timeout value for SYNC operation | Specify a value for timeouts in operation mode SYNC. Whenever no input event is detected within the specified time a timeout notification is raised (see tag rba_Gtm_SyncPwm_9_ToutIsr). Hint: If the configured timout value is not exactly met due to hardware limitations (especially timer resoultion!), the next possible higher value is chosen. The integer value is specified in [us].
          string rba_Gtm_SyncPwm_9_ToutIsr [0..1]: multiplicity set at pre-compile, origin=RB:1.23.0:2015-10-30, post-build-variant-multiplicity=true, post-build-variant-value=true, set at pre-compile, max-length=127, min-length=3, regular-expression=[A-Za-z_][A-Za-z0-9_]*  # Timeout notification | This notification function is called whenever a SYNC timout occurs. The notification header is the same as given for the standard call-back notification. This tag must be configured if rba_Gtm_SyncPwm_8_SyncTout is configured
          container rba_Gtm_SyncPwm_Out [0..*]: multiplicity set at pre-compile, post-build-variant-multiplicity=true  # Output | SyncPwm output connection container
            string rba_Gtm_SyncPwm_10_McsChannel [0..1]: multiplicity set at pre-compile, origin=RB:1.0.0:2019-07-31, post-build-variant-multiplicity=true, post-build-variant-value=true, set at pre-compile, regular-expression=MCS[0-9]*_CH[0-7]  # MCS channel | Optionally specify the used MCS channel ressource, e.g. MCS3_CH6. If this tag is given a separate MCS configuration is not necessary.
            integer rba_Gtm_SyncPwm_4_Span [0..1]: 1..255, multiplicity set at pre-compile, origin=RB:3.0.0:2014-07-17, post-build-variant-multiplicity=true, post-build-variant-value=true, set at pre-compile, default-value=1  # Output Period Span | One output cycle shall span that many input synchronisation cycles. Is only effective in mode SYNC. Default value is '1'. Maximum value is 255.
            enumeration rba_Gtm_SyncPwm_5_Polarity: origin=RB:0.1.0:2011-04-19, post-build-variant-value=true, set at pre-compile  # Pulse polarity | Selects the polarity of the generated output signal. High: generates a rising edge on the selected trigger event. Low: generates a falling edge on the selected trigger event.
              high  # generate an active high pulse
              low  # generate an active low pulse
            enumeration rba_Gtm_SyncPwm_6_Atom: {ATOM0, ATOM1, ATOM2, ATOM3, ATOM4, ATOM5, ATOM6, ATOM7, ATOM8, ATOM9, ATOM10, ATOM11}, origin=RB:0.1.0:2011-04-19, post-build-variant-value=true, set at pre-compile  # ATOM Number | Selecs the ATOM module, effective number of ATOM modules is device dependent.
            enumeration rba_Gtm_SyncPwm_7_AtomCh: {CH0, CH1, CH2, CH3, CH4, CH5, CH6, CH7}, origin=RB:0.1.0:2011-04-19, post-build-variant-value=true, set at pre-compile  # ATOM Channel Number | Selects the ATOM channel to be configured.
            string rba_Gtm_SyncPwm_8_OutConn [0..1000]: multiplicity set at pre-compile, origin=RB:0.1.0:2011-04-19, post-build-variant-multiplicity=true, post-build-variant-value=true, set at pre-compile, regular-expression=[A-Za-z_][A-Za-z0-9_]*  # Output connection | Specifies to which device and which pin on this device this signal is connected to. Configure the connection in following way: PORT_<PortIdx>_<PinIdx>. <PortIdx> is the name of the uC Port, <PinIdx> is the name of the uC Pin. Example for a input connection from Port 2 Pin 8 (IFX): PORT_02_08 Example for a input connection from Port A Pin 3 (JDP): PORT_A_03
            string rba_Gtm_SyncPwm_9_Isr [0..1]: multiplicity set at pre-compile, origin=RB:0.5.0:2012-10-11, post-build-variant-multiplicity=true, post-build-variant-value=true, set at pre-compile, max-length=127, min-length=3, regular-expression=[A-Za-z_][A-Za-z0-9_]*  # ISR Name | This Tag specifies the function which shall optionally be called at every period edge of the output signal. This Isr can be enabled / disabled by SW. The function must be of type void - void.
            string rba_Gtm_SyncPwm_9a_IsrHeader [0..1]: multiplicity set at pre-compile, origin=RB:0.5.0:2012-10-11, post-build-variant-multiplicity=true, post-build-variant-value=true, set at pre-compile, max-length=127, min-length=3, regular-expression=[A-Za-z_][A-Za-z0-9_]*.h  # ISR Header Name | Header File name to be included when a call-back is configured. Will be included in the approprate c-file in rba_Gtm_SyncPwm
        container rba_Gtm_Timeout [0..*]: multiplicity set at pre-compile, post-build-variant-multiplicity=true  # Timeout Detection | Container for a timout detection input This configuration must be completed by a TIM and a MCS channel configuration. These two containers must be named just like the Timout container. The content of the MCS container must be module and channel. The content of the TIM container must be module, channel and input connection. Hint: An input connection 'AUX_IN_SRC' is not supported by rba_Gtm_Timeout because the appropriate registers are used for internal purposes.
          string rba_Gtm_Timeout_10_InputTim [0..1]: multiplicity set at pre-compile, origin=RB:1.0.0:2019-07-31, post-build-variant-multiplicity=true, post-build-variant-value=true, set at pre-compile, regular-expression=TIM[0-9]*_CH[0-7]  # Input TIM | Optionally specify the used input TIM ressource, e.g. TIM3_CH6
          string rba_Gtm_Timeout_11_InputPort [0..1]: multiplicity set at pre-compile, origin=RB:1.0.0:2019-07-31, post-build-variant-multiplicity=true, post-build-variant-value=true, set at pre-compile, regular-expression=[A-Za-z_][A-Za-z0-9_]*  # Input Port | Optionally specify the input Port connected to the TIM, e.g. PORT_H_08
          string rba_Gtm_Timeout_12_McsChannel [0..1]: multiplicity set at pre-compile, origin=RB:1.0.0:2019-07-31, post-build-variant-multiplicity=true, post-build-variant-value=true, set at pre-compile, regular-expression=MCS[0-9]*_CH[0-7]  # MCS channel | Optionally specify the used MCS channel ressource, e.g. MCS3_CH6
          enumeration rba_Gtm_Timeout_4_Lvl: origin=RB:4.25.0:2015-04-30, post-build-variant-value=true, set at pre-compile  # Timout Level | Select signal input level for which the timeout shall be active.
            low  # timeout is active on low signal levels
            high  # timeout is active on high signal levels
            both  # timeout is active on both signal levels
          integer rba_Gtm_Timeout_5_Tout: origin=RB:4.25.0:2015-04-30, post-build-variant-value=true, set at pre-compile  # Timeout Value | Specify the timeout value in [us]. Whenever an input signal is seen with unchanged level as specified in tag rba_Gtm_Timeout_4_Lvl the timeout notification is raised.
          string rba_Gtm_Timeout_6_Notification: origin=RB:4.25.0:2015-04-30, post-build-variant-value=true, set at pre-compile, max-length=127, min-length=3, regular-expression=[A-Za-z_][A-Za-z0-9_]*  # Notification Name | This Tag specifies the function which shall be called if a timeout event occurs.If no notification is required enter NULL_PTR.
          string rba_Gtm_Timeout_7_NotifHeader: origin=RB:4.25.0:2015-04-30, post-build-variant-value=true, set at pre-compile, max-length=127, min-length=3, regular-expression=[A-Za-z_][A-Za-z0-9_]*(.h)?  # Notification Header | Header File name to be included when a call-back is configured. Will be included in the approprate c-file in rba_Gtm. Plain file name is required without path..If no call-back is required enter NULL_PTR.
    container rba_Gtm_General [0..1]: multiplicity set at pre-compile  # General configuration | General GTM configuration valid for all post build configurations.
      boolean rba_Gtm_ActErrDet [0..1]: multiplicity set at pre-compile, origin=RB:0.1.0:2011-04-19, set at pre-compile, default-value=false  # Development error detection | Enables/disables the detection and notification of development errors. If this parameter is enabled, then extended error checking is performed during runtime; any errors detected by these checks are reported to the Det module. This feature should be switched off in series software. Currently not supported, this setting has no effect!
      integer rba_Gtm_BrcChannelStartVal [0..1]: 0..11, multiplicity set at pre-compile, origin=RB:1.1.0:2020-02-12, set at pre-compile, default-value=0  # BRC channel auto select start value | Start value for BRC channel auto selection. Defaults to 0. Should only be changed in IPP environments to avoid collisions. Background. BRC channels aure automatically distributed starting with channel 0. As in IPP environments all parties are independent this would lead to collisions if more than one party is using BRC channels. To avoid this the integrator must ensure that all BRC channels in all IPP environments have unique indices by distributing the auto-select start values accordingly. The BRC report file shows all distributed channels.
      integer rba_Gtm_BrcOutStartVal [0..1]: 0..21, multiplicity set at pre-compile, origin=RB:1.1.0:2020-02-12, set at pre-compile, default-value=0  # BRC output channel auto select start value | Start value for BRC output channel auto selection. Defaults to 0. Should only be changed in IPP environments to avoid collisions. See tag rba_Gtm_BrcChannelStartVal for more information.
      enumeration rba_Gtm_ClsClkDefault [0..1]: multiplicity set at pre-compile, origin=RB:8.1.0:2023-04-30, set at pre-compile, default-value=BIT2  # Default Cluster Clock Divider | The standard cluster cloick divider is 2 to get a 100MHz cluster clock by default. However, in IPP environments all unused clusters should be disabeled and so the default value can be changed to 'disable cluster'
        BIT0  # disable cluster
        BIT2  # DIV_2
      boolean rba_Gtm_ForcInt [0..1]: multiplicity set at pre-compile, origin=RB:0.1.0:2011-04-19, set at pre-compile, default-value=false  # FORCINT handling, disable RF_PROT bit | Set this option to TRUE if the GTM_CTRL.RF_PROT Bit shall be disabled. In this case all GTM interrupts can be triggered directly by SW in all FORCINT registers without disabling and re-enabling the RF_PROT bit each time.
      string rba_Gtm_McsAsmPath: multiplicity set at pre-compile, origin=RB:1.1.0:2019-10-31, set at pre-compile  # MCS Assembler Path | Absolute path to the MCS assembly tool, e.g. C:\toolbase\greenhills_mcs\assem_201517_2fp\asmcs.exe
      enumeration rba_Gtm_McsAsmTool: multiplicity set at pre-compile, origin=RB:1.1.0:2019-10-31, set at pre-compile  # MCS Assembler Tool
        GreenHills  # GreenHills MCS Assembler
        asm_mcs
      boolean rba_Gtm_McsDataCompression [0..1]: multiplicity set at pre-compile, origin=RB:1.28.0:2017-01-27, set at pre-compile, default-value=false  # MCS Data Compression | Setting this option to 'true' will activate compression of MCS data in Flash memory. It will reduce the needed Flash size but as the data needs to be de-compressed in the function rba_Gtm_Init() the runtime of this function will likely be increased. The used compression algorithm is RLE0. Activcating this feature has influence on the significance of the return parameters of the function rba_Gtm_GetMcsFlashAdr(), see rba_Gtm_SW_Design_Doc.ppt for details.
      boolean rba_Gtm_McsFlashArrayOptimisation [0..1]: multiplicity set at pre-compile, origin=RB:1.32.0:2018-01-19, set at pre-compile, default-value=false  # MCS Flash Array Optimisation | Identify identical MCS flash arrays and store them only once. This feature can be used to reduce flash consumption of MCS RAM initialisation data. However, as checksum calculations are used to identify identical arrays there is a inherent remaining risk that arrays are identified as idetical although they are not. Use at own risk.
      boolean rba_Gtm_McsRamArrMemMap [0..1]: multiplicity set at pre-compile, origin=RB:7.0.0:2022-07-28, set at pre-compile, default-value=false  # Separate MemMap section for MCS RAM arrays | Set this option to TRUE to generate separate MemMap section for each MCS RAM array. Without this option all arrays are generated as SEC_CONST_32
      boolean rba_Gtm_MskWrRsp [0..1]: multiplicity set at pre-compile, origin=RB:3.2.0:2014-10-15, set at pre-compile, default-value=false  # Activate Masked Write Response | Set this option to TRUE if the GTM_BRIDGE_MODE.MSK_WR_RSP Bit shall be set during GTM initialisation. In this case all GTM error and status information (AEI_STATUS) will not be passed to the controller.
      boolean rba_Gtm_VersionInfoApi [0..1]: multiplicity set at pre-compile, origin=RB:0.1.0:2011-04-19, set at pre-compile, default-value=false  # Version information API | Enables/disables the GetVersionInfo() API. This functionality can be used e.g. for providing version information to test equipment. --> This feature is currently not supported! <--
      container rba_Gtm_Cmu [0..1]: multiplicity set at pre-compile  # Clock Management Unit | Container for CMU (Clock Management Unit) configuration
        enumeration rba_Gtm_Cmu_01_SysClock [0..1]: multiplicity set at pre-compile, origin=RB:0.1.0:2011-04-19, set at pre-compile, default-value=auto  # Gtm Sys Clock Input | Sys clock input value. There is a limited number of configuration options, partly depending on device and machine type. Selection of 'auto' will automatically select the correct value if possible. Important: This is not a configuration option! This tag is used to tell the script about the actual GTM clock frequency provided by the Microcontroller.
          MHz_100  # 100 MHz
          MHz_200  # 200 MHz
          auto
        enumeration rba_Gtm_Cmu_02_GlobalClock [0..1]: multiplicity set at pre-compile, origin=RB:0.1.0:2011-04-19, set at pre-compile, default-value=MHz_100  # Cmu Global Clock | Specifies the CMU global clock frequency (GCLK). Can either be 40MHz, 80Mhz, 100MHz or 200MHz but must be smaller than or equal to the Cluster 0 clock setting! Default value is 100MHz.
          MHz_40  # 40 MHz
          MHz_80  # 80 MHz
          MHz_100  # 100 MHz
          MHz_200  # 200 MHz
        enumeration rba_Gtm_Cmu_03_FxClkSrc [0..1]: {CmuClk_0, CmuClk_1, CmuClk_2, CmuClk_3, CmuClk_4, CmuClk_5, CmuClk_6, CmuClk_7, Cmu_GClk}, multiplicity set at pre-compile, origin=RB:0.5.0:2012-10-16, set at pre-compile, default-value=CmuClk_0  # FxClk source | Select one of the eight CMU clock bus lines or CMU GCLK as clock source for the five FxClk lines. Defrault value is CmuClk_0 @ 50 MHz. Deviations from this configuration should be handled with care!
        string rba_Gtm_Cmu_10_Clk0 [0..1]: multiplicity set at pre-compile, origin=RB:4.23.0:2015-09-30, set at pre-compile, default-value=50MHz, regular-expression=[0-9]*[A-Za-z0-9_ \,]*  # CMU Clock 0 | CMU_CLK0 defaults to 50MHz if not configured. For configuration options see CMU_CLK3 description
        string rba_Gtm_Cmu_11_Clk1 [0..1]: multiplicity set at pre-compile, origin=RB:0.1.0:2011-04-19, set at pre-compile, default-value=20MHz, regular-expression=[0-9]*[A-Za-z0-9_ \,]*  # CMU Clock 1 | CMU_CLK1 defaults to 20MHz if not configured. For configuration options see CMU_CLK3 description
        string rba_Gtm_Cmu_12_Clk2 [0..1]: multiplicity set at pre-compile, origin=RB:4.23.0:2015-09-30, set at pre-compile, default-value=2.5MHz, regular-expression=[0-9]*[A-Za-z0-9_ \,]*  # CMU Clock 2 | CMU_CLK2 defaults to 2,5MHz if not configured. For configuration options see CMU_CLK3 description
        string rba_Gtm_Cmu_13_Clk3 [0..1]: multiplicity set at pre-compile, origin=RB:0.1.0:2011-04-19, set at pre-compile, regular-expression=[0-9]*[A-Za-z0-9_ \,]*  # CMU Clock 3 | CMU_CLK3 configuration: 1) DIV_1000 for a divider of 1000 (based on global clock, see rba_Gtm_Cmu_02_GlobalClock) 2) 610 Hz for a frequency of 610 Hz (most close value is chosen if there is no exact match). Possible units are <Hz>, <kHz> and <MHz>.
        string rba_Gtm_Cmu_14_Clk4 [0..1]: multiplicity set at pre-compile, origin=RB:0.1.0:2011-04-19, set at pre-compile, regular-expression=[0-9]*[A-Za-z0-9_ \,]*  # CMU Clock 4 | Cmu Clock 4 setting, see Clock3 description.
        string rba_Gtm_Cmu_15_Clk5 [0..1]: multiplicity set at pre-compile, origin=RB:0.1.0:2011-04-19, set at pre-compile, regular-expression=[0-9]*[A-Za-z0-9_ \,]*  # CMU Clock 5 | Cmu Clock 5 setting, see Clock3 description.
        string rba_Gtm_Cmu_16_Clk6 [0..1]: multiplicity set at pre-compile, origin=RB:0.1.0:2011-04-19, set at pre-compile, regular-expression=[A-Z0-9]*[A-Za-z0-9_ \,]*  # CMU Clock 6 | Cmu Clock 6 setting, see Clock3 description. Additionally following options are available only for this clock line: 1) SUB_INC2 to connect to the DPLL signal SUB_INC2 2) SUB_INC1c to connect to the DPLL signal SUB_INC1c 3) CCM0_CMU_CLK6 to connect to this signal of CCM0
        string rba_Gtm_Cmu_17_Clk7 [0..1]: multiplicity set at pre-compile, origin=RB:0.1.0:2011-04-19, set at pre-compile, regular-expression=[A-Z0-9]*[A-Za-z0-9_ \,]*  # CMU Clock 7 | Cmu Clock 7 setting, see Clock3 description. Additionally following options are available only for thic clock line: 1) SUB_INC1 to connect to the DPLL signal SUB_INC1 2) SUB_INC2c to connect to the DPLL signal SUB_INC2c
        enumeration rba_Gtm_Cmu_18_Clk8 [0..1]: {ECLK0, CLS0_CLK}, multiplicity set at pre-compile, origin=RB:4.29.0:2017-04-28, set at pre-compile  # CMU Clock 8 | This clock can either be clocked by CLS0_CLK or by ECLK0
      container rba_Gtm_Tbu [0..1]: multiplicity set at pre-compile  # Time Base Unit | Container for TBU (Time Base Unit) configuration
        enumeration rba_Gtm_Tbu_0a_Ts0Src [0..1]: multiplicity set at pre-compile, origin=RB:0.1.0:2011-04-19, set at pre-compile, default-value=CMU_CLK1  # TBU CH0 clock source | Select clock source for TBU_CH0_BASE.
          CMU_CLK{0..7}  # CMU Clock {0..7}
        enumeration rba_Gtm_Tbu_0b_Ts0Mode [0..1]: multiplicity set at pre-compile, origin=RB:0.1.0:2011-04-19, set at pre-compile, default-value=BIT1  # TBU TS0 resolution | Configure TBU_TS0 signal resolution. The resolution of the TBU_TS0 signal can be selected between the lower 24 bits of TBU_CH0_BASE or the upper 24 bit of TBU_CH0_BASE. TBU_TS0 is used in GTM as e.g. capture source for TIM input events.
          BIT0  # lower bits 0 to 23
          BIT1  # upper bits 3 to 26
        boolean rba_Gtm_Tbu_0c_Ts0Enbl [0..1]: multiplicity set at pre-compile, origin=RB:2.1.0:2014-02-13, set at pre-compile, default-value=true  # TBU CH0 enable | Select if TBU_TS0 shall be enabled in rba_Gtm_Init(). Should normally be set to TRUE for regular operation.
        enumeration rba_Gtm_Tbu_1a_Ts1Src [0..1]: multiplicity set at pre-compile, origin=RB:0.1.0:2011-04-19, set at pre-compile  # TBU CH1 clock source | Select clock source for TBU_CH1_BASE.
          CMU_CLK{0..7}  # CMU Clock {0..7}
        enumeration rba_Gtm_Tbu_1b_Ts1Mode [0..1]: multiplicity set at pre-compile, origin=RB:0.1.0:2011-04-19, set at pre-compile  # TBU CH1 mode | Configure TS1 channel mode. Please note: in forward/backward mode the setting of rba_Gtm_Tbu_1a_Ts1Src has no effect and is ignored by HW (see manual)!
          BIT0  # Free Running Counter
          BIT1  # Forward Backward Counter
        boolean rba_Gtm_Tbu_1c_Ts1Enbl [0..1]: multiplicity set at pre-compile, origin=RB:2.1.0:2014-02-13, set at pre-compile, default-value=false  # TBU CH1 enable | Select if TBU_TS1 shall be enabled in rba_Gtm_Init(). This parameter should be set to FALSE in PS-EC environments because the Epm package fully controls TBU_TS1.
        enumeration rba_Gtm_Tbu_2a_Ts2Src [0..1]: multiplicity set at pre-compile, origin=RB:0.1.0:2011-04-19, set at pre-compile  # TBU CH2 clock source | Select clock source for TBU TS2. Also configure Ts2Mode, otherwise the configuration is ignored.
          CMU_CLK{0..7}  # CMU Clock {0..7}
        enumeration rba_Gtm_Tbu_2b_Ts2Mode [0..1]: multiplicity set at pre-compile, origin=RB:0.1.0:2011-04-19, set at pre-compile  # TBU CH2 mode | Configure TS2 channel mode. This item is only evaluated if rba_Gtm_Tbu_2a_Ts2Src is configured.
          BIT0  # Free Running Counter
          BIT1  # Forward Backward Counter
        boolean rba_Gtm_Tbu_2c_Ts2Enbl [0..1]: multiplicity set at pre-compile, origin=RB:2.1.0:2014-02-13, set at pre-compile, default-value=false  # TBU CH2 enable | Select TRUE if TBU_TS2 shall be enabled in rba_Gtm_Init().
        enumeration rba_Gtm_Tbu_3a_Ts3Src [0..1]: multiplicity set at pre-compile, origin=RB:4.23.0:2015-08-30, set at pre-compile  # TBU CH3 channel selector | Select capture source for TBU TS3
          BIT0  # TBU_TS1
          BIT1  # TBU_TS2
        integer rba_Gtm_Tbu_3c_Ts3BaseMark [0..1]: multiplicity set at pre-compile, origin=RB:4.23.0:2015-08-30, set at pre-compile  # TBU CH3 Base Mark | Configure the initialisation value for the TBU_CH3_BASE_MARK register. Valid values are [0 .. MAXUINT24]
        boolean rba_Gtm_Tbu_3c_Ts3Enbl [0..1]: multiplicity set at pre-compile, origin=RB:4.23.0:2015-08-30, set at pre-compile, default-value=false  # TBU CH3 enable | Select TRUE if TBU_TS3 shall be enabled in rba_Gtm_Init()
