AUTOSAR XML (schema 00051)
package /ETAS_Project/EcucModuleConfigurationValuess
  module config BswM: implementation-config-variant=VARIANT-PRE-COMPILE
    BswMConfig
      BswMArbitration
        6 x BswMLogicalExpression:
          BswM_LE_InitBlockTwo: BswMArgumentRef=BswM_MC_BswM_StartupOne
          BswM_LE_InitBlockReadAllComplete: BswMLogicalOperator=BSWM_AND, BswMArgumentRef=BswM_MC_BswM_StartupTwo, BswMArgumentRef=BswM_MC_BswModules_ReadAllComplete
          BswM_LE_StartCom: BswMArgumentRef=BswM_MC_BswM_Run
          BswM_LE_Run: BswMLogicalOperator=BSWM_AND, BswMArgumentRef=BswM_MC_BswM_AppRun, BswMArgumentRef=BswM_MC_TestTask_StopDemand
          BswM_LE_Shutdown: BswMArgumentRef=BswM_MC_BswM_PostRun
          BswM_LE_GoDown: BswMLogicalOperator=BSWM_AND, BswMArgumentRef=BswM_MC_BswM_PrepShutdown, BswMArgumentRef=BswM_MC_BswModules_WriteAllComplete
        7 x BswMModeCondition, all with BswMConditionType=BSWM_EQUALS:
          BswM_MC_BswM_StartupOne: BswMConditionMode=BswM_MRP_BswM_MDG
            BswM_MC_Val (BswMConditionValue)
              BswMModeDeclaration: BswMModeValueRef=ECU_STARTUP_ONE
          BswM_MC_BswM_StartupTwo: BswMConditionMode=BswM_MRP_BswM_MDG
            BswM_MC_Val (BswMConditionValue)
              BswMModeDeclaration: BswMModeValueRef=ECU_STARTUP_TWO
          BswM_MC_BswM_Run: BswMConditionMode=BswM_MRP_BswM_MDG
            BswM_MC_Val (BswMConditionValue)
              BswMModeDeclaration: BswMModeValueRef=ECU_RUN
          BswM_MC_BswM_AppRun: BswMConditionMode=BswM_MRP_BswM_MDG
            BswM_MC_Val (BswMConditionValue)
              BswMModeDeclaration: BswMModeValueRef=ECU_APP_RUN
          BswM_MC_BswM_PostRun: BswMConditionMode=BswM_MRP_BswM_MDG
            BswM_MC_Val (BswMConditionValue)
              BswMModeDeclaration: BswMModeValueRef=ECU_APP_POST_RUN
          BswM_MC_BswM_PrepShutdown: BswMConditionMode=BswM_MRP_BswM_MDG
            BswM_MC_Val (BswMConditionValue)
              BswMModeDeclaration: BswMModeValueRef=(unset)
          BswM_MC_TestTask_StopDemand: BswMConditionMode=BswM_MRP_ApplicationRequestPort
            BswMConditionValue
              BswMBswMode: BswMBswRequestedMode=1
        BswM_MRP_BswM_MDG (BswMModeRequestPort): BswMRequestProcessing=BSWM_IMMEDIATE
          BswMModeRequestSource
            BswMBswModeNotification: BswMRbBswModeDeclarationGroup=/AUTOSAR_BswM/ModeDeclarationGroups/MDG_ECUM_STATE
        BswM_MRP_ApplicationRequestPort (BswMModeRequestPort): BswMRequestProcessing=BSWM_DEFERRED
          BswMModeRequestSource
            BswMGenericRequest: BswMModeRequesterId=0, BswMRbRequestType=SWC, BswMRequestedModeMax=3
        6 x BswMRule, all with BswMRuleInitState=BSWM_FALSE:
          BswM_AR_InitBlockTwo: BswMRuleTrueActionList=BswM_AL_BswModules_InitListTwo, BswMRuleExpressionRef=BswM_LE_StartupOne
          BswM_AR_ReadAllComplete: BswMRuleExpressionRef=BswM_LE_InitBlockReadAllComplete, BswMRuleTrueActionList=BswM_AL_BswModules_InitListReadAll
          BswM_AR_StartCom: BswMRuleExpressionRef=BswM_LE_StartCom, BswMRuleTrueActionList=BswM_AL_FullComm_AllBus
          BswM_AR_PostRun: BswMRuleExpressionRef=BswM_LE_Run, BswMRuleTrueActionList=BswM_AL_StopComm_AllBus
          BswM_AR_Shutdown: BswMRuleExpressionRef=BswM_LE_Shutdown, BswMRuleTrueActionList=BswM_AL_Shutdown
          BswM_AR_WriteAllComplete: BswMRuleExpressionRef=BswM_LE_GoDown, BswMRuleTrueActionList=BswM_AL_GoDown
        BswM_MRP_SwcModeRequest (BswMModeRequestPort): BswMRequestProcessing=BSWM_DEFERRED
          BswMModeRequestSource
            BswMSwcModeNotification: BswMSwcModeNotificationModeDeclarationGroupPrototypeRef=MDGP_MSI_ShutDown
        BswM_LE_SwcModeRequest (BswMLogicalExpression): BswMArgumentRef=BswM_MC_SwcModeRequest
        BswM_MC_SwcModeRequest (BswMModeCondition): BswMConditionType=BSWM_EQUALS, BswMConditionMode=BswM_MRP_SwcModeRequest
          BswMConditionValue
            BswMModeDeclaration: BswMModeValueRef=SHUT_DOWN
        BswM_AR_SwcModeRequest (BswMRule): BswMRuleInitState=BSWM_FALSE, BswMRuleExpressionRef=BswM_LE_SwcModeRequest, BswMRuleTrueActionList=BswM_AL_ShutdownAndReset
        BswM_MRP_NvmReadAllComplete (BswMModeRequestPort): BswMRequestProcessing=BSWM_IMMEDIATE
          BswMModeRequestSource_0 (BswMModeRequestSource)
            BswMNvMJobModeIndication_0 (BswMNvMJobModeIndication): BswMNvmService=NvmReadAll
        BswM_MC_BswModules_ReadAllComplete (BswMModeCondition): BswMConditionType=BSWM_EQUALS_NOT, BswMConditionMode=BswM_MRP_NvmReadAllComplete
          BswMConditionValue
            BswMBswMode: BswMBswRequestedMode=NVM_REQ_PENDING
        BswM_MRP_NvmWriteAllComplete (BswMModeRequestPort): BswMRequestProcessing=BSWM_IMMEDIATE
          BswMModeRequestSource
            BswMNvMJobModeIndication: BswMNvmService=NvmWriteAll
        BswM_MC_BswModules_WriteAllComplete (BswMModeCondition): BswMConditionType=BSWM_EQUALS_NOT, BswMConditionMode=BswM_MRP_NvmWriteAllComplete
          BswMConditionValue
            BswMBswMode: BswMBswRequestedMode=NVM_REQ_PENDING
        BswM_LE_StartupOne (BswMLogicalExpression): BswMArgumentRef=MC_R_BswM_AR_InitBlockTwo_0
        MC_R_BswM_AR_InitBlockTwo_0 (BswMModeCondition): BswMConditionType=BSWM_EQUALS, BswMConditionMode=MRP_R_BswM_AR_InitBlockTwo_0
          BswMConditionValue
            BswMModeDeclaration: BswMModeValueRef=ECU_STARTUP_ONE
        MRP_R_BswM_AR_InitBlockTwo_0 (BswMModeRequestPort): BswMRequestProcessing=BSWM_DEFERRED
          BswMModeRequestSource
            BswMBswModeNotification: BswMRbBswModeDeclarationGroup=/AUTOSAR_BswM/ModeDeclarationGroups/MDG_ECUM_STATE
      BswMDataTypeMappingSets: BswMDataTypeMappingSetRef=ECUM_STATE_Mapping, BswMDataTypeMappingSetRef=MG_Shutdown_Mapping
      BswMModeControl
        21 x BswMAction:
          BswM_AI_ComMReqFullComm_User0
            BswMAvailableActions
              BswMComMModeSwitch: BswMComMRequestedMode=BSWM_COMM_FULL_COMMUNICATION, BswMComMUserRef=ComMUser_Can_Network_Channel_Can_Network
          BswM_AI_ComMReqNoComm_User0
            BswMAvailableActions
              BswMComMModeSwitch: BswMComMRequestedMode=BSWM_COMM_NO_COMMUNICATION, BswMComMUserRef=ComMUser_Can_Network_Channel_Can_Network
          BswM_AI_ComMCommAllowed_Can0
            BswMAvailableActions
              BswMComMAllowCom: BswMComAllowed=true, BswMComMAllowChannelRef=Can_Network_Channel_Can_Network
          BswM_AI_ComMCommNotAllowed_Can0
            BswMAvailableActions
              BswMComMAllowCom: BswMComAllowed=false, BswMComMAllowChannelRef=Can_Network_Channel_Can_Network
          BswM_AI_StartPduGroup_All
            BswMAvailableActions
              BswMPduGroupSwitch: BswMPduGroupSwitchReinit=false, BswMEnabledPduGroupRef=ComIPduGroup_Tx, BswMEnabledPduGroupRef=ComIPduGroup_Rx
          BswM_AI_StopPduGroup_All
            BswMAvailableActions
              BswMPduGroupSwitch: BswMPduGroupSwitchReinit=false, BswMDisabledPduGroupRef=ComIPduGroup_Rx, BswMDisabledPduGroupRef=ComIPduGroup_Tx
          BswM_AI_CanIfInit
            BswMAvailableActions
              BswMUserCallout: BswMUserCalloutFunction=CanIf_Init(NULL_PTR)
          BswM_AI_CanInit
            BswMAvailableActions
              BswMUserCallout: BswMUserCalloutFunction=Can_Init(&Can_ConfigData)
          BswM_AI_ComMInit
            BswMAvailableActions
              BswMUserCallout: BswMUserCalloutFunction=ComM_Init(NULL_PTR)
          BswM_AI_CanSmInit
            BswMAvailableActions
              BswMUserCallout: BswMUserCalloutFunction=CanSM_Init(NULL_PTR)
          BswM_AI_ComInit
            BswMAvailableActions
              BswMUserCallout: BswMUserCalloutFunction=Com_Init(NULL_PTR)
          BswM_AI_PduRInit
            BswMAvailableActions
              BswMUserCallout: BswMUserCalloutFunction=PduR_Init(&PduR_Config)
          BswM_AI_RteStop
            BswMAvailableActions
              BswM_UserCallout (BswMUserCallout): BswMUserCalloutFunction=Rte_Stop()
          BswM_AI_RteTimerStart
            BswMAvailableActions
              BswMUserCallout: BswMUserCalloutFunction=Rte_Start()
          BswM_AI_ComMDeInit
            BswMAvailableActions
              BswM_UserCallout (BswMUserCallout): BswMUserCalloutFunction=ComM_DeInit()
          BswM_AI_GoDown
            BswMAvailableActions
              BswM_UserCallout (BswMUserCallout): BswMUserCalloutFunction=EcuM_GoDown(0)
          BswM_AI_BswMSwitchStartupTwo
            BswMAvailableActions
              BswMSchMSwitch: BswMSchMSwitchedMode=ECU_STARTUP_TWO
          BswM_AI_BswMSwitchRun
            BswMAvailableActions
              BswMSchMSwitch: BswMSchMSwitchedMode=ECU_RUN
          BswM_AI_BswMSwitchAppRun
            BswMAvailableActions
              BswMSchMSwitch: BswMSchMSwitchedMode=ECU_APP_RUN, BswMSchMModeDeclarationGroupRef=MDG_ECUM_STATE
          BswM_AI_BswMSwitchPrepShutdown
            BswMAvailableActions
              BswMSchMSwitch: BswMSchMSwitchedMode=(unset)
          BswM_AI_BswMSwitchPostRun
            BswMAvailableActions
              BswMSchMSwitch: BswMSchMSwitchedMode=ECU_APP_POST_RUN
        7 x BswMActionList:
          BswM_AL_BswModules_InitListTwo: BswMActionListExecution=BSWM_CONDITION
            8 x BswMActionListItem:
              BswM_ALI_BswMStartupTwo: BswMAbortOnFail=false, BswMActionListItemIndex=5, BswMActionListItemRef=BswM_AI_BswMSwitchStartupTwo
              BswM_ALI_FlsInit: BswMAbortOnFail=0, BswMActionListItemIndex=1, BswMActionListItemRef=BswM_AI_FlsInit
              BswM_ALI_FeeInit: BswMAbortOnFail=0, BswMActionListItemIndex=2, BswMActionListItemRef=BswM_AI_FeeInit
              BswM_ALI_FeeRbEndInit: BswMAbortOnFail=0, BswMActionListItemIndex=3, BswMActionListItemRef=BswM_AI_FeeRbEndInit
              BswM_ALI_NvmInit: BswMAbortOnFail=0, BswMActionListItemIndex=4, BswMActionListItemRef=BswM_AI_NvMInit
              BswM_ALI_NvMReadAll: BswMAbortOnFail=0, BswMActionListItemIndex=6, BswMActionListItemRef=BswM_AI_NvMReadAll
              BswM_ALI_WdgMInit: BswMAbortOnFail=0, BswMActionListItemIndex=7, BswMActionListItemRef=BswM_AI_WdgMInit
              BswMActionListItem_0: BswMAbortOnFail=0, BswMReportFailRuntimeErrorId=128, BswMActionListItemIndex=0, BswMActionListItemRef=BswM_AI_DetInit
          BswM_AL_BswModules_InitListReadAll: BswMActionListExecution=BSWM_TRIGGER
            13 x BswMActionListItem:
              BswM_ALI_CanInit: BswMAbortOnFail=0, BswMActionListItemIndex=0, BswMActionListItemRef=BswM_AI_CanInit
              BswM_ALI_CanIfInit: BswMAbortOnFail=0, BswMActionListItemIndex=1, BswMActionListItemRef=BswM_AI_CanIfInit
              BswM_ALI_CanSmInit: BswMAbortOnFail=0, BswMActionListItemIndex=2, BswMActionListItemRef=BswM_AI_CanSmInit
              BswM_ALI_PduRInit: BswMAbortOnFail=0, BswMActionListItemIndex=3, BswMActionListItemRef=BswM_AI_PduRInit
              BswM_ALI_ComInit: BswMAbortOnFail=0, BswMActionListItemIndex=4, BswMActionListItemRef=BswM_AI_ComInit
              BswM_ALI_ComMInit: BswMAbortOnFail=0, BswMActionListItemIndex=5, BswMActionListItemRef=BswM_AI_ComMInit
              BswM_ALI_RteTimerStart: BswMAbortOnFail=true, BswMActionListItemIndex=6, BswMActionListItemRef=BswM_AI_RteTimerStart
              BswM_ALI_BswMRun: BswMAbortOnFail=0, BswMActionListItemIndex=7, BswMActionListItemRef=BswM_AI_BswMSwitchRun
              BswM_ALI_CanTpInit: BswMAbortOnFail=0, BswMActionListItemIndex=8, BswMActionListItemRef=BswM_AI_CanTpInit
              BswM_ALI_FimInit: BswMAbortOnFail=0, BswMActionListItemIndex=9, BswMActionListItemRef=BswM_AI_FimInit
              BswM_ALI_DcmInit: BswMAbortOnFail=0, BswMActionListItemIndex=10, BswMActionListItemRef=BswM_AI_DcmInit
              BswM_ALI_DemInit: BswMAbortOnFail=0, BswMActionListItemIndex=11, BswMActionListItemRef=BswM_AI_Dem_Init
              BswM_ALI_XcpInit: BswMAbortOnFail=0, BswMActionListItemIndex=12, BswMActionListItemRef=BswM_AI_XcpInit
          BswM_AL_FullComm_AllBus: BswMActionListExecution=BSWM_TRIGGER
            4 x BswMActionListItem, all with BswMAbortOnFail=false:
              BswM_ALI_StartPdu: BswMActionListItemIndex=0, BswMActionListItemRef=BswM_AI_StartPduGroup_All
              BswM_ALI_AllowComm_Can0: BswMActionListItemIndex=1, BswMActionListItemRef=BswM_AI_ComMCommAllowed_Can0
              BswM_ALI_RequestComMode: BswMActionListItemIndex=2, BswMActionListItemRef=BswM_AI_ComMReqFullComm_User0
              BswM_ALI_BswMAppRun: BswMActionListItemIndex=3, BswMActionListItemRef=BswM_AI_BswMSwitchAppRun
          BswM_AL_StopComm_AllBus: BswMActionListExecution=BSWM_TRIGGER
            4 x BswMActionListItem, all with BswMAbortOnFail=false:
              BswM_ALI_RequestNoComMode: BswMActionListItemIndex=0, BswMActionListItemRef=BswM_AI_ComMReqNoComm_User0
              BswM_ALI_DisAllowComm_Can0: BswMActionListItemIndex=1, BswMActionListItemRef=BswM_AI_ComMCommNotAllowed_Can0
              BswM_ALI_StopPdu: BswMActionListItemIndex=2, BswMActionListItemRef=BswM_AI_StopPduGroup_All
              BswM_ALI_BswMPostRun: BswMActionListItemIndex=3, BswMActionListItemRef=BswM_AI_BswMSwitchPostRun
          BswM_AL_Shutdown: BswMActionListExecution=BSWM_TRIGGER
            5 x BswMActionListItem:
              BswM_ALI_RteStop: BswMAbortOnFail=0, BswMActionListItemIndex=0, BswMActionListItemRef=BswM_AI_RteStop
              BswM_ALI_ComMDeInit: BswMAbortOnFail=0, BswMActionListItemIndex=1, BswMActionListItemRef=BswM_AI_ComMDeInit
              BswM_ALI_BswMPrepShutdown: BswMAbortOnFail=0, BswMActionListItemIndex=2, BswMActionListItemRef=BswM_AI_BswMSwitchPrepShutdown
              BswM_ALI_NvMWriteAll: BswMActionListItemIndex=3, BswMAbortOnFail=false, BswMActionListItemRef=BswM_AI_NvMWriteAll
              BswM_ALI_DemShutdown: BswMAbortOnFail=0, BswMActionListItemIndex=4, BswMActionListItemRef=BswM_AI_DemShutdown
          BswM_AL_GoDown: BswMActionListExecution=BSWM_TRIGGER
            BswM_ALI_GoDown (BswMActionListItem): BswMAbortOnFail=false, BswMActionListItemIndex=0, BswMActionListItemRef=BswM_AI_GoDown
          BswM_AL_ShutdownAndReset: BswMActionListExecution=BSWM_TRIGGER
            5 x BswMActionListItem:
              BswM_ALI_RteStop: BswMAbortOnFail=0, BswMActionListItemIndex=0, BswMActionListItemRef=BswM_AI_RteStop
              BswM_ALI_ComMDeinit: BswMAbortOnFail=0, BswMActionListItemIndex=1, BswMActionListItemRef=BswM_AI_ComMDeInit
              BswM_ALI_BswMPrepShutdown: BswMAbortOnFail=0, BswMActionListItemIndex=2, BswMActionListItemRef=BswM_AI_BswMSwitchPrepShutdown
              BswM_ALI_GoDown: BswMAbortOnFail=0, BswMActionListItemIndex=4, BswMActionListItemRef=BswM_AL_GoDown
              BswM_ALI_NvMWriteAll: BswMActionListItemIndex=3, BswMAbortOnFail=false, BswMActionListItemRef=BswM_AI_NvMWriteAll
        14 x BswMAction:
          BswM_AI_FlsInit
            BswMAvailableActions
              BswMUserCallout: BswMUserCalloutFunction=Fls_Init(NULL_PTR)
          BswM_AI_FeeInit
            BswMAvailableActions
              BswMUserCallout: BswMUserCalloutFunction=Fee_Init(NULL_PTR)
          BswM_AI_NvMInit
            BswMAvailableActions
              BswMUserCallout: BswMUserCalloutFunction=NvM_Init()
          BswM_AI_FeeRbEndInit
            BswMAvailableActions
              BswMUserCallout: BswMUserCalloutFunction=Fee_Rb_EndInit()
          BswM_AI_NvMReadAll
            BswMAvailableActions
              BswMUserCallout: BswMUserCalloutFunction=EcuM_User_NvM_ReadAll()
          BswM_AI_NvMWriteAll
            BswMAvailableActions
              BswMUserCallout: BswMUserCalloutFunction=IC_BswM_NvM_WriteAll()
          BswM_AI_CanTpInit
            BswMAvailableActions_0 (BswMAvailableActions)
              BswMUserCallout: BswMUserCalloutFunction=CanTp_Init(NULL_PTR)
          BswM_AI_FimInit
            BswMAvailableActions_0 (BswMAvailableActions)
              BswMUserCallout: BswMUserCalloutFunction=FiM_Init(&FiM_Config)
          BswM_AI_DcmInit
            BswMAvailableActions_0 (BswMAvailableActions)
              BswMUserCallout: BswMUserCalloutFunction=Dcm_Init(NULL_PTR)
          BswM_AI_Dem_Init
            BswMAvailableActions_0 (BswMAvailableActions)
              BswMUserCallout: BswMUserCalloutFunction=Dem_Init()
          BswM_AI_DemShutdown
            BswMAvailableActions_0 (BswMAvailableActions)
              BswMUserCallout: BswMUserCalloutFunction=Dem_Shutdown()
          BswM_AI_WdgMInit
            BswMAvailableActions_0 (BswMAvailableActions)
              BswMUserCallout: BswMUserCalloutFunction=WdgM_Init(NULL_PTR)
          BswM_AI_XcpInit
            BswMAvailableActions
              BswMUserCallout: BswMUserCalloutFunction=Xcp_Init(NULL_PTR)
          BswM_AI_DetInit
            BswMAvailableActions_0 (BswMAvailableActions)
              BswMUserCallout: BswMUserCalloutFunction=Det_Init(NULL_PTR)
    BswMGeneral:
      BswMCanSMEnabled = true
      BswMComMEnabled = true
      BswMDcmEnabled = true
      BswMDevErrorDetect = false
      BswMEcuMEnabled = true
      BswMEthSMEnabled = false
      BswMFrSMEnabled = false
      BswMGenericRequestEnabled = true
      BswMJ1939DcmEnabled = false
      BswMJ1939NmEnabled = false
      BswMLinSMEnabled = false
      BswMLinTPEnabled = false
      BswMNvMEnabled = true
      BswMRbDebugEnable = false
      BswMRbIntrptQueueMaxSize = 5
      BswMSchMEnabled = true
      BswMSdEnabled = false
      BswMVersionInfoApi = false
      BswMNmEnabled = false
      BswMRbMaxNumOfRules = 255
      BswMEthIfEnabled = 0
      BswMRbComEnabled = true
      BswMMainFunctionPeriod = 0.01
      BswMUserIncludeFiles:
        BswMUserIncludeFile = Mcu.h
        BswMUserIncludeFile = CanIf.h
        BswMUserIncludeFile = Can.h
        BswMUserIncludeFile = Rte_Main.h
        BswMUserIncludeFile = CanSM.h
        BswMUserIncludeFile = NvM.h
        BswMUserIncludeFile = CanTp.h
        BswMUserIncludeFile = Fim.h
        BswMUserIncludeFile = WdgM.h
        BswMUserIncludeFile = Fls.h
        BswMUserIncludeFile = Fee.h
        BswMUserIncludeFile = Nvm_MultiBlockCallback.h
        BswMUserIncludeFile = Xcp.h
        BswMUserIncludeFile = Dcm.h
        BswMUserIncludeFile = Det.h
