AUTOSAR XML (schema 00048)
package /RB/RBA/rba_FeeFs1x/ApplicationDataTypes
  4 x application record data type, all with category=STRUCTURE, sw-calibration-access=READ-ONLY:
    rba_FeeFs1x_PAMap_data_tst_APP
      application record element currWrPage_u32: category=VALUE, type=Mem_u32
    rba_FeeFs1x_Sector_data_tst_APP
      application record element maxSectCngCnt_u32: category=VALUE, type=Mem_u32
    rba_FeeFs1x_Sector_SectorListElement_tst_APP
      5 x application record element, all with category=VALUE:
        sectorCngCnt_u32: type=Mem_u32
        startMarkerContent_u32: type=Mem_u32
        sectorState_en: type=Mem_enum8
        sectorMarkerWriteIdx_u8: type=Mem_u8
        physSectIdx_u8: type=Mem_u8
    rba_FeeFs1x_Reorg_stm_tst_APP
      8 x application record element:
        pageNrOfSector0OverlapBlk_u32: category=VALUE, type=Mem_u32
        persIdOfSector0OverlapBlk_u16: category=VALUE, type=Mem_u16
        feeIndexOfSect0OverlapBlk_u16: category=VALUE, type=Mem_u16
        entry_b: category=BOOLEAN, type=Mem_bool
        sector0OverlapBlkIsKnownBlk_b: category=BOOLEAN, type=Mem_bool
        isSoftReorgOngoing_b: category=BOOLEAN, type=Mem_bool
        sectorOverflowAttemptCtr_u8: category=VALUE, type=Mem_u8
        state_en: category=VALUE, type=Mem_enum8
  application array data type ARRAY_WriteBfr_au8_APP: category=ARRAY, sw-calibration-access=READ-ONLY
    element ARRAY_WriteBfr_au8_APP_El: category=VALUE, type=Mem_u8, max-number-of-elements=8
  application array data type ARRAY_rba_FeeFs1x_Sector_sectorInfo_ast_APP: category=ARRAY, sw-calibration-access=READ-ONLY
    element ARRAY_rba_FeeFs1x_Sector_sectorInfo_ast_APP_El: category=VALUE, type=rba_FeeFs1x_Sector_SectorListElement_tst_APP, max-number-of-elements=2
  application record data type rba_FeeFs1x_Sector_erase_tst_APP: category=STRUCTURE, sw-calibration-access=READ-ONLY
    7 x application record element:
      eraseStartAddr_u32: category=VALUE, type=Mem_u32
      eraseLength_u32: category=VALUE, type=Mem_u32
      WriteBfr_au8_ast: category=VALUE, type=ARRAY_WriteBfr_au8_APP
      state_en: category=VALUE, type=Mem_enum8
      logSectIdx_u8: category=VALUE, type=Mem_u8
      entry_b: category=BOOLEAN, type=Mem_bool
      isReerasing_b: category=BOOLEAN, type=Mem_bool
package /RB/RBA/rba_FeeFs1x/ImplementationDataTypes
  7 x impl type:
    rba_FeeFs1x_PAMap_data_tst_RTE: category=STRUCTURE
      element currWrPage_u32: implementation-data-type=uint32
    rba_FeeFs1x_Sector_data_tst_RTE: category=STRUCTURE
      element maxSectCngCnt_u32: implementation-data-type=uint32
    rba_FeeFs1x_Sector_SectorListElement_tst_RTE: category=STRUCTURE
      5 x element, all with category=TYPE_REFERENCE:
        sectorCngCnt_u32: implementation-data-type=uint32
        startMarkerContent_u32: implementation-data-type=uint32
        sectorState_en: implementation-data-type=Mem_enum8
        sectorMarkerWriteIdx_u8: implementation-data-type=uint8
        physSectIdx_u8: implementation-data-type=uint8
    rba_FeeFs1x_Reorg_stm_tst_RTE: category=STRUCTURE
      8 x element, all with category=TYPE_REFERENCE:
        pageNrOfSector0OverlapBlk_u32: implementation-data-type=uint32
        persIdOfSector0OverlapBlk_u16: implementation-data-type=uint16
        feeIndexOfSect0OverlapBlk_u16: implementation-data-type=uint16
        entry_b: implementation-data-type=boolean
        sector0OverlapBlkIsKnownBlk_b: implementation-data-type=boolean
        isSoftReorgOngoing_b: implementation-data-type=boolean
        sectorOverflowAttemptCtr_u8: implementation-data-type=uint8
        state_en: implementation-data-type=Mem_enum8
    ARRAY_WriteBfr_au8_RTE: category=ARRAY
      element IMPL_WriteBfr_au8: array-size=8, array-size-semantics=FIXED-SIZE, implementation-data-type=uint8
    ARRAY_rba_FeeFs1x_Sector_sectorInfo_ast_RTE: category=ARRAY
      element IMPL_rba_FeeFs1x_Sector_sectorInfo_ast: array-size=2, array-size-semantics=FIXED-SIZE, implementation-data-type=rba_FeeFs1x_Sector_SectorListElement_tst_RTE
    rba_FeeFs1x_Sector_erase_tst_RTE: category=STRUCTURE
      7 x element, all with category=TYPE_REFERENCE:
        eraseStartAddr_u32: implementation-data-type=uint32
        eraseLength_u32: implementation-data-type=uint32
        WriteBfr_au8: implementation-data-type=ARRAY_WriteBfr_au8_RTE
        state_en: implementation-data-type=Mem_enum8
        logSectIdx_u8: implementation-data-type=uint8
        entry_b: implementation-data-type=boolean
        isReerasing_b: implementation-data-type=boolean
package /RB/RBA/rba_FeeFs1x/DataTypeMappingSets
  data type mapping set DataTypeMappingSet
    data-type-maps:
      application-data-type=rba_FeeFs1x_PAMap_data_tst_APP, implementation-data-type=rba_FeeFs1x_PAMap_data_tst_RTE
      application-data-type=rba_FeeFs1x_Sector_data_tst_APP, implementation-data-type=rba_FeeFs1x_Sector_data_tst_RTE
      application-data-type=rba_FeeFs1x_Sector_SectorListElement_tst_APP, implementation-data-type=rba_FeeFs1x_Sector_SectorListElement_tst_RTE
      application-data-type=rba_FeeFs1x_Reorg_stm_tst_APP, implementation-data-type=rba_FeeFs1x_Reorg_stm_tst_RTE
      application-data-type=ARRAY_WriteBfr_au8_APP, implementation-data-type=ARRAY_WriteBfr_au8_RTE
      application-data-type=ARRAY_rba_FeeFs1x_Sector_sectorInfo_ast_APP, implementation-data-type=ARRAY_rba_FeeFs1x_Sector_sectorInfo_ast_RTE
      application-data-type=rba_FeeFs1x_Sector_erase_tst_APP, implementation-data-type=rba_FeeFs1x_Sector_erase_tst_RTE
package /RB/RBA/rba_FeeFs1x/BswModuleDescriptions
  bsw module description rba_FeeFs1x: category=BSW_MODULE  # Flash Eeprom Emulation Fs1x
    bsw internal behavior BswInternalBehavior: data-type-mapping=DataTypeMappingSet
package /RB/RBA/rba_FeeFs1x/BswImplementations
  bsw implementation rba_FeeFs1x: programming-language=C, sw-version=22.0.1, vendor-id=6, ar-release-version=4.5.0, behavior=BswInternalBehavior
    code-descriptors:
      code CodeDescriptor: artifact-descriptors=autosar-engineering-object={short-label=ArEngObj, category=SWSRC}
