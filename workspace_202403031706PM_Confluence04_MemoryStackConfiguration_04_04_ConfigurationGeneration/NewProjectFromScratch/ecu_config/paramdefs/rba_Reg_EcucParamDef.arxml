AUTOSAR XML (schema 4-2-2)
package /RB/RBA/rba_Reg/EcucModuleDefs
  module definition rba_Reg [0..1]: category=VENDOR_SPECIFIC_MODULE_DEFINITION, variants pre-compile  # MCAL Register header | Module provides headers
    container rba_Reg_Module [1..*]: multiplicity set at pre-compile  # Module Container | Base Address collection of modules for particular machine type
      string rba_Reg_Module_BaseAddr: origin=RB:0.1.0:2012-12-12, set at pre-compile, default-value=false  # Base Address of the Module | Base Address of module
