AUTOSAR XML (schema 00051)
package /System
  composition sw component type TopLevelComposition
    7 x component:
      CPT_MySWC_ApplicationECU: type=MySWC
      CPT_MySWC_TestECU: type=MySWC
      CPT_EcuM: type=EcuM
      CPT_ComM: type=ComM
      CPT_Det: type=Det
      CPT_BswM: type=BswM
      CPT_rba_DiagLib: type=rba_DiagLib
    connect CPT_MySWC_ApplicationECU.PPortPrototype_0 -> CPT_MySWC_TestECU.RPortPrototype_0
    connect CPT_MySWC_TestECU.PPortPrototype_0 -> CPT_MySWC_ApplicationECU.RPortPrototype_0
