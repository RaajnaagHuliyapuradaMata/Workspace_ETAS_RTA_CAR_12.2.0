AUTOSAR XML (schema 4-2-2)
package /AUTOSAR_Det/BswModuleDescriptions
  bsw module description Det: category=BSW_MODULE, module-id=15  # Default Error Tracer
    bsw internal behavior BswInternalBehavior
package /AUTOSAR_Det/BswImplementations
  bsw implementation Det: programming-language=C, sw-version=5.0.0, vendor-id=6, ar-release-version=4.5.0, behavior=BswInternalBehavior
    code-descriptors:
      code CodeDescriptor: artifact-descriptors=autosar-engineering-object={short-label=ArEngObject, category=SWSRC}
    resource consumption Det_ResourceConsumption
      4 x memory section, all with prefix=DET:
        DET_VAR_CLEARED_UNSPECIFIED: sw-addrmethod=VAR_CLEARED, symbol=VAR_CLEARED_UNSPECIFIED
        DET_VAR_INIT_UNSPECIFIED: sw-addrmethod=VAR_INIT, symbol=VAR_INIT_UNSPECIFIED
        DET_CONST_UNSPECIFIED: sw-addrmethod=CONST, symbol=CONST_UNSPECIFIED
        DET_CODE: sw-addrmethod=CODE, symbol=CODE
      section name prefix DET
