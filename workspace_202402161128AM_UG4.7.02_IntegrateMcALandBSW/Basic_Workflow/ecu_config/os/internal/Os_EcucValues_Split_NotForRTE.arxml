AUTOSAR XML (schema 00051)
package /OS
  module config Os
    VECU_SystemClock_ISR (OsIsr): OsIsrCategory=CATEGORY_2, OsIsrAddress=Interrupt_7, OsIsrPriority=IPL_1, OsIsrResourceRef=RTE_RESOURCE
