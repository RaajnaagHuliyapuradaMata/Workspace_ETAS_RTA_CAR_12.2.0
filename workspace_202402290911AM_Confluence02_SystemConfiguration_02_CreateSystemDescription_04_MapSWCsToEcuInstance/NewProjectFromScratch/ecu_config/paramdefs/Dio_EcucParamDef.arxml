AUTOSAR XML (schema 00048)
package /AUTOSAR_Dio/EcucModuleDefs
  module definition Dio [0..1]: category=VENDOR_SPECIFIC_MODULE_DEFINITION, post-build-variant-support=true, refined-module-def=Dio, variants pre-compile  # MCAL Digital I/O | Configuration of the MCAL module for digital inputs and outputs.
    container DioConfig  # Configuration data set | Defines one data set of post-build configuration. Which of these data sets is actually active is controlled by EcuM. Data sets can only be switched at initialization time.
      container DioPort [1..*]: multiplicity set at pre-compile, post-build-variant-multiplicity=true  # Port | Configuration of a single digital input/output port, consisting of channels and possible channel groups. This name needs to have the following format IFX: Port_<two digits with leading zero 00..99> JDP: Port_<one capital character A..Z>
        string DioRbHwPort: origin=RB:0.1.0:2011-05-09, post-build-variant-value=true, set at pre-compile  # Hardware Port | Hardware identifier of the Dio port. IFX: Number without leading zero JDP: one capital letter
        container DioChannel [0..*]: multiplicity set at pre-compile, post-build-variant-multiplicity=true  # Channel | Configuration of an individual Dio channel. The symbolic name for API calls will be: DioChannel = Abc Symbolic Name will be: DioConf_DioChannel_Abc
          string DioRbCustSpecName [0..1]: multiplicity set at pre-compile, origin=RB:0.1.0:2013-03-18, post-build-variant-multiplicity=true, post-build-variant-value=true, set at pre-compile  # Customer-specific name | Customer-specific name of this signal. If present, this name is visible in the report.
          integer DioRbHwPin: origin=RB:0.1.0:2011-05-09, post-build-variant-value=true, set at pre-compile  # Hardware Pin | Numeric identifier of the Dio pin.
          string DioRbPortName [0..1]: multiplicity set at pre-compile, origin=RB:0.1.0:2013-07-15, post-build-variant-multiplicity=true, post-build-variant-value=true, set at pre-compile  # Port Name | The shortname of this tag can be used for the Dio_ReadPort API. The #define which is generated is DioConf_DioRbPortName_<Shortname>. Only configure this tag if Dio_ReadPort API is used. In all other cases this will lead to an increase of resources.
          function name DioRbVirtFunc [0..1]: multiplicity set at pre-compile, origin=RB, post-build-variant-multiplicity=true, post-build-variant-value=true, set at pre-compile  # Virtualization function | Virtualization function. This tag is only evaluated if the paramdef of the module rba_VecuRouter is present in the software build. If this tag is configured with a function name the configured function is called everytime the DioChannels API are called. If it is not configured the default function rba_VecuRouter_Cfg_Dio will be called instead.
    container DioGeneral  # General settings | Configuration of general aspects of the Dio module.
      boolean DioDevErrorDetect: set at pre-compile  # Development error detection | Enables/disables the detection and notification of development errors. If this parameter is enabled, then extended error checking is performed during runtime; any errors detected by these checks are reported to the Dem module. This feature should be switched off in series software.
      boolean DioRbMedc17LegacyHeader [0..1]: multiplicity set at pre-compile, origin=RB:0.1.0:2011-05-09, set at pre-compile, default-value=false  # Include MEDC17 legacy header | Setting this define to TRUE includes the HAL layer rba_IoSigDio.h header in dio.h. This makes it possible to acccess supported legacy interfaces provided by IoSigDio which were included via dio.h in the past.
