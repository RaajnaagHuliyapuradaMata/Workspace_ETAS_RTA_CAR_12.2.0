AUTOSAR XML (schema 00051)
package /ETAS_Project/EcucModuleConfigurationValuess
  ecuc value collection EcucValueCollection_0: ecu-extract=EXTR_ApplicationECU, ecuc-values=[Rte, Os, rba_BswSrv, Com, CanIf, Can, PduR, CanSM, ComM, EcuC, Mcu, Compiler_0, Platform_0, Bfx_0, Det_0, EcuM, BswM, rba_ArxmlGen]
