AUTOSAR XML (schema 00048)
package /AUTOSAR_Cdd/EcucModuleDefs
  module definition Cdd [0..*]: category=VENDOR_SPECIFIC_MODULE_DEFINITION, refined-module-def=Cdd, variants pre-compile  # The CDD module describes the minimal requirements that are necessary for the configuration of a CDD with respect to the surrounding standardized BSW modules.
    container CddComStackContribution [0..1]: multiplicity set at pre-compile  # Contribution of COM Stack modules.
      container CddComIfUpperLayerContribution [0..1]: multiplicity set at pre-compile  # Parameters that are necessary for the configuration of a Complex Driver that serves as the UpperLayer of the Com Interface module.
        container CddComIfUpperLayerRxPdu [0..*]: multiplicity set at pre-compile  # This container specifies Rx PDUs that are exchanged between the CDD and the standardized BSW module.
          integer CddComIfHandleId [0..1]: 0..65535, multiplicity set at pre-compile, set at pre-compile, symbolic-name-value=true, with-auto=true  # ECU wide unique, symbolic handle for the Pdu.
          reference CddComIfPduRef: multiplicity set at pre-compile, set at pre-compile, destination=Pdu  # Reference to the "global" Pdu structure to allow harmonization of handle IDs in the COM-Stack.
        container CddComIfUpperLayerTxPdu [0..*]: multiplicity set at pre-compile  # This container specifies Tx PDUs that are exchanged between the CDD and the standardized BSW module.
          integer CddComIfHandleId [0..1]: 0..65535, multiplicity set at pre-compile, set at pre-compile, symbolic-name-value=true, with-auto=true  # ECU wide unique, symbolic handle for the Pdu.
          reference CddComIfPduRef: multiplicity set at pre-compile, set at pre-compile, destination=Pdu  # Reference to the "global" Pdu structure to allow harmonization of handle IDs in the COM-Stack.
      container CddComMLowerLayerContribution [0..1]: multiplicity set at pre-compile  # Parameters that are necessary for the configuration of a Complex Driver that serves as the LowerLayer of the Communication Manager module.
        container CddComMLowerLayerChannel [1..*]: multiplicity set at pre-compile  # This container contains the network specific parameters.
          reference CddComMLowerLayerChannelRef: multiplicity set at pre-compile, set at pre-compile, requires-symbolic-name-value=true, destination=ComMChannel  # Unique handle to identify one certain network. Reference to one of the network handles configured for the ComM.
      container CddGenericNmLowerLayerContribution [0..1]: multiplicity set at pre-compile  # Parameters that are necessary for the configuration of a Complex Driver that serves as the LowerLayer of the Generic NM module.
        container CddGenericNmLowerLayerChannel [1..*]: multiplicity set at pre-compile  # NM Channel specific configuration parameters.
          reference CddGenericNmComMNetworkHandleRef: multiplicity set at pre-compile, set at pre-compile, requires-symbolic-name-value=true, destination=ComMChannel  # This reference points to the unique channel defined by the ComMChannel and provides access to the unique channel index value in ComMChannelId.
      container CddJ1939RmContribution [0..0]: multiplicity set at pre-compile  # Contribution of J1939Rm module
        boolean CddJ1939RmAckIndication [0..0]: multiplicity set at pre-compile, set at pre-compile  # Defines whether the <User>_AckIndication callback function is implemented.
        boolean CddJ1939RmRequestIndication [0..0]: multiplicity set at pre-compile, set at pre-compile  # Defines whether the <User>_RequestIndication callback function is implemented.
        boolean CddJ1939RmRequestTimeoutIndication [0..0]: multiplicity set at pre-compile, set at pre-compile  # Defines whether the <User>_RequestTimeoutIndication callback function is implemented.
      container CddPduRLowerLayerContribution [0..1]: multiplicity set at pre-compile  # Parameters that are necessary for the configuration of a Complex Driver that serves as the LowerLayer of the Pdu Router module.
        container CddPduRLowerLayerRxPdu [0..*]: multiplicity set at pre-compile  # This container specifies Rx PDUs that are exchanged between the CDD and the standardized BSW module.
          enumeration CddPduRApiType [0..1]: {IF, TP}, multiplicity set at pre-compile, set at pre-compile  # This parameter configures the type of the CDD interface (IF/TP)
          integer CddPduRLowerLayerHandleId [0..1]: 0..65535, multiplicity set at pre-compile, set at pre-compile, symbolic-name-value=true, with-auto=true  # ECU wide unique, symbolic handle for the Pdu.
          reference CddPduRLowerLayerPduRef: multiplicity set at pre-compile, set at pre-compile, destination=Pdu  # Reference to the "global" Pdu structure to allow harmonization of handle IDs in the COM-Stack.
        container CddPduRLowerLayerTxPdu [0..*]: multiplicity set at pre-compile  # This container specifies Tx PDUs that are exchanged between the CDD and the standardized BSW module.
          enumeration CddPduRApiType [0..1]: {IF, TP}, multiplicity set at pre-compile, set at pre-compile  # This parameter configures the type of the CDD interface (IF/TP)
          integer CddPduRLowerLayerHandleId [0..1]: 0..65535, multiplicity set at pre-compile, set at pre-compile, symbolic-name-value=true, with-auto=true  # ECU wide unique, symbolic handle for the Pdu.
          reference CddPduRLowerLayerPduRef: multiplicity set at pre-compile, set at pre-compile, destination=Pdu  # Reference to the "global" Pdu structure to allow harmonization of handle IDs in the COM-Stack.
      container CddPduRUpperLayerContribution [0..1]: multiplicity set at pre-compile  # Parameters that are necessary for the configuration of a Complex Driver that serves as the UpperLayer of the Pdu Router module.
        container CddPduRUpperLayerRxPdu [0..*]: multiplicity set at pre-compile  # This container specifies Rx PDUs that are exchanged between the CDD and the standardized BSW module.
          enumeration CddPduRApiType [0..1]: {IF, TP}, multiplicity set at pre-compile, set at pre-compile  # This parameter configures the type of the CDD interface (IF/TP)
          integer CddPduRUpperLayerHandleId [0..1]: 0..65535, multiplicity set at pre-compile, set at pre-compile, symbolic-name-value=true, with-auto=true  # ECU wide unique, symbolic handle for the Pdu.
          reference CddPduRUpperLayerPduRef: multiplicity set at pre-compile, set at pre-compile, destination=Pdu  # Reference to the "global" Pdu structure to allow harmonization of handle IDs in the COM-Stack.
        container CddPduRUpperLayerTxPdu [0..*]: multiplicity set at pre-compile  # This container specifies Tx PDUs that are exchanged between the CDD and the standardized BSW module.
          enumeration CddPduRApiType [0..1]: {IF, TP}, multiplicity set at pre-compile, set at pre-compile  # This parameter configures the type of the CDD interface (IF/TP)
          integer CddPduRUpperLayerHandleId [0..1]: 0..65535, multiplicity set at pre-compile, set at pre-compile, symbolic-name-value=true, with-auto=true  # ECU wide unique, symbolic handle for the Pdu.
          reference CddPduRUpperLayerPduRef: multiplicity set at pre-compile, set at pre-compile, destination=Pdu  # Reference to the "global" Pdu structure to allow harmonization of handle IDs in the COM-Stack.
      container CddSoAdUpperLayerContribution [0..1]: multiplicity set at pre-compile  # Parameters that are necessary for the configuration of a Complex Driver that serves as the UpperLayer of the SoAd module.
        container CddSoAdUpperLayerRxPdu [0..*]: multiplicity set at pre-compile  # This container specifies Rx PDUs that are exchanged between the CDD and the standardized BSW module.
          enumeration CddPduRApiType [0..1]: {IF, TP}, multiplicity set at pre-compile, set at pre-compile  # This parameter configures the type of the CDD interface (IF/TP)
          integer CddSoAdUpperLayerHandleId: 0..65535, multiplicity set at pre-compile, set at pre-compile, symbolic-name-value=true  # ECU wide unique, symbolic handle for the Pdu.
          reference CddSoAdUpperLayerPduRef: multiplicity set at pre-compile, set at pre-compile, destination=Pdu  # Reference to the "global" Pdu structure to allow harmonization of handle IDs in the COM-Stack.
        container CddSoAdUpperLayerTxPdu [0..*]: multiplicity set at pre-compile  # This container specifies Tx PDUs that are exchanged between the CDD and the standardized BSW module.
          enumeration CddPduRApiType [0..1]: {IF, TP}, multiplicity set at pre-compile, set at pre-compile  # This parameter configures the type of the CDD interface (IF/TP)
          integer CddSoAdUpperLayerHandleId [0..1]: 0..65535, multiplicity set at pre-compile, set at pre-compile, symbolic-name-value=true  # ECU wide unique, symbolic handle for the Pdu.
          reference CddSoAdUpperLayerPduRef: multiplicity set at pre-compile, set at pre-compile, destination=Pdu  # Reference to the "global" Pdu structure to allow harmonization of handle IDs in the COM-Stack.
    container CddEcucPartitionInteraction [0..0]: multiplicity set at pre-compile  # This optional container holds the partition interaction configuration.
      function name CddPartitionStoppedFunctionName [0..0]: multiplicity set at pre-compile, set at pre-compile  # Function name to be called when the partition which is triggering the Complex Driver is stopped.
      reference CddEcucPartitionRef: multiplicity set at pre-compile, set at pre-compile, destination=EcucPartition  # Reference to the "EcucPartition" which executes the software which triggers the CDD.
    container CddGeneral [0..0]: multiplicity set at pre-compile  # Contains the general configuration parameters of the module.
      integer CddInstanceId [0..0]: 0..255, set at pre-compile  # Specifies the InstanceId of this module instance. If only one instance is present it shall have the Id 0.
    container CddGlobalTimeContribution [0..0]: multiplicity set at pre-compile  # Contribution of Global Time modules.
      container CddGlobalTimeDomain [0..0]: multiplicity set at pre-compile  # This represents the existence of a CDD global time domain. The CddGlobalTimeContribution can administrate several global time domains at the same time that in itself form a hierarchy of domains and sub-domains.
        integer CddGlobalTimeDomainId [0..0]: 0..31, multiplicity set at pre-compile, set at pre-compile  # The global time domain ID.
        reference CddSynSynchronizedTimeBaseRef [0..0]: multiplicity set at pre-compile, set at pre-compile, requires-symbolic-name-value=true, destination=StbMSynchronizedTimeBase  # Mandatory reference to the required synchronized time-base.
        container CddGlobalTimeMaster [0..0]: multiplicity set at pre-compile  # Configuration of the global time master. Each global time domain is required to have exactly one global time master. This master may or may not exist on the configured ECU.
          float CddGlobalTimeTxPeriod [0..0]: 0..INF, multiplicity set at pre-compile, set at pre-compile  # This represents configuration of the TX period. Unit: seconds
          container CddGlobalTimeMasterPdu [0..0]: multiplicity set at pre-compile  # This container encloses the configuration of the PDU that is supposed to contain the global time information. | Please note that the configuration of CddGlobalTimeMasterPdu is optional and shall only be used for Complex Drivers that are using Pdus for carrying timeSync information.
            reference CddGlobalTimeMasterPduRef [0..0]: multiplicity set at pre-compile, set at pre-compile, destination=CddComIfUpperLayerTxPdu  # This represents the reference to the Pdu taken to transmit the global time information. The global time master of a global time domain is the sender of this Pdu.
        container CddGlobalTimeSlave [0..0]: multiplicity set at pre-compile  # Configuration of a global time slave. Each global time domain is required to have at least one time slave. The configured ECU may or may not represent a time slave.
          container CddGlobalTimeSlavePdu [0..0]: multiplicity set at pre-compile  # This container encloses the configuration of the PDU that is supposed to contain the global time information. | Please note that the configuration of CddGlobalTimeSlavePdu is optional and shall only be used for Complex Drivers that are using Pdus for carrying timeSync information.
            reference CddGlobalTimeSlavePduRef [0..0]: multiplicity set at pre-compile, set at pre-compile, destination=CddComIfUpperLayerRxPdu  # This represents the reference to the Pdu taken to transmit the global time information. All the time slaves are supposed to receive the Pdu.
