AUTOSAR XML (schema 00051)
package /System_EcuExtract
  system EXTR_ApplicationECU: category=ECU_EXTRACT, ecu-extract-version=1.0.0, pnc-vector-length=0, pnc-vector-offset=0, system-version=1.0.0
    system mapping SYSMPG_ApplicationECU
      data-mappings:
        data-element=CPT_ApplicationECU_FlatView.PPortPrototype_0.DE_MyDataElement, system-signal=ApplicationECU_To_TestECU_Data
        data-element=CPT_ApplicationECU_FlatView.RPortPrototype_0.DE_MyDataElement, system-signal=TestECU_To_ApplicationECU_Data
      sw-mappings:
        swc to ecu mapping SwcToEcuMapping_0: ecu-instance=ApplicationECU
          component:
            CPT_ApplicationECU_FlatView.CPT_MySWC_ApplicationECU
            CPT_ApplicationECU_FlatView.CPT_BswM
            CPT_ApplicationECU_FlatView.CPT_ComM
            CPT_ApplicationECU_FlatView.CPT_Det
            CPT_ApplicationECU_FlatView.CPT_EcuM
            CPT_ApplicationECU_FlatView.CPT_rba_DiagLib
    root-software-compositions:
      root sw composition prototype CPT_ApplicationECU_FlatView: flat-map=ApplicationECU_FlatMap, software-composition=ApplicationECU_FlatView
