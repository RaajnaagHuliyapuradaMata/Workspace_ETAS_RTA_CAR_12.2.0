AUTOSAR XML (schema 00048)
package /AUTOSAR_Det/EcucModuleDefs
  module definition Det [0..1]: category=VENDOR_SPECIFIC_MODULE_DEFINITION, refined-module-def=Det, variants pre-compile  # Det configuration includes the functions to be called at notification. On one side the application functions are specified and in general it can be decided whether Dlt shall be called at each call of Det. | side the application functions are specified and in general it can be decided whether Dlt shall be called at each call of Det.
    container DetConfigSet [0..1]  # Configuration set container for Det.
      container DetModule [0..*]  # This container describes a non BSW module that is using the Det via Service Interface.
        integer DetModuleId: 4096..65535, set at pre-compile, symbolic-name-value=true  # Unique identifier of the error reporting component. When reporting errors to the DET, a symbolic name derived from the moduleID has to be used to identify the reporter.
        container DetModuleInstance [1..*]: multiplicity set at pre-compile, post-build-variant-multiplicity=true  # Describes the Instance used for the according Service Port. | It shall be used to differentiate software component instances when multiple instantiation is used.
          integer DetInstanceId: 0..255, set at pre-compile, default-value=0  # Describes the InstanceId used for the according Service Port. | It shall be used to differentiate software component instances when multiple instantiation is used. Else it shall be set to 0.
    container DetGeneral  # Generic configuration parameters of the Det module.
      boolean DetForwardToDlt [0..1]: multiplicity set at pre-compile, set at pre-compile  # Only if the parameter is present and set to true, the Det requires the Dlt interface and forwards it's call to the function Dlt_DetForwardErrorTrace. In this case the optional interface to Dlt_Det is required.
      boolean DetVersionInfoApi: set at pre-compile, default-value=false  # Pre-processor switch to enable / disable the API to read out the modules version information. | true: Version info API enabled. false: Version info API disabled.
      container DetRbBuffer [0..1]  # Contains RB specific configuration parameters for the error entry buffer.
        boolean DetRbAtomicIncrementAvailable [0..1]: origin=RB:AR42.10.0.0:2021-04-18, set at pre-compile, default-value=false  # Parameter to indicate if Atomic Increment function is available in order to support multiple write operations. The parameter needs to be set to TRUE only if the Atomic Increment operation is available through rba_BswSrv. | TRUE: AtomicIncrement operation is supported by the hardware, the buffer entry uses lockfree mechanism. FALSE: AtomicIncrement operation is not suppoted by the hardware, the buffer entry uses lock mechanism.
        integer DetRbErrorBufferSize: 1..4294967296, origin=RB:AR42.1.0.0:2016-02-20  # Parameter to set the size of the error buffer. | If the buffer is enabled the min size is 1 and the max size is 4,294,967,296. Feasible range suggested is below 1000.
        boolean DetRbFilterDuplicateBufferEntries [0..1]: origin=RB:AR42.4.0.0:2018-02-20, set at pre-compile, default-value=false  # Parameter to filter duplicate error entires in Det buffer. | TRUE: Duplicate error entries in the buffer are filtered. FALSE: Duplicate error entries in the buffer are not filtered.
        boolean DetRbForwardErrorEntries [0..1]: origin=RB:AR47.1.0.0:2022-06-30, set at pre-compile, default-value=false  # Parameter to enable / disable the forwarding of the development error entry buffer i.e Det_ErrorEntryBuffer to rba_ArxmlGen . | True: DetRbForwardErrorEntries enabled. False: DetRbForwardErrorEntries disabled.
        boolean DetRbUseErrorBufferApi: origin=RB:AR42.1.0.0:2016-02-20, set at pre-compile  # Pre-processor switch to enable / disable the API for error buffer handling. | TRUE: Buffer handler APIs enabled. FALSE: Buffer handler APIs disabled.
    container DetNotification [0..1]  # Configuration of the notification functions.
      function name DetErrorHook [0..*]: multiplicity set at pre-compile, set at pre-compile  # Optional list of functions to be called by the Default Error Tracer in context of each call of Det_ReportError. | The type of these functions shall be identical the type of Det_ReportError itself: Std_ReturnType (*f)(uint16, uint8, uint8, uint8).
      function name DetReportRuntimeErrorCallout [0..*]: set at pre-compile  # This parameter defines the existence and the names of callout functions for the corresponding runtime error handler. | The type of these functions shall be identical the type of Det_ReportRuntimeError itself: Std_ReturnType (*f)(uint16, uint8, uint8, uint8)
      function name DetReportTransientFaultCallout [0..*]: set at pre-compile  # This parameter defines the existence and the names of callout functions for the corresponding transient fault handler. | The type of these functions shall be identical the type of Det_ReportTransientFault itself: Std_ReturnType (*f)(uint16, uint8, uint8, uint8)
