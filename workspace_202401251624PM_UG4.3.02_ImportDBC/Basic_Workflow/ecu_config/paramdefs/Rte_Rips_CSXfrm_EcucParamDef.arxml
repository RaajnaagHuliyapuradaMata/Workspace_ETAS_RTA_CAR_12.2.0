AUTOSAR XML (schema 00051)
package /AUTOSAR_Rte_Rips_CSXfrm/EcucModuleDefs
  module definition Rte_Rips_CSXfrm [0..1]: category=VENDOR_SPECIFIC_MODULE_DEFINITION, variants pre-compile  # Configuration of the RIPS module to support Inter-ECU C/S Communication with Transformers.
    container RteRipsPluginProps: destination-uri=RteRipsPlugin  # This container defines the identity of the Rte Implementation Plug-in and provides the RTE relevant parameters of the Rte Implementation Plug-in.
      boolean RtePluginSupportsIReadIWrite: default-value=false  # Denotes if or if not the plug-in supports the Rte_Rips_IRead/IWrite macros for primitive/complex data.
      enumeration RteRipsGlobalCopyInstantiationPolicy: {RTE_RIPS_INSTANTIATION_BY_PLUGIN, RTE_RIPS_INSTANTIATION_BY_RTE}, default-value=RTE_RIPS_INSTANTIATION_BY_RTE  # Globally enables or disables the support for Rte Implementation Plug-Ins (RIPS) Tags: atp.Status=draft
      boolean RtePluginSupportsInvokeReturnResult: origin=ETAS, default-value=false  # Denotes if or if not the plug-in supports the Rte_Rips_Invoke/ReturnResult APIs for (a)synchronous C/S Communication.
      boolean RtePluginSupportsAutonomousError: origin=ETAS, default-value=true  # Denotes if or if not the plug-in supports the Autonomous error response.
      boolean RtePluginSupportsTimoutHandling: origin=ETAS, default-value=false  # Denotes if or if not the plug-in supports the (a)synchronous C/S Data Transformation via LDCOM_TP.
      boolean RtePluginSupportsSyncCommWithoutTimeout: origin=ETAS, default-value=false  # Denotes if or if not the plug-in shall support synchronous C/S Communication without Timeout.
      boolean RtePluginSupportsLdComTP: origin=ETAS, default-value=false  # Denotes if or if not the plug-in supports the (a)synchronous C/S Data Transformation via LDCOM_TP.
      boolean RtePluginSupportsLdComIF: origin=ETAS, default-value=false  # Denotes if or if not the plug-in supports the (a)synchronous C/S Data Transformation via LDCOM_IF.
      boolean RtePluginNoNestLockSupportEnable: origin=ETAS, default-value=false  # Denotes if or if not the plug-in supports the Generation of NoNest Lock Functions.
      boolean RtePluginGenerateQueueFullErrorHook: origin=ETAS, default-value=false  # Denotes if or if not the plug-in supports the Generation of Callout function in Server Queue Full Error Scenario.
      enumeration RtePluginCallbackMemMapPolicy: {RTE_RIPS_SIGNAL_BASED_MEMMAP_ENABLED, RTE_RIPS_SIGNAL_BASED_MEMMAP_DISABLED}, origin=ETAS, default-value=RTE_RIPS_SIGNAL_BASED_MEMMAP_ENABLED  # Enable Generation of Callbacks based on ComSignals/LdComIPdus or SW-Cs
      enumeration RteRipsPluginCommunicationScope [0..1]: {RTE_RIPS_CROSS_SW_CLUSTER_COM, RTE_RIPS_LOCAL_SW_CLUSTER_COM}, set at pre-compile, default-value=RTE_RIPS_LOCAL_SW_CLUSTER_COM  # Defines the communication scope for which the Rte Implementation Plug-Ins (RIPS) serves. If this parameter is not set, the default behavior RTE_RIPS_LOCAL_SW_CLUSTER_COM applies.
      container RteRipsPluginCommunicationTypeSupport [0..1]: multiplicity set at pre-compile  # This container defines the different elements of communication graphs that the plugin is responsible for. Tags: atp.Status=draft
        enumeration RteRipsPluginCommunicationType [1..*]: scope=ECU, multiplicity set at pre-compile, set at pre-compile  # The type of the communication. Tags: atp.Status=draft
          INTER_ECU  # Tags: atp.Status=draft
          INTER_PARTITION  # Tags: atp.Status=draft
          INTRA_PARTITION  # Tags: atp.Status=draft
    container RteRipsPluginFillFlushRoutine [0..*]: destination-uri=RteRipsPluginFillFlushRoutine
      enumeration RteRipsModeDisablingHandling: {RTE_RIPS_CONSIDER_MODE_DISABLINGS, RTE_RIPS_IGNORE_MODE_DISABLINGS}  # This parameter configures whether mode disabling dependencies are considered for the invocation of Rte_Rips_FillFlushRoutines.
      enumeration RteRipsOsSchedulePoint [0..1]: {NONE, UNCONDITIONAL}  # Introduce a schedule point by explicitly calling Os Schedule service after the execution of the Rte_Rips_FillFlushRoutine.
      function name RteRipsPluginFillFlushRoutineSymbol: origin=ETAS  # C-Symbol of the Rte_Rips_FillFlushRoutine function.
    container RteRipsInvocationHandler [0..*]: destination-uri=RteRipsInvocationHandler
      container RteRipsInvocationHandlerFnc [0..*]  # This container describes an invocation handler function implemented by an RTE Implementation Plug-In to handle the invocation of server runnables.
        function name RteRipsInvocationHandlerFncSymbol  # C-Symbol of the Rte_Rips_InvocationHandler function.
        boolean RteRipsInvocationHandlerSupportsMultipleServerActivation [0..1]: origin=ETAS, default-value=false  # Denotes if or if not the InvocationHadler supports the multiple activation of server runnable.
        float RteRipsInvocationHandlerServerResponseTimeout [0..1]: 0..3600, origin=ETAS, set at pre-compile  # Specifies the maximum time of waiting for results from Server Runnable. Unit is seconds.
